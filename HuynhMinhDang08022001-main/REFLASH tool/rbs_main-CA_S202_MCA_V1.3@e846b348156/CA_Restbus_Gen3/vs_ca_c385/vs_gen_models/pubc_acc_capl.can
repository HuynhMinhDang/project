
/*@@var:*/
variables
{
    //Used interact between raw and the physical environment variables
    byte chgEv_ACC_31A_ACC_IACCHWAEnable = 0;
    byte chgEv_ACC_31A_ACC_RLaneMarkerType = 0;
    byte chgEv_ACC_31A_ACC_IACCHWAMode = 0;
    byte chgEv_ACC_31A_ACC_Voiceinfo = 0;
    byte chgEv_ACC_31A_ACC_LASModeSelectionStatus = 0;
    byte chgEv_ACC_31A_ACC_IACCHWATextInfoForDriver = 0;
    byte chgEv_ACC_31A_ACC_LLaneMarkerType = 0;
    byte chgEv_ACC_31A_ACC_LatTakeoverReq = 0;
    byte chgEv_ACC_31A_ACC_DriverHandsOffStatus = 0;
    byte chgEv_ACC_31A_ACC_HostLaneLeftStatus = 0;
    byte chgEv_ACC_31A_ACC_LASWarningModeSelectionSts = 0;
    byte chgEv_ACC_31A_ACC_HostLaneRightStatus = 0;
    byte chgEv_ACC_NM_ACC_NMSourceAddress = 0;
    byte chgEv_ACC_312_ACC_RLaneDistanceFusion = 0;
    byte chgEv_ACC_312_ACC_ACCTargetID = 0;
    byte chgEv_ACC_312_ACC_LLaneDistanceFusion = 0;
    byte chgEv_ACC_1BA_ADS_Authernticator_1BA = 0;
    byte chgEv_ACC_1BA_ADS_Reqmode = 0;
    byte chgEv_ACC_1BA_ADS_MesssageCounter_1BA = 0;
    byte chgEv_ACC_1BA_ACC_LatAngReqActive = 0;
    byte chgEv_ACC_1BA_ACC_MotorTorqueMaxLimitRequest = 0;
    byte chgEv_ACC_1BA_ACC_MotorTorqueMinLimitRequest = 0;
    byte chgEv_ACC_1BA_ADS_ErrorStatus = 0;
    byte chgEv_ACC_1BA_ACC_LatAngReq = 0;
    byte chgEv_ACC_1BA_ADS_ResetFlag_1BA = 0;
    byte chgEv_ACC_307_ACC_ACCEPBrequest = 0;
    byte chgEv_ACC_307_ACC_TimeGapSet = 0;
    byte chgEv_ACC_307_ACC_HostTargetDetection = 0;
    byte chgEv_ACC_307_ACC_DistanceLevel = 0;
    byte chgEv_ACC_307_ACC_TextInfoForDriver = 0;
    byte chgEv_ACC_307_ACC_SaftyBeltVibrationReq = 0;
    byte chgEv_ACC_307_ACC_ACCTargetLngRange = 0;
    byte chgEv_ACC_307_ACC_SaftyBelt_Tightened = 0;
    byte chgEv_ACC_307_ACC_ObjValid = 0;
    byte chgEv_ACC_307_ACC_LngTakeOverReq = 0;
    byte chgEv_ACC_307_ACC_SetSpeed = 0;
    byte chgEv_ACC_307_ACC_ACCTargetType = 0;
    byte chgEv_ACC_378_ACC_LaneEquationC1 = 0;
    byte chgEv_ACC_378_ACC_LaneQuality = 0;
    byte chgEv_ACC_378_ACC_LaneEquationC3 = 0;
    byte chgEv_ACC_378_ACC_LaneEquationStatus = 0;
    byte chgEv_ACC_378_ACC_LaneEquationC2 = 0;
    byte chgEv_ACC_244_ACC_CDDActive = 0;
    byte chgEv_ACC_244_ACC_Driveoff_Request = 0;
    byte chgEv_ACC_244_ACC_AccTrqReqActive = 0;
    byte chgEv_ACC_244_ACC_AWBlevel = 0;
    byte chgEv_ACC_244_ACC_DecToStop = 0;
    byte chgEv_ACC_244_ACC_ABAlevel = 0;
    byte chgEv_ACC_244_ACC_ABAActive = 0;
    byte chgEv_ACC_244_ACC_PrefillActive = 0;
    byte chgEv_ACC_244_ACC_AEBCtrlType = 0;
    byte chgEv_ACC_244_ACC_FCWActive = 0;
    byte chgEv_ACC_244_ACC_FCWLatentWarning = 0;
    byte chgEv_ACC_244_ACC_LDWVibrationWarningReq = 0;
    byte chgEv_ACC_244_ADS_MesssageCounter_244 = 0;
    byte chgEv_ACC_244_ACC_AEBTargetDeceleration = 0;
    byte chgEv_ACC_244_ACC_AEBVehilceHoldReq = 0;
    byte chgEv_ACC_244_ACC_AccTrqReq = 0;
    byte chgEv_ACC_244_ADS_ResetFlag_244 = 0;
    byte chgEv_ACC_244_ACC_LDWStatus = 0;
    byte chgEv_ACC_244_ACC_ACCTargetAcceleration = 0;
    byte chgEv_ACC_244_ACC_EmergencyDataRrdReq = 0;
    byte chgEv_ACC_244_ADS_Authernticator_244 = 0;
    byte chgEv_ACC_244_ACC_AEBActive = 0;
    byte chgEv_ACC_244_ACC_LKAStatus = 0;
    byte chgEv_ACC_244_ACC_FCWPreWarning = 0;
    byte chgEv_ACC_244_ACC_AWBActive = 0;
    byte chgEv_ACC_244_ACC_ACCMode = 0;
    
    message ACC_31A        Msg_ACC_31A;
    msTimer Tm_ACC_31A;
    int Cycle_ACC_31A = 100;
    message ACC_NM        Msg_ACC_NM;
    msTimer Tm_ACC_NM;
    int Cycle_ACC_NM = 1000;
    message ACC_312        Msg_ACC_312;
    msTimer Tm_ACC_312;
    int Cycle_ACC_312 = 100;
    message ACC_382        Msg_ACC_382;
    msTimer Tm_ACC_382;
    int Cycle_ACC_382 = 100;
    message ACC_1BA        Msg_ACC_1BA;
    msTimer Tm_ACC_1BA;
    int Cycle_ACC_1BA = 10;
    message ACC_307        Msg_ACC_307;
    msTimer Tm_ACC_307;
    int Cycle_ACC_307 = 100;
    message ACC_378        Msg_ACC_378;
    msTimer Tm_ACC_378;
    int Cycle_ACC_378 = 100;
    message ACC_244        Msg_ACC_244;
    msTimer Tm_ACC_244;
    int Cycle_ACC_244 = 20;
    
    int ACC_31A_ACC_CRCCheck_30A_counter =0;
    int ACC_31A_ACC_CRCCheck_30A_wrongvalctr =0;
    int ACC_31A_ACC_CRCCheck_31A_counter =0;
    int ACC_31A_ACC_CRCCheck_31A_wrongvalctr =0;
    int ACC_31A_ACC_CRCCheck_36D_counter =0;
    int ACC_31A_ACC_CRCCheck_36D_wrongvalctr =0;
    int ACC_31A_ACC_RollingCounter_30A_counter =0;
    int ACC_31A_ACC_RollingCounter_30A_wrongvalctr =0;
    int ACC_31A_ACC_RollingCounter_31A_counter =0;
    int ACC_31A_ACC_RollingCounter_31A_wrongvalctr =0;
    int ACC_31A_ACC_RollingCounter_36D_counter =0;
    int ACC_31A_ACC_RollingCounter_36D_wrongvalctr =0;
    int ACC_312_ACC_CRCCheck_3E4_counter =0;
    int ACC_312_ACC_CRCCheck_3E4_wrongvalctr =0;
    int ACC_312_ACC_RollingCounter_3E4_counter =0;
    int ACC_312_ACC_RollingCounter_3E4_wrongvalctr =0;
    int ACC_312_ADS_CRCCheck_312_counter =0;
    int ACC_312_ADS_CRCCheck_312_wrongvalctr =0;
    int ACC_312_ADS_RollingCounter_312_counter =0;
    int ACC_312_ADS_RollingCounter_312_wrongvalctr =0;
    int ACC_382_ACC_CRCCheck_382_counter =0;
    int ACC_382_ACC_CRCCheck_382_wrongvalctr =0;
    int ACC_382_ACC_CRCCheck_3E6_counter =0;
    int ACC_382_ACC_CRCCheck_3E6_wrongvalctr =0;
    int ACC_382_ACC_RollingCounter_382_counter =0;
    int ACC_382_ACC_RollingCounter_382_wrongvalctr =0;
    int ACC_382_ACC_RollingCounter_3E6_counter =0;
    int ACC_382_ACC_RollingCounter_3E6_wrongvalctr =0;
    int ACC_1BA_ACC_CRCCheck_1C0_counter =0;
    int ACC_1BA_ACC_CRCCheck_1C0_wrongvalctr =0;
    int ACC_1BA_ACC_RollingCounter_1C0_counter =0;
    int ACC_1BA_ACC_RollingCounter_1C0_wrongvalctr =0;
    int ACC_307_ACC_CRCCheck_307_counter =0;
    int ACC_307_ACC_CRCCheck_307_wrongvalctr =0;
    int ACC_307_ACC_CRCCheck_322_counter =0;
    int ACC_307_ACC_CRCCheck_322_wrongvalctr =0;
    int ACC_307_ACC_CRCCheck_344_counter =0;
    int ACC_307_ACC_CRCCheck_344_wrongvalctr =0;
    int ACC_307_ACC_CRCCheck_35E_counter =0;
    int ACC_307_ACC_CRCCheck_35E_wrongvalctr =0;
    int ACC_307_ACC_CRCCheck_35F_counter =0;
    int ACC_307_ACC_CRCCheck_35F_wrongvalctr =0;
    int ACC_307_ACC_RollingCounter_307_counter =0;
    int ACC_307_ACC_RollingCounter_307_wrongvalctr =0;
    int ACC_307_ACC_RollingCounter_322_counter =0;
    int ACC_307_ACC_RollingCounter_322_wrongvalctr =0;
    int ACC_307_ACC_RollingCounter_344_counter =0;
    int ACC_307_ACC_RollingCounter_344_wrongvalctr =0;
    int ACC_307_ACC_RollingCounter_35E_counter =0;
    int ACC_307_ACC_RollingCounter_35E_wrongvalctr =0;
    int ACC_307_ACC_RollingCounter_35F_counter =0;
    int ACC_307_ACC_RollingCounter_35F_wrongvalctr =0;
    int ACC_244_ACC_CRCCheck_24E_counter =0;
    int ACC_244_ACC_CRCCheck_24E_wrongvalctr =0;
    int ACC_244_ACC_CRCCheck_25E_counter =0;
    int ACC_244_ACC_CRCCheck_25E_wrongvalctr =0;
    int ACC_244_ACC_RollingCounter_24E_counter =0;
    int ACC_244_ACC_RollingCounter_24E_wrongvalctr =0;
    int ACC_244_ACC_RollingCounter_25E_counter =0;
    int ACC_244_ACC_RollingCounter_25E_wrongvalctr =0;
    
    //CRC Polynomial for MQB     
    byte cb_ChkSum_POLY_MQB =0x2F;
	// CANFD DLC
	byte Dbc_dlc;
	int i=0;
	char CAN_DLC[7]={9,10,11,12,13,14,15};
	char CANFD_DLC[7]={12,16,20,24,32,48,64};
    

    
        byte CRC_J1850_Table[256] = {
 /*0 - 7*/  0x00, 0x1D, 0x3A, 0x27, 0x74, 0x69, 0x4E, 0x53,
 /*8 - 15*/ 0xE8, 0xF5, 0xD2, 0xCF, 0x9C, 0x81, 0xA6, 0xBB,
 /*16 - 23*/ 0xCD, 0xD0, 0xF7, 0xEA, 0xB9, 0xA4, 0x83, 0x9E,
 /*24 - 31*/ 0x25, 0x38, 0x1F, 0x02, 0x51, 0x4C, 0x6B, 0x76,
 /*32 - 39*/ 0x87, 0x9A, 0xBD, 0xA0, 0xF3, 0xEE, 0xC9, 0xD4,
 /*40 - 47*/ 0x6F, 0x72, 0x55, 0x48, 0x1B, 0x06, 0x21, 0x3C,
 /*48 - 55*/ 0x4A, 0x57, 0x70, 0x6D, 0x3E, 0x23, 0x04, 0x19,
 /*56 - 63*/ 0xA2, 0xBF, 0x98, 0x85, 0xD6, 0xCB, 0xEC, 0xF1,
 /*64 - 71*/  0x13, 0x0E, 0x29, 0x34, 0x67, 0x7A, 0x5D, 0x40,
 /*72 - 79*/ 0xFB, 0xE6, 0xC1, 0xDC, 0x8F, 0x92, 0xB5, 0xA8,
 /*80 - 87*/ 0xDE, 0xC3, 0xE4, 0xF9, 0xAA, 0xB7, 0x90, 0x8D,
 /*88 - 95*/ 0x36, 0x2B, 0x0C, 0x11, 0x42, 0x5F, 0x78, 0x65,
 /*96 - 103*/ 0x94, 0x89, 0xAE, 0xB3, 0xE0, 0xFD, 0xDA, 0xC7,
 /*104 - 111*/ 0x7C, 0x61, 0x46, 0x5B, 0x08, 0x15, 0x32, 0x2F,
 /*112 - 119*/ 0x59, 0x44, 0x63, 0x7E, 0x2D, 0x30, 0x17, 0x0A,
 /*120 - 127*/ 0xB1, 0xAC, 0x8B, 0x96, 0xC5, 0xD8, 0xFF, 0xE2,
 /*128 - 135*/ 0x26, 0x3B, 0x1C, 0x01, 0x52, 0x4F, 0x68, 0x75,
 /*136 - 143*/ 0xCE, 0xD3, 0xF4, 0xE9, 0xBA, 0xA7, 0x80, 0x9D,
 /*144 - 151*/ 0xEB, 0xF6, 0xD1, 0xCC, 0x9F, 0x82, 0xA5, 0xB8,
 /*152 - 159*/ 0x03, 0x1E, 0x39, 0x24, 0x77, 0x6A, 0x4D, 0x50,
 /*160 - 167*/ 0xA1, 0xBC, 0x9B, 0x86, 0xD5, 0xC8, 0xEF, 0xF2,
 /*168 - 175*/ 0x49, 0x54, 0x73, 0x6E, 0x3D, 0x20, 0x07, 0x1A,
 /*176 - 183*/ 0x6C, 0x71, 0x56, 0x4B, 0x18, 0x05, 0x22, 0x3F,
 /*184 - 191*/ 0x84, 0x99, 0xBE, 0xA3, 0xF0, 0xED, 0xCA, 0xD7,
 /*192 - 199*/ 0x35, 0x28, 0x0F, 0x12, 0x41, 0x5C, 0x7B, 0x66,
 /*200 - 207*/ 0xDD, 0xC0, 0xE7, 0xFA, 0xA9, 0xB4, 0x93, 0x8E,
 /*208 - 215*/ 0xF8, 0xE5, 0xC2, 0xDF, 0x8C, 0x91, 0xB6, 0xAB,
 /*216 - 223*/ 0x10, 0x0D, 0x2A, 0x37, 0x64, 0x79, 0x5E, 0x43,
 /*224 - 231*/ 0xB2, 0xAF, 0x88, 0x95, 0xC6, 0xDB, 0xFC, 0xE1,
 /*232 - 239*/ 0x5A, 0x47, 0x60, 0x7D, 0x2E, 0x33, 0x14, 0x09,
 /*240 - 247*/ 0x7F, 0x62, 0x45, 0x58, 0x0B, 0x16, 0x31, 0x2C,
 /*248 - 255*/ 0x97, 0x8A, 0xAD, 0xB0, 0xE3, 0xFE, 0xD9, 0xC4
};

int64 CRC16_CCITT_FALSE_H1021_Table[256] =
{
    /*0 - 7*/     0x0000, 0x1021, 0x2042, 0x3063, 0x4084, 0x50A5, 0x60C6, 0x70E7,
    /*8 - 15*/    0x8108, 0x9129, 0xA14A, 0xB16B, 0xC18C, 0xD1AD, 0xE1CE, 0xF1EF,
    /*16 - 23*/   0x1231, 0x0210, 0x3273, 0x2252, 0x52B5, 0x4294, 0x72F7, 0x62D6,
    /*24 - 31*/   0x9339, 0x8318, 0xB37B, 0xA35A, 0xD3BD, 0xC39C, 0xF3FF, 0xE3DE,
    /*32 - 39*/   0x2462, 0x3443, 0x0420, 0x1401, 0x64E6, 0x74C7, 0x44A4, 0x5485,
    /*40 - 47*/   0xA56A, 0xB54B, 0x8528, 0x9509, 0xE5EE, 0xF5CF, 0xC5AC, 0xD58D,
    /*48 - 55*/   0x3653, 0x2672, 0x1611, 0x0630, 0x76D7, 0x66F6, 0x5695, 0x46B4,
    /*56 - 63*/   0xB75B, 0xA77A, 0x9719, 0x8738, 0xF7DF, 0xE7FE, 0xD79D, 0xC7BC,
    /*64 - 71*/   0x48C4, 0x58E5, 0x6886, 0x78A7, 0x0840, 0x1861, 0x2802, 0x3823,
    /*72 - 79*/   0xC9CC, 0xD9ED, 0xE98E, 0xF9AF, 0x8948, 0x9969, 0xA90A, 0xB92B,
    /*80 - 87*/   0x5AF5, 0x4AD4, 0x7AB7, 0x6A96, 0x1A71, 0x0A50, 0x3A33, 0x2A12,
    /*88 - 95*/   0xDBFD, 0xCBDC, 0xFBBF, 0xEB9E, 0x9B79, 0x8B58, 0xBB3B, 0xAB1A,
    /*96 - 103*/  0x6CA6, 0x7C87, 0x4CE4, 0x5CC5, 0x2C22, 0x3C03, 0x0C60, 0x1C41,
    /*104 - 111*/ 0xEDAE, 0xFD8F, 0xCDEC, 0xDDCD, 0xAD2A, 0xBD0B, 0x8D68, 0x9D49,
    /*112 - 119*/ 0x7E97, 0x6EB6, 0x5ED5, 0x4EF4, 0x3E13, 0x2E32, 0x1E51, 0x0E70,
    /*120 - 127*/ 0xFF9F, 0xEFBE, 0xDFDD, 0xCFFC, 0xBF1B, 0xAF3A, 0x9F59, 0x8F78,
    /*128 - 135*/ 0x9188, 0x81A9, 0xB1CA, 0xA1EB, 0xD10C, 0xC12D, 0xF14E, 0xE16F,
    /*136 - 143*/ 0x1080, 0x00A1, 0x30C2, 0x20E3, 0x5004, 0x4025, 0x7046, 0x6067,
    /*144 - 151*/ 0x83B9, 0x9398, 0xA3FB, 0xB3DA, 0xC33D, 0xD31C, 0xE37F, 0xF35E,
    /*152 - 159*/ 0x02B1, 0x1290, 0x22F3, 0x32D2, 0x4235, 0x5214, 0x6277, 0x7256,
    /*160 - 167*/ 0xB5EA, 0xA5CB, 0x95A8, 0x8589, 0xF56E, 0xE54F, 0xD52C, 0xC50D,
    /*168 - 175*/ 0x34E2, 0x24C3, 0x14A0, 0x0481, 0x7466, 0x6447, 0x5424, 0x4405,
    /*176 - 183*/ 0xA7DB, 0xB7FA, 0x8799, 0x97B8, 0xE75F, 0xF77E, 0xC71D, 0xD73C,
    /*184 - 191*/ 0x26D3, 0x36F2, 0x0691, 0x16B0, 0x6657, 0x7676, 0x4615, 0x5634,
    /*192 - 199*/ 0xD94C, 0xC96D, 0xF90E, 0xE92F, 0x99C8, 0x89E9, 0xB98A, 0xA9AB,
    /*200 - 207*/ 0x5844, 0x4865, 0x7806, 0x6827, 0x18C0, 0x08E1, 0x3882, 0x28A3,
    /*208 - 215*/ 0xCB7D, 0xDB5C, 0xEB3F, 0xFB1E, 0x8BF9, 0x9BD8, 0xABBB, 0xBB9A,
    /*216 - 223*/ 0x4A75, 0x5A54, 0x6A37, 0x7A16, 0x0AF1, 0x1AD0, 0x2AB3, 0x3A92,
    /*224 - 231*/ 0xFD2E, 0xED0F, 0xDD6C, 0xCD4D, 0xBDAA, 0xAD8B, 0x9DE8, 0x8DC9,
    /*232 - 239*/ 0x7C26, 0x6C07, 0x5C64, 0x4C45, 0x3CA2, 0x2C83, 0x1CE0, 0x0CC1,
    /*240 - 247*/ 0xEF1F, 0xFF3E, 0xCF5D, 0xDF7C, 0xAF9B, 0xBFBA, 0x8FD9, 0x9FF8,
    /*248 - 255*/ 0x6E17, 0x7E36, 0x4E55, 0x5E74, 0x2E93, 0x3EB2, 0x0ED1, 0x1EF0
};
         
}
/*@@end*/


/*@@startStart:Start:*/
on start
{
    //Initialise cycle time and message timer 
    putValue(E_pubc_ACC_ACC_31A_cycleTm,Cycle_ACC_31A);
    SetTimer( Tm_ACC_31A,100);
    putValue(E_pubc_ACC_ACC_31A_Tm,1);
    putValue(E_pubc_ACC_ACC_NM_cycleTm,Cycle_ACC_NM);
    SetTimer( Tm_ACC_NM,101);
    putValue(E_pubc_ACC_ACC_NM_Tm,1);
    putValue(E_pubc_ACC_ACC_312_cycleTm,Cycle_ACC_312);
    SetTimer( Tm_ACC_312,102);
    putValue(E_pubc_ACC_ACC_312_Tm,1);
    putValue(E_pubc_ACC_ACC_382_cycleTm,Cycle_ACC_382);
    SetTimer( Tm_ACC_382,103);
    putValue(E_pubc_ACC_ACC_382_Tm,1);
    putValue(E_pubc_ACC_ACC_1BA_cycleTm,Cycle_ACC_1BA);
    SetTimer( Tm_ACC_1BA,104);
    putValue(E_pubc_ACC_ACC_1BA_Tm,1);
    putValue(E_pubc_ACC_ACC_307_cycleTm,Cycle_ACC_307);
    SetTimer( Tm_ACC_307,105);
    putValue(E_pubc_ACC_ACC_307_Tm,1);
    putValue(E_pubc_ACC_ACC_378_cycleTm,Cycle_ACC_378);
    SetTimer( Tm_ACC_378,106);
    putValue(E_pubc_ACC_ACC_378_Tm,1);
    putValue(E_pubc_ACC_ACC_244_cycleTm,Cycle_ACC_244);
    SetTimer( Tm_ACC_244,107);
    putValue(E_pubc_ACC_ACC_244_Tm,1);
    
    //Initialise signals with init raw value
    Msg_ACC_31A.ACC_IACCHWAEnable   =getvalue(E_pubc_ACC_ACC_31A_ACC_IACCHWAEnable_Rv);
    Msg_ACC_31A.ACC_RLaneMarkerType   =getvalue(E_pubc_ACC_ACC_31A_ACC_RLaneMarkerType_Rv);
    Msg_ACC_31A.ACC_IACCHWAMode   =getvalue(E_pubc_ACC_ACC_31A_ACC_IACCHWAMode_Rv);
    Msg_ACC_31A.ACC_Voiceinfo   =getvalue(E_pubc_ACC_ACC_31A_ACC_Voiceinfo_Rv);
    Msg_ACC_31A.ACC_LASModeSelectionStatus   =getvalue(E_pubc_ACC_ACC_31A_ACC_LASModeSelectionStatus_Rv);
    Msg_ACC_31A.ACC_IACCHWATextInfoForDriver   =getvalue(E_pubc_ACC_ACC_31A_ACC_IACCHWATextInfoForDriver_Rv);
    Msg_ACC_31A.ACC_LLaneMarkerType   =getvalue(E_pubc_ACC_ACC_31A_ACC_LLaneMarkerType_Rv);
    Msg_ACC_31A.ACC_LatTakeoverReq   =getvalue(E_pubc_ACC_ACC_31A_ACC_LatTakeoverReq_Rv);
    Msg_ACC_31A.ACC_DriverHandsOffStatus   =getvalue(E_pubc_ACC_ACC_31A_ACC_DriverHandsOffStatus_Rv);
    Msg_ACC_31A.ACC_HostLaneLeftStatus   =getvalue(E_pubc_ACC_ACC_31A_ACC_HostLaneLeftStatus_Rv);
    Msg_ACC_31A.ACC_LASWarningModeSelectionSts   =getvalue(E_pubc_ACC_ACC_31A_ACC_LASWarningModeSelectionSts_Rv);
    Msg_ACC_31A.ACC_HostLaneRightStatus   =getvalue(E_pubc_ACC_ACC_31A_ACC_HostLaneRightStatus_Rv);
    Msg_ACC_NM.ACC_NMSourceAddress   =getvalue(E_pubc_ACC_ACC_NM_ACC_NMSourceAddress_Rv);
    Msg_ACC_312.ACC_RLaneDistanceFusion   =getvalue(E_pubc_ACC_ACC_312_ACC_RLaneDistanceFusion_Rv);
    Msg_ACC_312.ACC_ACCTargetID   =getvalue(E_pubc_ACC_ACC_312_ACC_ACCTargetID_Rv);
    Msg_ACC_312.ACC_LLaneDistanceFusion   =getvalue(E_pubc_ACC_ACC_312_ACC_LLaneDistanceFusion_Rv);
    Msg_ACC_1BA.ADS_Authernticator_1BA   =getvalue(E_pubc_ACC_ACC_1BA_ADS_Authernticator_1BA_Rv);
    Msg_ACC_1BA.ADS_Reqmode   =getvalue(E_pubc_ACC_ACC_1BA_ADS_Reqmode_Rv);
    Msg_ACC_1BA.ADS_MesssageCounter_1BA   =getvalue(E_pubc_ACC_ACC_1BA_ADS_MesssageCounter_1BA_Rv);
    Msg_ACC_1BA.ACC_LatAngReqActive   =getvalue(E_pubc_ACC_ACC_1BA_ACC_LatAngReqActive_Rv);
    Msg_ACC_1BA.ACC_MotorTorqueMaxLimitRequest   =getvalue(E_pubc_ACC_ACC_1BA_ACC_MotorTorqueMaxLimitRequest_Rv);
    Msg_ACC_1BA.ACC_MotorTorqueMinLimitRequest   =getvalue(E_pubc_ACC_ACC_1BA_ACC_MotorTorqueMinLimitRequest_Rv);
    Msg_ACC_1BA.ADS_ErrorStatus   =getvalue(E_pubc_ACC_ACC_1BA_ADS_ErrorStatus_Rv);
    Msg_ACC_1BA.ACC_LatAngReq   =getvalue(E_pubc_ACC_ACC_1BA_ACC_LatAngReq_Rv);
    Msg_ACC_1BA.ADS_ResetFlag_1BA   =getvalue(E_pubc_ACC_ACC_1BA_ADS_ResetFlag_1BA_Rv);
    Msg_ACC_307.ACC_ACCEPBrequest   =getvalue(E_pubc_ACC_ACC_307_ACC_ACCEPBrequest_Rv);
    Msg_ACC_307.ACC_TimeGapSet   =getvalue(E_pubc_ACC_ACC_307_ACC_TimeGapSet_Rv);
    Msg_ACC_307.ACC_HostTargetDetection   =getvalue(E_pubc_ACC_ACC_307_ACC_HostTargetDetection_Rv);
    Msg_ACC_307.ACC_DistanceLevel   =getvalue(E_pubc_ACC_ACC_307_ACC_DistanceLevel_Rv);
    Msg_ACC_307.ACC_TextInfoForDriver   =getvalue(E_pubc_ACC_ACC_307_ACC_TextInfoForDriver_Rv);
    Msg_ACC_307.ACC_SaftyBeltVibrationReq   =getvalue(E_pubc_ACC_ACC_307_ACC_SaftyBeltVibrationReq_Rv);
    Msg_ACC_307.ACC_ACCTargetLngRange   =getvalue(E_pubc_ACC_ACC_307_ACC_ACCTargetLngRange_Rv);
    Msg_ACC_307.ACC_SaftyBelt_Tightened   =getvalue(E_pubc_ACC_ACC_307_ACC_SaftyBelt_Tightened_Rv);
    Msg_ACC_307.ACC_ObjValid   =getvalue(E_pubc_ACC_ACC_307_ACC_ObjValid_Rv);
    Msg_ACC_307.ACC_LngTakeOverReq   =getvalue(E_pubc_ACC_ACC_307_ACC_LngTakeOverReq_Rv);
    Msg_ACC_307.ACC_SetSpeed   =getvalue(E_pubc_ACC_ACC_307_ACC_SetSpeed_Rv);
    Msg_ACC_307.ACC_ACCTargetType   =getvalue(E_pubc_ACC_ACC_307_ACC_ACCTargetType_Rv);
    Msg_ACC_378.ACC_LaneEquationC1   =getvalue(E_pubc_ACC_ACC_378_ACC_LaneEquationC1_Rv);
    Msg_ACC_378.ACC_LaneQuality   =getvalue(E_pubc_ACC_ACC_378_ACC_LaneQuality_Rv);
    Msg_ACC_378.ACC_LaneEquationC3   =getvalue(E_pubc_ACC_ACC_378_ACC_LaneEquationC3_Rv);
    Msg_ACC_378.ACC_LaneEquationStatus   =getvalue(E_pubc_ACC_ACC_378_ACC_LaneEquationStatus_Rv);
    Msg_ACC_378.ACC_LaneEquationC2   =getvalue(E_pubc_ACC_ACC_378_ACC_LaneEquationC2_Rv);
    Msg_ACC_244.ACC_CDDActive   =getvalue(E_pubc_ACC_ACC_244_ACC_CDDActive_Rv);
    Msg_ACC_244.ACC_Driveoff_Request   =getvalue(E_pubc_ACC_ACC_244_ACC_Driveoff_Request_Rv);
    Msg_ACC_244.ACC_AccTrqReqActive   =getvalue(E_pubc_ACC_ACC_244_ACC_AccTrqReqActive_Rv);
    Msg_ACC_244.ACC_AWBlevel   =getvalue(E_pubc_ACC_ACC_244_ACC_AWBlevel_Rv);
    Msg_ACC_244.ACC_DecToStop   =getvalue(E_pubc_ACC_ACC_244_ACC_DecToStop_Rv);
    Msg_ACC_244.ACC_ABAlevel   =getvalue(E_pubc_ACC_ACC_244_ACC_ABAlevel_Rv);
    Msg_ACC_244.ACC_ABAActive   =getvalue(E_pubc_ACC_ACC_244_ACC_ABAActive_Rv);
    Msg_ACC_244.ACC_PrefillActive   =getvalue(E_pubc_ACC_ACC_244_ACC_PrefillActive_Rv);
    Msg_ACC_244.ACC_AEBCtrlType   =getvalue(E_pubc_ACC_ACC_244_ACC_AEBCtrlType_Rv);
    Msg_ACC_244.ACC_FCWActive   =getvalue(E_pubc_ACC_ACC_244_ACC_FCWActive_Rv);
    Msg_ACC_244.ACC_FCWLatentWarning   =getvalue(E_pubc_ACC_ACC_244_ACC_FCWLatentWarning_Rv);
    Msg_ACC_244.ACC_LDWVibrationWarningReq   =getvalue(E_pubc_ACC_ACC_244_ACC_LDWVibrationWarningReq_Rv);
    Msg_ACC_244.ADS_MesssageCounter_244   =getvalue(E_pubc_ACC_ACC_244_ADS_MesssageCounter_244_Rv);
    Msg_ACC_244.ACC_AEBTargetDeceleration   =getvalue(E_pubc_ACC_ACC_244_ACC_AEBTargetDeceleration_Rv);
    Msg_ACC_244.ACC_AEBVehilceHoldReq   =getvalue(E_pubc_ACC_ACC_244_ACC_AEBVehilceHoldReq_Rv);
    Msg_ACC_244.ACC_AccTrqReq   =getvalue(E_pubc_ACC_ACC_244_ACC_AccTrqReq_Rv);
    Msg_ACC_244.ADS_ResetFlag_244   =getvalue(E_pubc_ACC_ACC_244_ADS_ResetFlag_244_Rv);
    Msg_ACC_244.ACC_LDWStatus   =getvalue(E_pubc_ACC_ACC_244_ACC_LDWStatus_Rv);
    Msg_ACC_244.ACC_ACCTargetAcceleration   =getvalue(E_pubc_ACC_ACC_244_ACC_ACCTargetAcceleration_Rv);
    Msg_ACC_244.ACC_EmergencyDataRrdReq   =getvalue(E_pubc_ACC_ACC_244_ACC_EmergencyDataRrdReq_Rv);
    Msg_ACC_244.ADS_Authernticator_244   =getvalue(E_pubc_ACC_ACC_244_ADS_Authernticator_244_Rv);
    Msg_ACC_244.ACC_AEBActive   =getvalue(E_pubc_ACC_ACC_244_ACC_AEBActive_Rv);
    Msg_ACC_244.ACC_LKAStatus   =getvalue(E_pubc_ACC_ACC_244_ACC_LKAStatus_Rv);
    Msg_ACC_244.ACC_FCWPreWarning   =getvalue(E_pubc_ACC_ACC_244_ACC_FCWPreWarning_Rv);
    Msg_ACC_244.ACC_AWBActive   =getvalue(E_pubc_ACC_ACC_244_ACC_AWBActive_Rv);
    Msg_ACC_244.ACC_ACCMode   =getvalue(E_pubc_ACC_ACC_244_ACC_ACCMode_Rv);
}
/*@@end*/

/*@@envVar:E_pubc_ACC_CycMsgsON:*/
on envVar E_pubc_ACC_CycMsgsON
{
    // enable all the cyclic messages 
    putValue(E_pubc_ACC_ACC_31A_Tm,1);
    putValue(E_pubc_ACC_ACC_NM_Tm,1);
    putValue(E_pubc_ACC_ACC_312_Tm,1);
    putValue(E_pubc_ACC_ACC_382_Tm,1);
    putValue(E_pubc_ACC_ACC_1BA_Tm,1);
    putValue(E_pubc_ACC_ACC_307_Tm,1);
    putValue(E_pubc_ACC_ACC_378_Tm,1);
    putValue(E_pubc_ACC_ACC_244_Tm,1);
}
/*@@end*/

/*@@envVar:E_pubc_ACC_CycMsgsOFF:*/
on envVar E_pubc_ACC_CycMsgsOFF
{
    // disable all the cyclic messages
    putValue(E_pubc_ACC_ACC_31A_Tm,0);
    putValue(E_pubc_ACC_ACC_NM_Tm,0);
    putValue(E_pubc_ACC_ACC_312_Tm,0);
    putValue(E_pubc_ACC_ACC_382_Tm,0);
    putValue(E_pubc_ACC_ACC_1BA_Tm,0);
    putValue(E_pubc_ACC_ACC_307_Tm,0);
    putValue(E_pubc_ACC_ACC_378_Tm,0);
    putValue(E_pubc_ACC_ACC_244_Tm,0);
    
}
/*@@end*/
/*@@timer:Tm_ACC_31A:*/
on timer Tm_ACC_31A
{
    //cyclic message timer 
    if(getValue(E_pubc_ACC_ACC_31A_Tm) == 1)
    {
        
		//update the BZ Signal
        if(ACC_31A_ACC_RollingCounter_36D_wrongvalctr == 0)
        {
            update_ACC_31A_ACC_RollingCounter_36D_counter();
            Msg_ACC_31A.ACC_RollingCounter_36D= ACC_31A_ACC_RollingCounter_36D_counter;
        }
        else if(ACC_31A_ACC_RollingCounter_36D_wrongvalctr > 0)
        {
			ACC_31A_ACC_RollingCounter_36D_counter=ACC_31A_ACC_RollingCounter_36D_counter + ACC_31A_ACC_RollingCounter_36D_wrongvalctr;
			 Msg_ACC_31A.ACC_RollingCounter_36D= ACC_31A_ACC_RollingCounter_36D_counter;
            /* ACC_31A_ACC_RollingCounter_36D_wrongvalctr--;
             // if counter becomes zero, update panel controller to zero
             if(ACC_31A_ACC_RollingCounter_36D_wrongvalctr == 0)
             {
                putValue(E_pubc_ACC_ACC_31A_ACC_RollingCounter_36D_wrongvalctr,0);
             } */
        }
        else
        {
            // do nothing
        }
        if(ACC_31A_ACC_RollingCounter_30A_wrongvalctr == 0)
        {
            update_ACC_31A_ACC_RollingCounter_30A_counter();
            Msg_ACC_31A.ACC_RollingCounter_30A= ACC_31A_ACC_RollingCounter_30A_counter;
        }
        else if(ACC_31A_ACC_RollingCounter_30A_wrongvalctr > 0)
        {
			ACC_31A_ACC_RollingCounter_30A_counter=ACC_31A_ACC_RollingCounter_30A_counter + ACC_31A_ACC_RollingCounter_30A_wrongvalctr;
			 Msg_ACC_31A.ACC_RollingCounter_30A= ACC_31A_ACC_RollingCounter_30A_counter;
            /* ACC_31A_ACC_RollingCounter_30A_wrongvalctr--;
             // if counter becomes zero, update panel controller to zero
             if(ACC_31A_ACC_RollingCounter_30A_wrongvalctr == 0)
             {
                putValue(E_pubc_ACC_ACC_31A_ACC_RollingCounter_30A_wrongvalctr,0);
             } */
        }
        else
        {
            // do nothing
        }
        if(ACC_31A_ACC_RollingCounter_31A_wrongvalctr == 0)
        {
            update_ACC_31A_ACC_RollingCounter_31A_counter();
            Msg_ACC_31A.ACC_RollingCounter_31A= ACC_31A_ACC_RollingCounter_31A_counter;
        }
        else if(ACC_31A_ACC_RollingCounter_31A_wrongvalctr > 0)
        {
			ACC_31A_ACC_RollingCounter_31A_counter=ACC_31A_ACC_RollingCounter_31A_counter + ACC_31A_ACC_RollingCounter_31A_wrongvalctr;
			 Msg_ACC_31A.ACC_RollingCounter_31A= ACC_31A_ACC_RollingCounter_31A_counter;
            /* ACC_31A_ACC_RollingCounter_31A_wrongvalctr--;
             // if counter becomes zero, update panel controller to zero
             if(ACC_31A_ACC_RollingCounter_31A_wrongvalctr == 0)
             {
                putValue(E_pubc_ACC_ACC_31A_ACC_RollingCounter_31A_wrongvalctr,0);
             } */
        }
        else
        {
            // do nothing
        }
	
        update_ACC_31A_CRC_CheckSum();
        output(Msg_ACC_31A);
        
    }
    //Reset Timer
    SetTimer(Tm_ACC_31A,Cycle_ACC_31A);
}
/*@@end*/

/*@@envVar:E_pubc_ACC_ACC_31A_cycleTm:*/
on envVar E_pubc_ACC_ACC_31A_cycleTm
{
    // update the cycle time 
    Cycle_ACC_31A=getvalue(this);
}
/*@@end*/
/*@@timer:Tm_ACC_NM:*/
on timer Tm_ACC_NM
{
    //cyclic message timer 
    if(getValue(E_pubc_ACC_ACC_NM_Tm) == 1)
    {
        
		//update the BZ Signal
	
        output(Msg_ACC_NM);
        
    }
    //Reset Timer
    SetTimer(Tm_ACC_NM,Cycle_ACC_NM);
}
/*@@end*/

/*@@envVar:E_pubc_ACC_ACC_NM_cycleTm:*/
on envVar E_pubc_ACC_ACC_NM_cycleTm
{
    // update the cycle time 
    Cycle_ACC_NM=getvalue(this);
}
/*@@end*/
/*@@timer:Tm_ACC_312:*/
on timer Tm_ACC_312
{
    //cyclic message timer 
    if(getValue(E_pubc_ACC_ACC_312_Tm) == 1)
    {
        
		//update the BZ Signal
        if(ACC_312_ACC_RollingCounter_3E4_wrongvalctr == 0)
        {
            update_ACC_312_ACC_RollingCounter_3E4_counter();
            Msg_ACC_312.ACC_RollingCounter_3E4= ACC_312_ACC_RollingCounter_3E4_counter;
        }
        else if(ACC_312_ACC_RollingCounter_3E4_wrongvalctr > 0)
        {
			ACC_312_ACC_RollingCounter_3E4_counter=ACC_312_ACC_RollingCounter_3E4_counter + ACC_312_ACC_RollingCounter_3E4_wrongvalctr;
			 Msg_ACC_312.ACC_RollingCounter_3E4= ACC_312_ACC_RollingCounter_3E4_counter;
            /* ACC_312_ACC_RollingCounter_3E4_wrongvalctr--;
             // if counter becomes zero, update panel controller to zero
             if(ACC_312_ACC_RollingCounter_3E4_wrongvalctr == 0)
             {
                putValue(E_pubc_ACC_ACC_312_ACC_RollingCounter_3E4_wrongvalctr,0);
             } */
        }
        else
        {
            // do nothing
        }
        if(ACC_312_ADS_RollingCounter_312_wrongvalctr == 0)
        {
            update_ACC_312_ADS_RollingCounter_312_counter();
            Msg_ACC_312.ADS_RollingCounter_312= ACC_312_ADS_RollingCounter_312_counter;
        }
        else if(ACC_312_ADS_RollingCounter_312_wrongvalctr > 0)
        {
			ACC_312_ADS_RollingCounter_312_counter=ACC_312_ADS_RollingCounter_312_counter + ACC_312_ADS_RollingCounter_312_wrongvalctr;
			 Msg_ACC_312.ADS_RollingCounter_312= ACC_312_ADS_RollingCounter_312_counter;
            /* ACC_312_ADS_RollingCounter_312_wrongvalctr--;
             // if counter becomes zero, update panel controller to zero
             if(ACC_312_ADS_RollingCounter_312_wrongvalctr == 0)
             {
                putValue(E_pubc_ACC_ACC_312_ADS_RollingCounter_312_wrongvalctr,0);
             } */
        }
        else
        {
            // do nothing
        }
	
        update_ACC_312_CRC_CheckSum();
        output(Msg_ACC_312);
        
    }
    //Reset Timer
    SetTimer(Tm_ACC_312,Cycle_ACC_312);
}
/*@@end*/

/*@@envVar:E_pubc_ACC_ACC_312_cycleTm:*/
on envVar E_pubc_ACC_ACC_312_cycleTm
{
    // update the cycle time 
    Cycle_ACC_312=getvalue(this);
}
/*@@end*/
/*@@timer:Tm_ACC_382:*/
on timer Tm_ACC_382
{
    //cyclic message timer 
    if(getValue(E_pubc_ACC_ACC_382_Tm) == 1)
    {
        
		//update the BZ Signal
        if(ACC_382_ACC_RollingCounter_382_wrongvalctr == 0)
        {
            update_ACC_382_ACC_RollingCounter_382_counter();
            Msg_ACC_382.ACC_RollingCounter_382= ACC_382_ACC_RollingCounter_382_counter;
        }
        else if(ACC_382_ACC_RollingCounter_382_wrongvalctr > 0)
        {
			ACC_382_ACC_RollingCounter_382_counter=ACC_382_ACC_RollingCounter_382_counter + ACC_382_ACC_RollingCounter_382_wrongvalctr;
			 Msg_ACC_382.ACC_RollingCounter_382= ACC_382_ACC_RollingCounter_382_counter;
            /* ACC_382_ACC_RollingCounter_382_wrongvalctr--;
             // if counter becomes zero, update panel controller to zero
             if(ACC_382_ACC_RollingCounter_382_wrongvalctr == 0)
             {
                putValue(E_pubc_ACC_ACC_382_ACC_RollingCounter_382_wrongvalctr,0);
             } */
        }
        else
        {
            // do nothing
        }
        if(ACC_382_ACC_RollingCounter_3E6_wrongvalctr == 0)
        {
            update_ACC_382_ACC_RollingCounter_3E6_counter();
            Msg_ACC_382.ACC_RollingCounter_3E6= ACC_382_ACC_RollingCounter_3E6_counter;
        }
        else if(ACC_382_ACC_RollingCounter_3E6_wrongvalctr > 0)
        {
			ACC_382_ACC_RollingCounter_3E6_counter=ACC_382_ACC_RollingCounter_3E6_counter + ACC_382_ACC_RollingCounter_3E6_wrongvalctr;
			 Msg_ACC_382.ACC_RollingCounter_3E6= ACC_382_ACC_RollingCounter_3E6_counter;
            /* ACC_382_ACC_RollingCounter_3E6_wrongvalctr--;
             // if counter becomes zero, update panel controller to zero
             if(ACC_382_ACC_RollingCounter_3E6_wrongvalctr == 0)
             {
                putValue(E_pubc_ACC_ACC_382_ACC_RollingCounter_3E6_wrongvalctr,0);
             } */
        }
        else
        {
            // do nothing
        }
	
        update_ACC_382_CRC_CheckSum();
        output(Msg_ACC_382);
        
    }
    //Reset Timer
    SetTimer(Tm_ACC_382,Cycle_ACC_382);
}
/*@@end*/

/*@@envVar:E_pubc_ACC_ACC_382_cycleTm:*/
on envVar E_pubc_ACC_ACC_382_cycleTm
{
    // update the cycle time 
    Cycle_ACC_382=getvalue(this);
}
/*@@end*/
/*@@timer:Tm_ACC_1BA:*/
on timer Tm_ACC_1BA
{
    //cyclic message timer 
    if(getValue(E_pubc_ACC_ACC_1BA_Tm) == 1)
    {
        
		//update the BZ Signal
        if(ACC_1BA_ACC_RollingCounter_1C0_wrongvalctr == 0)
        {
            update_ACC_1BA_ACC_RollingCounter_1C0_counter();
            Msg_ACC_1BA.ACC_RollingCounter_1C0= ACC_1BA_ACC_RollingCounter_1C0_counter;
        }
        else if(ACC_1BA_ACC_RollingCounter_1C0_wrongvalctr > 0)
        {
			ACC_1BA_ACC_RollingCounter_1C0_counter=ACC_1BA_ACC_RollingCounter_1C0_counter + ACC_1BA_ACC_RollingCounter_1C0_wrongvalctr;
			 Msg_ACC_1BA.ACC_RollingCounter_1C0= ACC_1BA_ACC_RollingCounter_1C0_counter;
            /* ACC_1BA_ACC_RollingCounter_1C0_wrongvalctr--;
             // if counter becomes zero, update panel controller to zero
             if(ACC_1BA_ACC_RollingCounter_1C0_wrongvalctr == 0)
             {
                putValue(E_pubc_ACC_ACC_1BA_ACC_RollingCounter_1C0_wrongvalctr,0);
             } */
        }
        else
        {
            // do nothing
        }
	
        update_ACC_1BA_CRC_CheckSum();
        output(Msg_ACC_1BA);
        
    }
    //Reset Timer
    SetTimer(Tm_ACC_1BA,Cycle_ACC_1BA);
}
/*@@end*/

/*@@envVar:E_pubc_ACC_ACC_1BA_cycleTm:*/
on envVar E_pubc_ACC_ACC_1BA_cycleTm
{
    // update the cycle time 
    Cycle_ACC_1BA=getvalue(this);
}
/*@@end*/
/*@@timer:Tm_ACC_307:*/
on timer Tm_ACC_307
{
    //cyclic message timer 
    if(getValue(E_pubc_ACC_ACC_307_Tm) == 1)
    {
        
		//update the BZ Signal
        if(ACC_307_ACC_RollingCounter_307_wrongvalctr == 0)
        {
            update_ACC_307_ACC_RollingCounter_307_counter();
            Msg_ACC_307.ACC_RollingCounter_307= ACC_307_ACC_RollingCounter_307_counter;
        }
        else if(ACC_307_ACC_RollingCounter_307_wrongvalctr > 0)
        {
			ACC_307_ACC_RollingCounter_307_counter=ACC_307_ACC_RollingCounter_307_counter + ACC_307_ACC_RollingCounter_307_wrongvalctr;
			 Msg_ACC_307.ACC_RollingCounter_307= ACC_307_ACC_RollingCounter_307_counter;
            /* ACC_307_ACC_RollingCounter_307_wrongvalctr--;
             // if counter becomes zero, update panel controller to zero
             if(ACC_307_ACC_RollingCounter_307_wrongvalctr == 0)
             {
                putValue(E_pubc_ACC_ACC_307_ACC_RollingCounter_307_wrongvalctr,0);
             } */
        }
        else
        {
            // do nothing
        }
        if(ACC_307_ACC_RollingCounter_35E_wrongvalctr == 0)
        {
            update_ACC_307_ACC_RollingCounter_35E_counter();
            Msg_ACC_307.ACC_RollingCounter_35E= ACC_307_ACC_RollingCounter_35E_counter;
        }
        else if(ACC_307_ACC_RollingCounter_35E_wrongvalctr > 0)
        {
			ACC_307_ACC_RollingCounter_35E_counter=ACC_307_ACC_RollingCounter_35E_counter + ACC_307_ACC_RollingCounter_35E_wrongvalctr;
			 Msg_ACC_307.ACC_RollingCounter_35E= ACC_307_ACC_RollingCounter_35E_counter;
            /* ACC_307_ACC_RollingCounter_35E_wrongvalctr--;
             // if counter becomes zero, update panel controller to zero
             if(ACC_307_ACC_RollingCounter_35E_wrongvalctr == 0)
             {
                putValue(E_pubc_ACC_ACC_307_ACC_RollingCounter_35E_wrongvalctr,0);
             } */
        }
        else
        {
            // do nothing
        }
        if(ACC_307_ACC_RollingCounter_35F_wrongvalctr == 0)
        {
            update_ACC_307_ACC_RollingCounter_35F_counter();
            Msg_ACC_307.ACC_RollingCounter_35F= ACC_307_ACC_RollingCounter_35F_counter;
        }
        else if(ACC_307_ACC_RollingCounter_35F_wrongvalctr > 0)
        {
			ACC_307_ACC_RollingCounter_35F_counter=ACC_307_ACC_RollingCounter_35F_counter + ACC_307_ACC_RollingCounter_35F_wrongvalctr;
			 Msg_ACC_307.ACC_RollingCounter_35F= ACC_307_ACC_RollingCounter_35F_counter;
            /* ACC_307_ACC_RollingCounter_35F_wrongvalctr--;
             // if counter becomes zero, update panel controller to zero
             if(ACC_307_ACC_RollingCounter_35F_wrongvalctr == 0)
             {
                putValue(E_pubc_ACC_ACC_307_ACC_RollingCounter_35F_wrongvalctr,0);
             } */
        }
        else
        {
            // do nothing
        }
        if(ACC_307_ACC_RollingCounter_344_wrongvalctr == 0)
        {
            update_ACC_307_ACC_RollingCounter_344_counter();
            Msg_ACC_307.ACC_RollingCounter_344= ACC_307_ACC_RollingCounter_344_counter;
        }
        else if(ACC_307_ACC_RollingCounter_344_wrongvalctr > 0)
        {
			ACC_307_ACC_RollingCounter_344_counter=ACC_307_ACC_RollingCounter_344_counter + ACC_307_ACC_RollingCounter_344_wrongvalctr;
			 Msg_ACC_307.ACC_RollingCounter_344= ACC_307_ACC_RollingCounter_344_counter;
            /* ACC_307_ACC_RollingCounter_344_wrongvalctr--;
             // if counter becomes zero, update panel controller to zero
             if(ACC_307_ACC_RollingCounter_344_wrongvalctr == 0)
             {
                putValue(E_pubc_ACC_ACC_307_ACC_RollingCounter_344_wrongvalctr,0);
             } */
        }
        else
        {
            // do nothing
        }
        if(ACC_307_ACC_RollingCounter_322_wrongvalctr == 0)
        {
            update_ACC_307_ACC_RollingCounter_322_counter();
            Msg_ACC_307.ACC_RollingCounter_322= ACC_307_ACC_RollingCounter_322_counter;
        }
        else if(ACC_307_ACC_RollingCounter_322_wrongvalctr > 0)
        {
			ACC_307_ACC_RollingCounter_322_counter=ACC_307_ACC_RollingCounter_322_counter + ACC_307_ACC_RollingCounter_322_wrongvalctr;
			 Msg_ACC_307.ACC_RollingCounter_322= ACC_307_ACC_RollingCounter_322_counter;
            /* ACC_307_ACC_RollingCounter_322_wrongvalctr--;
             // if counter becomes zero, update panel controller to zero
             if(ACC_307_ACC_RollingCounter_322_wrongvalctr == 0)
             {
                putValue(E_pubc_ACC_ACC_307_ACC_RollingCounter_322_wrongvalctr,0);
             } */
        }
        else
        {
            // do nothing
        }
	
        update_ACC_307_CRC_CheckSum();
        output(Msg_ACC_307);
        
    }
    //Reset Timer
    SetTimer(Tm_ACC_307,Cycle_ACC_307);
}
/*@@end*/

/*@@envVar:E_pubc_ACC_ACC_307_cycleTm:*/
on envVar E_pubc_ACC_ACC_307_cycleTm
{
    // update the cycle time 
    Cycle_ACC_307=getvalue(this);
}
/*@@end*/
/*@@timer:Tm_ACC_378:*/
on timer Tm_ACC_378
{
    //cyclic message timer 
    if(getValue(E_pubc_ACC_ACC_378_Tm) == 1)
    {
        
		//update the BZ Signal
	
        output(Msg_ACC_378);
        
    }
    //Reset Timer
    SetTimer(Tm_ACC_378,Cycle_ACC_378);
}
/*@@end*/

/*@@envVar:E_pubc_ACC_ACC_378_cycleTm:*/
on envVar E_pubc_ACC_ACC_378_cycleTm
{
    // update the cycle time 
    Cycle_ACC_378=getvalue(this);
}
/*@@end*/
/*@@timer:Tm_ACC_244:*/
on timer Tm_ACC_244
{
    //cyclic message timer 
    if(getValue(E_pubc_ACC_ACC_244_Tm) == 1)
    {
        
		//update the BZ Signal
        if(ACC_244_ACC_RollingCounter_25E_wrongvalctr == 0)
        {
            update_ACC_244_ACC_RollingCounter_25E_counter();
            Msg_ACC_244.ACC_RollingCounter_25E= ACC_244_ACC_RollingCounter_25E_counter;
        }
        else if(ACC_244_ACC_RollingCounter_25E_wrongvalctr > 0)
        {
			ACC_244_ACC_RollingCounter_25E_counter=ACC_244_ACC_RollingCounter_25E_counter + ACC_244_ACC_RollingCounter_25E_wrongvalctr;
			 Msg_ACC_244.ACC_RollingCounter_25E= ACC_244_ACC_RollingCounter_25E_counter;
            /* ACC_244_ACC_RollingCounter_25E_wrongvalctr--;
             // if counter becomes zero, update panel controller to zero
             if(ACC_244_ACC_RollingCounter_25E_wrongvalctr == 0)
             {
                putValue(E_pubc_ACC_ACC_244_ACC_RollingCounter_25E_wrongvalctr,0);
             } */
        }
        else
        {
            // do nothing
        }
        if(ACC_244_ACC_RollingCounter_24E_wrongvalctr == 0)
        {
            update_ACC_244_ACC_RollingCounter_24E_counter();
            Msg_ACC_244.ACC_RollingCounter_24E= ACC_244_ACC_RollingCounter_24E_counter;
        }
        else if(ACC_244_ACC_RollingCounter_24E_wrongvalctr > 0)
        {
			ACC_244_ACC_RollingCounter_24E_counter=ACC_244_ACC_RollingCounter_24E_counter + ACC_244_ACC_RollingCounter_24E_wrongvalctr;
			 Msg_ACC_244.ACC_RollingCounter_24E= ACC_244_ACC_RollingCounter_24E_counter;
            /* ACC_244_ACC_RollingCounter_24E_wrongvalctr--;
             // if counter becomes zero, update panel controller to zero
             if(ACC_244_ACC_RollingCounter_24E_wrongvalctr == 0)
             {
                putValue(E_pubc_ACC_ACC_244_ACC_RollingCounter_24E_wrongvalctr,0);
             } */
        }
        else
        {
            // do nothing
        }
	
        update_ACC_244_CRC_CheckSum();
        output(Msg_ACC_244);
        
    }
    //Reset Timer
    SetTimer(Tm_ACC_244,Cycle_ACC_244);
}
/*@@end*/

/*@@envVar:E_pubc_ACC_ACC_244_cycleTm:*/
on envVar E_pubc_ACC_ACC_244_cycleTm
{
    // update the cycle time 
    Cycle_ACC_244=getvalue(this);
}
/*@@end*/

/*@@envVar:E_pubc_ACC_ACC_31A_tx:*/
on envVar E_pubc_ACC_ACC_31A_tx
{
    if(getValue(this))
    {       
        
        //update the BZ Signal
        if(ACC_31A_ACC_RollingCounter_36D_wrongvalctr == 0)
        {
            update_ACC_31A_ACC_RollingCounter_36D_counter();
            Msg_ACC_31A.ACC_RollingCounter_36D= ACC_31A_ACC_RollingCounter_36D_counter;
        }
        else if(ACC_31A_ACC_RollingCounter_36D_wrongvalctr > 0)
        {
			ACC_31A_ACC_RollingCounter_36D_counter=ACC_31A_ACC_RollingCounter_36D_counter + ACC_31A_ACC_RollingCounter_36D_wrongvalctr;
			 Msg_ACC_31A.ACC_RollingCounter_36D= ACC_31A_ACC_RollingCounter_36D_counter;
            /* ACC_31A_ACC_RollingCounter_36D_wrongvalctr--;
              // if counter becomes zero, update panel controller to zero
             if(ACC_31A_ACC_RollingCounter_36D_wrongvalctr == 0)
             {
                 putValue(E_pubc_ACC_ACC_31A_ACC_RollingCounter_36D_wrongvalctr,0);
             } */
        }
        else
        { 
			// do nothing
        }    
        //update the BZ Signal
        if(ACC_31A_ACC_RollingCounter_30A_wrongvalctr == 0)
        {
            update_ACC_31A_ACC_RollingCounter_30A_counter();
            Msg_ACC_31A.ACC_RollingCounter_30A= ACC_31A_ACC_RollingCounter_30A_counter;
        }
        else if(ACC_31A_ACC_RollingCounter_30A_wrongvalctr > 0)
        {
			ACC_31A_ACC_RollingCounter_30A_counter=ACC_31A_ACC_RollingCounter_30A_counter + ACC_31A_ACC_RollingCounter_30A_wrongvalctr;
			 Msg_ACC_31A.ACC_RollingCounter_30A= ACC_31A_ACC_RollingCounter_30A_counter;
            /* ACC_31A_ACC_RollingCounter_30A_wrongvalctr--;
              // if counter becomes zero, update panel controller to zero
             if(ACC_31A_ACC_RollingCounter_30A_wrongvalctr == 0)
             {
                 putValue(E_pubc_ACC_ACC_31A_ACC_RollingCounter_30A_wrongvalctr,0);
             } */
        }
        else
        { 
			// do nothing
        }    
        //update the BZ Signal
        if(ACC_31A_ACC_RollingCounter_31A_wrongvalctr == 0)
        {
            update_ACC_31A_ACC_RollingCounter_31A_counter();
            Msg_ACC_31A.ACC_RollingCounter_31A= ACC_31A_ACC_RollingCounter_31A_counter;
        }
        else if(ACC_31A_ACC_RollingCounter_31A_wrongvalctr > 0)
        {
			ACC_31A_ACC_RollingCounter_31A_counter=ACC_31A_ACC_RollingCounter_31A_counter + ACC_31A_ACC_RollingCounter_31A_wrongvalctr;
			 Msg_ACC_31A.ACC_RollingCounter_31A= ACC_31A_ACC_RollingCounter_31A_counter;
            /* ACC_31A_ACC_RollingCounter_31A_wrongvalctr--;
              // if counter becomes zero, update panel controller to zero
             if(ACC_31A_ACC_RollingCounter_31A_wrongvalctr == 0)
             {
                 putValue(E_pubc_ACC_ACC_31A_ACC_RollingCounter_31A_wrongvalctr,0);
             } */
        }
        else
        { 
			// do nothing
        }    
        //calculate the CRC CheckSum
        update_ACC_31A_CRC_CheckSum();

        output(Msg_ACC_31A);        
    }
}
/*@@end*/

/*@@envVar:E_pubc_ACC_ACC_31A_Range:*/
on envVar E_pubc_ACC_ACC_31A_Range
{
    qword rawstatus = 0ll;
    qword rawValue = 0ll;    
    
    rawstatus = getvalue(this);    
    // set all the signals with min raw /max raw /init raw
    switch (rawstatus) 
    {
     case(0) :
        rawValue= 0;
        putValue(E_pubc_ACC_ACC_31A_ACC_IACCHWAEnable_Rv, rawValue);
        rawValue= 0;
        putValue(E_pubc_ACC_ACC_31A_ACC_RLaneMarkerType_Rv, rawValue);
        rawValue= 0;
        putValue(E_pubc_ACC_ACC_31A_ACC_IACCHWAMode_Rv, rawValue);
        rawValue= 0;
        putValue(E_pubc_ACC_ACC_31A_ACC_Voiceinfo_Rv, rawValue);
        rawValue= 0;
        putValue(E_pubc_ACC_ACC_31A_ACC_LASModeSelectionStatus_Rv, rawValue);
        rawValue= 0;
        putValue(E_pubc_ACC_ACC_31A_ACC_IACCHWATextInfoForDriver_Rv, rawValue);
        rawValue= 0;
        putValue(E_pubc_ACC_ACC_31A_ACC_LLaneMarkerType_Rv, rawValue);
        rawValue= 0;
        putValue(E_pubc_ACC_ACC_31A_ACC_LatTakeoverReq_Rv, rawValue);
        rawValue= 0;
        putValue(E_pubc_ACC_ACC_31A_ACC_DriverHandsOffStatus_Rv, rawValue);
        rawValue= 0;
        putValue(E_pubc_ACC_ACC_31A_ACC_HostLaneLeftStatus_Rv, rawValue);
        rawValue= 0;
        putValue(E_pubc_ACC_ACC_31A_ACC_LASWarningModeSelectionSts_Rv, rawValue);
        rawValue= 0;
        putValue(E_pubc_ACC_ACC_31A_ACC_HostLaneRightStatus_Rv, rawValue);
        break;
     case(1) :
        rawValue= 1;
        putValue(E_pubc_ACC_ACC_31A_ACC_IACCHWAEnable_Rv, rawValue);
        rawValue= 7;
        putValue(E_pubc_ACC_ACC_31A_ACC_RLaneMarkerType_Rv, rawValue);
        rawValue= 7;
        putValue(E_pubc_ACC_ACC_31A_ACC_IACCHWAMode_Rv, rawValue);
        rawValue= 31;
        putValue(E_pubc_ACC_ACC_31A_ACC_Voiceinfo_Rv, rawValue);
        rawValue= 7;
        putValue(E_pubc_ACC_ACC_31A_ACC_LASModeSelectionStatus_Rv, rawValue);
        rawValue= 31;
        putValue(E_pubc_ACC_ACC_31A_ACC_IACCHWATextInfoForDriver_Rv, rawValue);
        rawValue= 7;
        putValue(E_pubc_ACC_ACC_31A_ACC_LLaneMarkerType_Rv, rawValue);
        rawValue= 3;
        putValue(E_pubc_ACC_ACC_31A_ACC_LatTakeoverReq_Rv, rawValue);
        rawValue= 3;
        putValue(E_pubc_ACC_ACC_31A_ACC_DriverHandsOffStatus_Rv, rawValue);
        rawValue= 15;
        putValue(E_pubc_ACC_ACC_31A_ACC_HostLaneLeftStatus_Rv, rawValue);
        rawValue= 7;
        putValue(E_pubc_ACC_ACC_31A_ACC_LASWarningModeSelectionSts_Rv, rawValue);
        rawValue= 15;
        putValue(E_pubc_ACC_ACC_31A_ACC_HostLaneRightStatus_Rv, rawValue);
        break;
     default :
        rawValue= 0;
        putValue(E_pubc_ACC_ACC_31A_ACC_IACCHWAEnable_Rv, rawValue);
        rawValue= 0;
        putValue(E_pubc_ACC_ACC_31A_ACC_RLaneMarkerType_Rv, rawValue);
        rawValue= 0;
        putValue(E_pubc_ACC_ACC_31A_ACC_IACCHWAMode_Rv, rawValue);
        rawValue= 0;
        putValue(E_pubc_ACC_ACC_31A_ACC_Voiceinfo_Rv, rawValue);
        rawValue= 0;
        putValue(E_pubc_ACC_ACC_31A_ACC_LASModeSelectionStatus_Rv, rawValue);
        rawValue= 0;
        putValue(E_pubc_ACC_ACC_31A_ACC_IACCHWATextInfoForDriver_Rv, rawValue);
        rawValue= 0;
        putValue(E_pubc_ACC_ACC_31A_ACC_LLaneMarkerType_Rv, rawValue);
        rawValue= 0;
        putValue(E_pubc_ACC_ACC_31A_ACC_LatTakeoverReq_Rv, rawValue);
        rawValue= 0;
        putValue(E_pubc_ACC_ACC_31A_ACC_DriverHandsOffStatus_Rv, rawValue);
        rawValue= 0;
        putValue(E_pubc_ACC_ACC_31A_ACC_HostLaneLeftStatus_Rv, rawValue);
        rawValue= 0;
        putValue(E_pubc_ACC_ACC_31A_ACC_LASWarningModeSelectionSts_Rv, rawValue);
        rawValue= 0;
        putValue(E_pubc_ACC_ACC_31A_ACC_HostLaneRightStatus_Rv, rawValue);
      break;
   }
}
/*@@end*/

/*@@envVar:E_pubc_ACC_ACC_31A_Dlc:*/
on envVar E_pubc_ACC_ACC_31A_Dlc
{
    if(getValue(E_pubc_ACC_ACC_31A_enDlc))
    {
        Msg_ACC_31A.dlc =getValue(this);
    }
    else
    {
       Dbc_dlc = 64;
	   Msg_ACC_31A.dlc = Calc_Canfd_dlc(Dbc_dlc);
	   // Msg_ACC_31A.dlc = 64;
	   	
  }
}
/*@@end*/

/*@@envVar:E_pubc_ACC_ACC_31A_enDlc:*/
on envVar E_pubc_ACC_ACC_31A_enDlc
{
    //For Messages with DLC = 8, set wrong DLC to smaller than defined DLC
    //For Messages with DLC < 8 set wrong DLC to smaller/longer than defined DLC
    if(getValue(this))
    {
        Msg_ACC_31A.dlc =getValue(E_pubc_ACC_ACC_31A_Dlc);
    }
    else
    {
       Dbc_dlc = 64;
	   Msg_ACC_31A.dlc = Calc_Canfd_dlc(Dbc_dlc);
	   // Msg_ACC_31A.dlc = 64;
    }
}
/*@@end*/

/*@@envVar:E_pubc_ACC_ACC_31A_ACC_CRCCheck_30A_wrongvalctr:*/
on envVar E_pubc_ACC_ACC_31A_ACC_CRCCheck_30A_wrongvalctr
{
    //update disturb count
    //disturb value range:(-1 = always send wrong value),( X>0 ,x is the number of Messages with wrong CHK sent)
    ACC_31A_ACC_CRCCheck_30A_wrongvalctr =getValue(this);    
}
/*@@end*/
/*@@envVar:E_pubc_ACC_ACC_31A_ACC_CRCCheck_31A_wrongvalctr:*/
on envVar E_pubc_ACC_ACC_31A_ACC_CRCCheck_31A_wrongvalctr
{
    //update disturb count
    //disturb value range:(-1 = always send wrong value),( X>0 ,x is the number of Messages with wrong CHK sent)
    ACC_31A_ACC_CRCCheck_31A_wrongvalctr =getValue(this);    
}
/*@@end*/
/*@@envVar:E_pubc_ACC_ACC_31A_ACC_CRCCheck_36D_wrongvalctr:*/
on envVar E_pubc_ACC_ACC_31A_ACC_CRCCheck_36D_wrongvalctr
{
    //update disturb count
    //disturb value range:(-1 = always send wrong value),( X>0 ,x is the number of Messages with wrong CHK sent)
    ACC_31A_ACC_CRCCheck_36D_wrongvalctr =getValue(this);    
}
/*@@end*/
/*@@envVar:E_pubc_ACC_ACC_31A_ACC_RollingCounter_30A_wrongvalctr:*/
on envVar E_pubc_ACC_ACC_31A_ACC_RollingCounter_30A_wrongvalctr
{
    //update disturb count
    //disturb value range:(-1 = always send wrong value),( X>0 ,x is the number of Messages with wrong CHK sent)
    ACC_31A_ACC_RollingCounter_30A_wrongvalctr =getValue(this);    
}
/*@@end*/
/*@@envVar:E_pubc_ACC_ACC_31A_ACC_RollingCounter_31A_wrongvalctr:*/
on envVar E_pubc_ACC_ACC_31A_ACC_RollingCounter_31A_wrongvalctr
{
    //update disturb count
    //disturb value range:(-1 = always send wrong value),( X>0 ,x is the number of Messages with wrong CHK sent)
    ACC_31A_ACC_RollingCounter_31A_wrongvalctr =getValue(this);    
}
/*@@end*/
/*@@envVar:E_pubc_ACC_ACC_31A_ACC_RollingCounter_36D_wrongvalctr:*/
on envVar E_pubc_ACC_ACC_31A_ACC_RollingCounter_36D_wrongvalctr
{
    //update disturb count
    //disturb value range:(-1 = always send wrong value),( X>0 ,x is the number of Messages with wrong CHK sent)
    ACC_31A_ACC_RollingCounter_36D_wrongvalctr =getValue(this);    
}
/*@@end*/

/*@@envVar:E_pubc_ACC_ACC_31A_ACC_IACCHWAEnable_Rv:*/
on envVar E_pubc_ACC_ACC_31A_ACC_IACCHWAEnable_Rv
{
    int64 rawValue = 0ll;
    float rawValue_float = 0.0;
    float phyValue = 0.0;        

    //set the signal with updated raw value
    if(getValue(E_pubc_ACC_ACC_31A_ACC_IACCHWAEnable_SetVt)==0)
    {
        rawValue = getvalue(this);
        if(chgEv_ACC_31A_ACC_IACCHWAEnable == 0)
        {
            //type conversion to float
            rawValue_float = rawValue;        
            // raw to physical conversion
            phyValue = ((rawValue_float *1)+(0));
            putValue(E_pubc_ACC_ACC_31A_ACC_IACCHWAEnable_Pv, phyValue);
            chgEv_ACC_31A_ACC_IACCHWAEnable = 1;
        }
        else
        {
            chgEv_ACC_31A_ACC_IACCHWAEnable = 0;
        }    
        //update the signal value
        Msg_ACC_31A.ACC_IACCHWAEnable=rawValue;        
    }                                                                           
}
/*@@end*/

/*@@envVar:E_pubc_ACC_ACC_31A_ACC_IACCHWAEnable_Pv:*/
on envVar E_pubc_ACC_ACC_31A_ACC_IACCHWAEnable_Pv
{
    int64 rawValue = 0ll;
    float phyValue = 0.0;
    
    //update the raw value with physical value 
    if(getValue(E_pubc_ACC_ACC_31A_ACC_IACCHWAEnable_SetVt)==0)
    {
        if(chgEv_ACC_31A_ACC_IACCHWAEnable == 0)
        {
            phyValue = getvalue(this);
            // physical to raw conversion
            rawValue = ((phyValue -(0))/1);
            putValue(E_pubc_ACC_ACC_31A_ACC_IACCHWAEnable_Rv, rawValue);
            chgEv_ACC_31A_ACC_IACCHWAEnable = 1;  
        }
        else
        {
            chgEv_ACC_31A_ACC_IACCHWAEnable = 0;
        }
    }
}
/*@@end*/

/*@@envVar:E_pubc_ACC_ACC_31A_ACC_IACCHWAEnable_Vt:*/
on envVar E_pubc_ACC_ACC_31A_ACC_IACCHWAEnable_Vt
{
    qword rawValue = 0ll;
    if(getValue(E_pubc_ACC_ACC_31A_ACC_IACCHWAEnable_SetVt))
    {
        //update the signal value
        Msg_ACC_31A.ACC_IACCHWAEnable=getValue(this);
    }
}
/*@@end*/

/*@@envVar:E_pubc_ACC_ACC_31A_ACC_IACCHWAEnable_SetVt:*/
on envVar E_pubc_ACC_ACC_31A_ACC_IACCHWAEnable_SetVt
{
    if(getValue(E_pubc_ACC_ACC_31A_ACC_IACCHWAEnable_SetVt))
    {
        //update the signal value
        Msg_ACC_31A.ACC_IACCHWAEnable=getvalue(E_pubc_ACC_ACC_31A_ACC_IACCHWAEnable_Vt);
    }
    else
    {
        Msg_ACC_31A.ACC_IACCHWAEnable=getValue(E_pubc_ACC_ACC_31A_ACC_IACCHWAEnable_Rv);
    }
}
/*@@end*/
 
/*@@envVar:E_pubc_ACC_ACC_31A_ACC_RLaneMarkerType_Rv:*/
on envVar E_pubc_ACC_ACC_31A_ACC_RLaneMarkerType_Rv
{
    int64 rawValue = 0ll;
    float rawValue_float = 0.0;
    float phyValue = 0.0;        

    //set the signal with updated raw value
    if(getValue(E_pubc_ACC_ACC_31A_ACC_RLaneMarkerType_SetVt)==0)
    {
        rawValue = getvalue(this);
        if(chgEv_ACC_31A_ACC_RLaneMarkerType == 0)
        {
            //type conversion to float
            rawValue_float = rawValue;        
            // raw to physical conversion
            phyValue = ((rawValue_float *1)+(0));
            putValue(E_pubc_ACC_ACC_31A_ACC_RLaneMarkerType_Pv, phyValue);
            chgEv_ACC_31A_ACC_RLaneMarkerType = 1;
        }
        else
        {
            chgEv_ACC_31A_ACC_RLaneMarkerType = 0;
        }    
        //update the signal value
        Msg_ACC_31A.ACC_RLaneMarkerType=rawValue;        
    }                                                                           
}
/*@@end*/

/*@@envVar:E_pubc_ACC_ACC_31A_ACC_RLaneMarkerType_Pv:*/
on envVar E_pubc_ACC_ACC_31A_ACC_RLaneMarkerType_Pv
{
    int64 rawValue = 0ll;
    float phyValue = 0.0;
    
    //update the raw value with physical value 
    if(getValue(E_pubc_ACC_ACC_31A_ACC_RLaneMarkerType_SetVt)==0)
    {
        if(chgEv_ACC_31A_ACC_RLaneMarkerType == 0)
        {
            phyValue = getvalue(this);
            // physical to raw conversion
            rawValue = ((phyValue -(0))/1);
            putValue(E_pubc_ACC_ACC_31A_ACC_RLaneMarkerType_Rv, rawValue);
            chgEv_ACC_31A_ACC_RLaneMarkerType = 1;  
        }
        else
        {
            chgEv_ACC_31A_ACC_RLaneMarkerType = 0;
        }
    }
}
/*@@end*/

/*@@envVar:E_pubc_ACC_ACC_31A_ACC_RLaneMarkerType_Vt:*/
on envVar E_pubc_ACC_ACC_31A_ACC_RLaneMarkerType_Vt
{
    qword rawValue = 0ll;
    if(getValue(E_pubc_ACC_ACC_31A_ACC_RLaneMarkerType_SetVt))
    {
        //update the signal value
        Msg_ACC_31A.ACC_RLaneMarkerType=getValue(this);
    }
}
/*@@end*/

/*@@envVar:E_pubc_ACC_ACC_31A_ACC_RLaneMarkerType_SetVt:*/
on envVar E_pubc_ACC_ACC_31A_ACC_RLaneMarkerType_SetVt
{
    if(getValue(E_pubc_ACC_ACC_31A_ACC_RLaneMarkerType_SetVt))
    {
        //update the signal value
        Msg_ACC_31A.ACC_RLaneMarkerType=getvalue(E_pubc_ACC_ACC_31A_ACC_RLaneMarkerType_Vt);
    }
    else
    {
        Msg_ACC_31A.ACC_RLaneMarkerType=getValue(E_pubc_ACC_ACC_31A_ACC_RLaneMarkerType_Rv);
    }
}
/*@@end*/
 
/*@@envVar:E_pubc_ACC_ACC_31A_ACC_IACCHWAMode_Rv:*/
on envVar E_pubc_ACC_ACC_31A_ACC_IACCHWAMode_Rv
{
    int64 rawValue = 0ll;
    float rawValue_float = 0.0;
    float phyValue = 0.0;        

    //set the signal with updated raw value
    if(getValue(E_pubc_ACC_ACC_31A_ACC_IACCHWAMode_SetVt)==0)
    {
        rawValue = getvalue(this);
        if(chgEv_ACC_31A_ACC_IACCHWAMode == 0)
        {
            //type conversion to float
            rawValue_float = rawValue;        
            // raw to physical conversion
            phyValue = ((rawValue_float *1)+(0));
            putValue(E_pubc_ACC_ACC_31A_ACC_IACCHWAMode_Pv, phyValue);
            chgEv_ACC_31A_ACC_IACCHWAMode = 1;
        }
        else
        {
            chgEv_ACC_31A_ACC_IACCHWAMode = 0;
        }    
        //update the signal value
        Msg_ACC_31A.ACC_IACCHWAMode=rawValue;        
    }                                                                           
}
/*@@end*/

/*@@envVar:E_pubc_ACC_ACC_31A_ACC_IACCHWAMode_Pv:*/
on envVar E_pubc_ACC_ACC_31A_ACC_IACCHWAMode_Pv
{
    int64 rawValue = 0ll;
    float phyValue = 0.0;
    
    //update the raw value with physical value 
    if(getValue(E_pubc_ACC_ACC_31A_ACC_IACCHWAMode_SetVt)==0)
    {
        if(chgEv_ACC_31A_ACC_IACCHWAMode == 0)
        {
            phyValue = getvalue(this);
            // physical to raw conversion
            rawValue = ((phyValue -(0))/1);
            putValue(E_pubc_ACC_ACC_31A_ACC_IACCHWAMode_Rv, rawValue);
            chgEv_ACC_31A_ACC_IACCHWAMode = 1;  
        }
        else
        {
            chgEv_ACC_31A_ACC_IACCHWAMode = 0;
        }
    }
}
/*@@end*/

/*@@envVar:E_pubc_ACC_ACC_31A_ACC_IACCHWAMode_Vt:*/
on envVar E_pubc_ACC_ACC_31A_ACC_IACCHWAMode_Vt
{
    qword rawValue = 0ll;
    if(getValue(E_pubc_ACC_ACC_31A_ACC_IACCHWAMode_SetVt))
    {
        //update the signal value
        Msg_ACC_31A.ACC_IACCHWAMode=getValue(this);
    }
}
/*@@end*/

/*@@envVar:E_pubc_ACC_ACC_31A_ACC_IACCHWAMode_SetVt:*/
on envVar E_pubc_ACC_ACC_31A_ACC_IACCHWAMode_SetVt
{
    if(getValue(E_pubc_ACC_ACC_31A_ACC_IACCHWAMode_SetVt))
    {
        //update the signal value
        Msg_ACC_31A.ACC_IACCHWAMode=getvalue(E_pubc_ACC_ACC_31A_ACC_IACCHWAMode_Vt);
    }
    else
    {
        Msg_ACC_31A.ACC_IACCHWAMode=getValue(E_pubc_ACC_ACC_31A_ACC_IACCHWAMode_Rv);
    }
}
/*@@end*/
 
/*@@envVar:E_pubc_ACC_ACC_31A_ACC_Voiceinfo_Rv:*/
on envVar E_pubc_ACC_ACC_31A_ACC_Voiceinfo_Rv
{
    int64 rawValue = 0ll;
    float rawValue_float = 0.0;
    float phyValue = 0.0;        

    //set the signal with updated raw value
    if(getValue(E_pubc_ACC_ACC_31A_ACC_Voiceinfo_SetVt)==0)
    {
        rawValue = getvalue(this);
        if(chgEv_ACC_31A_ACC_Voiceinfo == 0)
        {
            //type conversion to float
            rawValue_float = rawValue;        
            // raw to physical conversion
            phyValue = ((rawValue_float *1)+(0));
            putValue(E_pubc_ACC_ACC_31A_ACC_Voiceinfo_Pv, phyValue);
            chgEv_ACC_31A_ACC_Voiceinfo = 1;
        }
        else
        {
            chgEv_ACC_31A_ACC_Voiceinfo = 0;
        }    
        //update the signal value
        Msg_ACC_31A.ACC_Voiceinfo=rawValue;        
    }                                                                           
}
/*@@end*/

/*@@envVar:E_pubc_ACC_ACC_31A_ACC_Voiceinfo_Pv:*/
on envVar E_pubc_ACC_ACC_31A_ACC_Voiceinfo_Pv
{
    int64 rawValue = 0ll;
    float phyValue = 0.0;
    
    //update the raw value with physical value 
    if(getValue(E_pubc_ACC_ACC_31A_ACC_Voiceinfo_SetVt)==0)
    {
        if(chgEv_ACC_31A_ACC_Voiceinfo == 0)
        {
            phyValue = getvalue(this);
            // physical to raw conversion
            rawValue = ((phyValue -(0))/1);
            putValue(E_pubc_ACC_ACC_31A_ACC_Voiceinfo_Rv, rawValue);
            chgEv_ACC_31A_ACC_Voiceinfo = 1;  
        }
        else
        {
            chgEv_ACC_31A_ACC_Voiceinfo = 0;
        }
    }
}
/*@@end*/

/*@@envVar:E_pubc_ACC_ACC_31A_ACC_Voiceinfo_Vt:*/
on envVar E_pubc_ACC_ACC_31A_ACC_Voiceinfo_Vt
{
    qword rawValue = 0ll;
    if(getValue(E_pubc_ACC_ACC_31A_ACC_Voiceinfo_SetVt))
    {
        //update the signal value
        Msg_ACC_31A.ACC_Voiceinfo=getValue(this);
    }
}
/*@@end*/

/*@@envVar:E_pubc_ACC_ACC_31A_ACC_Voiceinfo_SetVt:*/
on envVar E_pubc_ACC_ACC_31A_ACC_Voiceinfo_SetVt
{
    if(getValue(E_pubc_ACC_ACC_31A_ACC_Voiceinfo_SetVt))
    {
        //update the signal value
        Msg_ACC_31A.ACC_Voiceinfo=getvalue(E_pubc_ACC_ACC_31A_ACC_Voiceinfo_Vt);
    }
    else
    {
        Msg_ACC_31A.ACC_Voiceinfo=getValue(E_pubc_ACC_ACC_31A_ACC_Voiceinfo_Rv);
    }
}
/*@@end*/
 
/*@@envVar:E_pubc_ACC_ACC_31A_ACC_LASModeSelectionStatus_Rv:*/
on envVar E_pubc_ACC_ACC_31A_ACC_LASModeSelectionStatus_Rv
{
    int64 rawValue = 0ll;
    float rawValue_float = 0.0;
    float phyValue = 0.0;        

    //set the signal with updated raw value
    if(getValue(E_pubc_ACC_ACC_31A_ACC_LASModeSelectionStatus_SetVt)==0)
    {
        rawValue = getvalue(this);
        if(chgEv_ACC_31A_ACC_LASModeSelectionStatus == 0)
        {
            //type conversion to float
            rawValue_float = rawValue;        
            // raw to physical conversion
            phyValue = ((rawValue_float *1)+(0));
            putValue(E_pubc_ACC_ACC_31A_ACC_LASModeSelectionStatus_Pv, phyValue);
            chgEv_ACC_31A_ACC_LASModeSelectionStatus = 1;
        }
        else
        {
            chgEv_ACC_31A_ACC_LASModeSelectionStatus = 0;
        }    
        //update the signal value
        Msg_ACC_31A.ACC_LASModeSelectionStatus=rawValue;        
    }                                                                           
}
/*@@end*/

/*@@envVar:E_pubc_ACC_ACC_31A_ACC_LASModeSelectionStatus_Pv:*/
on envVar E_pubc_ACC_ACC_31A_ACC_LASModeSelectionStatus_Pv
{
    int64 rawValue = 0ll;
    float phyValue = 0.0;
    
    //update the raw value with physical value 
    if(getValue(E_pubc_ACC_ACC_31A_ACC_LASModeSelectionStatus_SetVt)==0)
    {
        if(chgEv_ACC_31A_ACC_LASModeSelectionStatus == 0)
        {
            phyValue = getvalue(this);
            // physical to raw conversion
            rawValue = ((phyValue -(0))/1);
            putValue(E_pubc_ACC_ACC_31A_ACC_LASModeSelectionStatus_Rv, rawValue);
            chgEv_ACC_31A_ACC_LASModeSelectionStatus = 1;  
        }
        else
        {
            chgEv_ACC_31A_ACC_LASModeSelectionStatus = 0;
        }
    }
}
/*@@end*/

/*@@envVar:E_pubc_ACC_ACC_31A_ACC_LASModeSelectionStatus_Vt:*/
on envVar E_pubc_ACC_ACC_31A_ACC_LASModeSelectionStatus_Vt
{
    qword rawValue = 0ll;
    if(getValue(E_pubc_ACC_ACC_31A_ACC_LASModeSelectionStatus_SetVt))
    {
        //update the signal value
        Msg_ACC_31A.ACC_LASModeSelectionStatus=getValue(this);
    }
}
/*@@end*/

/*@@envVar:E_pubc_ACC_ACC_31A_ACC_LASModeSelectionStatus_SetVt:*/
on envVar E_pubc_ACC_ACC_31A_ACC_LASModeSelectionStatus_SetVt
{
    if(getValue(E_pubc_ACC_ACC_31A_ACC_LASModeSelectionStatus_SetVt))
    {
        //update the signal value
        Msg_ACC_31A.ACC_LASModeSelectionStatus=getvalue(E_pubc_ACC_ACC_31A_ACC_LASModeSelectionStatus_Vt);
    }
    else
    {
        Msg_ACC_31A.ACC_LASModeSelectionStatus=getValue(E_pubc_ACC_ACC_31A_ACC_LASModeSelectionStatus_Rv);
    }
}
/*@@end*/
 
/*@@envVar:E_pubc_ACC_ACC_31A_ACC_IACCHWATextInfoForDriver_Rv:*/
on envVar E_pubc_ACC_ACC_31A_ACC_IACCHWATextInfoForDriver_Rv
{
    int64 rawValue = 0ll;
    float rawValue_float = 0.0;
    float phyValue = 0.0;        

    //set the signal with updated raw value
    if(getValue(E_pubc_ACC_ACC_31A_ACC_IACCHWATextInfoForDriver_SetVt)==0)
    {
        rawValue = getvalue(this);
        if(chgEv_ACC_31A_ACC_IACCHWATextInfoForDriver == 0)
        {
            //type conversion to float
            rawValue_float = rawValue;        
            // raw to physical conversion
            phyValue = ((rawValue_float *1)+(0));
            putValue(E_pubc_ACC_ACC_31A_ACC_IACCHWATextInfoForDriver_Pv, phyValue);
            chgEv_ACC_31A_ACC_IACCHWATextInfoForDriver = 1;
        }
        else
        {
            chgEv_ACC_31A_ACC_IACCHWATextInfoForDriver = 0;
        }    
        //update the signal value
        Msg_ACC_31A.ACC_IACCHWATextInfoForDriver=rawValue;        
    }                                                                           
}
/*@@end*/

/*@@envVar:E_pubc_ACC_ACC_31A_ACC_IACCHWATextInfoForDriver_Pv:*/
on envVar E_pubc_ACC_ACC_31A_ACC_IACCHWATextInfoForDriver_Pv
{
    int64 rawValue = 0ll;
    float phyValue = 0.0;
    
    //update the raw value with physical value 
    if(getValue(E_pubc_ACC_ACC_31A_ACC_IACCHWATextInfoForDriver_SetVt)==0)
    {
        if(chgEv_ACC_31A_ACC_IACCHWATextInfoForDriver == 0)
        {
            phyValue = getvalue(this);
            // physical to raw conversion
            rawValue = ((phyValue -(0))/1);
            putValue(E_pubc_ACC_ACC_31A_ACC_IACCHWATextInfoForDriver_Rv, rawValue);
            chgEv_ACC_31A_ACC_IACCHWATextInfoForDriver = 1;  
        }
        else
        {
            chgEv_ACC_31A_ACC_IACCHWATextInfoForDriver = 0;
        }
    }
}
/*@@end*/

/*@@envVar:E_pubc_ACC_ACC_31A_ACC_IACCHWATextInfoForDriver_Vt:*/
on envVar E_pubc_ACC_ACC_31A_ACC_IACCHWATextInfoForDriver_Vt
{
    qword rawValue = 0ll;
    if(getValue(E_pubc_ACC_ACC_31A_ACC_IACCHWATextInfoForDriver_SetVt))
    {
        //update the signal value
        Msg_ACC_31A.ACC_IACCHWATextInfoForDriver=getValue(this);
    }
}
/*@@end*/

/*@@envVar:E_pubc_ACC_ACC_31A_ACC_IACCHWATextInfoForDriver_SetVt:*/
on envVar E_pubc_ACC_ACC_31A_ACC_IACCHWATextInfoForDriver_SetVt
{
    if(getValue(E_pubc_ACC_ACC_31A_ACC_IACCHWATextInfoForDriver_SetVt))
    {
        //update the signal value
        Msg_ACC_31A.ACC_IACCHWATextInfoForDriver=getvalue(E_pubc_ACC_ACC_31A_ACC_IACCHWATextInfoForDriver_Vt);
    }
    else
    {
        Msg_ACC_31A.ACC_IACCHWATextInfoForDriver=getValue(E_pubc_ACC_ACC_31A_ACC_IACCHWATextInfoForDriver_Rv);
    }
}
/*@@end*/
 
/*@@envVar:E_pubc_ACC_ACC_31A_ACC_LLaneMarkerType_Rv:*/
on envVar E_pubc_ACC_ACC_31A_ACC_LLaneMarkerType_Rv
{
    int64 rawValue = 0ll;
    float rawValue_float = 0.0;
    float phyValue = 0.0;        

    //set the signal with updated raw value
    if(getValue(E_pubc_ACC_ACC_31A_ACC_LLaneMarkerType_SetVt)==0)
    {
        rawValue = getvalue(this);
        if(chgEv_ACC_31A_ACC_LLaneMarkerType == 0)
        {
            //type conversion to float
            rawValue_float = rawValue;        
            // raw to physical conversion
            phyValue = ((rawValue_float *1)+(0));
            putValue(E_pubc_ACC_ACC_31A_ACC_LLaneMarkerType_Pv, phyValue);
            chgEv_ACC_31A_ACC_LLaneMarkerType = 1;
        }
        else
        {
            chgEv_ACC_31A_ACC_LLaneMarkerType = 0;
        }    
        //update the signal value
        Msg_ACC_31A.ACC_LLaneMarkerType=rawValue;        
    }                                                                           
}
/*@@end*/

/*@@envVar:E_pubc_ACC_ACC_31A_ACC_LLaneMarkerType_Pv:*/
on envVar E_pubc_ACC_ACC_31A_ACC_LLaneMarkerType_Pv
{
    int64 rawValue = 0ll;
    float phyValue = 0.0;
    
    //update the raw value with physical value 
    if(getValue(E_pubc_ACC_ACC_31A_ACC_LLaneMarkerType_SetVt)==0)
    {
        if(chgEv_ACC_31A_ACC_LLaneMarkerType == 0)
        {
            phyValue = getvalue(this);
            // physical to raw conversion
            rawValue = ((phyValue -(0))/1);
            putValue(E_pubc_ACC_ACC_31A_ACC_LLaneMarkerType_Rv, rawValue);
            chgEv_ACC_31A_ACC_LLaneMarkerType = 1;  
        }
        else
        {
            chgEv_ACC_31A_ACC_LLaneMarkerType = 0;
        }
    }
}
/*@@end*/

/*@@envVar:E_pubc_ACC_ACC_31A_ACC_LLaneMarkerType_Vt:*/
on envVar E_pubc_ACC_ACC_31A_ACC_LLaneMarkerType_Vt
{
    qword rawValue = 0ll;
    if(getValue(E_pubc_ACC_ACC_31A_ACC_LLaneMarkerType_SetVt))
    {
        //update the signal value
        Msg_ACC_31A.ACC_LLaneMarkerType=getValue(this);
    }
}
/*@@end*/

/*@@envVar:E_pubc_ACC_ACC_31A_ACC_LLaneMarkerType_SetVt:*/
on envVar E_pubc_ACC_ACC_31A_ACC_LLaneMarkerType_SetVt
{
    if(getValue(E_pubc_ACC_ACC_31A_ACC_LLaneMarkerType_SetVt))
    {
        //update the signal value
        Msg_ACC_31A.ACC_LLaneMarkerType=getvalue(E_pubc_ACC_ACC_31A_ACC_LLaneMarkerType_Vt);
    }
    else
    {
        Msg_ACC_31A.ACC_LLaneMarkerType=getValue(E_pubc_ACC_ACC_31A_ACC_LLaneMarkerType_Rv);
    }
}
/*@@end*/
 
/*@@envVar:E_pubc_ACC_ACC_31A_ACC_LatTakeoverReq_Rv:*/
on envVar E_pubc_ACC_ACC_31A_ACC_LatTakeoverReq_Rv
{
    int64 rawValue = 0ll;
    float rawValue_float = 0.0;
    float phyValue = 0.0;        

    //set the signal with updated raw value
    if(getValue(E_pubc_ACC_ACC_31A_ACC_LatTakeoverReq_SetVt)==0)
    {
        rawValue = getvalue(this);
        if(chgEv_ACC_31A_ACC_LatTakeoverReq == 0)
        {
            //type conversion to float
            rawValue_float = rawValue;        
            // raw to physical conversion
            phyValue = ((rawValue_float *1)+(0));
            putValue(E_pubc_ACC_ACC_31A_ACC_LatTakeoverReq_Pv, phyValue);
            chgEv_ACC_31A_ACC_LatTakeoverReq = 1;
        }
        else
        {
            chgEv_ACC_31A_ACC_LatTakeoverReq = 0;
        }    
        //update the signal value
        Msg_ACC_31A.ACC_LatTakeoverReq=rawValue;        
    }                                                                           
}
/*@@end*/

/*@@envVar:E_pubc_ACC_ACC_31A_ACC_LatTakeoverReq_Pv:*/
on envVar E_pubc_ACC_ACC_31A_ACC_LatTakeoverReq_Pv
{
    int64 rawValue = 0ll;
    float phyValue = 0.0;
    
    //update the raw value with physical value 
    if(getValue(E_pubc_ACC_ACC_31A_ACC_LatTakeoverReq_SetVt)==0)
    {
        if(chgEv_ACC_31A_ACC_LatTakeoverReq == 0)
        {
            phyValue = getvalue(this);
            // physical to raw conversion
            rawValue = ((phyValue -(0))/1);
            putValue(E_pubc_ACC_ACC_31A_ACC_LatTakeoverReq_Rv, rawValue);
            chgEv_ACC_31A_ACC_LatTakeoverReq = 1;  
        }
        else
        {
            chgEv_ACC_31A_ACC_LatTakeoverReq = 0;
        }
    }
}
/*@@end*/

/*@@envVar:E_pubc_ACC_ACC_31A_ACC_LatTakeoverReq_Vt:*/
on envVar E_pubc_ACC_ACC_31A_ACC_LatTakeoverReq_Vt
{
    qword rawValue = 0ll;
    if(getValue(E_pubc_ACC_ACC_31A_ACC_LatTakeoverReq_SetVt))
    {
        //update the signal value
        Msg_ACC_31A.ACC_LatTakeoverReq=getValue(this);
    }
}
/*@@end*/

/*@@envVar:E_pubc_ACC_ACC_31A_ACC_LatTakeoverReq_SetVt:*/
on envVar E_pubc_ACC_ACC_31A_ACC_LatTakeoverReq_SetVt
{
    if(getValue(E_pubc_ACC_ACC_31A_ACC_LatTakeoverReq_SetVt))
    {
        //update the signal value
        Msg_ACC_31A.ACC_LatTakeoverReq=getvalue(E_pubc_ACC_ACC_31A_ACC_LatTakeoverReq_Vt);
    }
    else
    {
        Msg_ACC_31A.ACC_LatTakeoverReq=getValue(E_pubc_ACC_ACC_31A_ACC_LatTakeoverReq_Rv);
    }
}
/*@@end*/
 
/*@@envVar:E_pubc_ACC_ACC_31A_ACC_DriverHandsOffStatus_Rv:*/
on envVar E_pubc_ACC_ACC_31A_ACC_DriverHandsOffStatus_Rv
{
    int64 rawValue = 0ll;
    float rawValue_float = 0.0;
    float phyValue = 0.0;        

    //set the signal with updated raw value
    if(getValue(E_pubc_ACC_ACC_31A_ACC_DriverHandsOffStatus_SetVt)==0)
    {
        rawValue = getvalue(this);
        if(chgEv_ACC_31A_ACC_DriverHandsOffStatus == 0)
        {
            //type conversion to float
            rawValue_float = rawValue;        
            // raw to physical conversion
            phyValue = ((rawValue_float *1)+(0));
            putValue(E_pubc_ACC_ACC_31A_ACC_DriverHandsOffStatus_Pv, phyValue);
            chgEv_ACC_31A_ACC_DriverHandsOffStatus = 1;
        }
        else
        {
            chgEv_ACC_31A_ACC_DriverHandsOffStatus = 0;
        }    
        //update the signal value
        Msg_ACC_31A.ACC_DriverHandsOffStatus=rawValue;        
    }                                                                           
}
/*@@end*/

/*@@envVar:E_pubc_ACC_ACC_31A_ACC_DriverHandsOffStatus_Pv:*/
on envVar E_pubc_ACC_ACC_31A_ACC_DriverHandsOffStatus_Pv
{
    int64 rawValue = 0ll;
    float phyValue = 0.0;
    
    //update the raw value with physical value 
    if(getValue(E_pubc_ACC_ACC_31A_ACC_DriverHandsOffStatus_SetVt)==0)
    {
        if(chgEv_ACC_31A_ACC_DriverHandsOffStatus == 0)
        {
            phyValue = getvalue(this);
            // physical to raw conversion
            rawValue = ((phyValue -(0))/1);
            putValue(E_pubc_ACC_ACC_31A_ACC_DriverHandsOffStatus_Rv, rawValue);
            chgEv_ACC_31A_ACC_DriverHandsOffStatus = 1;  
        }
        else
        {
            chgEv_ACC_31A_ACC_DriverHandsOffStatus = 0;
        }
    }
}
/*@@end*/

/*@@envVar:E_pubc_ACC_ACC_31A_ACC_DriverHandsOffStatus_Vt:*/
on envVar E_pubc_ACC_ACC_31A_ACC_DriverHandsOffStatus_Vt
{
    qword rawValue = 0ll;
    if(getValue(E_pubc_ACC_ACC_31A_ACC_DriverHandsOffStatus_SetVt))
    {
        //update the signal value
        Msg_ACC_31A.ACC_DriverHandsOffStatus=getValue(this);
    }
}
/*@@end*/

/*@@envVar:E_pubc_ACC_ACC_31A_ACC_DriverHandsOffStatus_SetVt:*/
on envVar E_pubc_ACC_ACC_31A_ACC_DriverHandsOffStatus_SetVt
{
    if(getValue(E_pubc_ACC_ACC_31A_ACC_DriverHandsOffStatus_SetVt))
    {
        //update the signal value
        Msg_ACC_31A.ACC_DriverHandsOffStatus=getvalue(E_pubc_ACC_ACC_31A_ACC_DriverHandsOffStatus_Vt);
    }
    else
    {
        Msg_ACC_31A.ACC_DriverHandsOffStatus=getValue(E_pubc_ACC_ACC_31A_ACC_DriverHandsOffStatus_Rv);
    }
}
/*@@end*/
 
/*@@envVar:E_pubc_ACC_ACC_31A_ACC_HostLaneLeftStatus_Rv:*/
on envVar E_pubc_ACC_ACC_31A_ACC_HostLaneLeftStatus_Rv
{
    int64 rawValue = 0ll;
    float rawValue_float = 0.0;
    float phyValue = 0.0;        

    //set the signal with updated raw value
    if(getValue(E_pubc_ACC_ACC_31A_ACC_HostLaneLeftStatus_SetVt)==0)
    {
        rawValue = getvalue(this);
        if(chgEv_ACC_31A_ACC_HostLaneLeftStatus == 0)
        {
            //type conversion to float
            rawValue_float = rawValue;        
            // raw to physical conversion
            phyValue = ((rawValue_float *1)+(0));
            putValue(E_pubc_ACC_ACC_31A_ACC_HostLaneLeftStatus_Pv, phyValue);
            chgEv_ACC_31A_ACC_HostLaneLeftStatus = 1;
        }
        else
        {
            chgEv_ACC_31A_ACC_HostLaneLeftStatus = 0;
        }    
        //update the signal value
        Msg_ACC_31A.ACC_HostLaneLeftStatus=rawValue;        
    }                                                                           
}
/*@@end*/

/*@@envVar:E_pubc_ACC_ACC_31A_ACC_HostLaneLeftStatus_Pv:*/
on envVar E_pubc_ACC_ACC_31A_ACC_HostLaneLeftStatus_Pv
{
    int64 rawValue = 0ll;
    float phyValue = 0.0;
    
    //update the raw value with physical value 
    if(getValue(E_pubc_ACC_ACC_31A_ACC_HostLaneLeftStatus_SetVt)==0)
    {
        if(chgEv_ACC_31A_ACC_HostLaneLeftStatus == 0)
        {
            phyValue = getvalue(this);
            // physical to raw conversion
            rawValue = ((phyValue -(0))/1);
            putValue(E_pubc_ACC_ACC_31A_ACC_HostLaneLeftStatus_Rv, rawValue);
            chgEv_ACC_31A_ACC_HostLaneLeftStatus = 1;  
        }
        else
        {
            chgEv_ACC_31A_ACC_HostLaneLeftStatus = 0;
        }
    }
}
/*@@end*/

/*@@envVar:E_pubc_ACC_ACC_31A_ACC_HostLaneLeftStatus_Vt:*/
on envVar E_pubc_ACC_ACC_31A_ACC_HostLaneLeftStatus_Vt
{
    qword rawValue = 0ll;
    if(getValue(E_pubc_ACC_ACC_31A_ACC_HostLaneLeftStatus_SetVt))
    {
        //update the signal value
        Msg_ACC_31A.ACC_HostLaneLeftStatus=getValue(this);
    }
}
/*@@end*/

/*@@envVar:E_pubc_ACC_ACC_31A_ACC_HostLaneLeftStatus_SetVt:*/
on envVar E_pubc_ACC_ACC_31A_ACC_HostLaneLeftStatus_SetVt
{
    if(getValue(E_pubc_ACC_ACC_31A_ACC_HostLaneLeftStatus_SetVt))
    {
        //update the signal value
        Msg_ACC_31A.ACC_HostLaneLeftStatus=getvalue(E_pubc_ACC_ACC_31A_ACC_HostLaneLeftStatus_Vt);
    }
    else
    {
        Msg_ACC_31A.ACC_HostLaneLeftStatus=getValue(E_pubc_ACC_ACC_31A_ACC_HostLaneLeftStatus_Rv);
    }
}
/*@@end*/
 
/*@@envVar:E_pubc_ACC_ACC_31A_ACC_LASWarningModeSelectionSts_Rv:*/
on envVar E_pubc_ACC_ACC_31A_ACC_LASWarningModeSelectionSts_Rv
{
    int64 rawValue = 0ll;
    float rawValue_float = 0.0;
    float phyValue = 0.0;        

    //set the signal with updated raw value
    if(getValue(E_pubc_ACC_ACC_31A_ACC_LASWarningModeSelectionSts_SetVt)==0)
    {
        rawValue = getvalue(this);
        if(chgEv_ACC_31A_ACC_LASWarningModeSelectionSts == 0)
        {
            //type conversion to float
            rawValue_float = rawValue;        
            // raw to physical conversion
            phyValue = ((rawValue_float *1)+(0));
            putValue(E_pubc_ACC_ACC_31A_ACC_LASWarningModeSelectionSts_Pv, phyValue);
            chgEv_ACC_31A_ACC_LASWarningModeSelectionSts = 1;
        }
        else
        {
            chgEv_ACC_31A_ACC_LASWarningModeSelectionSts = 0;
        }    
        //update the signal value
        Msg_ACC_31A.ACC_LASWarningModeSelectionSts=rawValue;        
    }                                                                           
}
/*@@end*/

/*@@envVar:E_pubc_ACC_ACC_31A_ACC_LASWarningModeSelectionSts_Pv:*/
on envVar E_pubc_ACC_ACC_31A_ACC_LASWarningModeSelectionSts_Pv
{
    int64 rawValue = 0ll;
    float phyValue = 0.0;
    
    //update the raw value with physical value 
    if(getValue(E_pubc_ACC_ACC_31A_ACC_LASWarningModeSelectionSts_SetVt)==0)
    {
        if(chgEv_ACC_31A_ACC_LASWarningModeSelectionSts == 0)
        {
            phyValue = getvalue(this);
            // physical to raw conversion
            rawValue = ((phyValue -(0))/1);
            putValue(E_pubc_ACC_ACC_31A_ACC_LASWarningModeSelectionSts_Rv, rawValue);
            chgEv_ACC_31A_ACC_LASWarningModeSelectionSts = 1;  
        }
        else
        {
            chgEv_ACC_31A_ACC_LASWarningModeSelectionSts = 0;
        }
    }
}
/*@@end*/

/*@@envVar:E_pubc_ACC_ACC_31A_ACC_LASWarningModeSelectionSts_Vt:*/
on envVar E_pubc_ACC_ACC_31A_ACC_LASWarningModeSelectionSts_Vt
{
    qword rawValue = 0ll;
    if(getValue(E_pubc_ACC_ACC_31A_ACC_LASWarningModeSelectionSts_SetVt))
    {
        //update the signal value
        Msg_ACC_31A.ACC_LASWarningModeSelectionSts=getValue(this);
    }
}
/*@@end*/

/*@@envVar:E_pubc_ACC_ACC_31A_ACC_LASWarningModeSelectionSts_SetVt:*/
on envVar E_pubc_ACC_ACC_31A_ACC_LASWarningModeSelectionSts_SetVt
{
    if(getValue(E_pubc_ACC_ACC_31A_ACC_LASWarningModeSelectionSts_SetVt))
    {
        //update the signal value
        Msg_ACC_31A.ACC_LASWarningModeSelectionSts=getvalue(E_pubc_ACC_ACC_31A_ACC_LASWarningModeSelectionSts_Vt);
    }
    else
    {
        Msg_ACC_31A.ACC_LASWarningModeSelectionSts=getValue(E_pubc_ACC_ACC_31A_ACC_LASWarningModeSelectionSts_Rv);
    }
}
/*@@end*/
 
/*@@envVar:E_pubc_ACC_ACC_31A_ACC_HostLaneRightStatus_Rv:*/
on envVar E_pubc_ACC_ACC_31A_ACC_HostLaneRightStatus_Rv
{
    int64 rawValue = 0ll;
    float rawValue_float = 0.0;
    float phyValue = 0.0;        

    //set the signal with updated raw value
    if(getValue(E_pubc_ACC_ACC_31A_ACC_HostLaneRightStatus_SetVt)==0)
    {
        rawValue = getvalue(this);
        if(chgEv_ACC_31A_ACC_HostLaneRightStatus == 0)
        {
            //type conversion to float
            rawValue_float = rawValue;        
            // raw to physical conversion
            phyValue = ((rawValue_float *1)+(0));
            putValue(E_pubc_ACC_ACC_31A_ACC_HostLaneRightStatus_Pv, phyValue);
            chgEv_ACC_31A_ACC_HostLaneRightStatus = 1;
        }
        else
        {
            chgEv_ACC_31A_ACC_HostLaneRightStatus = 0;
        }    
        //update the signal value
        Msg_ACC_31A.ACC_HostLaneRightStatus=rawValue;        
    }                                                                           
}
/*@@end*/

/*@@envVar:E_pubc_ACC_ACC_31A_ACC_HostLaneRightStatus_Pv:*/
on envVar E_pubc_ACC_ACC_31A_ACC_HostLaneRightStatus_Pv
{
    int64 rawValue = 0ll;
    float phyValue = 0.0;
    
    //update the raw value with physical value 
    if(getValue(E_pubc_ACC_ACC_31A_ACC_HostLaneRightStatus_SetVt)==0)
    {
        if(chgEv_ACC_31A_ACC_HostLaneRightStatus == 0)
        {
            phyValue = getvalue(this);
            // physical to raw conversion
            rawValue = ((phyValue -(0))/1);
            putValue(E_pubc_ACC_ACC_31A_ACC_HostLaneRightStatus_Rv, rawValue);
            chgEv_ACC_31A_ACC_HostLaneRightStatus = 1;  
        }
        else
        {
            chgEv_ACC_31A_ACC_HostLaneRightStatus = 0;
        }
    }
}
/*@@end*/

/*@@envVar:E_pubc_ACC_ACC_31A_ACC_HostLaneRightStatus_Vt:*/
on envVar E_pubc_ACC_ACC_31A_ACC_HostLaneRightStatus_Vt
{
    qword rawValue = 0ll;
    if(getValue(E_pubc_ACC_ACC_31A_ACC_HostLaneRightStatus_SetVt))
    {
        //update the signal value
        Msg_ACC_31A.ACC_HostLaneRightStatus=getValue(this);
    }
}
/*@@end*/

/*@@envVar:E_pubc_ACC_ACC_31A_ACC_HostLaneRightStatus_SetVt:*/
on envVar E_pubc_ACC_ACC_31A_ACC_HostLaneRightStatus_SetVt
{
    if(getValue(E_pubc_ACC_ACC_31A_ACC_HostLaneRightStatus_SetVt))
    {
        //update the signal value
        Msg_ACC_31A.ACC_HostLaneRightStatus=getvalue(E_pubc_ACC_ACC_31A_ACC_HostLaneRightStatus_Vt);
    }
    else
    {
        Msg_ACC_31A.ACC_HostLaneRightStatus=getValue(E_pubc_ACC_ACC_31A_ACC_HostLaneRightStatus_Rv);
    }
}
/*@@end*/
 
/*@@envVar:E_pubc_ACC_ACC_NM_tx:*/
on envVar E_pubc_ACC_ACC_NM_tx
{
    if(getValue(this))
    {       
        

        output(Msg_ACC_NM);        
    }
}
/*@@end*/

/*@@envVar:E_pubc_ACC_ACC_NM_Range:*/
on envVar E_pubc_ACC_ACC_NM_Range
{
    qword rawstatus = 0ll;
    qword rawValue = 0ll;    
    
    rawstatus = getvalue(this);    
    // set all the signals with min raw /max raw /init raw
    switch (rawstatus) 
    {
     case(0) :
        rawValue= 0;
        putValue(E_pubc_ACC_ACC_NM_ACC_NMSourceAddress_Rv, rawValue);
        break;
     case(1) :
        rawValue= 255;
        putValue(E_pubc_ACC_ACC_NM_ACC_NMSourceAddress_Rv, rawValue);
        break;
     default :
        rawValue= 0;
        putValue(E_pubc_ACC_ACC_NM_ACC_NMSourceAddress_Rv, rawValue);
      break;
   }
}
/*@@end*/

/*@@envVar:E_pubc_ACC_ACC_NM_Dlc:*/
on envVar E_pubc_ACC_ACC_NM_Dlc
{
    if(getValue(E_pubc_ACC_ACC_NM_enDlc))
    {
        Msg_ACC_NM.dlc =getValue(this);
    }
    else
    {   
	   Msg_ACC_NM.dlc = 8;
	   	
  }
}
/*@@end*/

/*@@envVar:E_pubc_ACC_ACC_NM_enDlc:*/
on envVar E_pubc_ACC_ACC_NM_enDlc
{
    //For Messages with DLC = 8, set wrong DLC to smaller than defined DLC
    //For Messages with DLC < 8 set wrong DLC to smaller/longer than defined DLC
    if(getValue(this))
    {
        Msg_ACC_NM.dlc =getValue(E_pubc_ACC_ACC_NM_Dlc);
    }
    else
    {
	   Msg_ACC_NM.dlc = 8;
			
    }
}
/*@@end*/


/*@@envVar:E_pubc_ACC_ACC_NM_ACC_NMSourceAddress_Rv:*/
on envVar E_pubc_ACC_ACC_NM_ACC_NMSourceAddress_Rv
{
    int64 rawValue = 0ll;
    float rawValue_float = 0.0;
    float phyValue = 0.0;        

    //set the signal with updated raw value
    {
        rawValue = getvalue(this);
        if(chgEv_ACC_NM_ACC_NMSourceAddress == 0)
        {
            //type conversion to float
            rawValue_float = rawValue;        
            // raw to physical conversion
            phyValue = ((rawValue_float *1)+(0));
            putValue(E_pubc_ACC_ACC_NM_ACC_NMSourceAddress_Pv, phyValue);
            chgEv_ACC_NM_ACC_NMSourceAddress = 1;
        }
        else
        {
            chgEv_ACC_NM_ACC_NMSourceAddress = 0;
        }    
        //update the signal value
        Msg_ACC_NM.ACC_NMSourceAddress=rawValue;        
    }                                                                           
}
/*@@end*/

/*@@envVar:E_pubc_ACC_ACC_NM_ACC_NMSourceAddress_Pv:*/
on envVar E_pubc_ACC_ACC_NM_ACC_NMSourceAddress_Pv
{
    int64 rawValue = 0ll;
    float phyValue = 0.0;
    
    //update the raw value with physical value 
    {
        if(chgEv_ACC_NM_ACC_NMSourceAddress == 0)
        {
            phyValue = getvalue(this);
            // physical to raw conversion
            rawValue = ((phyValue -(0))/1);
            putValue(E_pubc_ACC_ACC_NM_ACC_NMSourceAddress_Rv, rawValue);
            chgEv_ACC_NM_ACC_NMSourceAddress = 1;  
        }
        else
        {
            chgEv_ACC_NM_ACC_NMSourceAddress = 0;
        }
    }
}
/*@@end*/


 
/*@@envVar:E_pubc_ACC_ACC_312_tx:*/
on envVar E_pubc_ACC_ACC_312_tx
{
    if(getValue(this))
    {       
        
        //update the BZ Signal
        if(ACC_312_ACC_RollingCounter_3E4_wrongvalctr == 0)
        {
            update_ACC_312_ACC_RollingCounter_3E4_counter();
            Msg_ACC_312.ACC_RollingCounter_3E4= ACC_312_ACC_RollingCounter_3E4_counter;
        }
        else if(ACC_312_ACC_RollingCounter_3E4_wrongvalctr > 0)
        {
			ACC_312_ACC_RollingCounter_3E4_counter=ACC_312_ACC_RollingCounter_3E4_counter + ACC_312_ACC_RollingCounter_3E4_wrongvalctr;
			 Msg_ACC_312.ACC_RollingCounter_3E4= ACC_312_ACC_RollingCounter_3E4_counter;
            /* ACC_312_ACC_RollingCounter_3E4_wrongvalctr--;
              // if counter becomes zero, update panel controller to zero
             if(ACC_312_ACC_RollingCounter_3E4_wrongvalctr == 0)
             {
                 putValue(E_pubc_ACC_ACC_312_ACC_RollingCounter_3E4_wrongvalctr,0);
             } */
        }
        else
        { 
			// do nothing
        }    
        //update the BZ Signal
        if(ACC_312_ADS_RollingCounter_312_wrongvalctr == 0)
        {
            update_ACC_312_ADS_RollingCounter_312_counter();
            Msg_ACC_312.ADS_RollingCounter_312= ACC_312_ADS_RollingCounter_312_counter;
        }
        else if(ACC_312_ADS_RollingCounter_312_wrongvalctr > 0)
        {
			ACC_312_ADS_RollingCounter_312_counter=ACC_312_ADS_RollingCounter_312_counter + ACC_312_ADS_RollingCounter_312_wrongvalctr;
			 Msg_ACC_312.ADS_RollingCounter_312= ACC_312_ADS_RollingCounter_312_counter;
            /* ACC_312_ADS_RollingCounter_312_wrongvalctr--;
              // if counter becomes zero, update panel controller to zero
             if(ACC_312_ADS_RollingCounter_312_wrongvalctr == 0)
             {
                 putValue(E_pubc_ACC_ACC_312_ADS_RollingCounter_312_wrongvalctr,0);
             } */
        }
        else
        { 
			// do nothing
        }    
        //calculate the CRC CheckSum
        update_ACC_312_CRC_CheckSum();

        output(Msg_ACC_312);        
    }
}
/*@@end*/

/*@@envVar:E_pubc_ACC_ACC_312_Range:*/
on envVar E_pubc_ACC_ACC_312_Range
{
    qword rawstatus = 0ll;
    qword rawValue = 0ll;    
    
    rawstatus = getvalue(this);    
    // set all the signals with min raw /max raw /init raw
    switch (rawstatus) 
    {
     case(0) :
        rawValue= 0;
        putValue(E_pubc_ACC_ACC_312_ACC_RLaneDistanceFusion_Rv, rawValue);
        rawValue= 0;
        putValue(E_pubc_ACC_ACC_312_ACC_ACCTargetID_Rv, rawValue);
        rawValue= 0;
        putValue(E_pubc_ACC_ACC_312_ACC_LLaneDistanceFusion_Rv, rawValue);
        break;
     case(1) :
        rawValue= 120;
        putValue(E_pubc_ACC_ACC_312_ACC_RLaneDistanceFusion_Rv, rawValue);
        rawValue= 15;
        putValue(E_pubc_ACC_ACC_312_ACC_ACCTargetID_Rv, rawValue);
        rawValue= 120;
        putValue(E_pubc_ACC_ACC_312_ACC_LLaneDistanceFusion_Rv, rawValue);
        break;
     default :
        rawValue= 0;
        putValue(E_pubc_ACC_ACC_312_ACC_RLaneDistanceFusion_Rv, rawValue);
        rawValue= 0;
        putValue(E_pubc_ACC_ACC_312_ACC_ACCTargetID_Rv, rawValue);
        rawValue= 0;
        putValue(E_pubc_ACC_ACC_312_ACC_LLaneDistanceFusion_Rv, rawValue);
      break;
   }
}
/*@@end*/

/*@@envVar:E_pubc_ACC_ACC_312_Dlc:*/
on envVar E_pubc_ACC_ACC_312_Dlc
{
    if(getValue(E_pubc_ACC_ACC_312_enDlc))
    {
        Msg_ACC_312.dlc =getValue(this);
    }
    else
    {
       Dbc_dlc = 64;
	   Msg_ACC_312.dlc = Calc_Canfd_dlc(Dbc_dlc);
	   // Msg_ACC_312.dlc = 64;
	   	
  }
}
/*@@end*/

/*@@envVar:E_pubc_ACC_ACC_312_enDlc:*/
on envVar E_pubc_ACC_ACC_312_enDlc
{
    //For Messages with DLC = 8, set wrong DLC to smaller than defined DLC
    //For Messages with DLC < 8 set wrong DLC to smaller/longer than defined DLC
    if(getValue(this))
    {
        Msg_ACC_312.dlc =getValue(E_pubc_ACC_ACC_312_Dlc);
    }
    else
    {
       Dbc_dlc = 64;
	   Msg_ACC_312.dlc = Calc_Canfd_dlc(Dbc_dlc);
	   // Msg_ACC_312.dlc = 64;
    }
}
/*@@end*/

/*@@envVar:E_pubc_ACC_ACC_312_ACC_CRCCheck_3E4_wrongvalctr:*/
on envVar E_pubc_ACC_ACC_312_ACC_CRCCheck_3E4_wrongvalctr
{
    //update disturb count
    //disturb value range:(-1 = always send wrong value),( X>0 ,x is the number of Messages with wrong CHK sent)
    ACC_312_ACC_CRCCheck_3E4_wrongvalctr =getValue(this);    
}
/*@@end*/
/*@@envVar:E_pubc_ACC_ACC_312_ACC_RollingCounter_3E4_wrongvalctr:*/
on envVar E_pubc_ACC_ACC_312_ACC_RollingCounter_3E4_wrongvalctr
{
    //update disturb count
    //disturb value range:(-1 = always send wrong value),( X>0 ,x is the number of Messages with wrong CHK sent)
    ACC_312_ACC_RollingCounter_3E4_wrongvalctr =getValue(this);    
}
/*@@end*/
/*@@envVar:E_pubc_ACC_ACC_312_ADS_CRCCheck_312_wrongvalctr:*/
on envVar E_pubc_ACC_ACC_312_ADS_CRCCheck_312_wrongvalctr
{
    //update disturb count
    //disturb value range:(-1 = always send wrong value),( X>0 ,x is the number of Messages with wrong CHK sent)
    ACC_312_ADS_CRCCheck_312_wrongvalctr =getValue(this);    
}
/*@@end*/
/*@@envVar:E_pubc_ACC_ACC_312_ADS_RollingCounter_312_wrongvalctr:*/
on envVar E_pubc_ACC_ACC_312_ADS_RollingCounter_312_wrongvalctr
{
    //update disturb count
    //disturb value range:(-1 = always send wrong value),( X>0 ,x is the number of Messages with wrong CHK sent)
    ACC_312_ADS_RollingCounter_312_wrongvalctr =getValue(this);    
}
/*@@end*/

/*@@envVar:E_pubc_ACC_ACC_312_ACC_RLaneDistanceFusion_Rv:*/
on envVar E_pubc_ACC_ACC_312_ACC_RLaneDistanceFusion_Rv
{
    int64 rawValue = 0ll;
    float rawValue_float = 0.0;
    float phyValue = 0.0;        

    //set the signal with updated raw value
    {
        rawValue = getvalue(this);
        if(chgEv_ACC_312_ACC_RLaneDistanceFusion == 0)
        {
            //type conversion to float
            rawValue_float = rawValue;        
            // raw to physical conversion
            phyValue = ((rawValue_float *0.05)+(-1));
            putValue(E_pubc_ACC_ACC_312_ACC_RLaneDistanceFusion_Pv, phyValue);
            chgEv_ACC_312_ACC_RLaneDistanceFusion = 1;
        }
        else
        {
            chgEv_ACC_312_ACC_RLaneDistanceFusion = 0;
        }    
        //update the signal value
        Msg_ACC_312.ACC_RLaneDistanceFusion=rawValue;        
    }                                                                           
}
/*@@end*/

/*@@envVar:E_pubc_ACC_ACC_312_ACC_RLaneDistanceFusion_Pv:*/
on envVar E_pubc_ACC_ACC_312_ACC_RLaneDistanceFusion_Pv
{
    int64 rawValue = 0ll;
    float phyValue = 0.0;
    
    //update the raw value with physical value 
    {
        if(chgEv_ACC_312_ACC_RLaneDistanceFusion == 0)
        {
            phyValue = getvalue(this);
            // physical to raw conversion
            rawValue = ((phyValue -(-1))/0.05);
            putValue(E_pubc_ACC_ACC_312_ACC_RLaneDistanceFusion_Rv, rawValue);
            chgEv_ACC_312_ACC_RLaneDistanceFusion = 1;  
        }
        else
        {
            chgEv_ACC_312_ACC_RLaneDistanceFusion = 0;
        }
    }
}
/*@@end*/


 
/*@@envVar:E_pubc_ACC_ACC_312_ACC_ACCTargetID_Rv:*/
on envVar E_pubc_ACC_ACC_312_ACC_ACCTargetID_Rv
{
    int64 rawValue = 0ll;
    float rawValue_float = 0.0;
    float phyValue = 0.0;        

    //set the signal with updated raw value
    {
        rawValue = getvalue(this);
        if(chgEv_ACC_312_ACC_ACCTargetID == 0)
        {
            //type conversion to float
            rawValue_float = rawValue;        
            // raw to physical conversion
            phyValue = ((rawValue_float *1)+(0));
            putValue(E_pubc_ACC_ACC_312_ACC_ACCTargetID_Pv, phyValue);
            chgEv_ACC_312_ACC_ACCTargetID = 1;
        }
        else
        {
            chgEv_ACC_312_ACC_ACCTargetID = 0;
        }    
        //update the signal value
        Msg_ACC_312.ACC_ACCTargetID=rawValue;        
    }                                                                           
}
/*@@end*/

/*@@envVar:E_pubc_ACC_ACC_312_ACC_ACCTargetID_Pv:*/
on envVar E_pubc_ACC_ACC_312_ACC_ACCTargetID_Pv
{
    int64 rawValue = 0ll;
    float phyValue = 0.0;
    
    //update the raw value with physical value 
    {
        if(chgEv_ACC_312_ACC_ACCTargetID == 0)
        {
            phyValue = getvalue(this);
            // physical to raw conversion
            rawValue = ((phyValue -(0))/1);
            putValue(E_pubc_ACC_ACC_312_ACC_ACCTargetID_Rv, rawValue);
            chgEv_ACC_312_ACC_ACCTargetID = 1;  
        }
        else
        {
            chgEv_ACC_312_ACC_ACCTargetID = 0;
        }
    }
}
/*@@end*/


 
/*@@envVar:E_pubc_ACC_ACC_312_ACC_LLaneDistanceFusion_Rv:*/
on envVar E_pubc_ACC_ACC_312_ACC_LLaneDistanceFusion_Rv
{
    int64 rawValue = 0ll;
    float rawValue_float = 0.0;
    float phyValue = 0.0;        

    //set the signal with updated raw value
    {
        rawValue = getvalue(this);
        if(chgEv_ACC_312_ACC_LLaneDistanceFusion == 0)
        {
            //type conversion to float
            rawValue_float = rawValue;        
            // raw to physical conversion
            phyValue = ((rawValue_float *0.05)+(-1));
            putValue(E_pubc_ACC_ACC_312_ACC_LLaneDistanceFusion_Pv, phyValue);
            chgEv_ACC_312_ACC_LLaneDistanceFusion = 1;
        }
        else
        {
            chgEv_ACC_312_ACC_LLaneDistanceFusion = 0;
        }    
        //update the signal value
        Msg_ACC_312.ACC_LLaneDistanceFusion=rawValue;        
    }                                                                           
}
/*@@end*/

/*@@envVar:E_pubc_ACC_ACC_312_ACC_LLaneDistanceFusion_Pv:*/
on envVar E_pubc_ACC_ACC_312_ACC_LLaneDistanceFusion_Pv
{
    int64 rawValue = 0ll;
    float phyValue = 0.0;
    
    //update the raw value with physical value 
    {
        if(chgEv_ACC_312_ACC_LLaneDistanceFusion == 0)
        {
            phyValue = getvalue(this);
            // physical to raw conversion
            rawValue = ((phyValue -(-1))/0.05);
            putValue(E_pubc_ACC_ACC_312_ACC_LLaneDistanceFusion_Rv, rawValue);
            chgEv_ACC_312_ACC_LLaneDistanceFusion = 1;  
        }
        else
        {
            chgEv_ACC_312_ACC_LLaneDistanceFusion = 0;
        }
    }
}
/*@@end*/


 
/*@@envVar:E_pubc_ACC_ACC_382_tx:*/
on envVar E_pubc_ACC_ACC_382_tx
{
    if(getValue(this))
    {       
        
        //update the BZ Signal
        if(ACC_382_ACC_RollingCounter_382_wrongvalctr == 0)
        {
            update_ACC_382_ACC_RollingCounter_382_counter();
            Msg_ACC_382.ACC_RollingCounter_382= ACC_382_ACC_RollingCounter_382_counter;
        }
        else if(ACC_382_ACC_RollingCounter_382_wrongvalctr > 0)
        {
			ACC_382_ACC_RollingCounter_382_counter=ACC_382_ACC_RollingCounter_382_counter + ACC_382_ACC_RollingCounter_382_wrongvalctr;
			 Msg_ACC_382.ACC_RollingCounter_382= ACC_382_ACC_RollingCounter_382_counter;
            /* ACC_382_ACC_RollingCounter_382_wrongvalctr--;
              // if counter becomes zero, update panel controller to zero
             if(ACC_382_ACC_RollingCounter_382_wrongvalctr == 0)
             {
                 putValue(E_pubc_ACC_ACC_382_ACC_RollingCounter_382_wrongvalctr,0);
             } */
        }
        else
        { 
			// do nothing
        }    
        //update the BZ Signal
        if(ACC_382_ACC_RollingCounter_3E6_wrongvalctr == 0)
        {
            update_ACC_382_ACC_RollingCounter_3E6_counter();
            Msg_ACC_382.ACC_RollingCounter_3E6= ACC_382_ACC_RollingCounter_3E6_counter;
        }
        else if(ACC_382_ACC_RollingCounter_3E6_wrongvalctr > 0)
        {
			ACC_382_ACC_RollingCounter_3E6_counter=ACC_382_ACC_RollingCounter_3E6_counter + ACC_382_ACC_RollingCounter_3E6_wrongvalctr;
			 Msg_ACC_382.ACC_RollingCounter_3E6= ACC_382_ACC_RollingCounter_3E6_counter;
            /* ACC_382_ACC_RollingCounter_3E6_wrongvalctr--;
              // if counter becomes zero, update panel controller to zero
             if(ACC_382_ACC_RollingCounter_3E6_wrongvalctr == 0)
             {
                 putValue(E_pubc_ACC_ACC_382_ACC_RollingCounter_3E6_wrongvalctr,0);
             } */
        }
        else
        { 
			// do nothing
        }    
        //calculate the CRC CheckSum
        update_ACC_382_CRC_CheckSum();

        output(Msg_ACC_382);        
    }
}
/*@@end*/

/*@@envVar:E_pubc_ACC_ACC_382_Range:*/
on envVar E_pubc_ACC_ACC_382_Range
{
    qword rawstatus = 0ll;
    qword rawValue = 0ll;    
    
    rawstatus = getvalue(this);    
    // set all the signals with min raw /max raw /init raw
    switch (rawstatus) 
    {
     case(0) :
        break;
     case(1) :
        break;
     default :
      break;
   }
}
/*@@end*/

/*@@envVar:E_pubc_ACC_ACC_382_Dlc:*/
on envVar E_pubc_ACC_ACC_382_Dlc
{
    if(getValue(E_pubc_ACC_ACC_382_enDlc))
    {
        Msg_ACC_382.dlc =getValue(this);
    }
    else
    {
       Dbc_dlc = 64;
	   Msg_ACC_382.dlc = Calc_Canfd_dlc(Dbc_dlc);
	   // Msg_ACC_382.dlc = 64;
	   	
  }
}
/*@@end*/

/*@@envVar:E_pubc_ACC_ACC_382_enDlc:*/
on envVar E_pubc_ACC_ACC_382_enDlc
{
    //For Messages with DLC = 8, set wrong DLC to smaller than defined DLC
    //For Messages with DLC < 8 set wrong DLC to smaller/longer than defined DLC
    if(getValue(this))
    {
        Msg_ACC_382.dlc =getValue(E_pubc_ACC_ACC_382_Dlc);
    }
    else
    {
       Dbc_dlc = 64;
	   Msg_ACC_382.dlc = Calc_Canfd_dlc(Dbc_dlc);
	   // Msg_ACC_382.dlc = 64;
    }
}
/*@@end*/

/*@@envVar:E_pubc_ACC_ACC_382_ACC_CRCCheck_382_wrongvalctr:*/
on envVar E_pubc_ACC_ACC_382_ACC_CRCCheck_382_wrongvalctr
{
    //update disturb count
    //disturb value range:(-1 = always send wrong value),( X>0 ,x is the number of Messages with wrong CHK sent)
    ACC_382_ACC_CRCCheck_382_wrongvalctr =getValue(this);    
}
/*@@end*/
/*@@envVar:E_pubc_ACC_ACC_382_ACC_CRCCheck_3E6_wrongvalctr:*/
on envVar E_pubc_ACC_ACC_382_ACC_CRCCheck_3E6_wrongvalctr
{
    //update disturb count
    //disturb value range:(-1 = always send wrong value),( X>0 ,x is the number of Messages with wrong CHK sent)
    ACC_382_ACC_CRCCheck_3E6_wrongvalctr =getValue(this);    
}
/*@@end*/
/*@@envVar:E_pubc_ACC_ACC_382_ACC_RollingCounter_382_wrongvalctr:*/
on envVar E_pubc_ACC_ACC_382_ACC_RollingCounter_382_wrongvalctr
{
    //update disturb count
    //disturb value range:(-1 = always send wrong value),( X>0 ,x is the number of Messages with wrong CHK sent)
    ACC_382_ACC_RollingCounter_382_wrongvalctr =getValue(this);    
}
/*@@end*/
/*@@envVar:E_pubc_ACC_ACC_382_ACC_RollingCounter_3E6_wrongvalctr:*/
on envVar E_pubc_ACC_ACC_382_ACC_RollingCounter_3E6_wrongvalctr
{
    //update disturb count
    //disturb value range:(-1 = always send wrong value),( X>0 ,x is the number of Messages with wrong CHK sent)
    ACC_382_ACC_RollingCounter_3E6_wrongvalctr =getValue(this);    
}
/*@@end*/

/*@@envVar:E_pubc_ACC_ACC_1BA_tx:*/
on envVar E_pubc_ACC_ACC_1BA_tx
{
    if(getValue(this))
    {       
        
        //update the BZ Signal
        if(ACC_1BA_ACC_RollingCounter_1C0_wrongvalctr == 0)
        {
            update_ACC_1BA_ACC_RollingCounter_1C0_counter();
            Msg_ACC_1BA.ACC_RollingCounter_1C0= ACC_1BA_ACC_RollingCounter_1C0_counter;
        }
        else if(ACC_1BA_ACC_RollingCounter_1C0_wrongvalctr > 0)
        {
			ACC_1BA_ACC_RollingCounter_1C0_counter=ACC_1BA_ACC_RollingCounter_1C0_counter + ACC_1BA_ACC_RollingCounter_1C0_wrongvalctr;
			 Msg_ACC_1BA.ACC_RollingCounter_1C0= ACC_1BA_ACC_RollingCounter_1C0_counter;
            /* ACC_1BA_ACC_RollingCounter_1C0_wrongvalctr--;
              // if counter becomes zero, update panel controller to zero
             if(ACC_1BA_ACC_RollingCounter_1C0_wrongvalctr == 0)
             {
                 putValue(E_pubc_ACC_ACC_1BA_ACC_RollingCounter_1C0_wrongvalctr,0);
             } */
        }
        else
        { 
			// do nothing
        }    
        //calculate the CRC CheckSum
        update_ACC_1BA_CRC_CheckSum();

        output(Msg_ACC_1BA);        
    }
}
/*@@end*/

/*@@envVar:E_pubc_ACC_ACC_1BA_Range:*/
on envVar E_pubc_ACC_ACC_1BA_Range
{
    qword rawstatus = 0ll;
    qword rawValue = 0ll;    
    
    rawstatus = getvalue(this);    
    // set all the signals with min raw /max raw /init raw
    switch (rawstatus) 
    {
     case(0) :
        rawValue= 0;
        putValue(E_pubc_ACC_ACC_1BA_ADS_Authernticator_1BA_Rv, rawValue);
        rawValue= 0;
        putValue(E_pubc_ACC_ACC_1BA_ADS_Reqmode_Rv, rawValue);
        rawValue= 0;
        putValue(E_pubc_ACC_ACC_1BA_ADS_MesssageCounter_1BA_Rv, rawValue);
        rawValue= 0;
        putValue(E_pubc_ACC_ACC_1BA_ACC_LatAngReqActive_Rv, rawValue);
        rawValue= 0;
        putValue(E_pubc_ACC_ACC_1BA_ACC_MotorTorqueMaxLimitRequest_Rv, rawValue);
        rawValue= 0;
        putValue(E_pubc_ACC_ACC_1BA_ACC_MotorTorqueMinLimitRequest_Rv, rawValue);
        rawValue= 0;
        putValue(E_pubc_ACC_ACC_1BA_ADS_ErrorStatus_Rv, rawValue);
        rawValue= 0;
        putValue(E_pubc_ACC_ACC_1BA_ACC_LatAngReq_Rv, rawValue);
        rawValue= 0;
        putValue(E_pubc_ACC_ACC_1BA_ADS_ResetFlag_1BA_Rv, rawValue);
        break;
     case(1) :
        rawValue= 0;
        putValue(E_pubc_ACC_ACC_1BA_ADS_Authernticator_1BA_Rv, rawValue);
        rawValue= 7;
        putValue(E_pubc_ACC_ACC_1BA_ADS_Reqmode_Rv, rawValue);
        rawValue= 63;
        putValue(E_pubc_ACC_ACC_1BA_ADS_MesssageCounter_1BA_Rv, rawValue);
        rawValue= 1;
        putValue(E_pubc_ACC_ACC_1BA_ACC_LatAngReqActive_Rv, rawValue);
        rawValue= 2046;
        putValue(E_pubc_ACC_ACC_1BA_ACC_MotorTorqueMaxLimitRequest_Rv, rawValue);
        rawValue= 2046;
        putValue(E_pubc_ACC_ACC_1BA_ACC_MotorTorqueMinLimitRequest_Rv, rawValue);
        rawValue= 1;
        putValue(E_pubc_ACC_ACC_1BA_ADS_ErrorStatus_Rv, rawValue);
        rawValue= 14400;
        putValue(E_pubc_ACC_ACC_1BA_ACC_LatAngReq_Rv, rawValue);
        rawValue= 3;
        putValue(E_pubc_ACC_ACC_1BA_ADS_ResetFlag_1BA_Rv, rawValue);
        break;
     default :
        rawValue= 0;
        putValue(E_pubc_ACC_ACC_1BA_ADS_Authernticator_1BA_Rv, rawValue);
        rawValue= 0;
        putValue(E_pubc_ACC_ACC_1BA_ADS_Reqmode_Rv, rawValue);
        rawValue= 0;
        putValue(E_pubc_ACC_ACC_1BA_ADS_MesssageCounter_1BA_Rv, rawValue);
        rawValue= 0;
        putValue(E_pubc_ACC_ACC_1BA_ACC_LatAngReqActive_Rv, rawValue);
        rawValue= 0;
        putValue(E_pubc_ACC_ACC_1BA_ACC_MotorTorqueMaxLimitRequest_Rv, rawValue);
        rawValue= 0;
        putValue(E_pubc_ACC_ACC_1BA_ACC_MotorTorqueMinLimitRequest_Rv, rawValue);
        rawValue= 0;
        putValue(E_pubc_ACC_ACC_1BA_ADS_ErrorStatus_Rv, rawValue);
        rawValue= 0;
        putValue(E_pubc_ACC_ACC_1BA_ACC_LatAngReq_Rv, rawValue);
        rawValue= 0;
        putValue(E_pubc_ACC_ACC_1BA_ADS_ResetFlag_1BA_Rv, rawValue);
      break;
   }
}
/*@@end*/

/*@@envVar:E_pubc_ACC_ACC_1BA_Dlc:*/
on envVar E_pubc_ACC_ACC_1BA_Dlc
{
    if(getValue(E_pubc_ACC_ACC_1BA_enDlc))
    {
        Msg_ACC_1BA.dlc =getValue(this);
    }
    else
    {
       Dbc_dlc = 32;
	   Msg_ACC_1BA.dlc = Calc_Canfd_dlc(Dbc_dlc);
	   // Msg_ACC_1BA.dlc = 32;
	   	
  }
}
/*@@end*/

/*@@envVar:E_pubc_ACC_ACC_1BA_enDlc:*/
on envVar E_pubc_ACC_ACC_1BA_enDlc
{
    //For Messages with DLC = 8, set wrong DLC to smaller than defined DLC
    //For Messages with DLC < 8 set wrong DLC to smaller/longer than defined DLC
    if(getValue(this))
    {
        Msg_ACC_1BA.dlc =getValue(E_pubc_ACC_ACC_1BA_Dlc);
    }
    else
    {
       Dbc_dlc = 32;
	   Msg_ACC_1BA.dlc = Calc_Canfd_dlc(Dbc_dlc);
	   // Msg_ACC_1BA.dlc = 32;
    }
}
/*@@end*/

/*@@envVar:E_pubc_ACC_ACC_1BA_ACC_CRCCheck_1C0_wrongvalctr:*/
on envVar E_pubc_ACC_ACC_1BA_ACC_CRCCheck_1C0_wrongvalctr
{
    //update disturb count
    //disturb value range:(-1 = always send wrong value),( X>0 ,x is the number of Messages with wrong CHK sent)
    ACC_1BA_ACC_CRCCheck_1C0_wrongvalctr =getValue(this);    
}
/*@@end*/
/*@@envVar:E_pubc_ACC_ACC_1BA_ACC_RollingCounter_1C0_wrongvalctr:*/
on envVar E_pubc_ACC_ACC_1BA_ACC_RollingCounter_1C0_wrongvalctr
{
    //update disturb count
    //disturb value range:(-1 = always send wrong value),( X>0 ,x is the number of Messages with wrong CHK sent)
    ACC_1BA_ACC_RollingCounter_1C0_wrongvalctr =getValue(this);    
}
/*@@end*/

/*@@envVar:E_pubc_ACC_ACC_1BA_ADS_Authernticator_1BA_Rv:*/
on envVar E_pubc_ACC_ACC_1BA_ADS_Authernticator_1BA_Rv
{
    int64 rawValue = 0ll;
    float rawValue_float = 0.0;
    float phyValue = 0.0;        

    //set the signal with updated raw value
    {
        rawValue = getvalue(this);
        if(chgEv_ACC_1BA_ADS_Authernticator_1BA == 0)
        {
            //type conversion to float
            rawValue_float = rawValue;        
            // raw to physical conversion
            phyValue = ((rawValue_float *1)+(0));
            putValue(E_pubc_ACC_ACC_1BA_ADS_Authernticator_1BA_Pv, phyValue);
            chgEv_ACC_1BA_ADS_Authernticator_1BA = 1;
        }
        else
        {
            chgEv_ACC_1BA_ADS_Authernticator_1BA = 0;
        }    
        //update the signal value
        Msg_ACC_1BA.ADS_Authernticator_1BA=rawValue;        
    }                                                                           
}
/*@@end*/

/*@@envVar:E_pubc_ACC_ACC_1BA_ADS_Authernticator_1BA_Pv:*/
on envVar E_pubc_ACC_ACC_1BA_ADS_Authernticator_1BA_Pv
{
    int64 rawValue = 0ll;
    float phyValue = 0.0;
    
    //update the raw value with physical value 
    {
        if(chgEv_ACC_1BA_ADS_Authernticator_1BA == 0)
        {
            phyValue = getvalue(this);
            // physical to raw conversion
            rawValue = ((phyValue -(0))/1);
            putValue(E_pubc_ACC_ACC_1BA_ADS_Authernticator_1BA_Rv, rawValue);
            chgEv_ACC_1BA_ADS_Authernticator_1BA = 1;  
        }
        else
        {
            chgEv_ACC_1BA_ADS_Authernticator_1BA = 0;
        }
    }
}
/*@@end*/


 
/*@@envVar:E_pubc_ACC_ACC_1BA_ADS_Reqmode_Rv:*/
on envVar E_pubc_ACC_ACC_1BA_ADS_Reqmode_Rv
{
    int64 rawValue = 0ll;
    float rawValue_float = 0.0;
    float phyValue = 0.0;        

    //set the signal with updated raw value
    if(getValue(E_pubc_ACC_ACC_1BA_ADS_Reqmode_SetVt)==0)
    {
        rawValue = getvalue(this);
        if(chgEv_ACC_1BA_ADS_Reqmode == 0)
        {
            //type conversion to float
            rawValue_float = rawValue;        
            // raw to physical conversion
            phyValue = ((rawValue_float *1)+(0));
            putValue(E_pubc_ACC_ACC_1BA_ADS_Reqmode_Pv, phyValue);
            chgEv_ACC_1BA_ADS_Reqmode = 1;
        }
        else
        {
            chgEv_ACC_1BA_ADS_Reqmode = 0;
        }    
        //update the signal value
        Msg_ACC_1BA.ADS_Reqmode=rawValue;        
    }                                                                           
}
/*@@end*/

/*@@envVar:E_pubc_ACC_ACC_1BA_ADS_Reqmode_Pv:*/
on envVar E_pubc_ACC_ACC_1BA_ADS_Reqmode_Pv
{
    int64 rawValue = 0ll;
    float phyValue = 0.0;
    
    //update the raw value with physical value 
    if(getValue(E_pubc_ACC_ACC_1BA_ADS_Reqmode_SetVt)==0)
    {
        if(chgEv_ACC_1BA_ADS_Reqmode == 0)
        {
            phyValue = getvalue(this);
            // physical to raw conversion
            rawValue = ((phyValue -(0))/1);
            putValue(E_pubc_ACC_ACC_1BA_ADS_Reqmode_Rv, rawValue);
            chgEv_ACC_1BA_ADS_Reqmode = 1;  
        }
        else
        {
            chgEv_ACC_1BA_ADS_Reqmode = 0;
        }
    }
}
/*@@end*/

/*@@envVar:E_pubc_ACC_ACC_1BA_ADS_Reqmode_Vt:*/
on envVar E_pubc_ACC_ACC_1BA_ADS_Reqmode_Vt
{
    qword rawValue = 0ll;
    if(getValue(E_pubc_ACC_ACC_1BA_ADS_Reqmode_SetVt))
    {
        //update the signal value
        Msg_ACC_1BA.ADS_Reqmode=getValue(this);
    }
}
/*@@end*/

/*@@envVar:E_pubc_ACC_ACC_1BA_ADS_Reqmode_SetVt:*/
on envVar E_pubc_ACC_ACC_1BA_ADS_Reqmode_SetVt
{
    if(getValue(E_pubc_ACC_ACC_1BA_ADS_Reqmode_SetVt))
    {
        //update the signal value
        Msg_ACC_1BA.ADS_Reqmode=getvalue(E_pubc_ACC_ACC_1BA_ADS_Reqmode_Vt);
    }
    else
    {
        Msg_ACC_1BA.ADS_Reqmode=getValue(E_pubc_ACC_ACC_1BA_ADS_Reqmode_Rv);
    }
}
/*@@end*/
 
/*@@envVar:E_pubc_ACC_ACC_1BA_ADS_MesssageCounter_1BA_Rv:*/
on envVar E_pubc_ACC_ACC_1BA_ADS_MesssageCounter_1BA_Rv
{
    int64 rawValue = 0ll;
    float rawValue_float = 0.0;
    float phyValue = 0.0;        

    //set the signal with updated raw value
    {
        rawValue = getvalue(this);
        if(chgEv_ACC_1BA_ADS_MesssageCounter_1BA == 0)
        {
            //type conversion to float
            rawValue_float = rawValue;        
            // raw to physical conversion
            phyValue = ((rawValue_float *1)+(0));
            putValue(E_pubc_ACC_ACC_1BA_ADS_MesssageCounter_1BA_Pv, phyValue);
            chgEv_ACC_1BA_ADS_MesssageCounter_1BA = 1;
        }
        else
        {
            chgEv_ACC_1BA_ADS_MesssageCounter_1BA = 0;
        }    
        //update the signal value
        Msg_ACC_1BA.ADS_MesssageCounter_1BA=rawValue;        
    }                                                                           
}
/*@@end*/

/*@@envVar:E_pubc_ACC_ACC_1BA_ADS_MesssageCounter_1BA_Pv:*/
on envVar E_pubc_ACC_ACC_1BA_ADS_MesssageCounter_1BA_Pv
{
    int64 rawValue = 0ll;
    float phyValue = 0.0;
    
    //update the raw value with physical value 
    {
        if(chgEv_ACC_1BA_ADS_MesssageCounter_1BA == 0)
        {
            phyValue = getvalue(this);
            // physical to raw conversion
            rawValue = ((phyValue -(0))/1);
            putValue(E_pubc_ACC_ACC_1BA_ADS_MesssageCounter_1BA_Rv, rawValue);
            chgEv_ACC_1BA_ADS_MesssageCounter_1BA = 1;  
        }
        else
        {
            chgEv_ACC_1BA_ADS_MesssageCounter_1BA = 0;
        }
    }
}
/*@@end*/


 
/*@@envVar:E_pubc_ACC_ACC_1BA_ACC_LatAngReqActive_Rv:*/
on envVar E_pubc_ACC_ACC_1BA_ACC_LatAngReqActive_Rv
{
    int64 rawValue = 0ll;
    float rawValue_float = 0.0;
    float phyValue = 0.0;        

    //set the signal with updated raw value
    if(getValue(E_pubc_ACC_ACC_1BA_ACC_LatAngReqActive_SetVt)==0)
    {
        rawValue = getvalue(this);
        if(chgEv_ACC_1BA_ACC_LatAngReqActive == 0)
        {
            //type conversion to float
            rawValue_float = rawValue;        
            // raw to physical conversion
            phyValue = ((rawValue_float *1)+(0));
            putValue(E_pubc_ACC_ACC_1BA_ACC_LatAngReqActive_Pv, phyValue);
            chgEv_ACC_1BA_ACC_LatAngReqActive = 1;
        }
        else
        {
            chgEv_ACC_1BA_ACC_LatAngReqActive = 0;
        }    
        //update the signal value
        Msg_ACC_1BA.ACC_LatAngReqActive=rawValue;        
    }                                                                           
}
/*@@end*/

/*@@envVar:E_pubc_ACC_ACC_1BA_ACC_LatAngReqActive_Pv:*/
on envVar E_pubc_ACC_ACC_1BA_ACC_LatAngReqActive_Pv
{
    int64 rawValue = 0ll;
    float phyValue = 0.0;
    
    //update the raw value with physical value 
    if(getValue(E_pubc_ACC_ACC_1BA_ACC_LatAngReqActive_SetVt)==0)
    {
        if(chgEv_ACC_1BA_ACC_LatAngReqActive == 0)
        {
            phyValue = getvalue(this);
            // physical to raw conversion
            rawValue = ((phyValue -(0))/1);
            putValue(E_pubc_ACC_ACC_1BA_ACC_LatAngReqActive_Rv, rawValue);
            chgEv_ACC_1BA_ACC_LatAngReqActive = 1;  
        }
        else
        {
            chgEv_ACC_1BA_ACC_LatAngReqActive = 0;
        }
    }
}
/*@@end*/

/*@@envVar:E_pubc_ACC_ACC_1BA_ACC_LatAngReqActive_Vt:*/
on envVar E_pubc_ACC_ACC_1BA_ACC_LatAngReqActive_Vt
{
    qword rawValue = 0ll;
    if(getValue(E_pubc_ACC_ACC_1BA_ACC_LatAngReqActive_SetVt))
    {
        //update the signal value
        Msg_ACC_1BA.ACC_LatAngReqActive=getValue(this);
    }
}
/*@@end*/

/*@@envVar:E_pubc_ACC_ACC_1BA_ACC_LatAngReqActive_SetVt:*/
on envVar E_pubc_ACC_ACC_1BA_ACC_LatAngReqActive_SetVt
{
    if(getValue(E_pubc_ACC_ACC_1BA_ACC_LatAngReqActive_SetVt))
    {
        //update the signal value
        Msg_ACC_1BA.ACC_LatAngReqActive=getvalue(E_pubc_ACC_ACC_1BA_ACC_LatAngReqActive_Vt);
    }
    else
    {
        Msg_ACC_1BA.ACC_LatAngReqActive=getValue(E_pubc_ACC_ACC_1BA_ACC_LatAngReqActive_Rv);
    }
}
/*@@end*/
 
/*@@envVar:E_pubc_ACC_ACC_1BA_ACC_MotorTorqueMaxLimitRequest_Rv:*/
on envVar E_pubc_ACC_ACC_1BA_ACC_MotorTorqueMaxLimitRequest_Rv
{
    int64 rawValue = 0ll;
    float rawValue_float = 0.0;
    float phyValue = 0.0;        

    //set the signal with updated raw value
    {
        rawValue = getvalue(this);
        if(chgEv_ACC_1BA_ACC_MotorTorqueMaxLimitRequest == 0)
        {
            //type conversion to float
            rawValue_float = rawValue;        
            // raw to physical conversion
            phyValue = ((rawValue_float *0.02)+(-20.48));
            putValue(E_pubc_ACC_ACC_1BA_ACC_MotorTorqueMaxLimitRequest_Pv, phyValue);
            chgEv_ACC_1BA_ACC_MotorTorqueMaxLimitRequest = 1;
        }
        else
        {
            chgEv_ACC_1BA_ACC_MotorTorqueMaxLimitRequest = 0;
        }    
        //update the signal value
        Msg_ACC_1BA.ACC_MotorTorqueMaxLimitRequest=rawValue;        
    }                                                                           
}
/*@@end*/

/*@@envVar:E_pubc_ACC_ACC_1BA_ACC_MotorTorqueMaxLimitRequest_Pv:*/
on envVar E_pubc_ACC_ACC_1BA_ACC_MotorTorqueMaxLimitRequest_Pv
{
    int64 rawValue = 0ll;
    float phyValue = 0.0;
    
    //update the raw value with physical value 
    {
        if(chgEv_ACC_1BA_ACC_MotorTorqueMaxLimitRequest == 0)
        {
            phyValue = getvalue(this);
            // physical to raw conversion
            rawValue = ((phyValue -(-20.48))/0.02);
            putValue(E_pubc_ACC_ACC_1BA_ACC_MotorTorqueMaxLimitRequest_Rv, rawValue);
            chgEv_ACC_1BA_ACC_MotorTorqueMaxLimitRequest = 1;  
        }
        else
        {
            chgEv_ACC_1BA_ACC_MotorTorqueMaxLimitRequest = 0;
        }
    }
}
/*@@end*/


 
/*@@envVar:E_pubc_ACC_ACC_1BA_ACC_MotorTorqueMinLimitRequest_Rv:*/
on envVar E_pubc_ACC_ACC_1BA_ACC_MotorTorqueMinLimitRequest_Rv
{
    int64 rawValue = 0ll;
    float rawValue_float = 0.0;
    float phyValue = 0.0;        

    //set the signal with updated raw value
    {
        rawValue = getvalue(this);
        if(chgEv_ACC_1BA_ACC_MotorTorqueMinLimitRequest == 0)
        {
            //type conversion to float
            rawValue_float = rawValue;        
            // raw to physical conversion
            phyValue = ((rawValue_float *0.02)+(-20.48));
            putValue(E_pubc_ACC_ACC_1BA_ACC_MotorTorqueMinLimitRequest_Pv, phyValue);
            chgEv_ACC_1BA_ACC_MotorTorqueMinLimitRequest = 1;
        }
        else
        {
            chgEv_ACC_1BA_ACC_MotorTorqueMinLimitRequest = 0;
        }    
        //update the signal value
        Msg_ACC_1BA.ACC_MotorTorqueMinLimitRequest=rawValue;        
    }                                                                           
}
/*@@end*/

/*@@envVar:E_pubc_ACC_ACC_1BA_ACC_MotorTorqueMinLimitRequest_Pv:*/
on envVar E_pubc_ACC_ACC_1BA_ACC_MotorTorqueMinLimitRequest_Pv
{
    int64 rawValue = 0ll;
    float phyValue = 0.0;
    
    //update the raw value with physical value 
    {
        if(chgEv_ACC_1BA_ACC_MotorTorqueMinLimitRequest == 0)
        {
            phyValue = getvalue(this);
            // physical to raw conversion
            rawValue = ((phyValue -(-20.48))/0.02);
            putValue(E_pubc_ACC_ACC_1BA_ACC_MotorTorqueMinLimitRequest_Rv, rawValue);
            chgEv_ACC_1BA_ACC_MotorTorqueMinLimitRequest = 1;  
        }
        else
        {
            chgEv_ACC_1BA_ACC_MotorTorqueMinLimitRequest = 0;
        }
    }
}
/*@@end*/


 
/*@@envVar:E_pubc_ACC_ACC_1BA_ADS_ErrorStatus_Rv:*/
on envVar E_pubc_ACC_ACC_1BA_ADS_ErrorStatus_Rv
{
    int64 rawValue = 0ll;
    float rawValue_float = 0.0;
    float phyValue = 0.0;        

    //set the signal with updated raw value
    if(getValue(E_pubc_ACC_ACC_1BA_ADS_ErrorStatus_SetVt)==0)
    {
        rawValue = getvalue(this);
        if(chgEv_ACC_1BA_ADS_ErrorStatus == 0)
        {
            //type conversion to float
            rawValue_float = rawValue;        
            // raw to physical conversion
            phyValue = ((rawValue_float *1)+(0));
            putValue(E_pubc_ACC_ACC_1BA_ADS_ErrorStatus_Pv, phyValue);
            chgEv_ACC_1BA_ADS_ErrorStatus = 1;
        }
        else
        {
            chgEv_ACC_1BA_ADS_ErrorStatus = 0;
        }    
        //update the signal value
        Msg_ACC_1BA.ADS_ErrorStatus=rawValue;        
    }                                                                           
}
/*@@end*/

/*@@envVar:E_pubc_ACC_ACC_1BA_ADS_ErrorStatus_Pv:*/
on envVar E_pubc_ACC_ACC_1BA_ADS_ErrorStatus_Pv
{
    int64 rawValue = 0ll;
    float phyValue = 0.0;
    
    //update the raw value with physical value 
    if(getValue(E_pubc_ACC_ACC_1BA_ADS_ErrorStatus_SetVt)==0)
    {
        if(chgEv_ACC_1BA_ADS_ErrorStatus == 0)
        {
            phyValue = getvalue(this);
            // physical to raw conversion
            rawValue = ((phyValue -(0))/1);
            putValue(E_pubc_ACC_ACC_1BA_ADS_ErrorStatus_Rv, rawValue);
            chgEv_ACC_1BA_ADS_ErrorStatus = 1;  
        }
        else
        {
            chgEv_ACC_1BA_ADS_ErrorStatus = 0;
        }
    }
}
/*@@end*/

/*@@envVar:E_pubc_ACC_ACC_1BA_ADS_ErrorStatus_Vt:*/
on envVar E_pubc_ACC_ACC_1BA_ADS_ErrorStatus_Vt
{
    qword rawValue = 0ll;
    if(getValue(E_pubc_ACC_ACC_1BA_ADS_ErrorStatus_SetVt))
    {
        //update the signal value
        Msg_ACC_1BA.ADS_ErrorStatus=getValue(this);
    }
}
/*@@end*/

/*@@envVar:E_pubc_ACC_ACC_1BA_ADS_ErrorStatus_SetVt:*/
on envVar E_pubc_ACC_ACC_1BA_ADS_ErrorStatus_SetVt
{
    if(getValue(E_pubc_ACC_ACC_1BA_ADS_ErrorStatus_SetVt))
    {
        //update the signal value
        Msg_ACC_1BA.ADS_ErrorStatus=getvalue(E_pubc_ACC_ACC_1BA_ADS_ErrorStatus_Vt);
    }
    else
    {
        Msg_ACC_1BA.ADS_ErrorStatus=getValue(E_pubc_ACC_ACC_1BA_ADS_ErrorStatus_Rv);
    }
}
/*@@end*/
 
/*@@envVar:E_pubc_ACC_ACC_1BA_ACC_LatAngReq_Rv:*/
on envVar E_pubc_ACC_ACC_1BA_ACC_LatAngReq_Rv
{
    int64 rawValue = 0ll;
    float rawValue_float = 0.0;
    float phyValue = 0.0;        

    //set the signal with updated raw value
    {
        rawValue = getvalue(this);
        if(chgEv_ACC_1BA_ACC_LatAngReq == 0)
        {
            //type conversion to float
            rawValue_float = rawValue;        
            // raw to physical conversion
            phyValue = ((rawValue_float *0.1)+(-720));
            putValue(E_pubc_ACC_ACC_1BA_ACC_LatAngReq_Pv, phyValue);
            chgEv_ACC_1BA_ACC_LatAngReq = 1;
        }
        else
        {
            chgEv_ACC_1BA_ACC_LatAngReq = 0;
        }    
        //update the signal value
        Msg_ACC_1BA.ACC_LatAngReq=rawValue;        
    }                                                                           
}
/*@@end*/

/*@@envVar:E_pubc_ACC_ACC_1BA_ACC_LatAngReq_Pv:*/
on envVar E_pubc_ACC_ACC_1BA_ACC_LatAngReq_Pv
{
    int64 rawValue = 0ll;
    float phyValue = 0.0;
    
    //update the raw value with physical value 
    {
        if(chgEv_ACC_1BA_ACC_LatAngReq == 0)
        {
            phyValue = getvalue(this);
            // physical to raw conversion
            rawValue = ((phyValue -(-720))/0.1);
            putValue(E_pubc_ACC_ACC_1BA_ACC_LatAngReq_Rv, rawValue);
            chgEv_ACC_1BA_ACC_LatAngReq = 1;  
        }
        else
        {
            chgEv_ACC_1BA_ACC_LatAngReq = 0;
        }
    }
}
/*@@end*/


 
/*@@envVar:E_pubc_ACC_ACC_1BA_ADS_ResetFlag_1BA_Rv:*/
on envVar E_pubc_ACC_ACC_1BA_ADS_ResetFlag_1BA_Rv
{
    int64 rawValue = 0ll;
    float rawValue_float = 0.0;
    float phyValue = 0.0;        

    //set the signal with updated raw value
    {
        rawValue = getvalue(this);
        if(chgEv_ACC_1BA_ADS_ResetFlag_1BA == 0)
        {
            //type conversion to float
            rawValue_float = rawValue;        
            // raw to physical conversion
            phyValue = ((rawValue_float *1)+(0));
            putValue(E_pubc_ACC_ACC_1BA_ADS_ResetFlag_1BA_Pv, phyValue);
            chgEv_ACC_1BA_ADS_ResetFlag_1BA = 1;
        }
        else
        {
            chgEv_ACC_1BA_ADS_ResetFlag_1BA = 0;
        }    
        //update the signal value
        Msg_ACC_1BA.ADS_ResetFlag_1BA=rawValue;        
    }                                                                           
}
/*@@end*/

/*@@envVar:E_pubc_ACC_ACC_1BA_ADS_ResetFlag_1BA_Pv:*/
on envVar E_pubc_ACC_ACC_1BA_ADS_ResetFlag_1BA_Pv
{
    int64 rawValue = 0ll;
    float phyValue = 0.0;
    
    //update the raw value with physical value 
    {
        if(chgEv_ACC_1BA_ADS_ResetFlag_1BA == 0)
        {
            phyValue = getvalue(this);
            // physical to raw conversion
            rawValue = ((phyValue -(0))/1);
            putValue(E_pubc_ACC_ACC_1BA_ADS_ResetFlag_1BA_Rv, rawValue);
            chgEv_ACC_1BA_ADS_ResetFlag_1BA = 1;  
        }
        else
        {
            chgEv_ACC_1BA_ADS_ResetFlag_1BA = 0;
        }
    }
}
/*@@end*/


 
/*@@envVar:E_pubc_ACC_ACC_307_tx:*/
on envVar E_pubc_ACC_ACC_307_tx
{
    if(getValue(this))
    {       
        
        //update the BZ Signal
        if(ACC_307_ACC_RollingCounter_307_wrongvalctr == 0)
        {
            update_ACC_307_ACC_RollingCounter_307_counter();
            Msg_ACC_307.ACC_RollingCounter_307= ACC_307_ACC_RollingCounter_307_counter;
        }
        else if(ACC_307_ACC_RollingCounter_307_wrongvalctr > 0)
        {
			ACC_307_ACC_RollingCounter_307_counter=ACC_307_ACC_RollingCounter_307_counter + ACC_307_ACC_RollingCounter_307_wrongvalctr;
			 Msg_ACC_307.ACC_RollingCounter_307= ACC_307_ACC_RollingCounter_307_counter;
            /* ACC_307_ACC_RollingCounter_307_wrongvalctr--;
              // if counter becomes zero, update panel controller to zero
             if(ACC_307_ACC_RollingCounter_307_wrongvalctr == 0)
             {
                 putValue(E_pubc_ACC_ACC_307_ACC_RollingCounter_307_wrongvalctr,0);
             } */
        }
        else
        { 
			// do nothing
        }    
        //update the BZ Signal
        if(ACC_307_ACC_RollingCounter_35E_wrongvalctr == 0)
        {
            update_ACC_307_ACC_RollingCounter_35E_counter();
            Msg_ACC_307.ACC_RollingCounter_35E= ACC_307_ACC_RollingCounter_35E_counter;
        }
        else if(ACC_307_ACC_RollingCounter_35E_wrongvalctr > 0)
        {
			ACC_307_ACC_RollingCounter_35E_counter=ACC_307_ACC_RollingCounter_35E_counter + ACC_307_ACC_RollingCounter_35E_wrongvalctr;
			 Msg_ACC_307.ACC_RollingCounter_35E= ACC_307_ACC_RollingCounter_35E_counter;
            /* ACC_307_ACC_RollingCounter_35E_wrongvalctr--;
              // if counter becomes zero, update panel controller to zero
             if(ACC_307_ACC_RollingCounter_35E_wrongvalctr == 0)
             {
                 putValue(E_pubc_ACC_ACC_307_ACC_RollingCounter_35E_wrongvalctr,0);
             } */
        }
        else
        { 
			// do nothing
        }    
        //update the BZ Signal
        if(ACC_307_ACC_RollingCounter_35F_wrongvalctr == 0)
        {
            update_ACC_307_ACC_RollingCounter_35F_counter();
            Msg_ACC_307.ACC_RollingCounter_35F= ACC_307_ACC_RollingCounter_35F_counter;
        }
        else if(ACC_307_ACC_RollingCounter_35F_wrongvalctr > 0)
        {
			ACC_307_ACC_RollingCounter_35F_counter=ACC_307_ACC_RollingCounter_35F_counter + ACC_307_ACC_RollingCounter_35F_wrongvalctr;
			 Msg_ACC_307.ACC_RollingCounter_35F= ACC_307_ACC_RollingCounter_35F_counter;
            /* ACC_307_ACC_RollingCounter_35F_wrongvalctr--;
              // if counter becomes zero, update panel controller to zero
             if(ACC_307_ACC_RollingCounter_35F_wrongvalctr == 0)
             {
                 putValue(E_pubc_ACC_ACC_307_ACC_RollingCounter_35F_wrongvalctr,0);
             } */
        }
        else
        { 
			// do nothing
        }    
        //update the BZ Signal
        if(ACC_307_ACC_RollingCounter_344_wrongvalctr == 0)
        {
            update_ACC_307_ACC_RollingCounter_344_counter();
            Msg_ACC_307.ACC_RollingCounter_344= ACC_307_ACC_RollingCounter_344_counter;
        }
        else if(ACC_307_ACC_RollingCounter_344_wrongvalctr > 0)
        {
			ACC_307_ACC_RollingCounter_344_counter=ACC_307_ACC_RollingCounter_344_counter + ACC_307_ACC_RollingCounter_344_wrongvalctr;
			 Msg_ACC_307.ACC_RollingCounter_344= ACC_307_ACC_RollingCounter_344_counter;
            /* ACC_307_ACC_RollingCounter_344_wrongvalctr--;
              // if counter becomes zero, update panel controller to zero
             if(ACC_307_ACC_RollingCounter_344_wrongvalctr == 0)
             {
                 putValue(E_pubc_ACC_ACC_307_ACC_RollingCounter_344_wrongvalctr,0);
             } */
        }
        else
        { 
			// do nothing
        }    
        //update the BZ Signal
        if(ACC_307_ACC_RollingCounter_322_wrongvalctr == 0)
        {
            update_ACC_307_ACC_RollingCounter_322_counter();
            Msg_ACC_307.ACC_RollingCounter_322= ACC_307_ACC_RollingCounter_322_counter;
        }
        else if(ACC_307_ACC_RollingCounter_322_wrongvalctr > 0)
        {
			ACC_307_ACC_RollingCounter_322_counter=ACC_307_ACC_RollingCounter_322_counter + ACC_307_ACC_RollingCounter_322_wrongvalctr;
			 Msg_ACC_307.ACC_RollingCounter_322= ACC_307_ACC_RollingCounter_322_counter;
            /* ACC_307_ACC_RollingCounter_322_wrongvalctr--;
              // if counter becomes zero, update panel controller to zero
             if(ACC_307_ACC_RollingCounter_322_wrongvalctr == 0)
             {
                 putValue(E_pubc_ACC_ACC_307_ACC_RollingCounter_322_wrongvalctr,0);
             } */
        }
        else
        { 
			// do nothing
        }    
        //calculate the CRC CheckSum
        update_ACC_307_CRC_CheckSum();

        output(Msg_ACC_307);        
    }
}
/*@@end*/

/*@@envVar:E_pubc_ACC_ACC_307_Range:*/
on envVar E_pubc_ACC_ACC_307_Range
{
    qword rawstatus = 0ll;
    qword rawValue = 0ll;    
    
    rawstatus = getvalue(this);    
    // set all the signals with min raw /max raw /init raw
    switch (rawstatus) 
    {
     case(0) :
        rawValue= 0;
        putValue(E_pubc_ACC_ACC_307_ACC_ACCEPBrequest_Rv, rawValue);
        rawValue= 0;
        putValue(E_pubc_ACC_ACC_307_ACC_TimeGapSet_Rv, rawValue);
        rawValue= 0;
        putValue(E_pubc_ACC_ACC_307_ACC_HostTargetDetection_Rv, rawValue);
        rawValue= 0;
        putValue(E_pubc_ACC_ACC_307_ACC_DistanceLevel_Rv, rawValue);
        rawValue= 0;
        putValue(E_pubc_ACC_ACC_307_ACC_TextInfoForDriver_Rv, rawValue);
        rawValue= 0;
        putValue(E_pubc_ACC_ACC_307_ACC_SaftyBeltVibrationReq_Rv, rawValue);
        rawValue= 0;
        putValue(E_pubc_ACC_ACC_307_ACC_ACCTargetLngRange_Rv, rawValue);
        rawValue= 0;
        putValue(E_pubc_ACC_ACC_307_ACC_SaftyBelt_Tightened_Rv, rawValue);
        rawValue= 0;
        putValue(E_pubc_ACC_ACC_307_ACC_ObjValid_Rv, rawValue);
        rawValue= 0;
        putValue(E_pubc_ACC_ACC_307_ACC_LngTakeOverReq_Rv, rawValue);
        rawValue= 0;
        putValue(E_pubc_ACC_ACC_307_ACC_SetSpeed_Rv, rawValue);
        rawValue= 0;
        putValue(E_pubc_ACC_ACC_307_ACC_ACCTargetType_Rv, rawValue);
        break;
     case(1) :
        rawValue= 1;
        putValue(E_pubc_ACC_ACC_307_ACC_ACCEPBrequest_Rv, rawValue);
        rawValue= 7;
        putValue(E_pubc_ACC_ACC_307_ACC_TimeGapSet_Rv, rawValue);
        rawValue= 7;
        putValue(E_pubc_ACC_ACC_307_ACC_HostTargetDetection_Rv, rawValue);
        rawValue= 7;
        putValue(E_pubc_ACC_ACC_307_ACC_DistanceLevel_Rv, rawValue);
        rawValue= 31;
        putValue(E_pubc_ACC_ACC_307_ACC_TextInfoForDriver_Rv, rawValue);
        rawValue= 1;
        putValue(E_pubc_ACC_ACC_307_ACC_SaftyBeltVibrationReq_Rv, rawValue);
        rawValue= 500;
        putValue(E_pubc_ACC_ACC_307_ACC_ACCTargetLngRange_Rv, rawValue);
        rawValue= 3;
        putValue(E_pubc_ACC_ACC_307_ACC_SaftyBelt_Tightened_Rv, rawValue);
        rawValue= 1;
        putValue(E_pubc_ACC_ACC_307_ACC_ObjValid_Rv, rawValue);
        rawValue= 3;
        putValue(E_pubc_ACC_ACC_307_ACC_LngTakeOverReq_Rv, rawValue);
        rawValue= 254;
        putValue(E_pubc_ACC_ACC_307_ACC_SetSpeed_Rv, rawValue);
        rawValue= 15;
        putValue(E_pubc_ACC_ACC_307_ACC_ACCTargetType_Rv, rawValue);
        break;
     default :
        rawValue= 0;
        putValue(E_pubc_ACC_ACC_307_ACC_ACCEPBrequest_Rv, rawValue);
        rawValue= 0;
        putValue(E_pubc_ACC_ACC_307_ACC_TimeGapSet_Rv, rawValue);
        rawValue= 0;
        putValue(E_pubc_ACC_ACC_307_ACC_HostTargetDetection_Rv, rawValue);
        rawValue= 0;
        putValue(E_pubc_ACC_ACC_307_ACC_DistanceLevel_Rv, rawValue);
        rawValue= 0;
        putValue(E_pubc_ACC_ACC_307_ACC_TextInfoForDriver_Rv, rawValue);
        rawValue= 0;
        putValue(E_pubc_ACC_ACC_307_ACC_SaftyBeltVibrationReq_Rv, rawValue);
        rawValue= 0;
        putValue(E_pubc_ACC_ACC_307_ACC_ACCTargetLngRange_Rv, rawValue);
        rawValue= 0;
        putValue(E_pubc_ACC_ACC_307_ACC_SaftyBelt_Tightened_Rv, rawValue);
        rawValue= 0;
        putValue(E_pubc_ACC_ACC_307_ACC_ObjValid_Rv, rawValue);
        rawValue= 0;
        putValue(E_pubc_ACC_ACC_307_ACC_LngTakeOverReq_Rv, rawValue);
        rawValue= 0;
        putValue(E_pubc_ACC_ACC_307_ACC_SetSpeed_Rv, rawValue);
        rawValue= 0;
        putValue(E_pubc_ACC_ACC_307_ACC_ACCTargetType_Rv, rawValue);
      break;
   }
}
/*@@end*/

/*@@envVar:E_pubc_ACC_ACC_307_Dlc:*/
on envVar E_pubc_ACC_ACC_307_Dlc
{
    if(getValue(E_pubc_ACC_ACC_307_enDlc))
    {
        Msg_ACC_307.dlc =getValue(this);
    }
    else
    {
       Dbc_dlc = 64;
	   Msg_ACC_307.dlc = Calc_Canfd_dlc(Dbc_dlc);
	   // Msg_ACC_307.dlc = 64;
	   	
  }
}
/*@@end*/

/*@@envVar:E_pubc_ACC_ACC_307_enDlc:*/
on envVar E_pubc_ACC_ACC_307_enDlc
{
    //For Messages with DLC = 8, set wrong DLC to smaller than defined DLC
    //For Messages with DLC < 8 set wrong DLC to smaller/longer than defined DLC
    if(getValue(this))
    {
        Msg_ACC_307.dlc =getValue(E_pubc_ACC_ACC_307_Dlc);
    }
    else
    {
       Dbc_dlc = 64;
	   Msg_ACC_307.dlc = Calc_Canfd_dlc(Dbc_dlc);
	   // Msg_ACC_307.dlc = 64;
    }
}
/*@@end*/

/*@@envVar:E_pubc_ACC_ACC_307_ACC_CRCCheck_307_wrongvalctr:*/
on envVar E_pubc_ACC_ACC_307_ACC_CRCCheck_307_wrongvalctr
{
    //update disturb count
    //disturb value range:(-1 = always send wrong value),( X>0 ,x is the number of Messages with wrong CHK sent)
    ACC_307_ACC_CRCCheck_307_wrongvalctr =getValue(this);    
}
/*@@end*/
/*@@envVar:E_pubc_ACC_ACC_307_ACC_CRCCheck_322_wrongvalctr:*/
on envVar E_pubc_ACC_ACC_307_ACC_CRCCheck_322_wrongvalctr
{
    //update disturb count
    //disturb value range:(-1 = always send wrong value),( X>0 ,x is the number of Messages with wrong CHK sent)
    ACC_307_ACC_CRCCheck_322_wrongvalctr =getValue(this);    
}
/*@@end*/
/*@@envVar:E_pubc_ACC_ACC_307_ACC_CRCCheck_344_wrongvalctr:*/
on envVar E_pubc_ACC_ACC_307_ACC_CRCCheck_344_wrongvalctr
{
    //update disturb count
    //disturb value range:(-1 = always send wrong value),( X>0 ,x is the number of Messages with wrong CHK sent)
    ACC_307_ACC_CRCCheck_344_wrongvalctr =getValue(this);    
}
/*@@end*/
/*@@envVar:E_pubc_ACC_ACC_307_ACC_CRCCheck_35E_wrongvalctr:*/
on envVar E_pubc_ACC_ACC_307_ACC_CRCCheck_35E_wrongvalctr
{
    //update disturb count
    //disturb value range:(-1 = always send wrong value),( X>0 ,x is the number of Messages with wrong CHK sent)
    ACC_307_ACC_CRCCheck_35E_wrongvalctr =getValue(this);    
}
/*@@end*/
/*@@envVar:E_pubc_ACC_ACC_307_ACC_CRCCheck_35F_wrongvalctr:*/
on envVar E_pubc_ACC_ACC_307_ACC_CRCCheck_35F_wrongvalctr
{
    //update disturb count
    //disturb value range:(-1 = always send wrong value),( X>0 ,x is the number of Messages with wrong CHK sent)
    ACC_307_ACC_CRCCheck_35F_wrongvalctr =getValue(this);    
}
/*@@end*/
/*@@envVar:E_pubc_ACC_ACC_307_ACC_RollingCounter_307_wrongvalctr:*/
on envVar E_pubc_ACC_ACC_307_ACC_RollingCounter_307_wrongvalctr
{
    //update disturb count
    //disturb value range:(-1 = always send wrong value),( X>0 ,x is the number of Messages with wrong CHK sent)
    ACC_307_ACC_RollingCounter_307_wrongvalctr =getValue(this);    
}
/*@@end*/
/*@@envVar:E_pubc_ACC_ACC_307_ACC_RollingCounter_322_wrongvalctr:*/
on envVar E_pubc_ACC_ACC_307_ACC_RollingCounter_322_wrongvalctr
{
    //update disturb count
    //disturb value range:(-1 = always send wrong value),( X>0 ,x is the number of Messages with wrong CHK sent)
    ACC_307_ACC_RollingCounter_322_wrongvalctr =getValue(this);    
}
/*@@end*/
/*@@envVar:E_pubc_ACC_ACC_307_ACC_RollingCounter_344_wrongvalctr:*/
on envVar E_pubc_ACC_ACC_307_ACC_RollingCounter_344_wrongvalctr
{
    //update disturb count
    //disturb value range:(-1 = always send wrong value),( X>0 ,x is the number of Messages with wrong CHK sent)
    ACC_307_ACC_RollingCounter_344_wrongvalctr =getValue(this);    
}
/*@@end*/
/*@@envVar:E_pubc_ACC_ACC_307_ACC_RollingCounter_35E_wrongvalctr:*/
on envVar E_pubc_ACC_ACC_307_ACC_RollingCounter_35E_wrongvalctr
{
    //update disturb count
    //disturb value range:(-1 = always send wrong value),( X>0 ,x is the number of Messages with wrong CHK sent)
    ACC_307_ACC_RollingCounter_35E_wrongvalctr =getValue(this);    
}
/*@@end*/
/*@@envVar:E_pubc_ACC_ACC_307_ACC_RollingCounter_35F_wrongvalctr:*/
on envVar E_pubc_ACC_ACC_307_ACC_RollingCounter_35F_wrongvalctr
{
    //update disturb count
    //disturb value range:(-1 = always send wrong value),( X>0 ,x is the number of Messages with wrong CHK sent)
    ACC_307_ACC_RollingCounter_35F_wrongvalctr =getValue(this);    
}
/*@@end*/

/*@@envVar:E_pubc_ACC_ACC_307_ACC_ACCEPBrequest_Rv:*/
on envVar E_pubc_ACC_ACC_307_ACC_ACCEPBrequest_Rv
{
    int64 rawValue = 0ll;
    float rawValue_float = 0.0;
    float phyValue = 0.0;        

    //set the signal with updated raw value
    if(getValue(E_pubc_ACC_ACC_307_ACC_ACCEPBrequest_SetVt)==0)
    {
        rawValue = getvalue(this);
        if(chgEv_ACC_307_ACC_ACCEPBrequest == 0)
        {
            //type conversion to float
            rawValue_float = rawValue;        
            // raw to physical conversion
            phyValue = ((rawValue_float *1)+(0));
            putValue(E_pubc_ACC_ACC_307_ACC_ACCEPBrequest_Pv, phyValue);
            chgEv_ACC_307_ACC_ACCEPBrequest = 1;
        }
        else
        {
            chgEv_ACC_307_ACC_ACCEPBrequest = 0;
        }    
        //update the signal value
        Msg_ACC_307.ACC_ACCEPBrequest=rawValue;        
    }                                                                           
}
/*@@end*/

/*@@envVar:E_pubc_ACC_ACC_307_ACC_ACCEPBrequest_Pv:*/
on envVar E_pubc_ACC_ACC_307_ACC_ACCEPBrequest_Pv
{
    int64 rawValue = 0ll;
    float phyValue = 0.0;
    
    //update the raw value with physical value 
    if(getValue(E_pubc_ACC_ACC_307_ACC_ACCEPBrequest_SetVt)==0)
    {
        if(chgEv_ACC_307_ACC_ACCEPBrequest == 0)
        {
            phyValue = getvalue(this);
            // physical to raw conversion
            rawValue = ((phyValue -(0))/1);
            putValue(E_pubc_ACC_ACC_307_ACC_ACCEPBrequest_Rv, rawValue);
            chgEv_ACC_307_ACC_ACCEPBrequest = 1;  
        }
        else
        {
            chgEv_ACC_307_ACC_ACCEPBrequest = 0;
        }
    }
}
/*@@end*/

/*@@envVar:E_pubc_ACC_ACC_307_ACC_ACCEPBrequest_Vt:*/
on envVar E_pubc_ACC_ACC_307_ACC_ACCEPBrequest_Vt
{
    qword rawValue = 0ll;
    if(getValue(E_pubc_ACC_ACC_307_ACC_ACCEPBrequest_SetVt))
    {
        //update the signal value
        Msg_ACC_307.ACC_ACCEPBrequest=getValue(this);
    }
}
/*@@end*/

/*@@envVar:E_pubc_ACC_ACC_307_ACC_ACCEPBrequest_SetVt:*/
on envVar E_pubc_ACC_ACC_307_ACC_ACCEPBrequest_SetVt
{
    if(getValue(E_pubc_ACC_ACC_307_ACC_ACCEPBrequest_SetVt))
    {
        //update the signal value
        Msg_ACC_307.ACC_ACCEPBrequest=getvalue(E_pubc_ACC_ACC_307_ACC_ACCEPBrequest_Vt);
    }
    else
    {
        Msg_ACC_307.ACC_ACCEPBrequest=getValue(E_pubc_ACC_ACC_307_ACC_ACCEPBrequest_Rv);
    }
}
/*@@end*/
 
/*@@envVar:E_pubc_ACC_ACC_307_ACC_TimeGapSet_Rv:*/
on envVar E_pubc_ACC_ACC_307_ACC_TimeGapSet_Rv
{
    int64 rawValue = 0ll;
    float rawValue_float = 0.0;
    float phyValue = 0.0;        

    //set the signal with updated raw value
    if(getValue(E_pubc_ACC_ACC_307_ACC_TimeGapSet_SetVt)==0)
    {
        rawValue = getvalue(this);
        if(chgEv_ACC_307_ACC_TimeGapSet == 0)
        {
            //type conversion to float
            rawValue_float = rawValue;        
            // raw to physical conversion
            phyValue = ((rawValue_float *1)+(0));
            putValue(E_pubc_ACC_ACC_307_ACC_TimeGapSet_Pv, phyValue);
            chgEv_ACC_307_ACC_TimeGapSet = 1;
        }
        else
        {
            chgEv_ACC_307_ACC_TimeGapSet = 0;
        }    
        //update the signal value
        Msg_ACC_307.ACC_TimeGapSet=rawValue;        
    }                                                                           
}
/*@@end*/

/*@@envVar:E_pubc_ACC_ACC_307_ACC_TimeGapSet_Pv:*/
on envVar E_pubc_ACC_ACC_307_ACC_TimeGapSet_Pv
{
    int64 rawValue = 0ll;
    float phyValue = 0.0;
    
    //update the raw value with physical value 
    if(getValue(E_pubc_ACC_ACC_307_ACC_TimeGapSet_SetVt)==0)
    {
        if(chgEv_ACC_307_ACC_TimeGapSet == 0)
        {
            phyValue = getvalue(this);
            // physical to raw conversion
            rawValue = ((phyValue -(0))/1);
            putValue(E_pubc_ACC_ACC_307_ACC_TimeGapSet_Rv, rawValue);
            chgEv_ACC_307_ACC_TimeGapSet = 1;  
        }
        else
        {
            chgEv_ACC_307_ACC_TimeGapSet = 0;
        }
    }
}
/*@@end*/

/*@@envVar:E_pubc_ACC_ACC_307_ACC_TimeGapSet_Vt:*/
on envVar E_pubc_ACC_ACC_307_ACC_TimeGapSet_Vt
{
    qword rawValue = 0ll;
    if(getValue(E_pubc_ACC_ACC_307_ACC_TimeGapSet_SetVt))
    {
        //update the signal value
        Msg_ACC_307.ACC_TimeGapSet=getValue(this);
    }
}
/*@@end*/

/*@@envVar:E_pubc_ACC_ACC_307_ACC_TimeGapSet_SetVt:*/
on envVar E_pubc_ACC_ACC_307_ACC_TimeGapSet_SetVt
{
    if(getValue(E_pubc_ACC_ACC_307_ACC_TimeGapSet_SetVt))
    {
        //update the signal value
        Msg_ACC_307.ACC_TimeGapSet=getvalue(E_pubc_ACC_ACC_307_ACC_TimeGapSet_Vt);
    }
    else
    {
        Msg_ACC_307.ACC_TimeGapSet=getValue(E_pubc_ACC_ACC_307_ACC_TimeGapSet_Rv);
    }
}
/*@@end*/
 
/*@@envVar:E_pubc_ACC_ACC_307_ACC_HostTargetDetection_Rv:*/
on envVar E_pubc_ACC_ACC_307_ACC_HostTargetDetection_Rv
{
    int64 rawValue = 0ll;
    float rawValue_float = 0.0;
    float phyValue = 0.0;        

    //set the signal with updated raw value
    if(getValue(E_pubc_ACC_ACC_307_ACC_HostTargetDetection_SetVt)==0)
    {
        rawValue = getvalue(this);
        if(chgEv_ACC_307_ACC_HostTargetDetection == 0)
        {
            //type conversion to float
            rawValue_float = rawValue;        
            // raw to physical conversion
            phyValue = ((rawValue_float *1)+(0));
            putValue(E_pubc_ACC_ACC_307_ACC_HostTargetDetection_Pv, phyValue);
            chgEv_ACC_307_ACC_HostTargetDetection = 1;
        }
        else
        {
            chgEv_ACC_307_ACC_HostTargetDetection = 0;
        }    
        //update the signal value
        Msg_ACC_307.ACC_HostTargetDetection=rawValue;        
    }                                                                           
}
/*@@end*/

/*@@envVar:E_pubc_ACC_ACC_307_ACC_HostTargetDetection_Pv:*/
on envVar E_pubc_ACC_ACC_307_ACC_HostTargetDetection_Pv
{
    int64 rawValue = 0ll;
    float phyValue = 0.0;
    
    //update the raw value with physical value 
    if(getValue(E_pubc_ACC_ACC_307_ACC_HostTargetDetection_SetVt)==0)
    {
        if(chgEv_ACC_307_ACC_HostTargetDetection == 0)
        {
            phyValue = getvalue(this);
            // physical to raw conversion
            rawValue = ((phyValue -(0))/1);
            putValue(E_pubc_ACC_ACC_307_ACC_HostTargetDetection_Rv, rawValue);
            chgEv_ACC_307_ACC_HostTargetDetection = 1;  
        }
        else
        {
            chgEv_ACC_307_ACC_HostTargetDetection = 0;
        }
    }
}
/*@@end*/

/*@@envVar:E_pubc_ACC_ACC_307_ACC_HostTargetDetection_Vt:*/
on envVar E_pubc_ACC_ACC_307_ACC_HostTargetDetection_Vt
{
    qword rawValue = 0ll;
    if(getValue(E_pubc_ACC_ACC_307_ACC_HostTargetDetection_SetVt))
    {
        //update the signal value
        Msg_ACC_307.ACC_HostTargetDetection=getValue(this);
    }
}
/*@@end*/

/*@@envVar:E_pubc_ACC_ACC_307_ACC_HostTargetDetection_SetVt:*/
on envVar E_pubc_ACC_ACC_307_ACC_HostTargetDetection_SetVt
{
    if(getValue(E_pubc_ACC_ACC_307_ACC_HostTargetDetection_SetVt))
    {
        //update the signal value
        Msg_ACC_307.ACC_HostTargetDetection=getvalue(E_pubc_ACC_ACC_307_ACC_HostTargetDetection_Vt);
    }
    else
    {
        Msg_ACC_307.ACC_HostTargetDetection=getValue(E_pubc_ACC_ACC_307_ACC_HostTargetDetection_Rv);
    }
}
/*@@end*/
 
/*@@envVar:E_pubc_ACC_ACC_307_ACC_DistanceLevel_Rv:*/
on envVar E_pubc_ACC_ACC_307_ACC_DistanceLevel_Rv
{
    int64 rawValue = 0ll;
    float rawValue_float = 0.0;
    float phyValue = 0.0;        

    //set the signal with updated raw value
    if(getValue(E_pubc_ACC_ACC_307_ACC_DistanceLevel_SetVt)==0)
    {
        rawValue = getvalue(this);
        if(chgEv_ACC_307_ACC_DistanceLevel == 0)
        {
            //type conversion to float
            rawValue_float = rawValue;        
            // raw to physical conversion
            phyValue = ((rawValue_float *1)+(0));
            putValue(E_pubc_ACC_ACC_307_ACC_DistanceLevel_Pv, phyValue);
            chgEv_ACC_307_ACC_DistanceLevel = 1;
        }
        else
        {
            chgEv_ACC_307_ACC_DistanceLevel = 0;
        }    
        //update the signal value
        Msg_ACC_307.ACC_DistanceLevel=rawValue;        
    }                                                                           
}
/*@@end*/

/*@@envVar:E_pubc_ACC_ACC_307_ACC_DistanceLevel_Pv:*/
on envVar E_pubc_ACC_ACC_307_ACC_DistanceLevel_Pv
{
    int64 rawValue = 0ll;
    float phyValue = 0.0;
    
    //update the raw value with physical value 
    if(getValue(E_pubc_ACC_ACC_307_ACC_DistanceLevel_SetVt)==0)
    {
        if(chgEv_ACC_307_ACC_DistanceLevel == 0)
        {
            phyValue = getvalue(this);
            // physical to raw conversion
            rawValue = ((phyValue -(0))/1);
            putValue(E_pubc_ACC_ACC_307_ACC_DistanceLevel_Rv, rawValue);
            chgEv_ACC_307_ACC_DistanceLevel = 1;  
        }
        else
        {
            chgEv_ACC_307_ACC_DistanceLevel = 0;
        }
    }
}
/*@@end*/

/*@@envVar:E_pubc_ACC_ACC_307_ACC_DistanceLevel_Vt:*/
on envVar E_pubc_ACC_ACC_307_ACC_DistanceLevel_Vt
{
    qword rawValue = 0ll;
    if(getValue(E_pubc_ACC_ACC_307_ACC_DistanceLevel_SetVt))
    {
        //update the signal value
        Msg_ACC_307.ACC_DistanceLevel=getValue(this);
    }
}
/*@@end*/

/*@@envVar:E_pubc_ACC_ACC_307_ACC_DistanceLevel_SetVt:*/
on envVar E_pubc_ACC_ACC_307_ACC_DistanceLevel_SetVt
{
    if(getValue(E_pubc_ACC_ACC_307_ACC_DistanceLevel_SetVt))
    {
        //update the signal value
        Msg_ACC_307.ACC_DistanceLevel=getvalue(E_pubc_ACC_ACC_307_ACC_DistanceLevel_Vt);
    }
    else
    {
        Msg_ACC_307.ACC_DistanceLevel=getValue(E_pubc_ACC_ACC_307_ACC_DistanceLevel_Rv);
    }
}
/*@@end*/
 
/*@@envVar:E_pubc_ACC_ACC_307_ACC_TextInfoForDriver_Rv:*/
on envVar E_pubc_ACC_ACC_307_ACC_TextInfoForDriver_Rv
{
    int64 rawValue = 0ll;
    float rawValue_float = 0.0;
    float phyValue = 0.0;        

    //set the signal with updated raw value
    if(getValue(E_pubc_ACC_ACC_307_ACC_TextInfoForDriver_SetVt)==0)
    {
        rawValue = getvalue(this);
        if(chgEv_ACC_307_ACC_TextInfoForDriver == 0)
        {
            //type conversion to float
            rawValue_float = rawValue;        
            // raw to physical conversion
            phyValue = ((rawValue_float *1)+(0));
            putValue(E_pubc_ACC_ACC_307_ACC_TextInfoForDriver_Pv, phyValue);
            chgEv_ACC_307_ACC_TextInfoForDriver = 1;
        }
        else
        {
            chgEv_ACC_307_ACC_TextInfoForDriver = 0;
        }    
        //update the signal value
        Msg_ACC_307.ACC_TextInfoForDriver=rawValue;        
    }                                                                           
}
/*@@end*/

/*@@envVar:E_pubc_ACC_ACC_307_ACC_TextInfoForDriver_Pv:*/
on envVar E_pubc_ACC_ACC_307_ACC_TextInfoForDriver_Pv
{
    int64 rawValue = 0ll;
    float phyValue = 0.0;
    
    //update the raw value with physical value 
    if(getValue(E_pubc_ACC_ACC_307_ACC_TextInfoForDriver_SetVt)==0)
    {
        if(chgEv_ACC_307_ACC_TextInfoForDriver == 0)
        {
            phyValue = getvalue(this);
            // physical to raw conversion
            rawValue = ((phyValue -(0))/1);
            putValue(E_pubc_ACC_ACC_307_ACC_TextInfoForDriver_Rv, rawValue);
            chgEv_ACC_307_ACC_TextInfoForDriver = 1;  
        }
        else
        {
            chgEv_ACC_307_ACC_TextInfoForDriver = 0;
        }
    }
}
/*@@end*/

/*@@envVar:E_pubc_ACC_ACC_307_ACC_TextInfoForDriver_Vt:*/
on envVar E_pubc_ACC_ACC_307_ACC_TextInfoForDriver_Vt
{
    qword rawValue = 0ll;
    if(getValue(E_pubc_ACC_ACC_307_ACC_TextInfoForDriver_SetVt))
    {
        //update the signal value
        Msg_ACC_307.ACC_TextInfoForDriver=getValue(this);
    }
}
/*@@end*/

/*@@envVar:E_pubc_ACC_ACC_307_ACC_TextInfoForDriver_SetVt:*/
on envVar E_pubc_ACC_ACC_307_ACC_TextInfoForDriver_SetVt
{
    if(getValue(E_pubc_ACC_ACC_307_ACC_TextInfoForDriver_SetVt))
    {
        //update the signal value
        Msg_ACC_307.ACC_TextInfoForDriver=getvalue(E_pubc_ACC_ACC_307_ACC_TextInfoForDriver_Vt);
    }
    else
    {
        Msg_ACC_307.ACC_TextInfoForDriver=getValue(E_pubc_ACC_ACC_307_ACC_TextInfoForDriver_Rv);
    }
}
/*@@end*/
 
/*@@envVar:E_pubc_ACC_ACC_307_ACC_SaftyBeltVibrationReq_Rv:*/
on envVar E_pubc_ACC_ACC_307_ACC_SaftyBeltVibrationReq_Rv
{
    int64 rawValue = 0ll;
    float rawValue_float = 0.0;
    float phyValue = 0.0;        

    //set the signal with updated raw value
    if(getValue(E_pubc_ACC_ACC_307_ACC_SaftyBeltVibrationReq_SetVt)==0)
    {
        rawValue = getvalue(this);
        if(chgEv_ACC_307_ACC_SaftyBeltVibrationReq == 0)
        {
            //type conversion to float
            rawValue_float = rawValue;        
            // raw to physical conversion
            phyValue = ((rawValue_float *1)+(0));
            putValue(E_pubc_ACC_ACC_307_ACC_SaftyBeltVibrationReq_Pv, phyValue);
            chgEv_ACC_307_ACC_SaftyBeltVibrationReq = 1;
        }
        else
        {
            chgEv_ACC_307_ACC_SaftyBeltVibrationReq = 0;
        }    
        //update the signal value
        Msg_ACC_307.ACC_SaftyBeltVibrationReq=rawValue;        
    }                                                                           
}
/*@@end*/

/*@@envVar:E_pubc_ACC_ACC_307_ACC_SaftyBeltVibrationReq_Pv:*/
on envVar E_pubc_ACC_ACC_307_ACC_SaftyBeltVibrationReq_Pv
{
    int64 rawValue = 0ll;
    float phyValue = 0.0;
    
    //update the raw value with physical value 
    if(getValue(E_pubc_ACC_ACC_307_ACC_SaftyBeltVibrationReq_SetVt)==0)
    {
        if(chgEv_ACC_307_ACC_SaftyBeltVibrationReq == 0)
        {
            phyValue = getvalue(this);
            // physical to raw conversion
            rawValue = ((phyValue -(0))/1);
            putValue(E_pubc_ACC_ACC_307_ACC_SaftyBeltVibrationReq_Rv, rawValue);
            chgEv_ACC_307_ACC_SaftyBeltVibrationReq = 1;  
        }
        else
        {
            chgEv_ACC_307_ACC_SaftyBeltVibrationReq = 0;
        }
    }
}
/*@@end*/

/*@@envVar:E_pubc_ACC_ACC_307_ACC_SaftyBeltVibrationReq_Vt:*/
on envVar E_pubc_ACC_ACC_307_ACC_SaftyBeltVibrationReq_Vt
{
    qword rawValue = 0ll;
    if(getValue(E_pubc_ACC_ACC_307_ACC_SaftyBeltVibrationReq_SetVt))
    {
        //update the signal value
        Msg_ACC_307.ACC_SaftyBeltVibrationReq=getValue(this);
    }
}
/*@@end*/

/*@@envVar:E_pubc_ACC_ACC_307_ACC_SaftyBeltVibrationReq_SetVt:*/
on envVar E_pubc_ACC_ACC_307_ACC_SaftyBeltVibrationReq_SetVt
{
    if(getValue(E_pubc_ACC_ACC_307_ACC_SaftyBeltVibrationReq_SetVt))
    {
        //update the signal value
        Msg_ACC_307.ACC_SaftyBeltVibrationReq=getvalue(E_pubc_ACC_ACC_307_ACC_SaftyBeltVibrationReq_Vt);
    }
    else
    {
        Msg_ACC_307.ACC_SaftyBeltVibrationReq=getValue(E_pubc_ACC_ACC_307_ACC_SaftyBeltVibrationReq_Rv);
    }
}
/*@@end*/
 
/*@@envVar:E_pubc_ACC_ACC_307_ACC_ACCTargetLngRange_Rv:*/
on envVar E_pubc_ACC_ACC_307_ACC_ACCTargetLngRange_Rv
{
    int64 rawValue = 0ll;
    float rawValue_float = 0.0;
    float phyValue = 0.0;        

    //set the signal with updated raw value
    {
        rawValue = getvalue(this);
        if(chgEv_ACC_307_ACC_ACCTargetLngRange == 0)
        {
            //type conversion to float
            rawValue_float = rawValue;        
            // raw to physical conversion
            phyValue = ((rawValue_float *0.5)+(-70));
            putValue(E_pubc_ACC_ACC_307_ACC_ACCTargetLngRange_Pv, phyValue);
            chgEv_ACC_307_ACC_ACCTargetLngRange = 1;
        }
        else
        {
            chgEv_ACC_307_ACC_ACCTargetLngRange = 0;
        }    
        //update the signal value
        Msg_ACC_307.ACC_ACCTargetLngRange=rawValue;        
    }                                                                           
}
/*@@end*/

/*@@envVar:E_pubc_ACC_ACC_307_ACC_ACCTargetLngRange_Pv:*/
on envVar E_pubc_ACC_ACC_307_ACC_ACCTargetLngRange_Pv
{
    int64 rawValue = 0ll;
    float phyValue = 0.0;
    
    //update the raw value with physical value 
    {
        if(chgEv_ACC_307_ACC_ACCTargetLngRange == 0)
        {
            phyValue = getvalue(this);
            // physical to raw conversion
            rawValue = ((phyValue -(-70))/0.5);
            putValue(E_pubc_ACC_ACC_307_ACC_ACCTargetLngRange_Rv, rawValue);
            chgEv_ACC_307_ACC_ACCTargetLngRange = 1;  
        }
        else
        {
            chgEv_ACC_307_ACC_ACCTargetLngRange = 0;
        }
    }
}
/*@@end*/


 
/*@@envVar:E_pubc_ACC_ACC_307_ACC_SaftyBelt_Tightened_Rv:*/
on envVar E_pubc_ACC_ACC_307_ACC_SaftyBelt_Tightened_Rv
{
    int64 rawValue = 0ll;
    float rawValue_float = 0.0;
    float phyValue = 0.0;        

    //set the signal with updated raw value
    if(getValue(E_pubc_ACC_ACC_307_ACC_SaftyBelt_Tightened_SetVt)==0)
    {
        rawValue = getvalue(this);
        if(chgEv_ACC_307_ACC_SaftyBelt_Tightened == 0)
        {
            //type conversion to float
            rawValue_float = rawValue;        
            // raw to physical conversion
            phyValue = ((rawValue_float *1)+(0));
            putValue(E_pubc_ACC_ACC_307_ACC_SaftyBelt_Tightened_Pv, phyValue);
            chgEv_ACC_307_ACC_SaftyBelt_Tightened = 1;
        }
        else
        {
            chgEv_ACC_307_ACC_SaftyBelt_Tightened = 0;
        }    
        //update the signal value
        Msg_ACC_307.ACC_SaftyBelt_Tightened=rawValue;        
    }                                                                           
}
/*@@end*/

/*@@envVar:E_pubc_ACC_ACC_307_ACC_SaftyBelt_Tightened_Pv:*/
on envVar E_pubc_ACC_ACC_307_ACC_SaftyBelt_Tightened_Pv
{
    int64 rawValue = 0ll;
    float phyValue = 0.0;
    
    //update the raw value with physical value 
    if(getValue(E_pubc_ACC_ACC_307_ACC_SaftyBelt_Tightened_SetVt)==0)
    {
        if(chgEv_ACC_307_ACC_SaftyBelt_Tightened == 0)
        {
            phyValue = getvalue(this);
            // physical to raw conversion
            rawValue = ((phyValue -(0))/1);
            putValue(E_pubc_ACC_ACC_307_ACC_SaftyBelt_Tightened_Rv, rawValue);
            chgEv_ACC_307_ACC_SaftyBelt_Tightened = 1;  
        }
        else
        {
            chgEv_ACC_307_ACC_SaftyBelt_Tightened = 0;
        }
    }
}
/*@@end*/

/*@@envVar:E_pubc_ACC_ACC_307_ACC_SaftyBelt_Tightened_Vt:*/
on envVar E_pubc_ACC_ACC_307_ACC_SaftyBelt_Tightened_Vt
{
    qword rawValue = 0ll;
    if(getValue(E_pubc_ACC_ACC_307_ACC_SaftyBelt_Tightened_SetVt))
    {
        //update the signal value
        Msg_ACC_307.ACC_SaftyBelt_Tightened=getValue(this);
    }
}
/*@@end*/

/*@@envVar:E_pubc_ACC_ACC_307_ACC_SaftyBelt_Tightened_SetVt:*/
on envVar E_pubc_ACC_ACC_307_ACC_SaftyBelt_Tightened_SetVt
{
    if(getValue(E_pubc_ACC_ACC_307_ACC_SaftyBelt_Tightened_SetVt))
    {
        //update the signal value
        Msg_ACC_307.ACC_SaftyBelt_Tightened=getvalue(E_pubc_ACC_ACC_307_ACC_SaftyBelt_Tightened_Vt);
    }
    else
    {
        Msg_ACC_307.ACC_SaftyBelt_Tightened=getValue(E_pubc_ACC_ACC_307_ACC_SaftyBelt_Tightened_Rv);
    }
}
/*@@end*/
 
/*@@envVar:E_pubc_ACC_ACC_307_ACC_ObjValid_Rv:*/
on envVar E_pubc_ACC_ACC_307_ACC_ObjValid_Rv
{
    int64 rawValue = 0ll;
    float rawValue_float = 0.0;
    float phyValue = 0.0;        

    //set the signal with updated raw value
    if(getValue(E_pubc_ACC_ACC_307_ACC_ObjValid_SetVt)==0)
    {
        rawValue = getvalue(this);
        if(chgEv_ACC_307_ACC_ObjValid == 0)
        {
            //type conversion to float
            rawValue_float = rawValue;        
            // raw to physical conversion
            phyValue = ((rawValue_float *1)+(0));
            putValue(E_pubc_ACC_ACC_307_ACC_ObjValid_Pv, phyValue);
            chgEv_ACC_307_ACC_ObjValid = 1;
        }
        else
        {
            chgEv_ACC_307_ACC_ObjValid = 0;
        }    
        //update the signal value
        Msg_ACC_307.ACC_ObjValid=rawValue;        
    }                                                                           
}
/*@@end*/

/*@@envVar:E_pubc_ACC_ACC_307_ACC_ObjValid_Pv:*/
on envVar E_pubc_ACC_ACC_307_ACC_ObjValid_Pv
{
    int64 rawValue = 0ll;
    float phyValue = 0.0;
    
    //update the raw value with physical value 
    if(getValue(E_pubc_ACC_ACC_307_ACC_ObjValid_SetVt)==0)
    {
        if(chgEv_ACC_307_ACC_ObjValid == 0)
        {
            phyValue = getvalue(this);
            // physical to raw conversion
            rawValue = ((phyValue -(0))/1);
            putValue(E_pubc_ACC_ACC_307_ACC_ObjValid_Rv, rawValue);
            chgEv_ACC_307_ACC_ObjValid = 1;  
        }
        else
        {
            chgEv_ACC_307_ACC_ObjValid = 0;
        }
    }
}
/*@@end*/

/*@@envVar:E_pubc_ACC_ACC_307_ACC_ObjValid_Vt:*/
on envVar E_pubc_ACC_ACC_307_ACC_ObjValid_Vt
{
    qword rawValue = 0ll;
    if(getValue(E_pubc_ACC_ACC_307_ACC_ObjValid_SetVt))
    {
        //update the signal value
        Msg_ACC_307.ACC_ObjValid=getValue(this);
    }
}
/*@@end*/

/*@@envVar:E_pubc_ACC_ACC_307_ACC_ObjValid_SetVt:*/
on envVar E_pubc_ACC_ACC_307_ACC_ObjValid_SetVt
{
    if(getValue(E_pubc_ACC_ACC_307_ACC_ObjValid_SetVt))
    {
        //update the signal value
        Msg_ACC_307.ACC_ObjValid=getvalue(E_pubc_ACC_ACC_307_ACC_ObjValid_Vt);
    }
    else
    {
        Msg_ACC_307.ACC_ObjValid=getValue(E_pubc_ACC_ACC_307_ACC_ObjValid_Rv);
    }
}
/*@@end*/
 
/*@@envVar:E_pubc_ACC_ACC_307_ACC_LngTakeOverReq_Rv:*/
on envVar E_pubc_ACC_ACC_307_ACC_LngTakeOverReq_Rv
{
    int64 rawValue = 0ll;
    float rawValue_float = 0.0;
    float phyValue = 0.0;        

    //set the signal with updated raw value
    if(getValue(E_pubc_ACC_ACC_307_ACC_LngTakeOverReq_SetVt)==0)
    {
        rawValue = getvalue(this);
        if(chgEv_ACC_307_ACC_LngTakeOverReq == 0)
        {
            //type conversion to float
            rawValue_float = rawValue;        
            // raw to physical conversion
            phyValue = ((rawValue_float *1)+(0));
            putValue(E_pubc_ACC_ACC_307_ACC_LngTakeOverReq_Pv, phyValue);
            chgEv_ACC_307_ACC_LngTakeOverReq = 1;
        }
        else
        {
            chgEv_ACC_307_ACC_LngTakeOverReq = 0;
        }    
        //update the signal value
        Msg_ACC_307.ACC_LngTakeOverReq=rawValue;        
    }                                                                           
}
/*@@end*/

/*@@envVar:E_pubc_ACC_ACC_307_ACC_LngTakeOverReq_Pv:*/
on envVar E_pubc_ACC_ACC_307_ACC_LngTakeOverReq_Pv
{
    int64 rawValue = 0ll;
    float phyValue = 0.0;
    
    //update the raw value with physical value 
    if(getValue(E_pubc_ACC_ACC_307_ACC_LngTakeOverReq_SetVt)==0)
    {
        if(chgEv_ACC_307_ACC_LngTakeOverReq == 0)
        {
            phyValue = getvalue(this);
            // physical to raw conversion
            rawValue = ((phyValue -(0))/1);
            putValue(E_pubc_ACC_ACC_307_ACC_LngTakeOverReq_Rv, rawValue);
            chgEv_ACC_307_ACC_LngTakeOverReq = 1;  
        }
        else
        {
            chgEv_ACC_307_ACC_LngTakeOverReq = 0;
        }
    }
}
/*@@end*/

/*@@envVar:E_pubc_ACC_ACC_307_ACC_LngTakeOverReq_Vt:*/
on envVar E_pubc_ACC_ACC_307_ACC_LngTakeOverReq_Vt
{
    qword rawValue = 0ll;
    if(getValue(E_pubc_ACC_ACC_307_ACC_LngTakeOverReq_SetVt))
    {
        //update the signal value
        Msg_ACC_307.ACC_LngTakeOverReq=getValue(this);
    }
}
/*@@end*/

/*@@envVar:E_pubc_ACC_ACC_307_ACC_LngTakeOverReq_SetVt:*/
on envVar E_pubc_ACC_ACC_307_ACC_LngTakeOverReq_SetVt
{
    if(getValue(E_pubc_ACC_ACC_307_ACC_LngTakeOverReq_SetVt))
    {
        //update the signal value
        Msg_ACC_307.ACC_LngTakeOverReq=getvalue(E_pubc_ACC_ACC_307_ACC_LngTakeOverReq_Vt);
    }
    else
    {
        Msg_ACC_307.ACC_LngTakeOverReq=getValue(E_pubc_ACC_ACC_307_ACC_LngTakeOverReq_Rv);
    }
}
/*@@end*/
 
/*@@envVar:E_pubc_ACC_ACC_307_ACC_SetSpeed_Rv:*/
on envVar E_pubc_ACC_ACC_307_ACC_SetSpeed_Rv
{
    int64 rawValue = 0ll;
    float rawValue_float = 0.0;
    float phyValue = 0.0;        

    //set the signal with updated raw value
    {
        rawValue = getvalue(this);
        if(chgEv_ACC_307_ACC_SetSpeed == 0)
        {
            //type conversion to float
            rawValue_float = rawValue;        
            // raw to physical conversion
            phyValue = ((rawValue_float *1)+(0));
            putValue(E_pubc_ACC_ACC_307_ACC_SetSpeed_Pv, phyValue);
            chgEv_ACC_307_ACC_SetSpeed = 1;
        }
        else
        {
            chgEv_ACC_307_ACC_SetSpeed = 0;
        }    
        //update the signal value
        Msg_ACC_307.ACC_SetSpeed=rawValue;        
    }                                                                           
}
/*@@end*/

/*@@envVar:E_pubc_ACC_ACC_307_ACC_SetSpeed_Pv:*/
on envVar E_pubc_ACC_ACC_307_ACC_SetSpeed_Pv
{
    int64 rawValue = 0ll;
    float phyValue = 0.0;
    
    //update the raw value with physical value 
    {
        if(chgEv_ACC_307_ACC_SetSpeed == 0)
        {
            phyValue = getvalue(this);
            // physical to raw conversion
            rawValue = ((phyValue -(0))/1);
            putValue(E_pubc_ACC_ACC_307_ACC_SetSpeed_Rv, rawValue);
            chgEv_ACC_307_ACC_SetSpeed = 1;  
        }
        else
        {
            chgEv_ACC_307_ACC_SetSpeed = 0;
        }
    }
}
/*@@end*/


 
/*@@envVar:E_pubc_ACC_ACC_307_ACC_ACCTargetType_Rv:*/
on envVar E_pubc_ACC_ACC_307_ACC_ACCTargetType_Rv
{
    int64 rawValue = 0ll;
    float rawValue_float = 0.0;
    float phyValue = 0.0;        

    //set the signal with updated raw value
    if(getValue(E_pubc_ACC_ACC_307_ACC_ACCTargetType_SetVt)==0)
    {
        rawValue = getvalue(this);
        if(chgEv_ACC_307_ACC_ACCTargetType == 0)
        {
            //type conversion to float
            rawValue_float = rawValue;        
            // raw to physical conversion
            phyValue = ((rawValue_float *1)+(0));
            putValue(E_pubc_ACC_ACC_307_ACC_ACCTargetType_Pv, phyValue);
            chgEv_ACC_307_ACC_ACCTargetType = 1;
        }
        else
        {
            chgEv_ACC_307_ACC_ACCTargetType = 0;
        }    
        //update the signal value
        Msg_ACC_307.ACC_ACCTargetType=rawValue;        
    }                                                                           
}
/*@@end*/

/*@@envVar:E_pubc_ACC_ACC_307_ACC_ACCTargetType_Pv:*/
on envVar E_pubc_ACC_ACC_307_ACC_ACCTargetType_Pv
{
    int64 rawValue = 0ll;
    float phyValue = 0.0;
    
    //update the raw value with physical value 
    if(getValue(E_pubc_ACC_ACC_307_ACC_ACCTargetType_SetVt)==0)
    {
        if(chgEv_ACC_307_ACC_ACCTargetType == 0)
        {
            phyValue = getvalue(this);
            // physical to raw conversion
            rawValue = ((phyValue -(0))/1);
            putValue(E_pubc_ACC_ACC_307_ACC_ACCTargetType_Rv, rawValue);
            chgEv_ACC_307_ACC_ACCTargetType = 1;  
        }
        else
        {
            chgEv_ACC_307_ACC_ACCTargetType = 0;
        }
    }
}
/*@@end*/

/*@@envVar:E_pubc_ACC_ACC_307_ACC_ACCTargetType_Vt:*/
on envVar E_pubc_ACC_ACC_307_ACC_ACCTargetType_Vt
{
    qword rawValue = 0ll;
    if(getValue(E_pubc_ACC_ACC_307_ACC_ACCTargetType_SetVt))
    {
        //update the signal value
        Msg_ACC_307.ACC_ACCTargetType=getValue(this);
    }
}
/*@@end*/

/*@@envVar:E_pubc_ACC_ACC_307_ACC_ACCTargetType_SetVt:*/
on envVar E_pubc_ACC_ACC_307_ACC_ACCTargetType_SetVt
{
    if(getValue(E_pubc_ACC_ACC_307_ACC_ACCTargetType_SetVt))
    {
        //update the signal value
        Msg_ACC_307.ACC_ACCTargetType=getvalue(E_pubc_ACC_ACC_307_ACC_ACCTargetType_Vt);
    }
    else
    {
        Msg_ACC_307.ACC_ACCTargetType=getValue(E_pubc_ACC_ACC_307_ACC_ACCTargetType_Rv);
    }
}
/*@@end*/
 
/*@@envVar:E_pubc_ACC_ACC_378_tx:*/
on envVar E_pubc_ACC_ACC_378_tx
{
    if(getValue(this))
    {       
        

        output(Msg_ACC_378);        
    }
}
/*@@end*/

/*@@envVar:E_pubc_ACC_ACC_378_Range:*/
on envVar E_pubc_ACC_ACC_378_Range
{
    qword rawstatus = 0ll;
    qword rawValue = 0ll;    
    
    rawstatus = getvalue(this);    
    // set all the signals with min raw /max raw /init raw
    switch (rawstatus) 
    {
     case(0) :
        rawValue= 0;
        putValue(E_pubc_ACC_ACC_378_ACC_LaneEquationC1_Rv, rawValue);
        rawValue= 0;
        putValue(E_pubc_ACC_ACC_378_ACC_LaneQuality_Rv, rawValue);
        rawValue= 0;
        putValue(E_pubc_ACC_ACC_378_ACC_LaneEquationC3_Rv, rawValue);
        rawValue= 0;
        putValue(E_pubc_ACC_ACC_378_ACC_LaneEquationStatus_Rv, rawValue);
        rawValue= 0;
        putValue(E_pubc_ACC_ACC_378_ACC_LaneEquationC2_Rv, rawValue);
        break;
     case(1) :
        rawValue= 4094;
        putValue(E_pubc_ACC_ACC_378_ACC_LaneEquationC1_Rv, rawValue);
        rawValue= 63;
        putValue(E_pubc_ACC_ACC_378_ACC_LaneQuality_Rv, rawValue);
        rawValue= 4094;
        putValue(E_pubc_ACC_ACC_378_ACC_LaneEquationC3_Rv, rawValue);
        rawValue= 3;
        putValue(E_pubc_ACC_ACC_378_ACC_LaneEquationStatus_Rv, rawValue);
        rawValue= 4093;
        putValue(E_pubc_ACC_ACC_378_ACC_LaneEquationC2_Rv, rawValue);
        break;
     default :
        rawValue= 0;
        putValue(E_pubc_ACC_ACC_378_ACC_LaneEquationC1_Rv, rawValue);
        rawValue= 0;
        putValue(E_pubc_ACC_ACC_378_ACC_LaneQuality_Rv, rawValue);
        rawValue= 0;
        putValue(E_pubc_ACC_ACC_378_ACC_LaneEquationC3_Rv, rawValue);
        rawValue= 0;
        putValue(E_pubc_ACC_ACC_378_ACC_LaneEquationStatus_Rv, rawValue);
        rawValue= 0;
        putValue(E_pubc_ACC_ACC_378_ACC_LaneEquationC2_Rv, rawValue);
      break;
   }
}
/*@@end*/

/*@@envVar:E_pubc_ACC_ACC_378_Dlc:*/
on envVar E_pubc_ACC_ACC_378_Dlc
{
    if(getValue(E_pubc_ACC_ACC_378_enDlc))
    {
        Msg_ACC_378.dlc =getValue(this);
    }
    else
    {
       Dbc_dlc = 32;
	   Msg_ACC_378.dlc = Calc_Canfd_dlc(Dbc_dlc);
	   // Msg_ACC_378.dlc = 32;
	   	
  }
}
/*@@end*/

/*@@envVar:E_pubc_ACC_ACC_378_enDlc:*/
on envVar E_pubc_ACC_ACC_378_enDlc
{
    //For Messages with DLC = 8, set wrong DLC to smaller than defined DLC
    //For Messages with DLC < 8 set wrong DLC to smaller/longer than defined DLC
    if(getValue(this))
    {
        Msg_ACC_378.dlc =getValue(E_pubc_ACC_ACC_378_Dlc);
    }
    else
    {
       Dbc_dlc = 32;
	   Msg_ACC_378.dlc = Calc_Canfd_dlc(Dbc_dlc);
	   // Msg_ACC_378.dlc = 32;
    }
}
/*@@end*/


/*@@envVar:E_pubc_ACC_ACC_378_ACC_LaneEquationC1_Rv:*/
on envVar E_pubc_ACC_ACC_378_ACC_LaneEquationC1_Rv
{
    int64 rawValue = 0ll;
    float rawValue_float = 0.0;
    float phyValue = 0.0;        

    //set the signal with updated raw value
    {
        rawValue = getvalue(this);
        if(chgEv_ACC_378_ACC_LaneEquationC1 == 0)
        {
            //type conversion to float
            rawValue_float = rawValue;        
            // raw to physical conversion
            phyValue = ((rawValue_float *0.000488281)+(-1));
            putValue(E_pubc_ACC_ACC_378_ACC_LaneEquationC1_Pv, phyValue);
            chgEv_ACC_378_ACC_LaneEquationC1 = 1;
        }
        else
        {
            chgEv_ACC_378_ACC_LaneEquationC1 = 0;
        }    
        //update the signal value
        Msg_ACC_378.ACC_LaneEquationC1=rawValue;        
    }                                                                           
}
/*@@end*/

/*@@envVar:E_pubc_ACC_ACC_378_ACC_LaneEquationC1_Pv:*/
on envVar E_pubc_ACC_ACC_378_ACC_LaneEquationC1_Pv
{
    int64 rawValue = 0ll;
    float phyValue = 0.0;
    
    //update the raw value with physical value 
    {
        if(chgEv_ACC_378_ACC_LaneEquationC1 == 0)
        {
            phyValue = getvalue(this);
            // physical to raw conversion
            rawValue = ((phyValue -(-1))/0.000488281);
            putValue(E_pubc_ACC_ACC_378_ACC_LaneEquationC1_Rv, rawValue);
            chgEv_ACC_378_ACC_LaneEquationC1 = 1;  
        }
        else
        {
            chgEv_ACC_378_ACC_LaneEquationC1 = 0;
        }
    }
}
/*@@end*/


 
/*@@envVar:E_pubc_ACC_ACC_378_ACC_LaneQuality_Rv:*/
on envVar E_pubc_ACC_ACC_378_ACC_LaneQuality_Rv
{
    int64 rawValue = 0ll;
    float rawValue_float = 0.0;
    float phyValue = 0.0;        

    //set the signal with updated raw value
    {
        rawValue = getvalue(this);
        if(chgEv_ACC_378_ACC_LaneQuality == 0)
        {
            //type conversion to float
            rawValue_float = rawValue;        
            // raw to physical conversion
            phyValue = ((rawValue_float *0.015625)+(0));
            putValue(E_pubc_ACC_ACC_378_ACC_LaneQuality_Pv, phyValue);
            chgEv_ACC_378_ACC_LaneQuality = 1;
        }
        else
        {
            chgEv_ACC_378_ACC_LaneQuality = 0;
        }    
        //update the signal value
        Msg_ACC_378.ACC_LaneQuality=rawValue;        
    }                                                                           
}
/*@@end*/

/*@@envVar:E_pubc_ACC_ACC_378_ACC_LaneQuality_Pv:*/
on envVar E_pubc_ACC_ACC_378_ACC_LaneQuality_Pv
{
    int64 rawValue = 0ll;
    float phyValue = 0.0;
    
    //update the raw value with physical value 
    {
        if(chgEv_ACC_378_ACC_LaneQuality == 0)
        {
            phyValue = getvalue(this);
            // physical to raw conversion
            rawValue = ((phyValue -(0))/0.015625);
            putValue(E_pubc_ACC_ACC_378_ACC_LaneQuality_Rv, rawValue);
            chgEv_ACC_378_ACC_LaneQuality = 1;  
        }
        else
        {
            chgEv_ACC_378_ACC_LaneQuality = 0;
        }
    }
}
/*@@end*/


 
/*@@envVar:E_pubc_ACC_ACC_378_ACC_LaneEquationC3_Rv:*/
on envVar E_pubc_ACC_ACC_378_ACC_LaneEquationC3_Rv
{
    int64 rawValue = 0ll;
    float rawValue_float = 0.0;
    float phyValue = 0.0;        

    //set the signal with updated raw value
    {
        rawValue = getvalue(this);
        if(chgEv_ACC_378_ACC_LaneEquationC3 == 0)
        {
            //type conversion to float
            rawValue_float = rawValue;        
            // raw to physical conversion
            phyValue = ((rawValue_float *4.76837e-007)+(-0.000976085662841797));
            putValue(E_pubc_ACC_ACC_378_ACC_LaneEquationC3_Pv, phyValue);
            chgEv_ACC_378_ACC_LaneEquationC3 = 1;
        }
        else
        {
            chgEv_ACC_378_ACC_LaneEquationC3 = 0;
        }    
        //update the signal value
        Msg_ACC_378.ACC_LaneEquationC3=rawValue;        
    }                                                                           
}
/*@@end*/

/*@@envVar:E_pubc_ACC_ACC_378_ACC_LaneEquationC3_Pv:*/
on envVar E_pubc_ACC_ACC_378_ACC_LaneEquationC3_Pv
{
    int64 rawValue = 0ll;
    float phyValue = 0.0;
    
    //update the raw value with physical value 
    {
        if(chgEv_ACC_378_ACC_LaneEquationC3 == 0)
        {
            phyValue = getvalue(this);
            // physical to raw conversion
            rawValue = ((phyValue -(-0.000976085662841797))/4.76837e-007);
            putValue(E_pubc_ACC_ACC_378_ACC_LaneEquationC3_Rv, rawValue);
            chgEv_ACC_378_ACC_LaneEquationC3 = 1;  
        }
        else
        {
            chgEv_ACC_378_ACC_LaneEquationC3 = 0;
        }
    }
}
/*@@end*/


 
/*@@envVar:E_pubc_ACC_ACC_378_ACC_LaneEquationStatus_Rv:*/
on envVar E_pubc_ACC_ACC_378_ACC_LaneEquationStatus_Rv
{
    int64 rawValue = 0ll;
    float rawValue_float = 0.0;
    float phyValue = 0.0;        

    //set the signal with updated raw value
    if(getValue(E_pubc_ACC_ACC_378_ACC_LaneEquationStatus_SetVt)==0)
    {
        rawValue = getvalue(this);
        if(chgEv_ACC_378_ACC_LaneEquationStatus == 0)
        {
            //type conversion to float
            rawValue_float = rawValue;        
            // raw to physical conversion
            phyValue = ((rawValue_float *1)+(0));
            putValue(E_pubc_ACC_ACC_378_ACC_LaneEquationStatus_Pv, phyValue);
            chgEv_ACC_378_ACC_LaneEquationStatus = 1;
        }
        else
        {
            chgEv_ACC_378_ACC_LaneEquationStatus = 0;
        }    
        //update the signal value
        Msg_ACC_378.ACC_LaneEquationStatus=rawValue;        
    }                                                                           
}
/*@@end*/

/*@@envVar:E_pubc_ACC_ACC_378_ACC_LaneEquationStatus_Pv:*/
on envVar E_pubc_ACC_ACC_378_ACC_LaneEquationStatus_Pv
{
    int64 rawValue = 0ll;
    float phyValue = 0.0;
    
    //update the raw value with physical value 
    if(getValue(E_pubc_ACC_ACC_378_ACC_LaneEquationStatus_SetVt)==0)
    {
        if(chgEv_ACC_378_ACC_LaneEquationStatus == 0)
        {
            phyValue = getvalue(this);
            // physical to raw conversion
            rawValue = ((phyValue -(0))/1);
            putValue(E_pubc_ACC_ACC_378_ACC_LaneEquationStatus_Rv, rawValue);
            chgEv_ACC_378_ACC_LaneEquationStatus = 1;  
        }
        else
        {
            chgEv_ACC_378_ACC_LaneEquationStatus = 0;
        }
    }
}
/*@@end*/

/*@@envVar:E_pubc_ACC_ACC_378_ACC_LaneEquationStatus_Vt:*/
on envVar E_pubc_ACC_ACC_378_ACC_LaneEquationStatus_Vt
{
    qword rawValue = 0ll;
    if(getValue(E_pubc_ACC_ACC_378_ACC_LaneEquationStatus_SetVt))
    {
        //update the signal value
        Msg_ACC_378.ACC_LaneEquationStatus=getValue(this);
    }
}
/*@@end*/

/*@@envVar:E_pubc_ACC_ACC_378_ACC_LaneEquationStatus_SetVt:*/
on envVar E_pubc_ACC_ACC_378_ACC_LaneEquationStatus_SetVt
{
    if(getValue(E_pubc_ACC_ACC_378_ACC_LaneEquationStatus_SetVt))
    {
        //update the signal value
        Msg_ACC_378.ACC_LaneEquationStatus=getvalue(E_pubc_ACC_ACC_378_ACC_LaneEquationStatus_Vt);
    }
    else
    {
        Msg_ACC_378.ACC_LaneEquationStatus=getValue(E_pubc_ACC_ACC_378_ACC_LaneEquationStatus_Rv);
    }
}
/*@@end*/
 
/*@@envVar:E_pubc_ACC_ACC_378_ACC_LaneEquationC2_Rv:*/
on envVar E_pubc_ACC_ACC_378_ACC_LaneEquationC2_Rv
{
    int64 rawValue = 0ll;
    float rawValue_float = 0.0;
    float phyValue = 0.0;        

    //set the signal with updated raw value
    {
        rawValue = getvalue(this);
        if(chgEv_ACC_378_ACC_LaneEquationC2 == 0)
        {
            //type conversion to float
            rawValue_float = rawValue;        
            // raw to physical conversion
            phyValue = ((rawValue_float *1.52588e-005)+(-0.0312347412109375));
            putValue(E_pubc_ACC_ACC_378_ACC_LaneEquationC2_Pv, phyValue);
            chgEv_ACC_378_ACC_LaneEquationC2 = 1;
        }
        else
        {
            chgEv_ACC_378_ACC_LaneEquationC2 = 0;
        }    
        //update the signal value
        Msg_ACC_378.ACC_LaneEquationC2=rawValue;        
    }                                                                           
}
/*@@end*/

/*@@envVar:E_pubc_ACC_ACC_378_ACC_LaneEquationC2_Pv:*/
on envVar E_pubc_ACC_ACC_378_ACC_LaneEquationC2_Pv
{
    int64 rawValue = 0ll;
    float phyValue = 0.0;
    
    //update the raw value with physical value 
    {
        if(chgEv_ACC_378_ACC_LaneEquationC2 == 0)
        {
            phyValue = getvalue(this);
            // physical to raw conversion
            rawValue = ((phyValue -(-0.0312347412109375))/1.52588e-005);
            putValue(E_pubc_ACC_ACC_378_ACC_LaneEquationC2_Rv, rawValue);
            chgEv_ACC_378_ACC_LaneEquationC2 = 1;  
        }
        else
        {
            chgEv_ACC_378_ACC_LaneEquationC2 = 0;
        }
    }
}
/*@@end*/


 
/*@@envVar:E_pubc_ACC_ACC_244_tx:*/
on envVar E_pubc_ACC_ACC_244_tx
{
    if(getValue(this))
    {       
        
        //update the BZ Signal
        if(ACC_244_ACC_RollingCounter_25E_wrongvalctr == 0)
        {
            update_ACC_244_ACC_RollingCounter_25E_counter();
            Msg_ACC_244.ACC_RollingCounter_25E= ACC_244_ACC_RollingCounter_25E_counter;
        }
        else if(ACC_244_ACC_RollingCounter_25E_wrongvalctr > 0)
        {
			ACC_244_ACC_RollingCounter_25E_counter=ACC_244_ACC_RollingCounter_25E_counter + ACC_244_ACC_RollingCounter_25E_wrongvalctr;
			 Msg_ACC_244.ACC_RollingCounter_25E= ACC_244_ACC_RollingCounter_25E_counter;
            /* ACC_244_ACC_RollingCounter_25E_wrongvalctr--;
              // if counter becomes zero, update panel controller to zero
             if(ACC_244_ACC_RollingCounter_25E_wrongvalctr == 0)
             {
                 putValue(E_pubc_ACC_ACC_244_ACC_RollingCounter_25E_wrongvalctr,0);
             } */
        }
        else
        { 
			// do nothing
        }    
        //update the BZ Signal
        if(ACC_244_ACC_RollingCounter_24E_wrongvalctr == 0)
        {
            update_ACC_244_ACC_RollingCounter_24E_counter();
            Msg_ACC_244.ACC_RollingCounter_24E= ACC_244_ACC_RollingCounter_24E_counter;
        }
        else if(ACC_244_ACC_RollingCounter_24E_wrongvalctr > 0)
        {
			ACC_244_ACC_RollingCounter_24E_counter=ACC_244_ACC_RollingCounter_24E_counter + ACC_244_ACC_RollingCounter_24E_wrongvalctr;
			 Msg_ACC_244.ACC_RollingCounter_24E= ACC_244_ACC_RollingCounter_24E_counter;
            /* ACC_244_ACC_RollingCounter_24E_wrongvalctr--;
              // if counter becomes zero, update panel controller to zero
             if(ACC_244_ACC_RollingCounter_24E_wrongvalctr == 0)
             {
                 putValue(E_pubc_ACC_ACC_244_ACC_RollingCounter_24E_wrongvalctr,0);
             } */
        }
        else
        { 
			// do nothing
        }    
        //calculate the CRC CheckSum
        update_ACC_244_CRC_CheckSum();

        output(Msg_ACC_244);        
    }
}
/*@@end*/

/*@@envVar:E_pubc_ACC_ACC_244_Range:*/
on envVar E_pubc_ACC_ACC_244_Range
{
    qword rawstatus = 0ll;
    qword rawValue = 0ll;    
    
    rawstatus = getvalue(this);    
    // set all the signals with min raw /max raw /init raw
    switch (rawstatus) 
    {
     case(0) :
        rawValue= 0;
        putValue(E_pubc_ACC_ACC_244_ACC_CDDActive_Rv, rawValue);
        rawValue= 0;
        putValue(E_pubc_ACC_ACC_244_ACC_Driveoff_Request_Rv, rawValue);
        rawValue= 0;
        putValue(E_pubc_ACC_ACC_244_ACC_AccTrqReqActive_Rv, rawValue);
        rawValue= 0;
        putValue(E_pubc_ACC_ACC_244_ACC_AWBlevel_Rv, rawValue);
        rawValue= 0;
        putValue(E_pubc_ACC_ACC_244_ACC_DecToStop_Rv, rawValue);
        rawValue= 0;
        putValue(E_pubc_ACC_ACC_244_ACC_ABAlevel_Rv, rawValue);
        rawValue= 0;
        putValue(E_pubc_ACC_ACC_244_ACC_ABAActive_Rv, rawValue);
        rawValue= 0;
        putValue(E_pubc_ACC_ACC_244_ACC_PrefillActive_Rv, rawValue);
        rawValue= 0;
        putValue(E_pubc_ACC_ACC_244_ACC_AEBCtrlType_Rv, rawValue);
        rawValue= 0;
        putValue(E_pubc_ACC_ACC_244_ACC_FCWActive_Rv, rawValue);
        rawValue= 0;
        putValue(E_pubc_ACC_ACC_244_ACC_FCWLatentWarning_Rv, rawValue);
        rawValue= 0;
        putValue(E_pubc_ACC_ACC_244_ACC_LDWVibrationWarningReq_Rv, rawValue);
        rawValue= 0;
        putValue(E_pubc_ACC_ACC_244_ADS_MesssageCounter_244_Rv, rawValue);
        rawValue= 0;
        putValue(E_pubc_ACC_ACC_244_ACC_AEBTargetDeceleration_Rv, rawValue);
        rawValue= 0;
        putValue(E_pubc_ACC_ACC_244_ACC_AEBVehilceHoldReq_Rv, rawValue);
        rawValue= 0;
        putValue(E_pubc_ACC_ACC_244_ACC_AccTrqReq_Rv, rawValue);
        rawValue= 0;
        putValue(E_pubc_ACC_ACC_244_ADS_ResetFlag_244_Rv, rawValue);
        rawValue= 0;
        putValue(E_pubc_ACC_ACC_244_ACC_LDWStatus_Rv, rawValue);
        rawValue= 0;
        putValue(E_pubc_ACC_ACC_244_ACC_ACCTargetAcceleration_Rv, rawValue);
        rawValue= 0;
        putValue(E_pubc_ACC_ACC_244_ACC_EmergencyDataRrdReq_Rv, rawValue);
        rawValue= 0;
        putValue(E_pubc_ACC_ACC_244_ADS_Authernticator_244_Rv, rawValue);
        rawValue= 0;
        putValue(E_pubc_ACC_ACC_244_ACC_AEBActive_Rv, rawValue);
        rawValue= 0;
        putValue(E_pubc_ACC_ACC_244_ACC_LKAStatus_Rv, rawValue);
        rawValue= 0;
        putValue(E_pubc_ACC_ACC_244_ACC_FCWPreWarning_Rv, rawValue);
        rawValue= 0;
        putValue(E_pubc_ACC_ACC_244_ACC_AWBActive_Rv, rawValue);
        rawValue= 0;
        putValue(E_pubc_ACC_ACC_244_ACC_ACCMode_Rv, rawValue);
        break;
     case(1) :
        rawValue= 1;
        putValue(E_pubc_ACC_ACC_244_ACC_CDDActive_Rv, rawValue);
        rawValue= 1;
        putValue(E_pubc_ACC_ACC_244_ACC_Driveoff_Request_Rv, rawValue);
        rawValue= 1;
        putValue(E_pubc_ACC_ACC_244_ACC_AccTrqReqActive_Rv, rawValue);
        rawValue= 15;
        putValue(E_pubc_ACC_ACC_244_ACC_AWBlevel_Rv, rawValue);
        rawValue= 1;
        putValue(E_pubc_ACC_ACC_244_ACC_DecToStop_Rv, rawValue);
        rawValue= 3;
        putValue(E_pubc_ACC_ACC_244_ACC_ABAlevel_Rv, rawValue);
        rawValue= 1;
        putValue(E_pubc_ACC_ACC_244_ACC_ABAActive_Rv, rawValue);
        rawValue= 1;
        putValue(E_pubc_ACC_ACC_244_ACC_PrefillActive_Rv, rawValue);
        rawValue= 15;
        putValue(E_pubc_ACC_ACC_244_ACC_AEBCtrlType_Rv, rawValue);
        rawValue= 1;
        putValue(E_pubc_ACC_ACC_244_ACC_FCWActive_Rv, rawValue);
        rawValue= 1;
        putValue(E_pubc_ACC_ACC_244_ACC_FCWLatentWarning_Rv, rawValue);
        rawValue= 3;
        putValue(E_pubc_ACC_ACC_244_ACC_LDWVibrationWarningReq_Rv, rawValue);
        rawValue= 63;
        putValue(E_pubc_ACC_ACC_244_ADS_MesssageCounter_244_Rv, rawValue);
        rawValue= 64000;
        putValue(E_pubc_ACC_ACC_244_ACC_AEBTargetDeceleration_Rv, rawValue);
        rawValue= 1;
        putValue(E_pubc_ACC_ACC_244_ACC_AEBVehilceHoldReq_Rv, rawValue);
        rawValue= 32767;
        putValue(E_pubc_ACC_ACC_244_ACC_AccTrqReq_Rv, rawValue);
        rawValue= 3;
        putValue(E_pubc_ACC_ACC_244_ADS_ResetFlag_244_Rv, rawValue);
        rawValue= 3;
        putValue(E_pubc_ACC_ACC_244_ACC_LDWStatus_Rv, rawValue);
        rawValue= 255;
        putValue(E_pubc_ACC_ACC_244_ACC_ACCTargetAcceleration_Rv, rawValue);
        rawValue= 3;
        putValue(E_pubc_ACC_ACC_244_ACC_EmergencyDataRrdReq_Rv, rawValue);
        rawValue= 0;
        putValue(E_pubc_ACC_ACC_244_ADS_Authernticator_244_Rv, rawValue);
        rawValue= 1;
        putValue(E_pubc_ACC_ACC_244_ACC_AEBActive_Rv, rawValue);
        rawValue= 3;
        putValue(E_pubc_ACC_ACC_244_ACC_LKAStatus_Rv, rawValue);
        rawValue= 1;
        putValue(E_pubc_ACC_ACC_244_ACC_FCWPreWarning_Rv, rawValue);
        rawValue= 1;
        putValue(E_pubc_ACC_ACC_244_ACC_AWBActive_Rv, rawValue);
        rawValue= 7;
        putValue(E_pubc_ACC_ACC_244_ACC_ACCMode_Rv, rawValue);
        break;
     default :
        rawValue= 0;
        putValue(E_pubc_ACC_ACC_244_ACC_CDDActive_Rv, rawValue);
        rawValue= 0;
        putValue(E_pubc_ACC_ACC_244_ACC_Driveoff_Request_Rv, rawValue);
        rawValue= 0;
        putValue(E_pubc_ACC_ACC_244_ACC_AccTrqReqActive_Rv, rawValue);
        rawValue= 0;
        putValue(E_pubc_ACC_ACC_244_ACC_AWBlevel_Rv, rawValue);
        rawValue= 0;
        putValue(E_pubc_ACC_ACC_244_ACC_DecToStop_Rv, rawValue);
        rawValue= 0;
        putValue(E_pubc_ACC_ACC_244_ACC_ABAlevel_Rv, rawValue);
        rawValue= 0;
        putValue(E_pubc_ACC_ACC_244_ACC_ABAActive_Rv, rawValue);
        rawValue= 0;
        putValue(E_pubc_ACC_ACC_244_ACC_PrefillActive_Rv, rawValue);
        rawValue= 0;
        putValue(E_pubc_ACC_ACC_244_ACC_AEBCtrlType_Rv, rawValue);
        rawValue= 0;
        putValue(E_pubc_ACC_ACC_244_ACC_FCWActive_Rv, rawValue);
        rawValue= 0;
        putValue(E_pubc_ACC_ACC_244_ACC_FCWLatentWarning_Rv, rawValue);
        rawValue= 0;
        putValue(E_pubc_ACC_ACC_244_ACC_LDWVibrationWarningReq_Rv, rawValue);
        rawValue= 0;
        putValue(E_pubc_ACC_ACC_244_ADS_MesssageCounter_244_Rv, rawValue);
        rawValue= 0;
        putValue(E_pubc_ACC_ACC_244_ACC_AEBTargetDeceleration_Rv, rawValue);
        rawValue= 0;
        putValue(E_pubc_ACC_ACC_244_ACC_AEBVehilceHoldReq_Rv, rawValue);
        rawValue= 0;
        putValue(E_pubc_ACC_ACC_244_ACC_AccTrqReq_Rv, rawValue);
        rawValue= 0;
        putValue(E_pubc_ACC_ACC_244_ADS_ResetFlag_244_Rv, rawValue);
        rawValue= 0;
        putValue(E_pubc_ACC_ACC_244_ACC_LDWStatus_Rv, rawValue);
        rawValue= 0;
        putValue(E_pubc_ACC_ACC_244_ACC_ACCTargetAcceleration_Rv, rawValue);
        rawValue= 0;
        putValue(E_pubc_ACC_ACC_244_ACC_EmergencyDataRrdReq_Rv, rawValue);
        rawValue= 0;
        putValue(E_pubc_ACC_ACC_244_ADS_Authernticator_244_Rv, rawValue);
        rawValue= 0;
        putValue(E_pubc_ACC_ACC_244_ACC_AEBActive_Rv, rawValue);
        rawValue= 0;
        putValue(E_pubc_ACC_ACC_244_ACC_LKAStatus_Rv, rawValue);
        rawValue= 0;
        putValue(E_pubc_ACC_ACC_244_ACC_FCWPreWarning_Rv, rawValue);
        rawValue= 0;
        putValue(E_pubc_ACC_ACC_244_ACC_AWBActive_Rv, rawValue);
        rawValue= 0;
        putValue(E_pubc_ACC_ACC_244_ACC_ACCMode_Rv, rawValue);
      break;
   }
}
/*@@end*/

/*@@envVar:E_pubc_ACC_ACC_244_Dlc:*/
on envVar E_pubc_ACC_ACC_244_Dlc
{
    if(getValue(E_pubc_ACC_ACC_244_enDlc))
    {
        Msg_ACC_244.dlc =getValue(this);
    }
    else
    {
       Dbc_dlc = 64;
	   Msg_ACC_244.dlc = Calc_Canfd_dlc(Dbc_dlc);
	   // Msg_ACC_244.dlc = 64;
	   	
  }
}
/*@@end*/

/*@@envVar:E_pubc_ACC_ACC_244_enDlc:*/
on envVar E_pubc_ACC_ACC_244_enDlc
{
    //For Messages with DLC = 8, set wrong DLC to smaller than defined DLC
    //For Messages with DLC < 8 set wrong DLC to smaller/longer than defined DLC
    if(getValue(this))
    {
        Msg_ACC_244.dlc =getValue(E_pubc_ACC_ACC_244_Dlc);
    }
    else
    {
       Dbc_dlc = 64;
	   Msg_ACC_244.dlc = Calc_Canfd_dlc(Dbc_dlc);
	   // Msg_ACC_244.dlc = 64;
    }
}
/*@@end*/

/*@@envVar:E_pubc_ACC_ACC_244_ACC_CRCCheck_24E_wrongvalctr:*/
on envVar E_pubc_ACC_ACC_244_ACC_CRCCheck_24E_wrongvalctr
{
    //update disturb count
    //disturb value range:(-1 = always send wrong value),( X>0 ,x is the number of Messages with wrong CHK sent)
    ACC_244_ACC_CRCCheck_24E_wrongvalctr =getValue(this);    
}
/*@@end*/
/*@@envVar:E_pubc_ACC_ACC_244_ACC_CRCCheck_25E_wrongvalctr:*/
on envVar E_pubc_ACC_ACC_244_ACC_CRCCheck_25E_wrongvalctr
{
    //update disturb count
    //disturb value range:(-1 = always send wrong value),( X>0 ,x is the number of Messages with wrong CHK sent)
    ACC_244_ACC_CRCCheck_25E_wrongvalctr =getValue(this);    
}
/*@@end*/
/*@@envVar:E_pubc_ACC_ACC_244_ACC_RollingCounter_24E_wrongvalctr:*/
on envVar E_pubc_ACC_ACC_244_ACC_RollingCounter_24E_wrongvalctr
{
    //update disturb count
    //disturb value range:(-1 = always send wrong value),( X>0 ,x is the number of Messages with wrong CHK sent)
    ACC_244_ACC_RollingCounter_24E_wrongvalctr =getValue(this);    
}
/*@@end*/
/*@@envVar:E_pubc_ACC_ACC_244_ACC_RollingCounter_25E_wrongvalctr:*/
on envVar E_pubc_ACC_ACC_244_ACC_RollingCounter_25E_wrongvalctr
{
    //update disturb count
    //disturb value range:(-1 = always send wrong value),( X>0 ,x is the number of Messages with wrong CHK sent)
    ACC_244_ACC_RollingCounter_25E_wrongvalctr =getValue(this);    
}
/*@@end*/

/*@@envVar:E_pubc_ACC_ACC_244_ACC_CDDActive_Rv:*/
on envVar E_pubc_ACC_ACC_244_ACC_CDDActive_Rv
{
    int64 rawValue = 0ll;
    float rawValue_float = 0.0;
    float phyValue = 0.0;        

    //set the signal with updated raw value
    if(getValue(E_pubc_ACC_ACC_244_ACC_CDDActive_SetVt)==0)
    {
        rawValue = getvalue(this);
        if(chgEv_ACC_244_ACC_CDDActive == 0)
        {
            //type conversion to float
            rawValue_float = rawValue;        
            // raw to physical conversion
            phyValue = ((rawValue_float *1)+(0));
            putValue(E_pubc_ACC_ACC_244_ACC_CDDActive_Pv, phyValue);
            chgEv_ACC_244_ACC_CDDActive = 1;
        }
        else
        {
            chgEv_ACC_244_ACC_CDDActive = 0;
        }    
        //update the signal value
        Msg_ACC_244.ACC_CDDActive=rawValue;        
    }                                                                           
}
/*@@end*/

/*@@envVar:E_pubc_ACC_ACC_244_ACC_CDDActive_Pv:*/
on envVar E_pubc_ACC_ACC_244_ACC_CDDActive_Pv
{
    int64 rawValue = 0ll;
    float phyValue = 0.0;
    
    //update the raw value with physical value 
    if(getValue(E_pubc_ACC_ACC_244_ACC_CDDActive_SetVt)==0)
    {
        if(chgEv_ACC_244_ACC_CDDActive == 0)
        {
            phyValue = getvalue(this);
            // physical to raw conversion
            rawValue = ((phyValue -(0))/1);
            putValue(E_pubc_ACC_ACC_244_ACC_CDDActive_Rv, rawValue);
            chgEv_ACC_244_ACC_CDDActive = 1;  
        }
        else
        {
            chgEv_ACC_244_ACC_CDDActive = 0;
        }
    }
}
/*@@end*/

/*@@envVar:E_pubc_ACC_ACC_244_ACC_CDDActive_Vt:*/
on envVar E_pubc_ACC_ACC_244_ACC_CDDActive_Vt
{
    qword rawValue = 0ll;
    if(getValue(E_pubc_ACC_ACC_244_ACC_CDDActive_SetVt))
    {
        //update the signal value
        Msg_ACC_244.ACC_CDDActive=getValue(this);
    }
}
/*@@end*/

/*@@envVar:E_pubc_ACC_ACC_244_ACC_CDDActive_SetVt:*/
on envVar E_pubc_ACC_ACC_244_ACC_CDDActive_SetVt
{
    if(getValue(E_pubc_ACC_ACC_244_ACC_CDDActive_SetVt))
    {
        //update the signal value
        Msg_ACC_244.ACC_CDDActive=getvalue(E_pubc_ACC_ACC_244_ACC_CDDActive_Vt);
    }
    else
    {
        Msg_ACC_244.ACC_CDDActive=getValue(E_pubc_ACC_ACC_244_ACC_CDDActive_Rv);
    }
}
/*@@end*/
 
/*@@envVar:E_pubc_ACC_ACC_244_ACC_Driveoff_Request_Rv:*/
on envVar E_pubc_ACC_ACC_244_ACC_Driveoff_Request_Rv
{
    int64 rawValue = 0ll;
    float rawValue_float = 0.0;
    float phyValue = 0.0;        

    //set the signal with updated raw value
    if(getValue(E_pubc_ACC_ACC_244_ACC_Driveoff_Request_SetVt)==0)
    {
        rawValue = getvalue(this);
        if(chgEv_ACC_244_ACC_Driveoff_Request == 0)
        {
            //type conversion to float
            rawValue_float = rawValue;        
            // raw to physical conversion
            phyValue = ((rawValue_float *1)+(0));
            putValue(E_pubc_ACC_ACC_244_ACC_Driveoff_Request_Pv, phyValue);
            chgEv_ACC_244_ACC_Driveoff_Request = 1;
        }
        else
        {
            chgEv_ACC_244_ACC_Driveoff_Request = 0;
        }    
        //update the signal value
        Msg_ACC_244.ACC_Driveoff_Request=rawValue;        
    }                                                                           
}
/*@@end*/

/*@@envVar:E_pubc_ACC_ACC_244_ACC_Driveoff_Request_Pv:*/
on envVar E_pubc_ACC_ACC_244_ACC_Driveoff_Request_Pv
{
    int64 rawValue = 0ll;
    float phyValue = 0.0;
    
    //update the raw value with physical value 
    if(getValue(E_pubc_ACC_ACC_244_ACC_Driveoff_Request_SetVt)==0)
    {
        if(chgEv_ACC_244_ACC_Driveoff_Request == 0)
        {
            phyValue = getvalue(this);
            // physical to raw conversion
            rawValue = ((phyValue -(0))/1);
            putValue(E_pubc_ACC_ACC_244_ACC_Driveoff_Request_Rv, rawValue);
            chgEv_ACC_244_ACC_Driveoff_Request = 1;  
        }
        else
        {
            chgEv_ACC_244_ACC_Driveoff_Request = 0;
        }
    }
}
/*@@end*/

/*@@envVar:E_pubc_ACC_ACC_244_ACC_Driveoff_Request_Vt:*/
on envVar E_pubc_ACC_ACC_244_ACC_Driveoff_Request_Vt
{
    qword rawValue = 0ll;
    if(getValue(E_pubc_ACC_ACC_244_ACC_Driveoff_Request_SetVt))
    {
        //update the signal value
        Msg_ACC_244.ACC_Driveoff_Request=getValue(this);
    }
}
/*@@end*/

/*@@envVar:E_pubc_ACC_ACC_244_ACC_Driveoff_Request_SetVt:*/
on envVar E_pubc_ACC_ACC_244_ACC_Driveoff_Request_SetVt
{
    if(getValue(E_pubc_ACC_ACC_244_ACC_Driveoff_Request_SetVt))
    {
        //update the signal value
        Msg_ACC_244.ACC_Driveoff_Request=getvalue(E_pubc_ACC_ACC_244_ACC_Driveoff_Request_Vt);
    }
    else
    {
        Msg_ACC_244.ACC_Driveoff_Request=getValue(E_pubc_ACC_ACC_244_ACC_Driveoff_Request_Rv);
    }
}
/*@@end*/
 
/*@@envVar:E_pubc_ACC_ACC_244_ACC_AccTrqReqActive_Rv:*/
on envVar E_pubc_ACC_ACC_244_ACC_AccTrqReqActive_Rv
{
    int64 rawValue = 0ll;
    float rawValue_float = 0.0;
    float phyValue = 0.0;        

    //set the signal with updated raw value
    if(getValue(E_pubc_ACC_ACC_244_ACC_AccTrqReqActive_SetVt)==0)
    {
        rawValue = getvalue(this);
        if(chgEv_ACC_244_ACC_AccTrqReqActive == 0)
        {
            //type conversion to float
            rawValue_float = rawValue;        
            // raw to physical conversion
            phyValue = ((rawValue_float *1)+(0));
            putValue(E_pubc_ACC_ACC_244_ACC_AccTrqReqActive_Pv, phyValue);
            chgEv_ACC_244_ACC_AccTrqReqActive = 1;
        }
        else
        {
            chgEv_ACC_244_ACC_AccTrqReqActive = 0;
        }    
        //update the signal value
        Msg_ACC_244.ACC_AccTrqReqActive=rawValue;        
    }                                                                           
}
/*@@end*/

/*@@envVar:E_pubc_ACC_ACC_244_ACC_AccTrqReqActive_Pv:*/
on envVar E_pubc_ACC_ACC_244_ACC_AccTrqReqActive_Pv
{
    int64 rawValue = 0ll;
    float phyValue = 0.0;
    
    //update the raw value with physical value 
    if(getValue(E_pubc_ACC_ACC_244_ACC_AccTrqReqActive_SetVt)==0)
    {
        if(chgEv_ACC_244_ACC_AccTrqReqActive == 0)
        {
            phyValue = getvalue(this);
            // physical to raw conversion
            rawValue = ((phyValue -(0))/1);
            putValue(E_pubc_ACC_ACC_244_ACC_AccTrqReqActive_Rv, rawValue);
            chgEv_ACC_244_ACC_AccTrqReqActive = 1;  
        }
        else
        {
            chgEv_ACC_244_ACC_AccTrqReqActive = 0;
        }
    }
}
/*@@end*/

/*@@envVar:E_pubc_ACC_ACC_244_ACC_AccTrqReqActive_Vt:*/
on envVar E_pubc_ACC_ACC_244_ACC_AccTrqReqActive_Vt
{
    qword rawValue = 0ll;
    if(getValue(E_pubc_ACC_ACC_244_ACC_AccTrqReqActive_SetVt))
    {
        //update the signal value
        Msg_ACC_244.ACC_AccTrqReqActive=getValue(this);
    }
}
/*@@end*/

/*@@envVar:E_pubc_ACC_ACC_244_ACC_AccTrqReqActive_SetVt:*/
on envVar E_pubc_ACC_ACC_244_ACC_AccTrqReqActive_SetVt
{
    if(getValue(E_pubc_ACC_ACC_244_ACC_AccTrqReqActive_SetVt))
    {
        //update the signal value
        Msg_ACC_244.ACC_AccTrqReqActive=getvalue(E_pubc_ACC_ACC_244_ACC_AccTrqReqActive_Vt);
    }
    else
    {
        Msg_ACC_244.ACC_AccTrqReqActive=getValue(E_pubc_ACC_ACC_244_ACC_AccTrqReqActive_Rv);
    }
}
/*@@end*/
 
/*@@envVar:E_pubc_ACC_ACC_244_ACC_AWBlevel_Rv:*/
on envVar E_pubc_ACC_ACC_244_ACC_AWBlevel_Rv
{
    int64 rawValue = 0ll;
    float rawValue_float = 0.0;
    float phyValue = 0.0;        

    //set the signal with updated raw value
    if(getValue(E_pubc_ACC_ACC_244_ACC_AWBlevel_SetVt)==0)
    {
        rawValue = getvalue(this);
        if(chgEv_ACC_244_ACC_AWBlevel == 0)
        {
            //type conversion to float
            rawValue_float = rawValue;        
            // raw to physical conversion
            phyValue = ((rawValue_float *1)+(0));
            putValue(E_pubc_ACC_ACC_244_ACC_AWBlevel_Pv, phyValue);
            chgEv_ACC_244_ACC_AWBlevel = 1;
        }
        else
        {
            chgEv_ACC_244_ACC_AWBlevel = 0;
        }    
        //update the signal value
        Msg_ACC_244.ACC_AWBlevel=rawValue;        
    }                                                                           
}
/*@@end*/

/*@@envVar:E_pubc_ACC_ACC_244_ACC_AWBlevel_Pv:*/
on envVar E_pubc_ACC_ACC_244_ACC_AWBlevel_Pv
{
    int64 rawValue = 0ll;
    float phyValue = 0.0;
    
    //update the raw value with physical value 
    if(getValue(E_pubc_ACC_ACC_244_ACC_AWBlevel_SetVt)==0)
    {
        if(chgEv_ACC_244_ACC_AWBlevel == 0)
        {
            phyValue = getvalue(this);
            // physical to raw conversion
            rawValue = ((phyValue -(0))/1);
            putValue(E_pubc_ACC_ACC_244_ACC_AWBlevel_Rv, rawValue);
            chgEv_ACC_244_ACC_AWBlevel = 1;  
        }
        else
        {
            chgEv_ACC_244_ACC_AWBlevel = 0;
        }
    }
}
/*@@end*/

/*@@envVar:E_pubc_ACC_ACC_244_ACC_AWBlevel_Vt:*/
on envVar E_pubc_ACC_ACC_244_ACC_AWBlevel_Vt
{
    qword rawValue = 0ll;
    if(getValue(E_pubc_ACC_ACC_244_ACC_AWBlevel_SetVt))
    {
        //update the signal value
        Msg_ACC_244.ACC_AWBlevel=getValue(this);
    }
}
/*@@end*/

/*@@envVar:E_pubc_ACC_ACC_244_ACC_AWBlevel_SetVt:*/
on envVar E_pubc_ACC_ACC_244_ACC_AWBlevel_SetVt
{
    if(getValue(E_pubc_ACC_ACC_244_ACC_AWBlevel_SetVt))
    {
        //update the signal value
        Msg_ACC_244.ACC_AWBlevel=getvalue(E_pubc_ACC_ACC_244_ACC_AWBlevel_Vt);
    }
    else
    {
        Msg_ACC_244.ACC_AWBlevel=getValue(E_pubc_ACC_ACC_244_ACC_AWBlevel_Rv);
    }
}
/*@@end*/
 
/*@@envVar:E_pubc_ACC_ACC_244_ACC_DecToStop_Rv:*/
on envVar E_pubc_ACC_ACC_244_ACC_DecToStop_Rv
{
    int64 rawValue = 0ll;
    float rawValue_float = 0.0;
    float phyValue = 0.0;        

    //set the signal with updated raw value
    if(getValue(E_pubc_ACC_ACC_244_ACC_DecToStop_SetVt)==0)
    {
        rawValue = getvalue(this);
        if(chgEv_ACC_244_ACC_DecToStop == 0)
        {
            //type conversion to float
            rawValue_float = rawValue;        
            // raw to physical conversion
            phyValue = ((rawValue_float *1)+(0));
            putValue(E_pubc_ACC_ACC_244_ACC_DecToStop_Pv, phyValue);
            chgEv_ACC_244_ACC_DecToStop = 1;
        }
        else
        {
            chgEv_ACC_244_ACC_DecToStop = 0;
        }    
        //update the signal value
        Msg_ACC_244.ACC_DecToStop=rawValue;        
    }                                                                           
}
/*@@end*/

/*@@envVar:E_pubc_ACC_ACC_244_ACC_DecToStop_Pv:*/
on envVar E_pubc_ACC_ACC_244_ACC_DecToStop_Pv
{
    int64 rawValue = 0ll;
    float phyValue = 0.0;
    
    //update the raw value with physical value 
    if(getValue(E_pubc_ACC_ACC_244_ACC_DecToStop_SetVt)==0)
    {
        if(chgEv_ACC_244_ACC_DecToStop == 0)
        {
            phyValue = getvalue(this);
            // physical to raw conversion
            rawValue = ((phyValue -(0))/1);
            putValue(E_pubc_ACC_ACC_244_ACC_DecToStop_Rv, rawValue);
            chgEv_ACC_244_ACC_DecToStop = 1;  
        }
        else
        {
            chgEv_ACC_244_ACC_DecToStop = 0;
        }
    }
}
/*@@end*/

/*@@envVar:E_pubc_ACC_ACC_244_ACC_DecToStop_Vt:*/
on envVar E_pubc_ACC_ACC_244_ACC_DecToStop_Vt
{
    qword rawValue = 0ll;
    if(getValue(E_pubc_ACC_ACC_244_ACC_DecToStop_SetVt))
    {
        //update the signal value
        Msg_ACC_244.ACC_DecToStop=getValue(this);
    }
}
/*@@end*/

/*@@envVar:E_pubc_ACC_ACC_244_ACC_DecToStop_SetVt:*/
on envVar E_pubc_ACC_ACC_244_ACC_DecToStop_SetVt
{
    if(getValue(E_pubc_ACC_ACC_244_ACC_DecToStop_SetVt))
    {
        //update the signal value
        Msg_ACC_244.ACC_DecToStop=getvalue(E_pubc_ACC_ACC_244_ACC_DecToStop_Vt);
    }
    else
    {
        Msg_ACC_244.ACC_DecToStop=getValue(E_pubc_ACC_ACC_244_ACC_DecToStop_Rv);
    }
}
/*@@end*/
 
/*@@envVar:E_pubc_ACC_ACC_244_ACC_ABAlevel_Rv:*/
on envVar E_pubc_ACC_ACC_244_ACC_ABAlevel_Rv
{
    int64 rawValue = 0ll;
    float rawValue_float = 0.0;
    float phyValue = 0.0;        

    //set the signal with updated raw value
    if(getValue(E_pubc_ACC_ACC_244_ACC_ABAlevel_SetVt)==0)
    {
        rawValue = getvalue(this);
        if(chgEv_ACC_244_ACC_ABAlevel == 0)
        {
            //type conversion to float
            rawValue_float = rawValue;        
            // raw to physical conversion
            phyValue = ((rawValue_float *1)+(0));
            putValue(E_pubc_ACC_ACC_244_ACC_ABAlevel_Pv, phyValue);
            chgEv_ACC_244_ACC_ABAlevel = 1;
        }
        else
        {
            chgEv_ACC_244_ACC_ABAlevel = 0;
        }    
        //update the signal value
        Msg_ACC_244.ACC_ABAlevel=rawValue;        
    }                                                                           
}
/*@@end*/

/*@@envVar:E_pubc_ACC_ACC_244_ACC_ABAlevel_Pv:*/
on envVar E_pubc_ACC_ACC_244_ACC_ABAlevel_Pv
{
    int64 rawValue = 0ll;
    float phyValue = 0.0;
    
    //update the raw value with physical value 
    if(getValue(E_pubc_ACC_ACC_244_ACC_ABAlevel_SetVt)==0)
    {
        if(chgEv_ACC_244_ACC_ABAlevel == 0)
        {
            phyValue = getvalue(this);
            // physical to raw conversion
            rawValue = ((phyValue -(0))/1);
            putValue(E_pubc_ACC_ACC_244_ACC_ABAlevel_Rv, rawValue);
            chgEv_ACC_244_ACC_ABAlevel = 1;  
        }
        else
        {
            chgEv_ACC_244_ACC_ABAlevel = 0;
        }
    }
}
/*@@end*/

/*@@envVar:E_pubc_ACC_ACC_244_ACC_ABAlevel_Vt:*/
on envVar E_pubc_ACC_ACC_244_ACC_ABAlevel_Vt
{
    qword rawValue = 0ll;
    if(getValue(E_pubc_ACC_ACC_244_ACC_ABAlevel_SetVt))
    {
        //update the signal value
        Msg_ACC_244.ACC_ABAlevel=getValue(this);
    }
}
/*@@end*/

/*@@envVar:E_pubc_ACC_ACC_244_ACC_ABAlevel_SetVt:*/
on envVar E_pubc_ACC_ACC_244_ACC_ABAlevel_SetVt
{
    if(getValue(E_pubc_ACC_ACC_244_ACC_ABAlevel_SetVt))
    {
        //update the signal value
        Msg_ACC_244.ACC_ABAlevel=getvalue(E_pubc_ACC_ACC_244_ACC_ABAlevel_Vt);
    }
    else
    {
        Msg_ACC_244.ACC_ABAlevel=getValue(E_pubc_ACC_ACC_244_ACC_ABAlevel_Rv);
    }
}
/*@@end*/
 
/*@@envVar:E_pubc_ACC_ACC_244_ACC_ABAActive_Rv:*/
on envVar E_pubc_ACC_ACC_244_ACC_ABAActive_Rv
{
    int64 rawValue = 0ll;
    float rawValue_float = 0.0;
    float phyValue = 0.0;        

    //set the signal with updated raw value
    if(getValue(E_pubc_ACC_ACC_244_ACC_ABAActive_SetVt)==0)
    {
        rawValue = getvalue(this);
        if(chgEv_ACC_244_ACC_ABAActive == 0)
        {
            //type conversion to float
            rawValue_float = rawValue;        
            // raw to physical conversion
            phyValue = ((rawValue_float *1)+(0));
            putValue(E_pubc_ACC_ACC_244_ACC_ABAActive_Pv, phyValue);
            chgEv_ACC_244_ACC_ABAActive = 1;
        }
        else
        {
            chgEv_ACC_244_ACC_ABAActive = 0;
        }    
        //update the signal value
        Msg_ACC_244.ACC_ABAActive=rawValue;        
    }                                                                           
}
/*@@end*/

/*@@envVar:E_pubc_ACC_ACC_244_ACC_ABAActive_Pv:*/
on envVar E_pubc_ACC_ACC_244_ACC_ABAActive_Pv
{
    int64 rawValue = 0ll;
    float phyValue = 0.0;
    
    //update the raw value with physical value 
    if(getValue(E_pubc_ACC_ACC_244_ACC_ABAActive_SetVt)==0)
    {
        if(chgEv_ACC_244_ACC_ABAActive == 0)
        {
            phyValue = getvalue(this);
            // physical to raw conversion
            rawValue = ((phyValue -(0))/1);
            putValue(E_pubc_ACC_ACC_244_ACC_ABAActive_Rv, rawValue);
            chgEv_ACC_244_ACC_ABAActive = 1;  
        }
        else
        {
            chgEv_ACC_244_ACC_ABAActive = 0;
        }
    }
}
/*@@end*/

/*@@envVar:E_pubc_ACC_ACC_244_ACC_ABAActive_Vt:*/
on envVar E_pubc_ACC_ACC_244_ACC_ABAActive_Vt
{
    qword rawValue = 0ll;
    if(getValue(E_pubc_ACC_ACC_244_ACC_ABAActive_SetVt))
    {
        //update the signal value
        Msg_ACC_244.ACC_ABAActive=getValue(this);
    }
}
/*@@end*/

/*@@envVar:E_pubc_ACC_ACC_244_ACC_ABAActive_SetVt:*/
on envVar E_pubc_ACC_ACC_244_ACC_ABAActive_SetVt
{
    if(getValue(E_pubc_ACC_ACC_244_ACC_ABAActive_SetVt))
    {
        //update the signal value
        Msg_ACC_244.ACC_ABAActive=getvalue(E_pubc_ACC_ACC_244_ACC_ABAActive_Vt);
    }
    else
    {
        Msg_ACC_244.ACC_ABAActive=getValue(E_pubc_ACC_ACC_244_ACC_ABAActive_Rv);
    }
}
/*@@end*/
 
/*@@envVar:E_pubc_ACC_ACC_244_ACC_PrefillActive_Rv:*/
on envVar E_pubc_ACC_ACC_244_ACC_PrefillActive_Rv
{
    int64 rawValue = 0ll;
    float rawValue_float = 0.0;
    float phyValue = 0.0;        

    //set the signal with updated raw value
    if(getValue(E_pubc_ACC_ACC_244_ACC_PrefillActive_SetVt)==0)
    {
        rawValue = getvalue(this);
        if(chgEv_ACC_244_ACC_PrefillActive == 0)
        {
            //type conversion to float
            rawValue_float = rawValue;        
            // raw to physical conversion
            phyValue = ((rawValue_float *1)+(0));
            putValue(E_pubc_ACC_ACC_244_ACC_PrefillActive_Pv, phyValue);
            chgEv_ACC_244_ACC_PrefillActive = 1;
        }
        else
        {
            chgEv_ACC_244_ACC_PrefillActive = 0;
        }    
        //update the signal value
        Msg_ACC_244.ACC_PrefillActive=rawValue;        
    }                                                                           
}
/*@@end*/

/*@@envVar:E_pubc_ACC_ACC_244_ACC_PrefillActive_Pv:*/
on envVar E_pubc_ACC_ACC_244_ACC_PrefillActive_Pv
{
    int64 rawValue = 0ll;
    float phyValue = 0.0;
    
    //update the raw value with physical value 
    if(getValue(E_pubc_ACC_ACC_244_ACC_PrefillActive_SetVt)==0)
    {
        if(chgEv_ACC_244_ACC_PrefillActive == 0)
        {
            phyValue = getvalue(this);
            // physical to raw conversion
            rawValue = ((phyValue -(0))/1);
            putValue(E_pubc_ACC_ACC_244_ACC_PrefillActive_Rv, rawValue);
            chgEv_ACC_244_ACC_PrefillActive = 1;  
        }
        else
        {
            chgEv_ACC_244_ACC_PrefillActive = 0;
        }
    }
}
/*@@end*/

/*@@envVar:E_pubc_ACC_ACC_244_ACC_PrefillActive_Vt:*/
on envVar E_pubc_ACC_ACC_244_ACC_PrefillActive_Vt
{
    qword rawValue = 0ll;
    if(getValue(E_pubc_ACC_ACC_244_ACC_PrefillActive_SetVt))
    {
        //update the signal value
        Msg_ACC_244.ACC_PrefillActive=getValue(this);
    }
}
/*@@end*/

/*@@envVar:E_pubc_ACC_ACC_244_ACC_PrefillActive_SetVt:*/
on envVar E_pubc_ACC_ACC_244_ACC_PrefillActive_SetVt
{
    if(getValue(E_pubc_ACC_ACC_244_ACC_PrefillActive_SetVt))
    {
        //update the signal value
        Msg_ACC_244.ACC_PrefillActive=getvalue(E_pubc_ACC_ACC_244_ACC_PrefillActive_Vt);
    }
    else
    {
        Msg_ACC_244.ACC_PrefillActive=getValue(E_pubc_ACC_ACC_244_ACC_PrefillActive_Rv);
    }
}
/*@@end*/
 
/*@@envVar:E_pubc_ACC_ACC_244_ACC_AEBCtrlType_Rv:*/
on envVar E_pubc_ACC_ACC_244_ACC_AEBCtrlType_Rv
{
    int64 rawValue = 0ll;
    float rawValue_float = 0.0;
    float phyValue = 0.0;        

    //set the signal with updated raw value
    if(getValue(E_pubc_ACC_ACC_244_ACC_AEBCtrlType_SetVt)==0)
    {
        rawValue = getvalue(this);
        if(chgEv_ACC_244_ACC_AEBCtrlType == 0)
        {
            //type conversion to float
            rawValue_float = rawValue;        
            // raw to physical conversion
            phyValue = ((rawValue_float *1)+(0));
            putValue(E_pubc_ACC_ACC_244_ACC_AEBCtrlType_Pv, phyValue);
            chgEv_ACC_244_ACC_AEBCtrlType = 1;
        }
        else
        {
            chgEv_ACC_244_ACC_AEBCtrlType = 0;
        }    
        //update the signal value
        Msg_ACC_244.ACC_AEBCtrlType=rawValue;        
    }                                                                           
}
/*@@end*/

/*@@envVar:E_pubc_ACC_ACC_244_ACC_AEBCtrlType_Pv:*/
on envVar E_pubc_ACC_ACC_244_ACC_AEBCtrlType_Pv
{
    int64 rawValue = 0ll;
    float phyValue = 0.0;
    
    //update the raw value with physical value 
    if(getValue(E_pubc_ACC_ACC_244_ACC_AEBCtrlType_SetVt)==0)
    {
        if(chgEv_ACC_244_ACC_AEBCtrlType == 0)
        {
            phyValue = getvalue(this);
            // physical to raw conversion
            rawValue = ((phyValue -(0))/1);
            putValue(E_pubc_ACC_ACC_244_ACC_AEBCtrlType_Rv, rawValue);
            chgEv_ACC_244_ACC_AEBCtrlType = 1;  
        }
        else
        {
            chgEv_ACC_244_ACC_AEBCtrlType = 0;
        }
    }
}
/*@@end*/

/*@@envVar:E_pubc_ACC_ACC_244_ACC_AEBCtrlType_Vt:*/
on envVar E_pubc_ACC_ACC_244_ACC_AEBCtrlType_Vt
{
    qword rawValue = 0ll;
    if(getValue(E_pubc_ACC_ACC_244_ACC_AEBCtrlType_SetVt))
    {
        //update the signal value
        Msg_ACC_244.ACC_AEBCtrlType=getValue(this);
    }
}
/*@@end*/

/*@@envVar:E_pubc_ACC_ACC_244_ACC_AEBCtrlType_SetVt:*/
on envVar E_pubc_ACC_ACC_244_ACC_AEBCtrlType_SetVt
{
    if(getValue(E_pubc_ACC_ACC_244_ACC_AEBCtrlType_SetVt))
    {
        //update the signal value
        Msg_ACC_244.ACC_AEBCtrlType=getvalue(E_pubc_ACC_ACC_244_ACC_AEBCtrlType_Vt);
    }
    else
    {
        Msg_ACC_244.ACC_AEBCtrlType=getValue(E_pubc_ACC_ACC_244_ACC_AEBCtrlType_Rv);
    }
}
/*@@end*/
 
/*@@envVar:E_pubc_ACC_ACC_244_ACC_FCWActive_Rv:*/
on envVar E_pubc_ACC_ACC_244_ACC_FCWActive_Rv
{
    int64 rawValue = 0ll;
    float rawValue_float = 0.0;
    float phyValue = 0.0;        

    //set the signal with updated raw value
    if(getValue(E_pubc_ACC_ACC_244_ACC_FCWActive_SetVt)==0)
    {
        rawValue = getvalue(this);
        if(chgEv_ACC_244_ACC_FCWActive == 0)
        {
            //type conversion to float
            rawValue_float = rawValue;        
            // raw to physical conversion
            phyValue = ((rawValue_float *1)+(0));
            putValue(E_pubc_ACC_ACC_244_ACC_FCWActive_Pv, phyValue);
            chgEv_ACC_244_ACC_FCWActive = 1;
        }
        else
        {
            chgEv_ACC_244_ACC_FCWActive = 0;
        }    
        //update the signal value
        Msg_ACC_244.ACC_FCWActive=rawValue;        
    }                                                                           
}
/*@@end*/

/*@@envVar:E_pubc_ACC_ACC_244_ACC_FCWActive_Pv:*/
on envVar E_pubc_ACC_ACC_244_ACC_FCWActive_Pv
{
    int64 rawValue = 0ll;
    float phyValue = 0.0;
    
    //update the raw value with physical value 
    if(getValue(E_pubc_ACC_ACC_244_ACC_FCWActive_SetVt)==0)
    {
        if(chgEv_ACC_244_ACC_FCWActive == 0)
        {
            phyValue = getvalue(this);
            // physical to raw conversion
            rawValue = ((phyValue -(0))/1);
            putValue(E_pubc_ACC_ACC_244_ACC_FCWActive_Rv, rawValue);
            chgEv_ACC_244_ACC_FCWActive = 1;  
        }
        else
        {
            chgEv_ACC_244_ACC_FCWActive = 0;
        }
    }
}
/*@@end*/

/*@@envVar:E_pubc_ACC_ACC_244_ACC_FCWActive_Vt:*/
on envVar E_pubc_ACC_ACC_244_ACC_FCWActive_Vt
{
    qword rawValue = 0ll;
    if(getValue(E_pubc_ACC_ACC_244_ACC_FCWActive_SetVt))
    {
        //update the signal value
        Msg_ACC_244.ACC_FCWActive=getValue(this);
    }
}
/*@@end*/

/*@@envVar:E_pubc_ACC_ACC_244_ACC_FCWActive_SetVt:*/
on envVar E_pubc_ACC_ACC_244_ACC_FCWActive_SetVt
{
    if(getValue(E_pubc_ACC_ACC_244_ACC_FCWActive_SetVt))
    {
        //update the signal value
        Msg_ACC_244.ACC_FCWActive=getvalue(E_pubc_ACC_ACC_244_ACC_FCWActive_Vt);
    }
    else
    {
        Msg_ACC_244.ACC_FCWActive=getValue(E_pubc_ACC_ACC_244_ACC_FCWActive_Rv);
    }
}
/*@@end*/
 
/*@@envVar:E_pubc_ACC_ACC_244_ACC_FCWLatentWarning_Rv:*/
on envVar E_pubc_ACC_ACC_244_ACC_FCWLatentWarning_Rv
{
    int64 rawValue = 0ll;
    float rawValue_float = 0.0;
    float phyValue = 0.0;        

    //set the signal with updated raw value
    if(getValue(E_pubc_ACC_ACC_244_ACC_FCWLatentWarning_SetVt)==0)
    {
        rawValue = getvalue(this);
        if(chgEv_ACC_244_ACC_FCWLatentWarning == 0)
        {
            //type conversion to float
            rawValue_float = rawValue;        
            // raw to physical conversion
            phyValue = ((rawValue_float *1)+(0));
            putValue(E_pubc_ACC_ACC_244_ACC_FCWLatentWarning_Pv, phyValue);
            chgEv_ACC_244_ACC_FCWLatentWarning = 1;
        }
        else
        {
            chgEv_ACC_244_ACC_FCWLatentWarning = 0;
        }    
        //update the signal value
        Msg_ACC_244.ACC_FCWLatentWarning=rawValue;        
    }                                                                           
}
/*@@end*/

/*@@envVar:E_pubc_ACC_ACC_244_ACC_FCWLatentWarning_Pv:*/
on envVar E_pubc_ACC_ACC_244_ACC_FCWLatentWarning_Pv
{
    int64 rawValue = 0ll;
    float phyValue = 0.0;
    
    //update the raw value with physical value 
    if(getValue(E_pubc_ACC_ACC_244_ACC_FCWLatentWarning_SetVt)==0)
    {
        if(chgEv_ACC_244_ACC_FCWLatentWarning == 0)
        {
            phyValue = getvalue(this);
            // physical to raw conversion
            rawValue = ((phyValue -(0))/1);
            putValue(E_pubc_ACC_ACC_244_ACC_FCWLatentWarning_Rv, rawValue);
            chgEv_ACC_244_ACC_FCWLatentWarning = 1;  
        }
        else
        {
            chgEv_ACC_244_ACC_FCWLatentWarning = 0;
        }
    }
}
/*@@end*/

/*@@envVar:E_pubc_ACC_ACC_244_ACC_FCWLatentWarning_Vt:*/
on envVar E_pubc_ACC_ACC_244_ACC_FCWLatentWarning_Vt
{
    qword rawValue = 0ll;
    if(getValue(E_pubc_ACC_ACC_244_ACC_FCWLatentWarning_SetVt))
    {
        //update the signal value
        Msg_ACC_244.ACC_FCWLatentWarning=getValue(this);
    }
}
/*@@end*/

/*@@envVar:E_pubc_ACC_ACC_244_ACC_FCWLatentWarning_SetVt:*/
on envVar E_pubc_ACC_ACC_244_ACC_FCWLatentWarning_SetVt
{
    if(getValue(E_pubc_ACC_ACC_244_ACC_FCWLatentWarning_SetVt))
    {
        //update the signal value
        Msg_ACC_244.ACC_FCWLatentWarning=getvalue(E_pubc_ACC_ACC_244_ACC_FCWLatentWarning_Vt);
    }
    else
    {
        Msg_ACC_244.ACC_FCWLatentWarning=getValue(E_pubc_ACC_ACC_244_ACC_FCWLatentWarning_Rv);
    }
}
/*@@end*/
 
/*@@envVar:E_pubc_ACC_ACC_244_ACC_LDWVibrationWarningReq_Rv:*/
on envVar E_pubc_ACC_ACC_244_ACC_LDWVibrationWarningReq_Rv
{
    int64 rawValue = 0ll;
    float rawValue_float = 0.0;
    float phyValue = 0.0;        

    //set the signal with updated raw value
    if(getValue(E_pubc_ACC_ACC_244_ACC_LDWVibrationWarningReq_SetVt)==0)
    {
        rawValue = getvalue(this);
        if(chgEv_ACC_244_ACC_LDWVibrationWarningReq == 0)
        {
            //type conversion to float
            rawValue_float = rawValue;        
            // raw to physical conversion
            phyValue = ((rawValue_float *1)+(0));
            putValue(E_pubc_ACC_ACC_244_ACC_LDWVibrationWarningReq_Pv, phyValue);
            chgEv_ACC_244_ACC_LDWVibrationWarningReq = 1;
        }
        else
        {
            chgEv_ACC_244_ACC_LDWVibrationWarningReq = 0;
        }    
        //update the signal value
        Msg_ACC_244.ACC_LDWVibrationWarningReq=rawValue;        
    }                                                                           
}
/*@@end*/

/*@@envVar:E_pubc_ACC_ACC_244_ACC_LDWVibrationWarningReq_Pv:*/
on envVar E_pubc_ACC_ACC_244_ACC_LDWVibrationWarningReq_Pv
{
    int64 rawValue = 0ll;
    float phyValue = 0.0;
    
    //update the raw value with physical value 
    if(getValue(E_pubc_ACC_ACC_244_ACC_LDWVibrationWarningReq_SetVt)==0)
    {
        if(chgEv_ACC_244_ACC_LDWVibrationWarningReq == 0)
        {
            phyValue = getvalue(this);
            // physical to raw conversion
            rawValue = ((phyValue -(0))/1);
            putValue(E_pubc_ACC_ACC_244_ACC_LDWVibrationWarningReq_Rv, rawValue);
            chgEv_ACC_244_ACC_LDWVibrationWarningReq = 1;  
        }
        else
        {
            chgEv_ACC_244_ACC_LDWVibrationWarningReq = 0;
        }
    }
}
/*@@end*/

/*@@envVar:E_pubc_ACC_ACC_244_ACC_LDWVibrationWarningReq_Vt:*/
on envVar E_pubc_ACC_ACC_244_ACC_LDWVibrationWarningReq_Vt
{
    qword rawValue = 0ll;
    if(getValue(E_pubc_ACC_ACC_244_ACC_LDWVibrationWarningReq_SetVt))
    {
        //update the signal value
        Msg_ACC_244.ACC_LDWVibrationWarningReq=getValue(this);
    }
}
/*@@end*/

/*@@envVar:E_pubc_ACC_ACC_244_ACC_LDWVibrationWarningReq_SetVt:*/
on envVar E_pubc_ACC_ACC_244_ACC_LDWVibrationWarningReq_SetVt
{
    if(getValue(E_pubc_ACC_ACC_244_ACC_LDWVibrationWarningReq_SetVt))
    {
        //update the signal value
        Msg_ACC_244.ACC_LDWVibrationWarningReq=getvalue(E_pubc_ACC_ACC_244_ACC_LDWVibrationWarningReq_Vt);
    }
    else
    {
        Msg_ACC_244.ACC_LDWVibrationWarningReq=getValue(E_pubc_ACC_ACC_244_ACC_LDWVibrationWarningReq_Rv);
    }
}
/*@@end*/
 
/*@@envVar:E_pubc_ACC_ACC_244_ADS_MesssageCounter_244_Rv:*/
on envVar E_pubc_ACC_ACC_244_ADS_MesssageCounter_244_Rv
{
    int64 rawValue = 0ll;
    float rawValue_float = 0.0;
    float phyValue = 0.0;        

    //set the signal with updated raw value
    {
        rawValue = getvalue(this);
        if(chgEv_ACC_244_ADS_MesssageCounter_244 == 0)
        {
            //type conversion to float
            rawValue_float = rawValue;        
            // raw to physical conversion
            phyValue = ((rawValue_float *1)+(0));
            putValue(E_pubc_ACC_ACC_244_ADS_MesssageCounter_244_Pv, phyValue);
            chgEv_ACC_244_ADS_MesssageCounter_244 = 1;
        }
        else
        {
            chgEv_ACC_244_ADS_MesssageCounter_244 = 0;
        }    
        //update the signal value
        Msg_ACC_244.ADS_MesssageCounter_244=rawValue;        
    }                                                                           
}
/*@@end*/

/*@@envVar:E_pubc_ACC_ACC_244_ADS_MesssageCounter_244_Pv:*/
on envVar E_pubc_ACC_ACC_244_ADS_MesssageCounter_244_Pv
{
    int64 rawValue = 0ll;
    float phyValue = 0.0;
    
    //update the raw value with physical value 
    {
        if(chgEv_ACC_244_ADS_MesssageCounter_244 == 0)
        {
            phyValue = getvalue(this);
            // physical to raw conversion
            rawValue = ((phyValue -(0))/1);
            putValue(E_pubc_ACC_ACC_244_ADS_MesssageCounter_244_Rv, rawValue);
            chgEv_ACC_244_ADS_MesssageCounter_244 = 1;  
        }
        else
        {
            chgEv_ACC_244_ADS_MesssageCounter_244 = 0;
        }
    }
}
/*@@end*/


 
/*@@envVar:E_pubc_ACC_ACC_244_ACC_AEBTargetDeceleration_Rv:*/
on envVar E_pubc_ACC_ACC_244_ACC_AEBTargetDeceleration_Rv
{
    int64 rawValue = 0ll;
    float rawValue_float = 0.0;
    float phyValue = 0.0;        

    //set the signal with updated raw value
    {
        rawValue = getvalue(this);
        if(chgEv_ACC_244_ACC_AEBTargetDeceleration == 0)
        {
            //type conversion to float
            rawValue_float = rawValue;        
            // raw to physical conversion
            phyValue = ((rawValue_float *0.0005)+(-16));
            putValue(E_pubc_ACC_ACC_244_ACC_AEBTargetDeceleration_Pv, phyValue);
            chgEv_ACC_244_ACC_AEBTargetDeceleration = 1;
        }
        else
        {
            chgEv_ACC_244_ACC_AEBTargetDeceleration = 0;
        }    
        //update the signal value
        Msg_ACC_244.ACC_AEBTargetDeceleration=rawValue;        
    }                                                                           
}
/*@@end*/

/*@@envVar:E_pubc_ACC_ACC_244_ACC_AEBTargetDeceleration_Pv:*/
on envVar E_pubc_ACC_ACC_244_ACC_AEBTargetDeceleration_Pv
{
    int64 rawValue = 0ll;
    float phyValue = 0.0;
    
    //update the raw value with physical value 
    {
        if(chgEv_ACC_244_ACC_AEBTargetDeceleration == 0)
        {
            phyValue = getvalue(this);
            // physical to raw conversion
            rawValue = ((phyValue -(-16))/0.0005);
            putValue(E_pubc_ACC_ACC_244_ACC_AEBTargetDeceleration_Rv, rawValue);
            chgEv_ACC_244_ACC_AEBTargetDeceleration = 1;  
        }
        else
        {
            chgEv_ACC_244_ACC_AEBTargetDeceleration = 0;
        }
    }
}
/*@@end*/


 
/*@@envVar:E_pubc_ACC_ACC_244_ACC_AEBVehilceHoldReq_Rv:*/
on envVar E_pubc_ACC_ACC_244_ACC_AEBVehilceHoldReq_Rv
{
    int64 rawValue = 0ll;
    float rawValue_float = 0.0;
    float phyValue = 0.0;        

    //set the signal with updated raw value
    if(getValue(E_pubc_ACC_ACC_244_ACC_AEBVehilceHoldReq_SetVt)==0)
    {
        rawValue = getvalue(this);
        if(chgEv_ACC_244_ACC_AEBVehilceHoldReq == 0)
        {
            //type conversion to float
            rawValue_float = rawValue;        
            // raw to physical conversion
            phyValue = ((rawValue_float *1)+(0));
            putValue(E_pubc_ACC_ACC_244_ACC_AEBVehilceHoldReq_Pv, phyValue);
            chgEv_ACC_244_ACC_AEBVehilceHoldReq = 1;
        }
        else
        {
            chgEv_ACC_244_ACC_AEBVehilceHoldReq = 0;
        }    
        //update the signal value
        Msg_ACC_244.ACC_AEBVehilceHoldReq=rawValue;        
    }                                                                           
}
/*@@end*/

/*@@envVar:E_pubc_ACC_ACC_244_ACC_AEBVehilceHoldReq_Pv:*/
on envVar E_pubc_ACC_ACC_244_ACC_AEBVehilceHoldReq_Pv
{
    int64 rawValue = 0ll;
    float phyValue = 0.0;
    
    //update the raw value with physical value 
    if(getValue(E_pubc_ACC_ACC_244_ACC_AEBVehilceHoldReq_SetVt)==0)
    {
        if(chgEv_ACC_244_ACC_AEBVehilceHoldReq == 0)
        {
            phyValue = getvalue(this);
            // physical to raw conversion
            rawValue = ((phyValue -(0))/1);
            putValue(E_pubc_ACC_ACC_244_ACC_AEBVehilceHoldReq_Rv, rawValue);
            chgEv_ACC_244_ACC_AEBVehilceHoldReq = 1;  
        }
        else
        {
            chgEv_ACC_244_ACC_AEBVehilceHoldReq = 0;
        }
    }
}
/*@@end*/

/*@@envVar:E_pubc_ACC_ACC_244_ACC_AEBVehilceHoldReq_Vt:*/
on envVar E_pubc_ACC_ACC_244_ACC_AEBVehilceHoldReq_Vt
{
    qword rawValue = 0ll;
    if(getValue(E_pubc_ACC_ACC_244_ACC_AEBVehilceHoldReq_SetVt))
    {
        //update the signal value
        Msg_ACC_244.ACC_AEBVehilceHoldReq=getValue(this);
    }
}
/*@@end*/

/*@@envVar:E_pubc_ACC_ACC_244_ACC_AEBVehilceHoldReq_SetVt:*/
on envVar E_pubc_ACC_ACC_244_ACC_AEBVehilceHoldReq_SetVt
{
    if(getValue(E_pubc_ACC_ACC_244_ACC_AEBVehilceHoldReq_SetVt))
    {
        //update the signal value
        Msg_ACC_244.ACC_AEBVehilceHoldReq=getvalue(E_pubc_ACC_ACC_244_ACC_AEBVehilceHoldReq_Vt);
    }
    else
    {
        Msg_ACC_244.ACC_AEBVehilceHoldReq=getValue(E_pubc_ACC_ACC_244_ACC_AEBVehilceHoldReq_Rv);
    }
}
/*@@end*/
 
/*@@envVar:E_pubc_ACC_ACC_244_ACC_AccTrqReq_Rv:*/
on envVar E_pubc_ACC_ACC_244_ACC_AccTrqReq_Rv
{
    int64 rawValue = 0ll;
    float rawValue_float = 0.0;
    float phyValue = 0.0;        

    //set the signal with updated raw value
    {
        rawValue = getvalue(this);
        if(chgEv_ACC_244_ACC_AccTrqReq == 0)
        {
            //type conversion to float
            rawValue_float = rawValue;        
            // raw to physical conversion
            phyValue = ((rawValue_float *1)+(-16384));
            putValue(E_pubc_ACC_ACC_244_ACC_AccTrqReq_Pv, phyValue);
            chgEv_ACC_244_ACC_AccTrqReq = 1;
        }
        else
        {
            chgEv_ACC_244_ACC_AccTrqReq = 0;
        }    
        //update the signal value
        Msg_ACC_244.ACC_AccTrqReq=rawValue;        
    }                                                                           
}
/*@@end*/

/*@@envVar:E_pubc_ACC_ACC_244_ACC_AccTrqReq_Pv:*/
on envVar E_pubc_ACC_ACC_244_ACC_AccTrqReq_Pv
{
    int64 rawValue = 0ll;
    float phyValue = 0.0;
    
    //update the raw value with physical value 
    {
        if(chgEv_ACC_244_ACC_AccTrqReq == 0)
        {
            phyValue = getvalue(this);
            // physical to raw conversion
            rawValue = ((phyValue -(-16384))/1);
            putValue(E_pubc_ACC_ACC_244_ACC_AccTrqReq_Rv, rawValue);
            chgEv_ACC_244_ACC_AccTrqReq = 1;  
        }
        else
        {
            chgEv_ACC_244_ACC_AccTrqReq = 0;
        }
    }
}
/*@@end*/


 
/*@@envVar:E_pubc_ACC_ACC_244_ADS_ResetFlag_244_Rv:*/
on envVar E_pubc_ACC_ACC_244_ADS_ResetFlag_244_Rv
{
    int64 rawValue = 0ll;
    float rawValue_float = 0.0;
    float phyValue = 0.0;        

    //set the signal with updated raw value
    {
        rawValue = getvalue(this);
        if(chgEv_ACC_244_ADS_ResetFlag_244 == 0)
        {
            //type conversion to float
            rawValue_float = rawValue;        
            // raw to physical conversion
            phyValue = ((rawValue_float *1)+(0));
            putValue(E_pubc_ACC_ACC_244_ADS_ResetFlag_244_Pv, phyValue);
            chgEv_ACC_244_ADS_ResetFlag_244 = 1;
        }
        else
        {
            chgEv_ACC_244_ADS_ResetFlag_244 = 0;
        }    
        //update the signal value
        Msg_ACC_244.ADS_ResetFlag_244=rawValue;        
    }                                                                           
}
/*@@end*/

/*@@envVar:E_pubc_ACC_ACC_244_ADS_ResetFlag_244_Pv:*/
on envVar E_pubc_ACC_ACC_244_ADS_ResetFlag_244_Pv
{
    int64 rawValue = 0ll;
    float phyValue = 0.0;
    
    //update the raw value with physical value 
    {
        if(chgEv_ACC_244_ADS_ResetFlag_244 == 0)
        {
            phyValue = getvalue(this);
            // physical to raw conversion
            rawValue = ((phyValue -(0))/1);
            putValue(E_pubc_ACC_ACC_244_ADS_ResetFlag_244_Rv, rawValue);
            chgEv_ACC_244_ADS_ResetFlag_244 = 1;  
        }
        else
        {
            chgEv_ACC_244_ADS_ResetFlag_244 = 0;
        }
    }
}
/*@@end*/


 
/*@@envVar:E_pubc_ACC_ACC_244_ACC_LDWStatus_Rv:*/
on envVar E_pubc_ACC_ACC_244_ACC_LDWStatus_Rv
{
    int64 rawValue = 0ll;
    float rawValue_float = 0.0;
    float phyValue = 0.0;        

    //set the signal with updated raw value
    if(getValue(E_pubc_ACC_ACC_244_ACC_LDWStatus_SetVt)==0)
    {
        rawValue = getvalue(this);
        if(chgEv_ACC_244_ACC_LDWStatus == 0)
        {
            //type conversion to float
            rawValue_float = rawValue;        
            // raw to physical conversion
            phyValue = ((rawValue_float *1)+(0));
            putValue(E_pubc_ACC_ACC_244_ACC_LDWStatus_Pv, phyValue);
            chgEv_ACC_244_ACC_LDWStatus = 1;
        }
        else
        {
            chgEv_ACC_244_ACC_LDWStatus = 0;
        }    
        //update the signal value
        Msg_ACC_244.ACC_LDWStatus=rawValue;        
    }                                                                           
}
/*@@end*/

/*@@envVar:E_pubc_ACC_ACC_244_ACC_LDWStatus_Pv:*/
on envVar E_pubc_ACC_ACC_244_ACC_LDWStatus_Pv
{
    int64 rawValue = 0ll;
    float phyValue = 0.0;
    
    //update the raw value with physical value 
    if(getValue(E_pubc_ACC_ACC_244_ACC_LDWStatus_SetVt)==0)
    {
        if(chgEv_ACC_244_ACC_LDWStatus == 0)
        {
            phyValue = getvalue(this);
            // physical to raw conversion
            rawValue = ((phyValue -(0))/1);
            putValue(E_pubc_ACC_ACC_244_ACC_LDWStatus_Rv, rawValue);
            chgEv_ACC_244_ACC_LDWStatus = 1;  
        }
        else
        {
            chgEv_ACC_244_ACC_LDWStatus = 0;
        }
    }
}
/*@@end*/

/*@@envVar:E_pubc_ACC_ACC_244_ACC_LDWStatus_Vt:*/
on envVar E_pubc_ACC_ACC_244_ACC_LDWStatus_Vt
{
    qword rawValue = 0ll;
    if(getValue(E_pubc_ACC_ACC_244_ACC_LDWStatus_SetVt))
    {
        //update the signal value
        Msg_ACC_244.ACC_LDWStatus=getValue(this);
    }
}
/*@@end*/

/*@@envVar:E_pubc_ACC_ACC_244_ACC_LDWStatus_SetVt:*/
on envVar E_pubc_ACC_ACC_244_ACC_LDWStatus_SetVt
{
    if(getValue(E_pubc_ACC_ACC_244_ACC_LDWStatus_SetVt))
    {
        //update the signal value
        Msg_ACC_244.ACC_LDWStatus=getvalue(E_pubc_ACC_ACC_244_ACC_LDWStatus_Vt);
    }
    else
    {
        Msg_ACC_244.ACC_LDWStatus=getValue(E_pubc_ACC_ACC_244_ACC_LDWStatus_Rv);
    }
}
/*@@end*/
 
/*@@envVar:E_pubc_ACC_ACC_244_ACC_ACCTargetAcceleration_Rv:*/
on envVar E_pubc_ACC_ACC_244_ACC_ACCTargetAcceleration_Rv
{
    int64 rawValue = 0ll;
    float rawValue_float = 0.0;
    float phyValue = 0.0;        

    //set the signal with updated raw value
    {
        rawValue = getvalue(this);
        if(chgEv_ACC_244_ACC_ACCTargetAcceleration == 0)
        {
            //type conversion to float
            rawValue_float = rawValue;        
            // raw to physical conversion
            phyValue = ((rawValue_float *0.05)+(-5));
            putValue(E_pubc_ACC_ACC_244_ACC_ACCTargetAcceleration_Pv, phyValue);
            chgEv_ACC_244_ACC_ACCTargetAcceleration = 1;
        }
        else
        {
            chgEv_ACC_244_ACC_ACCTargetAcceleration = 0;
        }    
        //update the signal value
        Msg_ACC_244.ACC_ACCTargetAcceleration=rawValue;        
    }                                                                           
}
/*@@end*/

/*@@envVar:E_pubc_ACC_ACC_244_ACC_ACCTargetAcceleration_Pv:*/
on envVar E_pubc_ACC_ACC_244_ACC_ACCTargetAcceleration_Pv
{
    int64 rawValue = 0ll;
    float phyValue = 0.0;
    
    //update the raw value with physical value 
    {
        if(chgEv_ACC_244_ACC_ACCTargetAcceleration == 0)
        {
            phyValue = getvalue(this);
            // physical to raw conversion
            rawValue = ((phyValue -(-5))/0.05);
            putValue(E_pubc_ACC_ACC_244_ACC_ACCTargetAcceleration_Rv, rawValue);
            chgEv_ACC_244_ACC_ACCTargetAcceleration = 1;  
        }
        else
        {
            chgEv_ACC_244_ACC_ACCTargetAcceleration = 0;
        }
    }
}
/*@@end*/


 
/*@@envVar:E_pubc_ACC_ACC_244_ACC_EmergencyDataRrdReq_Rv:*/
on envVar E_pubc_ACC_ACC_244_ACC_EmergencyDataRrdReq_Rv
{
    int64 rawValue = 0ll;
    float rawValue_float = 0.0;
    float phyValue = 0.0;        

    //set the signal with updated raw value
    if(getValue(E_pubc_ACC_ACC_244_ACC_EmergencyDataRrdReq_SetVt)==0)
    {
        rawValue = getvalue(this);
        if(chgEv_ACC_244_ACC_EmergencyDataRrdReq == 0)
        {
            //type conversion to float
            rawValue_float = rawValue;        
            // raw to physical conversion
            phyValue = ((rawValue_float *1)+(0));
            putValue(E_pubc_ACC_ACC_244_ACC_EmergencyDataRrdReq_Pv, phyValue);
            chgEv_ACC_244_ACC_EmergencyDataRrdReq = 1;
        }
        else
        {
            chgEv_ACC_244_ACC_EmergencyDataRrdReq = 0;
        }    
        //update the signal value
        Msg_ACC_244.ACC_EmergencyDataRrdReq=rawValue;        
    }                                                                           
}
/*@@end*/

/*@@envVar:E_pubc_ACC_ACC_244_ACC_EmergencyDataRrdReq_Pv:*/
on envVar E_pubc_ACC_ACC_244_ACC_EmergencyDataRrdReq_Pv
{
    int64 rawValue = 0ll;
    float phyValue = 0.0;
    
    //update the raw value with physical value 
    if(getValue(E_pubc_ACC_ACC_244_ACC_EmergencyDataRrdReq_SetVt)==0)
    {
        if(chgEv_ACC_244_ACC_EmergencyDataRrdReq == 0)
        {
            phyValue = getvalue(this);
            // physical to raw conversion
            rawValue = ((phyValue -(0))/1);
            putValue(E_pubc_ACC_ACC_244_ACC_EmergencyDataRrdReq_Rv, rawValue);
            chgEv_ACC_244_ACC_EmergencyDataRrdReq = 1;  
        }
        else
        {
            chgEv_ACC_244_ACC_EmergencyDataRrdReq = 0;
        }
    }
}
/*@@end*/

/*@@envVar:E_pubc_ACC_ACC_244_ACC_EmergencyDataRrdReq_Vt:*/
on envVar E_pubc_ACC_ACC_244_ACC_EmergencyDataRrdReq_Vt
{
    qword rawValue = 0ll;
    if(getValue(E_pubc_ACC_ACC_244_ACC_EmergencyDataRrdReq_SetVt))
    {
        //update the signal value
        Msg_ACC_244.ACC_EmergencyDataRrdReq=getValue(this);
    }
}
/*@@end*/

/*@@envVar:E_pubc_ACC_ACC_244_ACC_EmergencyDataRrdReq_SetVt:*/
on envVar E_pubc_ACC_ACC_244_ACC_EmergencyDataRrdReq_SetVt
{
    if(getValue(E_pubc_ACC_ACC_244_ACC_EmergencyDataRrdReq_SetVt))
    {
        //update the signal value
        Msg_ACC_244.ACC_EmergencyDataRrdReq=getvalue(E_pubc_ACC_ACC_244_ACC_EmergencyDataRrdReq_Vt);
    }
    else
    {
        Msg_ACC_244.ACC_EmergencyDataRrdReq=getValue(E_pubc_ACC_ACC_244_ACC_EmergencyDataRrdReq_Rv);
    }
}
/*@@end*/
 
/*@@envVar:E_pubc_ACC_ACC_244_ADS_Authernticator_244_Rv:*/
on envVar E_pubc_ACC_ACC_244_ADS_Authernticator_244_Rv
{
    int64 rawValue = 0ll;
    float rawValue_float = 0.0;
    float phyValue = 0.0;        

    //set the signal with updated raw value
    {
        rawValue = getvalue(this);
        if(chgEv_ACC_244_ADS_Authernticator_244 == 0)
        {
            //type conversion to float
            rawValue_float = rawValue;        
            // raw to physical conversion
            phyValue = ((rawValue_float *1)+(0));
            putValue(E_pubc_ACC_ACC_244_ADS_Authernticator_244_Pv, phyValue);
            chgEv_ACC_244_ADS_Authernticator_244 = 1;
        }
        else
        {
            chgEv_ACC_244_ADS_Authernticator_244 = 0;
        }    
        //update the signal value
        Msg_ACC_244.ADS_Authernticator_244=rawValue;        
    }                                                                           
}
/*@@end*/

/*@@envVar:E_pubc_ACC_ACC_244_ADS_Authernticator_244_Pv:*/
on envVar E_pubc_ACC_ACC_244_ADS_Authernticator_244_Pv
{
    int64 rawValue = 0ll;
    float phyValue = 0.0;
    
    //update the raw value with physical value 
    {
        if(chgEv_ACC_244_ADS_Authernticator_244 == 0)
        {
            phyValue = getvalue(this);
            // physical to raw conversion
            rawValue = ((phyValue -(0))/1);
            putValue(E_pubc_ACC_ACC_244_ADS_Authernticator_244_Rv, rawValue);
            chgEv_ACC_244_ADS_Authernticator_244 = 1;  
        }
        else
        {
            chgEv_ACC_244_ADS_Authernticator_244 = 0;
        }
    }
}
/*@@end*/


 
/*@@envVar:E_pubc_ACC_ACC_244_ACC_AEBActive_Rv:*/
on envVar E_pubc_ACC_ACC_244_ACC_AEBActive_Rv
{
    int64 rawValue = 0ll;
    float rawValue_float = 0.0;
    float phyValue = 0.0;        

    //set the signal with updated raw value
    if(getValue(E_pubc_ACC_ACC_244_ACC_AEBActive_SetVt)==0)
    {
        rawValue = getvalue(this);
        if(chgEv_ACC_244_ACC_AEBActive == 0)
        {
            //type conversion to float
            rawValue_float = rawValue;        
            // raw to physical conversion
            phyValue = ((rawValue_float *1)+(0));
            putValue(E_pubc_ACC_ACC_244_ACC_AEBActive_Pv, phyValue);
            chgEv_ACC_244_ACC_AEBActive = 1;
        }
        else
        {
            chgEv_ACC_244_ACC_AEBActive = 0;
        }    
        //update the signal value
        Msg_ACC_244.ACC_AEBActive=rawValue;        
    }                                                                           
}
/*@@end*/

/*@@envVar:E_pubc_ACC_ACC_244_ACC_AEBActive_Pv:*/
on envVar E_pubc_ACC_ACC_244_ACC_AEBActive_Pv
{
    int64 rawValue = 0ll;
    float phyValue = 0.0;
    
    //update the raw value with physical value 
    if(getValue(E_pubc_ACC_ACC_244_ACC_AEBActive_SetVt)==0)
    {
        if(chgEv_ACC_244_ACC_AEBActive == 0)
        {
            phyValue = getvalue(this);
            // physical to raw conversion
            rawValue = ((phyValue -(0))/1);
            putValue(E_pubc_ACC_ACC_244_ACC_AEBActive_Rv, rawValue);
            chgEv_ACC_244_ACC_AEBActive = 1;  
        }
        else
        {
            chgEv_ACC_244_ACC_AEBActive = 0;
        }
    }
}
/*@@end*/

/*@@envVar:E_pubc_ACC_ACC_244_ACC_AEBActive_Vt:*/
on envVar E_pubc_ACC_ACC_244_ACC_AEBActive_Vt
{
    qword rawValue = 0ll;
    if(getValue(E_pubc_ACC_ACC_244_ACC_AEBActive_SetVt))
    {
        //update the signal value
        Msg_ACC_244.ACC_AEBActive=getValue(this);
    }
}
/*@@end*/

/*@@envVar:E_pubc_ACC_ACC_244_ACC_AEBActive_SetVt:*/
on envVar E_pubc_ACC_ACC_244_ACC_AEBActive_SetVt
{
    if(getValue(E_pubc_ACC_ACC_244_ACC_AEBActive_SetVt))
    {
        //update the signal value
        Msg_ACC_244.ACC_AEBActive=getvalue(E_pubc_ACC_ACC_244_ACC_AEBActive_Vt);
    }
    else
    {
        Msg_ACC_244.ACC_AEBActive=getValue(E_pubc_ACC_ACC_244_ACC_AEBActive_Rv);
    }
}
/*@@end*/
 
/*@@envVar:E_pubc_ACC_ACC_244_ACC_LKAStatus_Rv:*/
on envVar E_pubc_ACC_ACC_244_ACC_LKAStatus_Rv
{
    int64 rawValue = 0ll;
    float rawValue_float = 0.0;
    float phyValue = 0.0;        

    //set the signal with updated raw value
    if(getValue(E_pubc_ACC_ACC_244_ACC_LKAStatus_SetVt)==0)
    {
        rawValue = getvalue(this);
        if(chgEv_ACC_244_ACC_LKAStatus == 0)
        {
            //type conversion to float
            rawValue_float = rawValue;        
            // raw to physical conversion
            phyValue = ((rawValue_float *1)+(0));
            putValue(E_pubc_ACC_ACC_244_ACC_LKAStatus_Pv, phyValue);
            chgEv_ACC_244_ACC_LKAStatus = 1;
        }
        else
        {
            chgEv_ACC_244_ACC_LKAStatus = 0;
        }    
        //update the signal value
        Msg_ACC_244.ACC_LKAStatus=rawValue;        
    }                                                                           
}
/*@@end*/

/*@@envVar:E_pubc_ACC_ACC_244_ACC_LKAStatus_Pv:*/
on envVar E_pubc_ACC_ACC_244_ACC_LKAStatus_Pv
{
    int64 rawValue = 0ll;
    float phyValue = 0.0;
    
    //update the raw value with physical value 
    if(getValue(E_pubc_ACC_ACC_244_ACC_LKAStatus_SetVt)==0)
    {
        if(chgEv_ACC_244_ACC_LKAStatus == 0)
        {
            phyValue = getvalue(this);
            // physical to raw conversion
            rawValue = ((phyValue -(0))/1);
            putValue(E_pubc_ACC_ACC_244_ACC_LKAStatus_Rv, rawValue);
            chgEv_ACC_244_ACC_LKAStatus = 1;  
        }
        else
        {
            chgEv_ACC_244_ACC_LKAStatus = 0;
        }
    }
}
/*@@end*/

/*@@envVar:E_pubc_ACC_ACC_244_ACC_LKAStatus_Vt:*/
on envVar E_pubc_ACC_ACC_244_ACC_LKAStatus_Vt
{
    qword rawValue = 0ll;
    if(getValue(E_pubc_ACC_ACC_244_ACC_LKAStatus_SetVt))
    {
        //update the signal value
        Msg_ACC_244.ACC_LKAStatus=getValue(this);
    }
}
/*@@end*/

/*@@envVar:E_pubc_ACC_ACC_244_ACC_LKAStatus_SetVt:*/
on envVar E_pubc_ACC_ACC_244_ACC_LKAStatus_SetVt
{
    if(getValue(E_pubc_ACC_ACC_244_ACC_LKAStatus_SetVt))
    {
        //update the signal value
        Msg_ACC_244.ACC_LKAStatus=getvalue(E_pubc_ACC_ACC_244_ACC_LKAStatus_Vt);
    }
    else
    {
        Msg_ACC_244.ACC_LKAStatus=getValue(E_pubc_ACC_ACC_244_ACC_LKAStatus_Rv);
    }
}
/*@@end*/
 
/*@@envVar:E_pubc_ACC_ACC_244_ACC_FCWPreWarning_Rv:*/
on envVar E_pubc_ACC_ACC_244_ACC_FCWPreWarning_Rv
{
    int64 rawValue = 0ll;
    float rawValue_float = 0.0;
    float phyValue = 0.0;        

    //set the signal with updated raw value
    if(getValue(E_pubc_ACC_ACC_244_ACC_FCWPreWarning_SetVt)==0)
    {
        rawValue = getvalue(this);
        if(chgEv_ACC_244_ACC_FCWPreWarning == 0)
        {
            //type conversion to float
            rawValue_float = rawValue;        
            // raw to physical conversion
            phyValue = ((rawValue_float *1)+(0));
            putValue(E_pubc_ACC_ACC_244_ACC_FCWPreWarning_Pv, phyValue);
            chgEv_ACC_244_ACC_FCWPreWarning = 1;
        }
        else
        {
            chgEv_ACC_244_ACC_FCWPreWarning = 0;
        }    
        //update the signal value
        Msg_ACC_244.ACC_FCWPreWarning=rawValue;        
    }                                                                           
}
/*@@end*/

/*@@envVar:E_pubc_ACC_ACC_244_ACC_FCWPreWarning_Pv:*/
on envVar E_pubc_ACC_ACC_244_ACC_FCWPreWarning_Pv
{
    int64 rawValue = 0ll;
    float phyValue = 0.0;
    
    //update the raw value with physical value 
    if(getValue(E_pubc_ACC_ACC_244_ACC_FCWPreWarning_SetVt)==0)
    {
        if(chgEv_ACC_244_ACC_FCWPreWarning == 0)
        {
            phyValue = getvalue(this);
            // physical to raw conversion
            rawValue = ((phyValue -(0))/1);
            putValue(E_pubc_ACC_ACC_244_ACC_FCWPreWarning_Rv, rawValue);
            chgEv_ACC_244_ACC_FCWPreWarning = 1;  
        }
        else
        {
            chgEv_ACC_244_ACC_FCWPreWarning = 0;
        }
    }
}
/*@@end*/

/*@@envVar:E_pubc_ACC_ACC_244_ACC_FCWPreWarning_Vt:*/
on envVar E_pubc_ACC_ACC_244_ACC_FCWPreWarning_Vt
{
    qword rawValue = 0ll;
    if(getValue(E_pubc_ACC_ACC_244_ACC_FCWPreWarning_SetVt))
    {
        //update the signal value
        Msg_ACC_244.ACC_FCWPreWarning=getValue(this);
    }
}
/*@@end*/

/*@@envVar:E_pubc_ACC_ACC_244_ACC_FCWPreWarning_SetVt:*/
on envVar E_pubc_ACC_ACC_244_ACC_FCWPreWarning_SetVt
{
    if(getValue(E_pubc_ACC_ACC_244_ACC_FCWPreWarning_SetVt))
    {
        //update the signal value
        Msg_ACC_244.ACC_FCWPreWarning=getvalue(E_pubc_ACC_ACC_244_ACC_FCWPreWarning_Vt);
    }
    else
    {
        Msg_ACC_244.ACC_FCWPreWarning=getValue(E_pubc_ACC_ACC_244_ACC_FCWPreWarning_Rv);
    }
}
/*@@end*/
 
/*@@envVar:E_pubc_ACC_ACC_244_ACC_AWBActive_Rv:*/
on envVar E_pubc_ACC_ACC_244_ACC_AWBActive_Rv
{
    int64 rawValue = 0ll;
    float rawValue_float = 0.0;
    float phyValue = 0.0;        

    //set the signal with updated raw value
    if(getValue(E_pubc_ACC_ACC_244_ACC_AWBActive_SetVt)==0)
    {
        rawValue = getvalue(this);
        if(chgEv_ACC_244_ACC_AWBActive == 0)
        {
            //type conversion to float
            rawValue_float = rawValue;        
            // raw to physical conversion
            phyValue = ((rawValue_float *1)+(0));
            putValue(E_pubc_ACC_ACC_244_ACC_AWBActive_Pv, phyValue);
            chgEv_ACC_244_ACC_AWBActive = 1;
        }
        else
        {
            chgEv_ACC_244_ACC_AWBActive = 0;
        }    
        //update the signal value
        Msg_ACC_244.ACC_AWBActive=rawValue;        
    }                                                                           
}
/*@@end*/

/*@@envVar:E_pubc_ACC_ACC_244_ACC_AWBActive_Pv:*/
on envVar E_pubc_ACC_ACC_244_ACC_AWBActive_Pv
{
    int64 rawValue = 0ll;
    float phyValue = 0.0;
    
    //update the raw value with physical value 
    if(getValue(E_pubc_ACC_ACC_244_ACC_AWBActive_SetVt)==0)
    {
        if(chgEv_ACC_244_ACC_AWBActive == 0)
        {
            phyValue = getvalue(this);
            // physical to raw conversion
            rawValue = ((phyValue -(0))/1);
            putValue(E_pubc_ACC_ACC_244_ACC_AWBActive_Rv, rawValue);
            chgEv_ACC_244_ACC_AWBActive = 1;  
        }
        else
        {
            chgEv_ACC_244_ACC_AWBActive = 0;
        }
    }
}
/*@@end*/

/*@@envVar:E_pubc_ACC_ACC_244_ACC_AWBActive_Vt:*/
on envVar E_pubc_ACC_ACC_244_ACC_AWBActive_Vt
{
    qword rawValue = 0ll;
    if(getValue(E_pubc_ACC_ACC_244_ACC_AWBActive_SetVt))
    {
        //update the signal value
        Msg_ACC_244.ACC_AWBActive=getValue(this);
    }
}
/*@@end*/

/*@@envVar:E_pubc_ACC_ACC_244_ACC_AWBActive_SetVt:*/
on envVar E_pubc_ACC_ACC_244_ACC_AWBActive_SetVt
{
    if(getValue(E_pubc_ACC_ACC_244_ACC_AWBActive_SetVt))
    {
        //update the signal value
        Msg_ACC_244.ACC_AWBActive=getvalue(E_pubc_ACC_ACC_244_ACC_AWBActive_Vt);
    }
    else
    {
        Msg_ACC_244.ACC_AWBActive=getValue(E_pubc_ACC_ACC_244_ACC_AWBActive_Rv);
    }
}
/*@@end*/
 
/*@@envVar:E_pubc_ACC_ACC_244_ACC_ACCMode_Rv:*/
on envVar E_pubc_ACC_ACC_244_ACC_ACCMode_Rv
{
    int64 rawValue = 0ll;
    float rawValue_float = 0.0;
    float phyValue = 0.0;        

    //set the signal with updated raw value
    if(getValue(E_pubc_ACC_ACC_244_ACC_ACCMode_SetVt)==0)
    {
        rawValue = getvalue(this);
        if(chgEv_ACC_244_ACC_ACCMode == 0)
        {
            //type conversion to float
            rawValue_float = rawValue;        
            // raw to physical conversion
            phyValue = ((rawValue_float *1)+(0));
            putValue(E_pubc_ACC_ACC_244_ACC_ACCMode_Pv, phyValue);
            chgEv_ACC_244_ACC_ACCMode = 1;
        }
        else
        {
            chgEv_ACC_244_ACC_ACCMode = 0;
        }    
        //update the signal value
        Msg_ACC_244.ACC_ACCMode=rawValue;        
    }                                                                           
}
/*@@end*/

/*@@envVar:E_pubc_ACC_ACC_244_ACC_ACCMode_Pv:*/
on envVar E_pubc_ACC_ACC_244_ACC_ACCMode_Pv
{
    int64 rawValue = 0ll;
    float phyValue = 0.0;
    
    //update the raw value with physical value 
    if(getValue(E_pubc_ACC_ACC_244_ACC_ACCMode_SetVt)==0)
    {
        if(chgEv_ACC_244_ACC_ACCMode == 0)
        {
            phyValue = getvalue(this);
            // physical to raw conversion
            rawValue = ((phyValue -(0))/1);
            putValue(E_pubc_ACC_ACC_244_ACC_ACCMode_Rv, rawValue);
            chgEv_ACC_244_ACC_ACCMode = 1;  
        }
        else
        {
            chgEv_ACC_244_ACC_ACCMode = 0;
        }
    }
}
/*@@end*/

/*@@envVar:E_pubc_ACC_ACC_244_ACC_ACCMode_Vt:*/
on envVar E_pubc_ACC_ACC_244_ACC_ACCMode_Vt
{
    qword rawValue = 0ll;
    if(getValue(E_pubc_ACC_ACC_244_ACC_ACCMode_SetVt))
    {
        //update the signal value
        Msg_ACC_244.ACC_ACCMode=getValue(this);
    }
}
/*@@end*/

/*@@envVar:E_pubc_ACC_ACC_244_ACC_ACCMode_SetVt:*/
on envVar E_pubc_ACC_ACC_244_ACC_ACCMode_SetVt
{
    if(getValue(E_pubc_ACC_ACC_244_ACC_ACCMode_SetVt))
    {
        //update the signal value
        Msg_ACC_244.ACC_ACCMode=getvalue(E_pubc_ACC_ACC_244_ACC_ACCMode_Vt);
    }
    else
    {
        Msg_ACC_244.ACC_ACCMode=getValue(E_pubc_ACC_ACC_244_ACC_ACCMode_Rv);
    }
}
/*@@end*/
 

/*@@caplFunc:update_ACC_31A_ACC_RollingCounter_36D_counter():*///function
update_ACC_31A_ACC_RollingCounter_36D_counter()
{
    //update the signal value
    Msg_ACC_31A.ACC_RollingCounter_36D=ACC_31A_ACC_RollingCounter_36D_counter;
    
    if(ACC_31A_ACC_RollingCounter_36D_counter == 15)
    {
        ACC_31A_ACC_RollingCounter_36D_counter =0;
    }
    else
    {
        ACC_31A_ACC_RollingCounter_36D_counter =ACC_31A_ACC_RollingCounter_36D_counter+1;
    }    
    
}
/*@@end*/
/*@@caplFunc:update_ACC_31A_ACC_RollingCounter_30A_counter():*///function
update_ACC_31A_ACC_RollingCounter_30A_counter()
{
    //update the signal value
    Msg_ACC_31A.ACC_RollingCounter_30A=ACC_31A_ACC_RollingCounter_30A_counter;
    
    if(ACC_31A_ACC_RollingCounter_30A_counter == 15)
    {
        ACC_31A_ACC_RollingCounter_30A_counter =0;
    }
    else
    {
        ACC_31A_ACC_RollingCounter_30A_counter =ACC_31A_ACC_RollingCounter_30A_counter+1;
    }    
    
}
/*@@end*/
/*@@caplFunc:update_ACC_31A_ACC_RollingCounter_31A_counter():*///function
update_ACC_31A_ACC_RollingCounter_31A_counter()
{
    //update the signal value
    Msg_ACC_31A.ACC_RollingCounter_31A=ACC_31A_ACC_RollingCounter_31A_counter;
    
    if(ACC_31A_ACC_RollingCounter_31A_counter == 15)
    {
        ACC_31A_ACC_RollingCounter_31A_counter =0;
    }
    else
    {
        ACC_31A_ACC_RollingCounter_31A_counter =ACC_31A_ACC_RollingCounter_31A_counter+1;
    }    
    
}
/*@@end*/
/*@@caplFunc:update_ACC_312_ACC_RollingCounter_3E4_counter():*///function
update_ACC_312_ACC_RollingCounter_3E4_counter()
{
    //update the signal value
    Msg_ACC_312.ACC_RollingCounter_3E4=ACC_312_ACC_RollingCounter_3E4_counter;
    
    if(ACC_312_ACC_RollingCounter_3E4_counter == 15)
    {
        ACC_312_ACC_RollingCounter_3E4_counter =0;
    }
    else
    {
        ACC_312_ACC_RollingCounter_3E4_counter =ACC_312_ACC_RollingCounter_3E4_counter+1;
    }    
    
}
/*@@end*/
/*@@caplFunc:update_ACC_312_ADS_RollingCounter_312_counter():*///function
update_ACC_312_ADS_RollingCounter_312_counter()
{
    //update the signal value
    Msg_ACC_312.ADS_RollingCounter_312=ACC_312_ADS_RollingCounter_312_counter;
    
    if(ACC_312_ADS_RollingCounter_312_counter == 15)
    {
        ACC_312_ADS_RollingCounter_312_counter =0;
    }
    else
    {
        ACC_312_ADS_RollingCounter_312_counter =ACC_312_ADS_RollingCounter_312_counter+1;
    }    
    
}
/*@@end*/
/*@@caplFunc:update_ACC_382_ACC_RollingCounter_382_counter():*///function
update_ACC_382_ACC_RollingCounter_382_counter()
{
    //update the signal value
    Msg_ACC_382.ACC_RollingCounter_382=ACC_382_ACC_RollingCounter_382_counter;
    
    if(ACC_382_ACC_RollingCounter_382_counter == 15)
    {
        ACC_382_ACC_RollingCounter_382_counter =0;
    }
    else
    {
        ACC_382_ACC_RollingCounter_382_counter =ACC_382_ACC_RollingCounter_382_counter+1;
    }    
    
}
/*@@end*/
/*@@caplFunc:update_ACC_382_ACC_RollingCounter_3E6_counter():*///function
update_ACC_382_ACC_RollingCounter_3E6_counter()
{
    //update the signal value
    Msg_ACC_382.ACC_RollingCounter_3E6=ACC_382_ACC_RollingCounter_3E6_counter;
    
    if(ACC_382_ACC_RollingCounter_3E6_counter == 15)
    {
        ACC_382_ACC_RollingCounter_3E6_counter =0;
    }
    else
    {
        ACC_382_ACC_RollingCounter_3E6_counter =ACC_382_ACC_RollingCounter_3E6_counter+1;
    }    
    
}
/*@@end*/
/*@@caplFunc:update_ACC_1BA_ACC_RollingCounter_1C0_counter():*///function
update_ACC_1BA_ACC_RollingCounter_1C0_counter()
{
    //update the signal value
    Msg_ACC_1BA.ACC_RollingCounter_1C0=ACC_1BA_ACC_RollingCounter_1C0_counter;
    
    if(ACC_1BA_ACC_RollingCounter_1C0_counter == 15)
    {
        ACC_1BA_ACC_RollingCounter_1C0_counter =0;
    }
    else
    {
        ACC_1BA_ACC_RollingCounter_1C0_counter =ACC_1BA_ACC_RollingCounter_1C0_counter+1;
    }    
    
}
/*@@end*/
/*@@caplFunc:update_ACC_307_ACC_RollingCounter_307_counter():*///function
update_ACC_307_ACC_RollingCounter_307_counter()
{
    //update the signal value
    Msg_ACC_307.ACC_RollingCounter_307=ACC_307_ACC_RollingCounter_307_counter;
    
    if(ACC_307_ACC_RollingCounter_307_counter == 15)
    {
        ACC_307_ACC_RollingCounter_307_counter =0;
    }
    else
    {
        ACC_307_ACC_RollingCounter_307_counter =ACC_307_ACC_RollingCounter_307_counter+1;
    }    
    
}
/*@@end*/
/*@@caplFunc:update_ACC_307_ACC_RollingCounter_35E_counter():*///function
update_ACC_307_ACC_RollingCounter_35E_counter()
{
    //update the signal value
    Msg_ACC_307.ACC_RollingCounter_35E=ACC_307_ACC_RollingCounter_35E_counter;
    
    if(ACC_307_ACC_RollingCounter_35E_counter == 15)
    {
        ACC_307_ACC_RollingCounter_35E_counter =0;
    }
    else
    {
        ACC_307_ACC_RollingCounter_35E_counter =ACC_307_ACC_RollingCounter_35E_counter+1;
    }    
    
}
/*@@end*/
/*@@caplFunc:update_ACC_307_ACC_RollingCounter_35F_counter():*///function
update_ACC_307_ACC_RollingCounter_35F_counter()
{
    //update the signal value
    Msg_ACC_307.ACC_RollingCounter_35F=ACC_307_ACC_RollingCounter_35F_counter;
    
    if(ACC_307_ACC_RollingCounter_35F_counter == 15)
    {
        ACC_307_ACC_RollingCounter_35F_counter =0;
    }
    else
    {
        ACC_307_ACC_RollingCounter_35F_counter =ACC_307_ACC_RollingCounter_35F_counter+1;
    }    
    
}
/*@@end*/
/*@@caplFunc:update_ACC_307_ACC_RollingCounter_344_counter():*///function
update_ACC_307_ACC_RollingCounter_344_counter()
{
    //update the signal value
    Msg_ACC_307.ACC_RollingCounter_344=ACC_307_ACC_RollingCounter_344_counter;
    
    if(ACC_307_ACC_RollingCounter_344_counter == 15)
    {
        ACC_307_ACC_RollingCounter_344_counter =0;
    }
    else
    {
        ACC_307_ACC_RollingCounter_344_counter =ACC_307_ACC_RollingCounter_344_counter+1;
    }    
    
}
/*@@end*/
/*@@caplFunc:update_ACC_307_ACC_RollingCounter_322_counter():*///function
update_ACC_307_ACC_RollingCounter_322_counter()
{
    //update the signal value
    Msg_ACC_307.ACC_RollingCounter_322=ACC_307_ACC_RollingCounter_322_counter;
    
    if(ACC_307_ACC_RollingCounter_322_counter == 15)
    {
        ACC_307_ACC_RollingCounter_322_counter =0;
    }
    else
    {
        ACC_307_ACC_RollingCounter_322_counter =ACC_307_ACC_RollingCounter_322_counter+1;
    }    
    
}
/*@@end*/
/*@@caplFunc:update_ACC_244_ACC_RollingCounter_25E_counter():*///function
update_ACC_244_ACC_RollingCounter_25E_counter()
{
    //update the signal value
    Msg_ACC_244.ACC_RollingCounter_25E=ACC_244_ACC_RollingCounter_25E_counter;
    
    if(ACC_244_ACC_RollingCounter_25E_counter == 15)
    {
        ACC_244_ACC_RollingCounter_25E_counter =0;
    }
    else
    {
        ACC_244_ACC_RollingCounter_25E_counter =ACC_244_ACC_RollingCounter_25E_counter+1;
    }    
    
}
/*@@end*/
/*@@caplFunc:update_ACC_244_ACC_RollingCounter_24E_counter():*///function
update_ACC_244_ACC_RollingCounter_24E_counter()
{
    //update the signal value
    Msg_ACC_244.ACC_RollingCounter_24E=ACC_244_ACC_RollingCounter_24E_counter;
    
    if(ACC_244_ACC_RollingCounter_24E_counter == 15)
    {
        ACC_244_ACC_RollingCounter_24E_counter =0;
    }
    else
    {
        ACC_244_ACC_RollingCounter_24E_counter =ACC_244_ACC_RollingCounter_24E_counter+1;
    }    
    
}
/*@@end*/


/*@@caplFunc:update_ACC_31A_CRC_CheckSum():*///function
update_ACC_31A_CRC_CheckSum()
{
  int l_Crc_Len1=0,l_Crc_Len2=0,l_Crc_Len3=0,l_count=0;
  int l_count_30A=0,l_count_31A =0,l_count_36D=0;
  int l_data_36D[8];
  int l_data_30A[8];
  int l_data_31A[64];
  
  l_Crc_Len1 = 7;
  l_Crc_Len2 = 15;
  l_Crc_Len3 = 64-2;
  

  //ACC_CRCCheck_36D
  for (l_count=0;l_count<l_Crc_Len1;l_count++)
    {
      l_data_36D[l_count_36D] = Msg_ACC_31A.BYTE(l_count);
      l_count_36D++ ;
    }
    l_count_36D =0;
       
	Msg_ACC_31A.BYTE(l_Crc_Len1) = calc_SAE_J1850(l_data_36D,7); 

	
	if(ACC_31A_ACC_CRCCheck_36D_wrongvalctr != 0)
    {
		Msg_ACC_31A.ACC_CRCCheck_36D+=1; 
        //update signal with wrong CRC value
		if(ACC_31A_ACC_CRCCheck_36D_wrongvalctr > 0)
        {
             ACC_31A_ACC_CRCCheck_36D_wrongvalctr--;
              // if counter becomes zero, update panel controller to zero
             if(ACC_31A_ACC_CRCCheck_36D_wrongvalctr == 0)
             {
                 putValue(E_pubc_ACC_ACC_31A_ACC_CRCCheck_36D_wrongvalctr,0);
             }
        }
	}
  
  //ACC_CRCCheck_30A
  for (l_count=8;l_count<l_Crc_Len2;l_count++)
    {
      l_data_30A[l_count_30A] = Msg_ACC_31A.BYTE(l_count);
      l_count_30A++ ;
    }
    l_count_30A =0;
       
	Msg_ACC_31A.BYTE(l_Crc_Len2) = calc_SAE_J1850(l_data_30A,7); 

	
	if(ACC_31A_ACC_CRCCheck_30A_wrongvalctr != 0)
    {
		Msg_ACC_31A.ACC_CRCCheck_30A+=1; 
        //update signal with wrong CRC value
		if(ACC_31A_ACC_CRCCheck_30A_wrongvalctr > 0)
        {
             ACC_31A_ACC_CRCCheck_30A_wrongvalctr--;
              // if counter becomes zero, update panel controller to zero
             if(ACC_31A_ACC_CRCCheck_30A_wrongvalctr == 0)
             {
                 putValue(E_pubc_ACC_ACC_31A_ACC_CRCCheck_30A_wrongvalctr,0);
             }
        }
	}
	
	// ACC_CRCCheck_31A (16)
  for (l_count=0;l_count<l_Crc_Len3;l_count++)
    {
      l_data_31A[l_count_31A] = Msg_ACC_31A.BYTE(l_count);
      l_count_31A++ ;
    }
    l_count_31A =0;
        
	Msg_ACC_31A.ACC_CRCCheck_31A = calc_CRC16_CCITT_FALSE_H1021(l_data_31A,62);
	
	if(ACC_31A_ACC_CRCCheck_31A_wrongvalctr != 0)
    {
		Msg_ACC_31A.ACC_CRCCheck_31A+=1; 
        //update signal with wrong CRC value
		if(ACC_31A_ACC_CRCCheck_31A_wrongvalctr > 0)
        {
             ACC_31A_ACC_CRCCheck_31A_wrongvalctr--;
              // if counter becomes zero, update panel controller to zero
             if(ACC_31A_ACC_CRCCheck_31A_wrongvalctr == 0)
             {
                 putValue(E_pubc_ACC_ACC_31A_ACC_CRCCheck_31A_wrongvalctr,0);
             }
        }
	}
	
	
}

update_ACC_312_CRC_CheckSum()
{
  int l_Crc_Len1=0,l_Crc_Len2=0,l_count=0;
  int l_count_3E4=0,l_count_312 =0;
  int l_data_3E4[8];
  int l_data_312[64];

 
  l_Crc_Len1 = 7;
  l_Crc_Len2 = 64-2;

  //ACC_CRCCheck_3E4
  for (l_count=0;l_count<l_Crc_Len1;l_count++)
    {
      l_data_3E4[l_count_3E4] = Msg_ACC_312.BYTE(l_count);
      l_count_3E4++ ;
    }
    l_count_3E4 =0;
       
	Msg_ACC_312.BYTE(l_Crc_Len1) = calc_SAE_J1850(l_data_3E4,7); 

	
	if(ACC_312_ACC_CRCCheck_3E4_wrongvalctr != 0)
    {
		Msg_ACC_312.ACC_CRCCheck_3E4+=1; 
        //update signal with wrong CRC value
		if(ACC_312_ACC_CRCCheck_3E4_wrongvalctr > 0)
        {
             ACC_312_ACC_CRCCheck_3E4_wrongvalctr--;
              // if counter becomes zero, update panel controller to zero
             if(ACC_312_ACC_CRCCheck_3E4_wrongvalctr == 0)
             {
                 putValue(E_pubc_ACC_ACC_312_ACC_CRCCheck_3E4_wrongvalctr,0);
             }
        }
	}
	
	// ADS_CRCCheck_312 (16)
  for (l_count=0;l_count<l_Crc_Len2;l_count++)
    {
      l_data_312[l_count_312] = Msg_ACC_312.BYTE(l_count);
      l_count_312++ ;
    }
    l_count_312 =0;
       
	Msg_ACC_312.ADS_CRCCheck_312 = calc_CRC16_CCITT_FALSE_H1021(l_data_312,62);
	
	if(ACC_312_ADS_CRCCheck_312_wrongvalctr != 0)
    {
		Msg_ACC_312.ADS_CRCCheck_312+=1; 
        //update signal with wrong CRC value
		if(ACC_312_ADS_CRCCheck_312_wrongvalctr > 0)
        {
             ACC_312_ADS_CRCCheck_312_wrongvalctr--;
              // if counter becomes zero, update panel controller to zero
             if(ACC_312_ADS_CRCCheck_312_wrongvalctr == 0)
             {
                 putValue(E_pubc_ACC_ACC_312_ADS_CRCCheck_312_wrongvalctr,0);
             }
        }
	}
}

update_ACC_382_CRC_CheckSum()
{
  int l_Crc_Len1=0,l_Crc_Len2=0,l_count=0;
  int l_count_3E6=0,l_count_382=0;
  int l_data_3E6[8];
  int l_data_382[64];

 
  l_Crc_Len1 = 23;
  l_Crc_Len2 = 64-2;

  //ACC_CRCCheck_3E6
  for (l_count=16;l_count<l_Crc_Len1;l_count++)
    {
      l_data_3E6[l_count_3E6] = Msg_ACC_382.BYTE(l_count);
      l_count_3E6++ ;
    }
    l_count_3E6 =0;
       
	Msg_ACC_382.BYTE(l_Crc_Len1) = calc_SAE_J1850(l_data_3E6,7); 

	
	if(ACC_382_ACC_CRCCheck_3E6_wrongvalctr != 0)
    {
		Msg_ACC_382.ACC_CRCCheck_3E6+=1; 
        //update signal with wrong CRC value
		if(ACC_382_ACC_CRCCheck_3E6_wrongvalctr > 0)
        {
             ACC_382_ACC_CRCCheck_3E6_wrongvalctr--;
              // if counter becomes zero, update panel controller to zero
             if(ACC_382_ACC_CRCCheck_3E6_wrongvalctr == 0)
             {
                 putValue(E_pubc_ACC_ACC_382_ACC_CRCCheck_3E6_wrongvalctr,0);
             }
        }
	}
	
	// ACC_CRCCheck_382 (16)
  for (l_count=0;l_count<l_Crc_Len2;l_count++)
    {
      l_data_382[l_count_382] = Msg_ACC_382.BYTE(l_count);
      l_count_382++ ;
    }
    l_count_382 =0;
       
	Msg_ACC_382.ACC_CRCCheck_382 = calc_CRC16_CCITT_FALSE_H1021(l_data_382,62);

	if(ACC_382_ACC_CRCCheck_382_wrongvalctr != 0)
    {
		Msg_ACC_382.ACC_CRCCheck_382+=1; 
        //update signal with wrong CRC value
		if(ACC_382_ACC_CRCCheck_382_wrongvalctr > 0)
        {
             ACC_382_ACC_CRCCheck_382_wrongvalctr--;
              // if counter becomes zero, update panel controller to zero
             if(ACC_382_ACC_CRCCheck_382_wrongvalctr == 0)
             {
                 putValue(E_pubc_ACC_ACC_382_ACC_CRCCheck_382_wrongvalctr,0);
             }
        }
	}
}
update_ACC_1BA_CRC_CheckSum()
{
  int l_Crc_Len=0,l_count=0;
  int l_data[8];
 
  l_Crc_Len = 8-1;
  for (l_count=0;l_count<l_Crc_Len;l_count++)
    {
      l_data[l_count] = Msg_ACC_1BA.BYTE(l_count);    
    }
       
	Msg_ACC_1BA.BYTE(l_Crc_Len) = calc_SAE_J1850(l_data,l_Crc_Len); 

	
	if(ACC_1BA_ACC_CRCCheck_1C0_wrongvalctr != 0)
    {
		Msg_ACC_1BA.ACC_CRCCheck_1C0+=1; 
        //update signal with wrong CRC value
		if(ACC_1BA_ACC_CRCCheck_1C0_wrongvalctr > 0)
        {
             ACC_1BA_ACC_CRCCheck_1C0_wrongvalctr--;
              // if counter becomes zero, update panel controller to zero
             if(ACC_1BA_ACC_CRCCheck_1C0_wrongvalctr == 0)
             {
                 putValue(E_pubc_ACC_ACC_1BA_ACC_CRCCheck_1C0_wrongvalctr,0);
             }
        }
	}
}
update_ACC_307_CRC_CheckSum()
{
  int l_Crc_Len1=0,l_Crc_Len2=0,l_Crc_Len3=0,l_Crc_Len4=0,l_Crc_Len5=0,l_count=0;
  int l_count_307=0,l_count_322 =0,l_count_344=0,l_count_35E =0,l_count_35F =0;
  
  int l_data_35E[8];
  int l_data_322[8];
  int l_data_344[8];
  int l_data_35F[8];
  int l_data_307[64];
 
  l_Crc_Len1 = 7;
  l_Crc_Len2 = 15;
  l_Crc_Len3 = 23;
  l_Crc_Len4 = 31;
  l_Crc_Len5 = 64-2;
  
  // ACC_CRCCheck_35E
	for (l_count=0;l_count<l_Crc_Len1;l_count++)
    {
      l_data_35E[l_count_35E] = Msg_ACC_307.BYTE(l_count);
      l_count_35E++;  
    }
       l_count_35E = 0;
	Msg_ACC_307.BYTE(l_Crc_Len1) = calc_SAE_J1850(l_data_35E,7); 

	
	if(ACC_307_ACC_CRCCheck_35E_wrongvalctr != 0)
    {
		Msg_ACC_307.ACC_CRCCheck_35E+=1; 
        //update signal with wrong CRC value
		if(ACC_307_ACC_CRCCheck_35E_wrongvalctr > 0)
        {
             ACC_307_ACC_CRCCheck_35E_wrongvalctr--;
              // if counter becomes zero, update panel controller to zero
             if(ACC_307_ACC_CRCCheck_35E_wrongvalctr == 0)
             {
                 putValue(E_pubc_ACC_ACC_307_ACC_CRCCheck_35E_wrongvalctr,0);
             }
        }
	}
	
	// ACC_CRCCheck_322
	for (l_count=8;l_count<l_Crc_Len2;l_count++)
    {
      l_data_322[l_count_322] = Msg_ACC_307.BYTE(l_count);
      l_count_322++;  
    }
     l_count_322 = 0;
	Msg_ACC_307.BYTE(l_Crc_Len2) = calc_SAE_J1850(l_data_322,7); 

	
	if(ACC_307_ACC_CRCCheck_322_wrongvalctr != 0)
    {
		Msg_ACC_307.ACC_CRCCheck_322+=1; 
        //update signal with wrong CRC value
		if(ACC_307_ACC_CRCCheck_322_wrongvalctr > 0)
        {
             ACC_307_ACC_CRCCheck_322_wrongvalctr--;
              // if counter becomes zero, update panel controller to zero
             if(ACC_307_ACC_CRCCheck_322_wrongvalctr == 0)
             {
                 putValue(E_pubc_ACC_ACC_307_ACC_CRCCheck_322_wrongvalctr,0);
             }
        }
	}
	
	// ACC_CRCCheck_344
	for (l_count=16;l_count<l_Crc_Len3;l_count++)
    {
      l_data_344[l_count_344] = Msg_ACC_307.BYTE(l_count); 
    l_count_344++;  
    }
       l_count_344 =0;
	Msg_ACC_307.BYTE(l_Crc_Len3) = calc_SAE_J1850(l_data_344,7); 

	
	if(ACC_307_ACC_CRCCheck_344_wrongvalctr != 0)
    {
		Msg_ACC_307.ACC_CRCCheck_344+=1; 
        //update signal with wrong CRC value
		if(ACC_307_ACC_CRCCheck_344_wrongvalctr > 0)
        {
             ACC_307_ACC_CRCCheck_344_wrongvalctr--;
              // if counter becomes zero, update panel controller to zero
             if(ACC_307_ACC_CRCCheck_344_wrongvalctr == 0)
             {
                 putValue(E_pubc_ACC_ACC_307_ACC_CRCCheck_344_wrongvalctr,0);
             }
        }
	}
	
	// ACC_CRCCheck_35F
	for (l_count=24;l_count<l_Crc_Len4;l_count++)
    {
      l_data_35F[l_count_35F] = Msg_ACC_307.BYTE(l_count);
      l_count_35F++;  
    }
       l_count_35F = 0;
	Msg_ACC_307.BYTE(l_Crc_Len4) = calc_SAE_J1850(l_data_35F,7); 

	
	if(ACC_307_ACC_CRCCheck_35F_wrongvalctr != 0)
    {
		Msg_ACC_307.ACC_CRCCheck_35F+=1; 
        //update signal with wrong CRC value
		if(ACC_307_ACC_CRCCheck_35F_wrongvalctr > 0)
        {
             ACC_307_ACC_CRCCheck_35F_wrongvalctr--;
              // if counter becomes zero, update panel controller to zero
             if(ACC_307_ACC_CRCCheck_35F_wrongvalctr == 0)
             {
                 putValue(E_pubc_ACC_ACC_307_ACC_CRCCheck_35F_wrongvalctr,0);
             }
        }
	}
	
	// ACC_CRCCheck_307 (16)
	for (l_count=0;l_count<l_Crc_Len5;l_count++)
    {
      l_data_307[l_count_307] = Msg_ACC_307.BYTE(l_count);
      l_count_307++ ;
    }
    l_count_307 =0;
       
	Msg_ACC_307.ACC_CRCCheck_35E = calc_CRC16_CCITT_FALSE_H1021(l_data_307,62);

	if(ACC_307_ACC_CRCCheck_307_wrongvalctr != 0)
    {
		Msg_ACC_307.ACC_CRCCheck_35E+=1; 
        //update signal with wrong CRC value
		if(ACC_307_ACC_CRCCheck_307_wrongvalctr > 0)
        {
             ACC_307_ACC_CRCCheck_307_wrongvalctr--;
              // if counter becomes zero, update panel controller to zero
             if(ACC_307_ACC_CRCCheck_307_wrongvalctr == 0)
             {
                 putValue(E_pubc_ACC_ACC_307_ACC_CRCCheck_307_wrongvalctr,0);
             }
        }
	}
  
}

update_ACC_244_CRC_CheckSum()
{
  int l_Crc_Len1=0,l_Crc_Len2=0,l_count=0;
  int l_count_24E=0,l_count_25E =0;
  int l_data_24E[8];
  int l_data_25E[8];
  
 
  l_Crc_Len1 = 7;
  l_Crc_Len2 = 15;
  
  //ACC_CRCCheck_24E
  for (l_count=0;l_count<l_Crc_Len1;l_count++)
    {
      l_data_24E[l_count_24E] = Msg_ACC_244.BYTE(l_count);
      l_count_24E++ ;
    }
    l_count_24E =0;
       
	Msg_ACC_244.BYTE(l_Crc_Len1) = calc_SAE_J1850(l_data_24E,7); 

	
	if(ACC_244_ACC_CRCCheck_24E_wrongvalctr != 0)
    {
		Msg_ACC_244.ACC_CRCCheck_24E+=1; 
        //update signal with wrong CRC value
		if(ACC_244_ACC_CRCCheck_24E_wrongvalctr > 0)
        {
             ACC_244_ACC_CRCCheck_24E_wrongvalctr--;
              // if counter becomes zero, update panel controller to zero
             if(ACC_244_ACC_CRCCheck_24E_wrongvalctr == 0)
             {
                 putValue(E_pubc_ACC_ACC_244_ACC_CRCCheck_24E_wrongvalctr,0);
             }
        }
	}
	
	// ACC_CRCCheck_25E
	for (l_count=8;l_count<l_Crc_Len2;l_count++)
    {
      l_data_25E[l_count_25E] = Msg_ACC_244.BYTE(l_count);
      l_count_25E++;  
    }
     l_count_25E = 0;  
	Msg_ACC_244.BYTE(l_Crc_Len2) = calc_SAE_J1850(l_data_25E,7); 

	
	if(ACC_244_ACC_CRCCheck_25E_wrongvalctr != 0)
    {
		Msg_ACC_244.ACC_CRCCheck_25E+=1; 
        //update signal with wrong CRC value
		if(ACC_244_ACC_CRCCheck_25E_wrongvalctr > 0)
        {
             ACC_244_ACC_CRCCheck_25E_wrongvalctr--;
              // if counter becomes zero, update panel controller to zero
             if(ACC_244_ACC_CRCCheck_25E_wrongvalctr == 0)
             {
                 putValue(E_pubc_ACC_ACC_244_ACC_CRCCheck_25E_wrongvalctr,0);
             }
        }
	}
	
	
}



int calc_SAE_J1850(int data[], int Crc_len)
	{
		int idx,crc,temp,temp1;
		crc = 0xFF;
        idx = 0;
        temp = 0;
        temp1 = 0;
	
        for(idx=0;idx < Crc_len;idx++)
        {
			temp1 = data[idx];
			temp = (crc^temp1);
			crc = CRC_J1850_Table[temp];
        }
		crc ^= 0xFF;
		return crc;
	}


/*	int calc_SAE_J1851(int data[], int Crc_len)
	{
		int crc;
		
        crc = (data[0]+data[1]+data[2]+data[3]+data[4]+data[5]+data[6]) ;
          
		crc ^= 255;
		return crc;
	}*/

	

/* 	int calc_SAE_J1850(int data[], int Crc_len)
	{
		int idx,crc,temp,temp1,temp2,idy;
		crc = 0xFF;
        idx = 0;
        idy = 0;
        temp = 0;
        temp1 = 0;
        temp2 = 0;
	
        for(idx=0;idx < Crc_len;idx++)
        {
         temp1 = data[idx];
         crc = (crc^temp1);
          for (idy=8; idy>0; idy--)
          {
              // Save the value before the top bit is shifted out.
              temp2 = crc;
              crc <<= 1;
              if (0 != (temp2 & 128))
              {
                  crc ^= 0x2f;
              }
          } 
          
         //crc = CRC_J1850_Table[temp];
        }
		crc ^= 0xFF;
		return crc;
	} */

int Calc_Canfd_dlc(byte Dbc_dlc1)
	{
		if(Dbc_dlc > 8)
		    {
			 while (i<=7)
			  {
				if (CANFD_DLC[i]==Dbc_dlc)
				{
				return CAN_DLC[i];
				 break;
				}
				i++ ;
			}
		}
    else
	
	return Dbc_dlc1 ;
	
		
	}
	
	
int calc_CRC16_CCITT_FALSE_H1021(int data[], int Crc_len)
{
	int idx, crc;

	crc = 0xFFFF;
	
    for (idx=0; idx<Crc_len; idx++)
    {
        /* Impact of temporary rest on next crc rest */
        /* MISRA RULE 12.8 VIOLATION: Shift is performed in the context of a data stream */
        crc ^= data[idx] << 8;

        /* Next temporary crc rest */
        /* MISRA RULE 12.8 VIOLATION: Shift is performed in the context of a data stream */
        crc = (crc << (8)) ^ CRC16_CCITT_FALSE_H1021_Table[(crc >> (8)) & (0xFF)];
    }
	return crc;
}

	//For Messages with DLC = 8, CAN FD data length =8
	//For Messages with DLC = 9, CAN FD data length =12
	//For Messages with DLC = 10, CAN FD data length =16
	//For Messages with DLC = 11, CAN FD data length =20
	//For Messages with DLC = 12, CAN FD data length =24
	//For Messages with DLC = 13, CAN FD data length =32
	//For Messages with DLC = 14, CAN FD data length =48
	//For Messages with DLC = 15, CAN FD data length =64
	

