/*@!Encoding:1252*/

variables
{
   msTimer error_free;
}
on start
{
    //Enable error free signal swirch 
    putValue(Env_error_free_switch,1);
}

on envVar Env_error_free_switch
{
  SetTimer( error_free,500);
  
 }
 On timer error_free
    {
       if (getValue(Env_error_free_switch)==1)
  {
   //Add error free signals
  //  putValue (E_pubc_GW_GW_3BB_HU_SpeedLimitDistance_Rv,0);
	putValue (E_pubc_GW_GW_180_EpsSasSteerAg_Rv,0);
	putValue (E_pubc_GW_GW_1C2_EspLatAccel_Rv,0);
	//putValue (E_pubc_GW_GW_278_ESP_YawRate_Rv,0);
	//putValue (E_pubc_GW_GW_278_ESP_YawRateValid_Rv,0);
	putValue (E_pubc_GW_GW_1C2_EspLgtAccel_Rv,0);
	putValue (E_pubc_GW_GW_1C2_EspVehSpdVld_Rv,0);
  }
  
 
  }





