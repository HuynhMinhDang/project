
/*@@var:*/
variables
{
    //Used interact between raw and the physical environment variables
    byte chgEv_VCU_38A_VcuCrsResuSwtSts = 0;
    byte chgEv_VCU_38A_VcuCrsDstSwtSts = 0;
    byte chgEv_VCU_38A_VcuCrsSetSwtSts = 0;
    byte chgEv_VCU_38A_VcuCrsSwtDiagInfo = 0;
    byte chgEv_VCU_161_VcuCalcnAccrPedlPosn = 0;
    byte chgEv_VCU_161_VcuOvrdModReq = 0;
    byte chgEv_VCU_161_VCUAccPedShield = 0;
    byte chgEv_VCU_161_VcuPtTqReqAvl = 0;
    byte chgEv_VCU_161_VcuAccrPedlPosnVld = 0;
    byte chgEv_VCU_161_VcuPtTqLimMax = 0;
    byte chgEv_VCU_161_VcuRdySts = 0;
    byte chgEv_VCU_161_VcuVehWhlReqTq = 0;
    byte chgEv_VCU_161_VcuPtTqRealVld = 0;
    byte chgEv_VCU_161_VCUShiftPostionValid = 0;
    byte chgEv_VCU_161_VcuPtTqReal = 0;
    byte chgEv_VCU_161_VcuPtTqLimMinVld = 0;
    byte chgEv_VCU_161_VcuGearPosn = 0;
    byte chgEv_VCU_161_VcuVehWhlReqTqVld = 0;
    byte chgEv_VCU_161_VcuSimnEpbSwtStsVld = 0;
    byte chgEv_VCU_161_VcuAccrMod = 0;
    byte chgEv_VCU_161_VcuAccrPedlPosn = 0;
    byte chgEv_VCU_161_VcuPtTqLimMaxVld = 0;
    byte chgEv_VCU_161_VcuCalcnAccrPedlPosnVld = 0;
    byte chgEv_VCU_161_VcuVehGearPosnVld = 0;
    byte chgEv_VCU_161_VcuShiftLvlPosn = 0;
    byte chgEv_VCU_161_VcuSimnEpbSwtSts = 0;
    byte chgEv_VCU_161_VcuPtTqLimMin = 0;
    byte chgEv_VCU_161_VcuComFltSts = 0;
    byte chgEv_VCU_161_VcuEnyRecyclMod = 0;
    
    message VCU_38A        Msg_VCU_38A;
    msTimer Tm_VCU_38A;
    int Cycle_VCU_38A = 100;
    message VCU_161        Msg_VCU_161;
    msTimer Tm_VCU_161;
    int Cycle_VCU_161 = 10;
    
    int VCU_38A_VcuCRCCheck_38A_counter =0;
    int VCU_38A_VcuCRCCheck_38A_wrongvalctr =0;
    int VCU_38A_VcuRollingCounter_38A_counter =0;
    int VCU_38A_VcuRollingCounter_38A_wrongvalctr =0;
    int VCU_161_VcuCrcChk161_counter =0;
    int VCU_161_VcuCrcChk161_wrongvalctr =0;
    int VCU_161_VcuCycCntr161_counter =0;
    int VCU_161_VcuCycCntr161_wrongvalctr =0;
    
    //CRC Polynomial for MQB     
    byte cb_ChkSum_POLY_MQB =0x2F;
	// CANFD DLC
	byte Dbc_dlc;
	int i=0;
	char CAN_DLC[7]={9,10,11,12,13,14,15};
	char CANFD_DLC[7]={12,16,20,24,32,48,64};
    

    
        byte CRC_J1850_Table[256] = {
 /*0 - 7*/  0x00, 0x1D, 0x3A, 0x27, 0x74, 0x69, 0x4E, 0x53,
 /*8 - 15*/ 0xE8, 0xF5, 0xD2, 0xCF, 0x9C, 0x81, 0xA6, 0xBB,
 /*16 - 23*/ 0xCD, 0xD0, 0xF7, 0xEA, 0xB9, 0xA4, 0x83, 0x9E,
 /*24 - 31*/ 0x25, 0x38, 0x1F, 0x02, 0x51, 0x4C, 0x6B, 0x76,
 /*32 - 39*/ 0x87, 0x9A, 0xBD, 0xA0, 0xF3, 0xEE, 0xC9, 0xD4,
 /*40 - 47*/ 0x6F, 0x72, 0x55, 0x48, 0x1B, 0x06, 0x21, 0x3C,
 /*48 - 55*/ 0x4A, 0x57, 0x70, 0x6D, 0x3E, 0x23, 0x04, 0x19,
 /*56 - 63*/ 0xA2, 0xBF, 0x98, 0x85, 0xD6, 0xCB, 0xEC, 0xF1,
 /*64 - 71*/  0x13, 0x0E, 0x29, 0x34, 0x67, 0x7A, 0x5D, 0x40,
 /*72 - 79*/ 0xFB, 0xE6, 0xC1, 0xDC, 0x8F, 0x92, 0xB5, 0xA8,
 /*80 - 87*/ 0xDE, 0xC3, 0xE4, 0xF9, 0xAA, 0xB7, 0x90, 0x8D,
 /*88 - 95*/ 0x36, 0x2B, 0x0C, 0x11, 0x42, 0x5F, 0x78, 0x65,
 /*96 - 103*/ 0x94, 0x89, 0xAE, 0xB3, 0xE0, 0xFD, 0xDA, 0xC7,
 /*104 - 111*/ 0x7C, 0x61, 0x46, 0x5B, 0x08, 0x15, 0x32, 0x2F,
 /*112 - 119*/ 0x59, 0x44, 0x63, 0x7E, 0x2D, 0x30, 0x17, 0x0A,
 /*120 - 127*/ 0xB1, 0xAC, 0x8B, 0x96, 0xC5, 0xD8, 0xFF, 0xE2,
 /*128 - 135*/ 0x26, 0x3B, 0x1C, 0x01, 0x52, 0x4F, 0x68, 0x75,
 /*136 - 143*/ 0xCE, 0xD3, 0xF4, 0xE9, 0xBA, 0xA7, 0x80, 0x9D,
 /*144 - 151*/ 0xEB, 0xF6, 0xD1, 0xCC, 0x9F, 0x82, 0xA5, 0xB8,
 /*152 - 159*/ 0x03, 0x1E, 0x39, 0x24, 0x77, 0x6A, 0x4D, 0x50,
 /*160 - 167*/ 0xA1, 0xBC, 0x9B, 0x86, 0xD5, 0xC8, 0xEF, 0xF2,
 /*168 - 175*/ 0x49, 0x54, 0x73, 0x6E, 0x3D, 0x20, 0x07, 0x1A,
 /*176 - 183*/ 0x6C, 0x71, 0x56, 0x4B, 0x18, 0x05, 0x22, 0x3F,
 /*184 - 191*/ 0x84, 0x99, 0xBE, 0xA3, 0xF0, 0xED, 0xCA, 0xD7,
 /*192 - 199*/ 0x35, 0x28, 0x0F, 0x12, 0x41, 0x5C, 0x7B, 0x66,
 /*200 - 207*/ 0xDD, 0xC0, 0xE7, 0xFA, 0xA9, 0xB4, 0x93, 0x8E,
 /*208 - 215*/ 0xF8, 0xE5, 0xC2, 0xDF, 0x8C, 0x91, 0xB6, 0xAB,
 /*216 - 223*/ 0x10, 0x0D, 0x2A, 0x37, 0x64, 0x79, 0x5E, 0x43,
 /*224 - 231*/ 0xB2, 0xAF, 0x88, 0x95, 0xC6, 0xDB, 0xFC, 0xE1,
 /*232 - 239*/ 0x5A, 0x47, 0x60, 0x7D, 0x2E, 0x33, 0x14, 0x09,
 /*240 - 247*/ 0x7F, 0x62, 0x45, 0x58, 0x0B, 0x16, 0x31, 0x2C,
 /*248 - 255*/ 0x97, 0x8A, 0xAD, 0xB0, 0xE3, 0xFE, 0xD9, 0xC4
};

int64 CRC16_CCITT_FALSE_H1021_Table[256] =
{
    /*0 - 7*/     0x0000, 0x1021, 0x2042, 0x3063, 0x4084, 0x50A5, 0x60C6, 0x70E7,
    /*8 - 15*/    0x8108, 0x9129, 0xA14A, 0xB16B, 0xC18C, 0xD1AD, 0xE1CE, 0xF1EF,
    /*16 - 23*/   0x1231, 0x0210, 0x3273, 0x2252, 0x52B5, 0x4294, 0x72F7, 0x62D6,
    /*24 - 31*/   0x9339, 0x8318, 0xB37B, 0xA35A, 0xD3BD, 0xC39C, 0xF3FF, 0xE3DE,
    /*32 - 39*/   0x2462, 0x3443, 0x0420, 0x1401, 0x64E6, 0x74C7, 0x44A4, 0x5485,
    /*40 - 47*/   0xA56A, 0xB54B, 0x8528, 0x9509, 0xE5EE, 0xF5CF, 0xC5AC, 0xD58D,
    /*48 - 55*/   0x3653, 0x2672, 0x1611, 0x0630, 0x76D7, 0x66F6, 0x5695, 0x46B4,
    /*56 - 63*/   0xB75B, 0xA77A, 0x9719, 0x8738, 0xF7DF, 0xE7FE, 0xD79D, 0xC7BC,
    /*64 - 71*/   0x48C4, 0x58E5, 0x6886, 0x78A7, 0x0840, 0x1861, 0x2802, 0x3823,
    /*72 - 79*/   0xC9CC, 0xD9ED, 0xE98E, 0xF9AF, 0x8948, 0x9969, 0xA90A, 0xB92B,
    /*80 - 87*/   0x5AF5, 0x4AD4, 0x7AB7, 0x6A96, 0x1A71, 0x0A50, 0x3A33, 0x2A12,
    /*88 - 95*/   0xDBFD, 0xCBDC, 0xFBBF, 0xEB9E, 0x9B79, 0x8B58, 0xBB3B, 0xAB1A,
    /*96 - 103*/  0x6CA6, 0x7C87, 0x4CE4, 0x5CC5, 0x2C22, 0x3C03, 0x0C60, 0x1C41,
    /*104 - 111*/ 0xEDAE, 0xFD8F, 0xCDEC, 0xDDCD, 0xAD2A, 0xBD0B, 0x8D68, 0x9D49,
    /*112 - 119*/ 0x7E97, 0x6EB6, 0x5ED5, 0x4EF4, 0x3E13, 0x2E32, 0x1E51, 0x0E70,
    /*120 - 127*/ 0xFF9F, 0xEFBE, 0xDFDD, 0xCFFC, 0xBF1B, 0xAF3A, 0x9F59, 0x8F78,
    /*128 - 135*/ 0x9188, 0x81A9, 0xB1CA, 0xA1EB, 0xD10C, 0xC12D, 0xF14E, 0xE16F,
    /*136 - 143*/ 0x1080, 0x00A1, 0x30C2, 0x20E3, 0x5004, 0x4025, 0x7046, 0x6067,
    /*144 - 151*/ 0x83B9, 0x9398, 0xA3FB, 0xB3DA, 0xC33D, 0xD31C, 0xE37F, 0xF35E,
    /*152 - 159*/ 0x02B1, 0x1290, 0x22F3, 0x32D2, 0x4235, 0x5214, 0x6277, 0x7256,
    /*160 - 167*/ 0xB5EA, 0xA5CB, 0x95A8, 0x8589, 0xF56E, 0xE54F, 0xD52C, 0xC50D,
    /*168 - 175*/ 0x34E2, 0x24C3, 0x14A0, 0x0481, 0x7466, 0x6447, 0x5424, 0x4405,
    /*176 - 183*/ 0xA7DB, 0xB7FA, 0x8799, 0x97B8, 0xE75F, 0xF77E, 0xC71D, 0xD73C,
    /*184 - 191*/ 0x26D3, 0x36F2, 0x0691, 0x16B0, 0x6657, 0x7676, 0x4615, 0x5634,
    /*192 - 199*/ 0xD94C, 0xC96D, 0xF90E, 0xE92F, 0x99C8, 0x89E9, 0xB98A, 0xA9AB,
    /*200 - 207*/ 0x5844, 0x4865, 0x7806, 0x6827, 0x18C0, 0x08E1, 0x3882, 0x28A3,
    /*208 - 215*/ 0xCB7D, 0xDB5C, 0xEB3F, 0xFB1E, 0x8BF9, 0x9BD8, 0xABBB, 0xBB9A,
    /*216 - 223*/ 0x4A75, 0x5A54, 0x6A37, 0x7A16, 0x0AF1, 0x1AD0, 0x2AB3, 0x3A92,
    /*224 - 231*/ 0xFD2E, 0xED0F, 0xDD6C, 0xCD4D, 0xBDAA, 0xAD8B, 0x9DE8, 0x8DC9,
    /*232 - 239*/ 0x7C26, 0x6C07, 0x5C64, 0x4C45, 0x3CA2, 0x2C83, 0x1CE0, 0x0CC1,
    /*240 - 247*/ 0xEF1F, 0xFF3E, 0xCF5D, 0xDF7C, 0xAF9B, 0xBFBA, 0x8FD9, 0x9FF8,
    /*248 - 255*/ 0x6E17, 0x7E36, 0x4E55, 0x5E74, 0x2E93, 0x3EB2, 0x0ED1, 0x1EF0
};
         
}
/*@@end*/


/*@@startStart:Start:*/
on start
{
    //Initialise cycle time and message timer 
    putValue(E_pubc_VCU_VCU_38A_cycleTm,Cycle_VCU_38A);
    SetTimer( Tm_VCU_38A,100);
    putValue(E_pubc_VCU_VCU_38A_Tm,1);
    putValue(E_pubc_VCU_VCU_161_cycleTm,Cycle_VCU_161);
    SetTimer( Tm_VCU_161,101);
    putValue(E_pubc_VCU_VCU_161_Tm,1);
    
    //Initialise signals with init raw value
    Msg_VCU_38A.VcuCrsResuSwtSts   =getvalue(E_pubc_VCU_VCU_38A_VcuCrsResuSwtSts_Rv);
    Msg_VCU_38A.VcuCrsDstSwtSts   =getvalue(E_pubc_VCU_VCU_38A_VcuCrsDstSwtSts_Rv);
    Msg_VCU_38A.VcuCrsSetSwtSts   =getvalue(E_pubc_VCU_VCU_38A_VcuCrsSetSwtSts_Rv);
    Msg_VCU_38A.VcuCrsSwtDiagInfo   =getvalue(E_pubc_VCU_VCU_38A_VcuCrsSwtDiagInfo_Rv);
    Msg_VCU_161.VcuCalcnAccrPedlPosn   =getvalue(E_pubc_VCU_VCU_161_VcuCalcnAccrPedlPosn_Rv);
    Msg_VCU_161.VcuOvrdModReq   =getvalue(E_pubc_VCU_VCU_161_VcuOvrdModReq_Rv);
    Msg_VCU_161.VCUAccPedShield   =getvalue(E_pubc_VCU_VCU_161_VCUAccPedShield_Rv);
    Msg_VCU_161.VcuPtTqReqAvl   =getvalue(E_pubc_VCU_VCU_161_VcuPtTqReqAvl_Rv);
    Msg_VCU_161.VcuAccrPedlPosnVld   =getvalue(E_pubc_VCU_VCU_161_VcuAccrPedlPosnVld_Rv);
    Msg_VCU_161.VcuPtTqLimMax   =getvalue(E_pubc_VCU_VCU_161_VcuPtTqLimMax_Rv);
    Msg_VCU_161.VcuRdySts   =getvalue(E_pubc_VCU_VCU_161_VcuRdySts_Rv);
    Msg_VCU_161.VcuVehWhlReqTq   =getvalue(E_pubc_VCU_VCU_161_VcuVehWhlReqTq_Rv);
    Msg_VCU_161.VcuPtTqRealVld   =getvalue(E_pubc_VCU_VCU_161_VcuPtTqRealVld_Rv);
    Msg_VCU_161.VCUShiftPostionValid   =getvalue(E_pubc_VCU_VCU_161_VCUShiftPostionValid_Rv);
    Msg_VCU_161.VcuPtTqReal   =getvalue(E_pubc_VCU_VCU_161_VcuPtTqReal_Rv);
    Msg_VCU_161.VcuPtTqLimMinVld   =getvalue(E_pubc_VCU_VCU_161_VcuPtTqLimMinVld_Rv);
    Msg_VCU_161.VcuGearPosn   =getvalue(E_pubc_VCU_VCU_161_VcuGearPosn_Rv);
    Msg_VCU_161.VcuVehWhlReqTqVld   =getvalue(E_pubc_VCU_VCU_161_VcuVehWhlReqTqVld_Rv);
    Msg_VCU_161.VcuSimnEpbSwtStsVld   =getvalue(E_pubc_VCU_VCU_161_VcuSimnEpbSwtStsVld_Rv);
    Msg_VCU_161.VcuAccrMod   =getvalue(E_pubc_VCU_VCU_161_VcuAccrMod_Rv);
    Msg_VCU_161.VcuAccrPedlPosn   =getvalue(E_pubc_VCU_VCU_161_VcuAccrPedlPosn_Rv);
    Msg_VCU_161.VcuPtTqLimMaxVld   =getvalue(E_pubc_VCU_VCU_161_VcuPtTqLimMaxVld_Rv);
    Msg_VCU_161.VcuCalcnAccrPedlPosnVld   =getvalue(E_pubc_VCU_VCU_161_VcuCalcnAccrPedlPosnVld_Rv);
    Msg_VCU_161.VcuVehGearPosnVld   =getvalue(E_pubc_VCU_VCU_161_VcuVehGearPosnVld_Rv);
    Msg_VCU_161.VcuShiftLvlPosn   =getvalue(E_pubc_VCU_VCU_161_VcuShiftLvlPosn_Rv);
    Msg_VCU_161.VcuSimnEpbSwtSts   =getvalue(E_pubc_VCU_VCU_161_VcuSimnEpbSwtSts_Rv);
    Msg_VCU_161.VcuPtTqLimMin   =getvalue(E_pubc_VCU_VCU_161_VcuPtTqLimMin_Rv);
    Msg_VCU_161.VcuComFltSts   =getvalue(E_pubc_VCU_VCU_161_VcuComFltSts_Rv);
    Msg_VCU_161.VcuEnyRecyclMod   =getvalue(E_pubc_VCU_VCU_161_VcuEnyRecyclMod_Rv);
}
/*@@end*/

/*@@envVar:E_pubc_VCU_CycMsgsON:*/
on envVar E_pubc_VCU_CycMsgsON
{
    // enable all the cyclic messages 
    putValue(E_pubc_VCU_VCU_38A_Tm,1);
    putValue(E_pubc_VCU_VCU_161_Tm,1);
}
/*@@end*/

/*@@envVar:E_pubc_VCU_CycMsgsOFF:*/
on envVar E_pubc_VCU_CycMsgsOFF
{
    // disable all the cyclic messages
    putValue(E_pubc_VCU_VCU_38A_Tm,0);
    putValue(E_pubc_VCU_VCU_161_Tm,0);
    
}
/*@@end*/
/*@@timer:Tm_VCU_38A:*/
on timer Tm_VCU_38A
{
    //cyclic message timer 
    if(getValue(E_pubc_VCU_VCU_38A_Tm) == 1)
    {
        
		//update the BZ Signal
        if(VCU_38A_VcuRollingCounter_38A_wrongvalctr == 0)
        {
            update_VCU_38A_VcuRollingCounter_38A_counter();
            Msg_VCU_38A.VcuRollingCounter_38A= VCU_38A_VcuRollingCounter_38A_counter;
        }
        else if(VCU_38A_VcuRollingCounter_38A_wrongvalctr > 0)
        {
			VCU_38A_VcuRollingCounter_38A_counter=VCU_38A_VcuRollingCounter_38A_counter + VCU_38A_VcuRollingCounter_38A_wrongvalctr;
			 Msg_VCU_38A.VcuRollingCounter_38A= VCU_38A_VcuRollingCounter_38A_counter;
            /* VCU_38A_VcuRollingCounter_38A_wrongvalctr--;
             // if counter becomes zero, update panel controller to zero
             if(VCU_38A_VcuRollingCounter_38A_wrongvalctr == 0)
             {
                putValue(E_pubc_VCU_VCU_38A_VcuRollingCounter_38A_wrongvalctr,0);
             } */
        }
        else
        {
            // do nothing
        }
	
        update_VCU_38A_CRC_CheckSum();
        output(Msg_VCU_38A);
        
    }
    //Reset Timer
    SetTimer(Tm_VCU_38A,Cycle_VCU_38A);
}
/*@@end*/

/*@@envVar:E_pubc_VCU_VCU_38A_cycleTm:*/
on envVar E_pubc_VCU_VCU_38A_cycleTm
{
    // update the cycle time 
    Cycle_VCU_38A=getvalue(this);
}
/*@@end*/
/*@@timer:Tm_VCU_161:*/
on timer Tm_VCU_161
{
    //cyclic message timer 
    if(getValue(E_pubc_VCU_VCU_161_Tm) == 1)
    {
        
		//update the BZ Signal
        if(VCU_161_VcuCycCntr161_wrongvalctr == 0)
        {
            update_VCU_161_VcuCycCntr161_counter();
            Msg_VCU_161.VcuCycCntr161= VCU_161_VcuCycCntr161_counter;
        }
        else if(VCU_161_VcuCycCntr161_wrongvalctr > 0)
        {
			VCU_161_VcuCycCntr161_counter=VCU_161_VcuCycCntr161_counter + VCU_161_VcuCycCntr161_wrongvalctr;
			 Msg_VCU_161.VcuCycCntr161= VCU_161_VcuCycCntr161_counter;
            /* VCU_161_VcuCycCntr161_wrongvalctr--;
             // if counter becomes zero, update panel controller to zero
             if(VCU_161_VcuCycCntr161_wrongvalctr == 0)
             {
                putValue(E_pubc_VCU_VCU_161_VcuCycCntr161_wrongvalctr,0);
             } */
        }
        else
        {
            // do nothing
        }
	
        update_VCU_161_CRC_CheckSum();
        output(Msg_VCU_161);
        
    }
    //Reset Timer
    SetTimer(Tm_VCU_161,Cycle_VCU_161);
}
/*@@end*/

/*@@envVar:E_pubc_VCU_VCU_161_cycleTm:*/
on envVar E_pubc_VCU_VCU_161_cycleTm
{
    // update the cycle time 
    Cycle_VCU_161=getvalue(this);
}
/*@@end*/

/*@@envVar:E_pubc_VCU_VCU_38A_tx:*/
on envVar E_pubc_VCU_VCU_38A_tx
{
    if(getValue(this))
    {       
        
        //update the BZ Signal
        if(VCU_38A_VcuRollingCounter_38A_wrongvalctr == 0)
        {
            update_VCU_38A_VcuRollingCounter_38A_counter();
            Msg_VCU_38A.VcuRollingCounter_38A= VCU_38A_VcuRollingCounter_38A_counter;
        }
        else if(VCU_38A_VcuRollingCounter_38A_wrongvalctr > 0)
        {
			VCU_38A_VcuRollingCounter_38A_counter=VCU_38A_VcuRollingCounter_38A_counter + VCU_38A_VcuRollingCounter_38A_wrongvalctr;
			 Msg_VCU_38A.VcuRollingCounter_38A= VCU_38A_VcuRollingCounter_38A_counter;
            /* VCU_38A_VcuRollingCounter_38A_wrongvalctr--;
              // if counter becomes zero, update panel controller to zero
             if(VCU_38A_VcuRollingCounter_38A_wrongvalctr == 0)
             {
                 putValue(E_pubc_VCU_VCU_38A_VcuRollingCounter_38A_wrongvalctr,0);
             } */
        }
        else
        { 
			// do nothing
        }    
        //calculate the CRC CheckSum
        update_VCU_38A_CRC_CheckSum();

        output(Msg_VCU_38A);        
    }
}
/*@@end*/

/*@@envVar:E_pubc_VCU_VCU_38A_Range:*/
on envVar E_pubc_VCU_VCU_38A_Range
{
    qword rawstatus = 0ll;
    qword rawValue = 0ll;    
    
    rawstatus = getvalue(this);    
    // set all the signals with min raw /max raw /init raw
    switch (rawstatus) 
    {
     case(0) :
        rawValue= 0;
        putValue(E_pubc_VCU_VCU_38A_VcuCrsResuSwtSts_Rv, rawValue);
        rawValue= 0;
        putValue(E_pubc_VCU_VCU_38A_VcuCrsDstSwtSts_Rv, rawValue);
        rawValue= 0;
        putValue(E_pubc_VCU_VCU_38A_VcuCrsSetSwtSts_Rv, rawValue);
        rawValue= 0;
        putValue(E_pubc_VCU_VCU_38A_VcuCrsSwtDiagInfo_Rv, rawValue);
        break;
     case(1) :
        rawValue= 3;
        putValue(E_pubc_VCU_VCU_38A_VcuCrsResuSwtSts_Rv, rawValue);
        rawValue= 3;
        putValue(E_pubc_VCU_VCU_38A_VcuCrsDstSwtSts_Rv, rawValue);
        rawValue= 3;
        putValue(E_pubc_VCU_VCU_38A_VcuCrsSetSwtSts_Rv, rawValue);
        rawValue= 7;
        putValue(E_pubc_VCU_VCU_38A_VcuCrsSwtDiagInfo_Rv, rawValue);
        break;
     default :
        rawValue= 0;
        putValue(E_pubc_VCU_VCU_38A_VcuCrsResuSwtSts_Rv, rawValue);
        rawValue= 0;
        putValue(E_pubc_VCU_VCU_38A_VcuCrsDstSwtSts_Rv, rawValue);
        rawValue= 0;
        putValue(E_pubc_VCU_VCU_38A_VcuCrsSetSwtSts_Rv, rawValue);
        rawValue= 0;
        putValue(E_pubc_VCU_VCU_38A_VcuCrsSwtDiagInfo_Rv, rawValue);
      break;
   }
}
/*@@end*/

/*@@envVar:E_pubc_VCU_VCU_38A_Dlc:*/
on envVar E_pubc_VCU_VCU_38A_Dlc
{
    if(getValue(E_pubc_VCU_VCU_38A_enDlc))
    {
        Msg_VCU_38A.dlc =getValue(this);
    }
    else
    {
       Dbc_dlc = 8;
	   Msg_VCU_38A.dlc = Calc_Canfd_dlc(Dbc_dlc);
	   // Msg_VCU_38A.dlc = 8;
	   	
  }
}
/*@@end*/

/*@@envVar:E_pubc_VCU_VCU_38A_enDlc:*/
on envVar E_pubc_VCU_VCU_38A_enDlc
{
    //For Messages with DLC = 8, set wrong DLC to smaller than defined DLC
    //For Messages with DLC < 8 set wrong DLC to smaller/longer than defined DLC
    if(getValue(this))
    {
        Msg_VCU_38A.dlc =getValue(E_pubc_VCU_VCU_38A_Dlc);
    }
    else
    {
       Dbc_dlc = 8;
	   Msg_VCU_38A.dlc = Calc_Canfd_dlc(Dbc_dlc);
	   // Msg_VCU_38A.dlc = 8;
    }
}
/*@@end*/

/*@@envVar:E_pubc_VCU_VCU_38A_VcuCRCCheck_38A_wrongvalctr:*/
on envVar E_pubc_VCU_VCU_38A_VcuCRCCheck_38A_wrongvalctr
{
    //update disturb count
    //disturb value range:(-1 = always send wrong value),( X>0 ,x is the number of Messages with wrong CHK sent)
    VCU_38A_VcuCRCCheck_38A_wrongvalctr =getValue(this);    
}
/*@@end*/
/*@@envVar:E_pubc_VCU_VCU_38A_VcuRollingCounter_38A_wrongvalctr:*/
on envVar E_pubc_VCU_VCU_38A_VcuRollingCounter_38A_wrongvalctr
{
    //update disturb count
    //disturb value range:(-1 = always send wrong value),( X>0 ,x is the number of Messages with wrong CHK sent)
    VCU_38A_VcuRollingCounter_38A_wrongvalctr =getValue(this);    
}
/*@@end*/

/*@@envVar:E_pubc_VCU_VCU_38A_VcuCrsResuSwtSts_Rv:*/
on envVar E_pubc_VCU_VCU_38A_VcuCrsResuSwtSts_Rv
{
    int64 rawValue = 0ll;
    float rawValue_float = 0.0;
    float phyValue = 0.0;        

    //set the signal with updated raw value
    if(getValue(E_pubc_VCU_VCU_38A_VcuCrsResuSwtSts_SetVt)==0)
    {
        rawValue = getvalue(this);
        if(chgEv_VCU_38A_VcuCrsResuSwtSts == 0)
        {
            //type conversion to float
            rawValue_float = rawValue;        
            // raw to physical conversion
            phyValue = ((rawValue_float *1)+(0));
            putValue(E_pubc_VCU_VCU_38A_VcuCrsResuSwtSts_Pv, phyValue);
            chgEv_VCU_38A_VcuCrsResuSwtSts = 1;
        }
        else
        {
            chgEv_VCU_38A_VcuCrsResuSwtSts = 0;
        }    
        //update the signal value
        Msg_VCU_38A.VcuCrsResuSwtSts=rawValue;        
    }                                                                           
}
/*@@end*/

/*@@envVar:E_pubc_VCU_VCU_38A_VcuCrsResuSwtSts_Pv:*/
on envVar E_pubc_VCU_VCU_38A_VcuCrsResuSwtSts_Pv
{
    int64 rawValue = 0ll;
    float phyValue = 0.0;
    
    //update the raw value with physical value 
    if(getValue(E_pubc_VCU_VCU_38A_VcuCrsResuSwtSts_SetVt)==0)
    {
        if(chgEv_VCU_38A_VcuCrsResuSwtSts == 0)
        {
            phyValue = getvalue(this);
            // physical to raw conversion
            rawValue = ((phyValue -(0))/1);
            putValue(E_pubc_VCU_VCU_38A_VcuCrsResuSwtSts_Rv, rawValue);
            chgEv_VCU_38A_VcuCrsResuSwtSts = 1;  
        }
        else
        {
            chgEv_VCU_38A_VcuCrsResuSwtSts = 0;
        }
    }
}
/*@@end*/

/*@@envVar:E_pubc_VCU_VCU_38A_VcuCrsResuSwtSts_Vt:*/
on envVar E_pubc_VCU_VCU_38A_VcuCrsResuSwtSts_Vt
{
    qword rawValue = 0ll;
    if(getValue(E_pubc_VCU_VCU_38A_VcuCrsResuSwtSts_SetVt))
    {
        //update the signal value
        Msg_VCU_38A.VcuCrsResuSwtSts=getValue(this);
    }
}
/*@@end*/

/*@@envVar:E_pubc_VCU_VCU_38A_VcuCrsResuSwtSts_SetVt:*/
on envVar E_pubc_VCU_VCU_38A_VcuCrsResuSwtSts_SetVt
{
    if(getValue(E_pubc_VCU_VCU_38A_VcuCrsResuSwtSts_SetVt))
    {
        //update the signal value
        Msg_VCU_38A.VcuCrsResuSwtSts=getvalue(E_pubc_VCU_VCU_38A_VcuCrsResuSwtSts_Vt);
    }
    else
    {
        Msg_VCU_38A.VcuCrsResuSwtSts=getValue(E_pubc_VCU_VCU_38A_VcuCrsResuSwtSts_Rv);
    }
}
/*@@end*/
 
/*@@envVar:E_pubc_VCU_VCU_38A_VcuCrsDstSwtSts_Rv:*/
on envVar E_pubc_VCU_VCU_38A_VcuCrsDstSwtSts_Rv
{
    int64 rawValue = 0ll;
    float rawValue_float = 0.0;
    float phyValue = 0.0;        

    //set the signal with updated raw value
    if(getValue(E_pubc_VCU_VCU_38A_VcuCrsDstSwtSts_SetVt)==0)
    {
        rawValue = getvalue(this);
        if(chgEv_VCU_38A_VcuCrsDstSwtSts == 0)
        {
            //type conversion to float
            rawValue_float = rawValue;        
            // raw to physical conversion
            phyValue = ((rawValue_float *1)+(0));
            putValue(E_pubc_VCU_VCU_38A_VcuCrsDstSwtSts_Pv, phyValue);
            chgEv_VCU_38A_VcuCrsDstSwtSts = 1;
        }
        else
        {
            chgEv_VCU_38A_VcuCrsDstSwtSts = 0;
        }    
        //update the signal value
        Msg_VCU_38A.VcuCrsDstSwtSts=rawValue;        
    }                                                                           
}
/*@@end*/

/*@@envVar:E_pubc_VCU_VCU_38A_VcuCrsDstSwtSts_Pv:*/
on envVar E_pubc_VCU_VCU_38A_VcuCrsDstSwtSts_Pv
{
    int64 rawValue = 0ll;
    float phyValue = 0.0;
    
    //update the raw value with physical value 
    if(getValue(E_pubc_VCU_VCU_38A_VcuCrsDstSwtSts_SetVt)==0)
    {
        if(chgEv_VCU_38A_VcuCrsDstSwtSts == 0)
        {
            phyValue = getvalue(this);
            // physical to raw conversion
            rawValue = ((phyValue -(0))/1);
            putValue(E_pubc_VCU_VCU_38A_VcuCrsDstSwtSts_Rv, rawValue);
            chgEv_VCU_38A_VcuCrsDstSwtSts = 1;  
        }
        else
        {
            chgEv_VCU_38A_VcuCrsDstSwtSts = 0;
        }
    }
}
/*@@end*/

/*@@envVar:E_pubc_VCU_VCU_38A_VcuCrsDstSwtSts_Vt:*/
on envVar E_pubc_VCU_VCU_38A_VcuCrsDstSwtSts_Vt
{
    qword rawValue = 0ll;
    if(getValue(E_pubc_VCU_VCU_38A_VcuCrsDstSwtSts_SetVt))
    {
        //update the signal value
        Msg_VCU_38A.VcuCrsDstSwtSts=getValue(this);
    }
}
/*@@end*/

/*@@envVar:E_pubc_VCU_VCU_38A_VcuCrsDstSwtSts_SetVt:*/
on envVar E_pubc_VCU_VCU_38A_VcuCrsDstSwtSts_SetVt
{
    if(getValue(E_pubc_VCU_VCU_38A_VcuCrsDstSwtSts_SetVt))
    {
        //update the signal value
        Msg_VCU_38A.VcuCrsDstSwtSts=getvalue(E_pubc_VCU_VCU_38A_VcuCrsDstSwtSts_Vt);
    }
    else
    {
        Msg_VCU_38A.VcuCrsDstSwtSts=getValue(E_pubc_VCU_VCU_38A_VcuCrsDstSwtSts_Rv);
    }
}
/*@@end*/
 
/*@@envVar:E_pubc_VCU_VCU_38A_VcuCrsSetSwtSts_Rv:*/
on envVar E_pubc_VCU_VCU_38A_VcuCrsSetSwtSts_Rv
{
    int64 rawValue = 0ll;
    float rawValue_float = 0.0;
    float phyValue = 0.0;        

    //set the signal with updated raw value
    if(getValue(E_pubc_VCU_VCU_38A_VcuCrsSetSwtSts_SetVt)==0)
    {
        rawValue = getvalue(this);
        if(chgEv_VCU_38A_VcuCrsSetSwtSts == 0)
        {
            //type conversion to float
            rawValue_float = rawValue;        
            // raw to physical conversion
            phyValue = ((rawValue_float *1)+(0));
            putValue(E_pubc_VCU_VCU_38A_VcuCrsSetSwtSts_Pv, phyValue);
            chgEv_VCU_38A_VcuCrsSetSwtSts = 1;
        }
        else
        {
            chgEv_VCU_38A_VcuCrsSetSwtSts = 0;
        }    
        //update the signal value
        Msg_VCU_38A.VcuCrsSetSwtSts=rawValue;        
    }                                                                           
}
/*@@end*/

/*@@envVar:E_pubc_VCU_VCU_38A_VcuCrsSetSwtSts_Pv:*/
on envVar E_pubc_VCU_VCU_38A_VcuCrsSetSwtSts_Pv
{
    int64 rawValue = 0ll;
    float phyValue = 0.0;
    
    //update the raw value with physical value 
    if(getValue(E_pubc_VCU_VCU_38A_VcuCrsSetSwtSts_SetVt)==0)
    {
        if(chgEv_VCU_38A_VcuCrsSetSwtSts == 0)
        {
            phyValue = getvalue(this);
            // physical to raw conversion
            rawValue = ((phyValue -(0))/1);
            putValue(E_pubc_VCU_VCU_38A_VcuCrsSetSwtSts_Rv, rawValue);
            chgEv_VCU_38A_VcuCrsSetSwtSts = 1;  
        }
        else
        {
            chgEv_VCU_38A_VcuCrsSetSwtSts = 0;
        }
    }
}
/*@@end*/

/*@@envVar:E_pubc_VCU_VCU_38A_VcuCrsSetSwtSts_Vt:*/
on envVar E_pubc_VCU_VCU_38A_VcuCrsSetSwtSts_Vt
{
    qword rawValue = 0ll;
    if(getValue(E_pubc_VCU_VCU_38A_VcuCrsSetSwtSts_SetVt))
    {
        //update the signal value
        Msg_VCU_38A.VcuCrsSetSwtSts=getValue(this);
    }
}
/*@@end*/

/*@@envVar:E_pubc_VCU_VCU_38A_VcuCrsSetSwtSts_SetVt:*/
on envVar E_pubc_VCU_VCU_38A_VcuCrsSetSwtSts_SetVt
{
    if(getValue(E_pubc_VCU_VCU_38A_VcuCrsSetSwtSts_SetVt))
    {
        //update the signal value
        Msg_VCU_38A.VcuCrsSetSwtSts=getvalue(E_pubc_VCU_VCU_38A_VcuCrsSetSwtSts_Vt);
    }
    else
    {
        Msg_VCU_38A.VcuCrsSetSwtSts=getValue(E_pubc_VCU_VCU_38A_VcuCrsSetSwtSts_Rv);
    }
}
/*@@end*/
 
/*@@envVar:E_pubc_VCU_VCU_38A_VcuCrsSwtDiagInfo_Rv:*/
on envVar E_pubc_VCU_VCU_38A_VcuCrsSwtDiagInfo_Rv
{
    int64 rawValue = 0ll;
    float rawValue_float = 0.0;
    float phyValue = 0.0;        

    //set the signal with updated raw value
    if(getValue(E_pubc_VCU_VCU_38A_VcuCrsSwtDiagInfo_SetVt)==0)
    {
        rawValue = getvalue(this);
        if(chgEv_VCU_38A_VcuCrsSwtDiagInfo == 0)
        {
            //type conversion to float
            rawValue_float = rawValue;        
            // raw to physical conversion
            phyValue = ((rawValue_float *1)+(0));
            putValue(E_pubc_VCU_VCU_38A_VcuCrsSwtDiagInfo_Pv, phyValue);
            chgEv_VCU_38A_VcuCrsSwtDiagInfo = 1;
        }
        else
        {
            chgEv_VCU_38A_VcuCrsSwtDiagInfo = 0;
        }    
        //update the signal value
        Msg_VCU_38A.VcuCrsSwtDiagInfo=rawValue;        
    }                                                                           
}
/*@@end*/

/*@@envVar:E_pubc_VCU_VCU_38A_VcuCrsSwtDiagInfo_Pv:*/
on envVar E_pubc_VCU_VCU_38A_VcuCrsSwtDiagInfo_Pv
{
    int64 rawValue = 0ll;
    float phyValue = 0.0;
    
    //update the raw value with physical value 
    if(getValue(E_pubc_VCU_VCU_38A_VcuCrsSwtDiagInfo_SetVt)==0)
    {
        if(chgEv_VCU_38A_VcuCrsSwtDiagInfo == 0)
        {
            phyValue = getvalue(this);
            // physical to raw conversion
            rawValue = ((phyValue -(0))/1);
            putValue(E_pubc_VCU_VCU_38A_VcuCrsSwtDiagInfo_Rv, rawValue);
            chgEv_VCU_38A_VcuCrsSwtDiagInfo = 1;  
        }
        else
        {
            chgEv_VCU_38A_VcuCrsSwtDiagInfo = 0;
        }
    }
}
/*@@end*/

/*@@envVar:E_pubc_VCU_VCU_38A_VcuCrsSwtDiagInfo_Vt:*/
on envVar E_pubc_VCU_VCU_38A_VcuCrsSwtDiagInfo_Vt
{
    qword rawValue = 0ll;
    if(getValue(E_pubc_VCU_VCU_38A_VcuCrsSwtDiagInfo_SetVt))
    {
        //update the signal value
        Msg_VCU_38A.VcuCrsSwtDiagInfo=getValue(this);
    }
}
/*@@end*/

/*@@envVar:E_pubc_VCU_VCU_38A_VcuCrsSwtDiagInfo_SetVt:*/
on envVar E_pubc_VCU_VCU_38A_VcuCrsSwtDiagInfo_SetVt
{
    if(getValue(E_pubc_VCU_VCU_38A_VcuCrsSwtDiagInfo_SetVt))
    {
        //update the signal value
        Msg_VCU_38A.VcuCrsSwtDiagInfo=getvalue(E_pubc_VCU_VCU_38A_VcuCrsSwtDiagInfo_Vt);
    }
    else
    {
        Msg_VCU_38A.VcuCrsSwtDiagInfo=getValue(E_pubc_VCU_VCU_38A_VcuCrsSwtDiagInfo_Rv);
    }
}
/*@@end*/
 
/*@@envVar:E_pubc_VCU_VCU_161_tx:*/
on envVar E_pubc_VCU_VCU_161_tx
{
    if(getValue(this))
    {       
        
        //update the BZ Signal
        if(VCU_161_VcuCycCntr161_wrongvalctr == 0)
        {
            update_VCU_161_VcuCycCntr161_counter();
            Msg_VCU_161.VcuCycCntr161= VCU_161_VcuCycCntr161_counter;
        }
        else if(VCU_161_VcuCycCntr161_wrongvalctr > 0)
        {
			VCU_161_VcuCycCntr161_counter=VCU_161_VcuCycCntr161_counter + VCU_161_VcuCycCntr161_wrongvalctr;
			 Msg_VCU_161.VcuCycCntr161= VCU_161_VcuCycCntr161_counter;
            /* VCU_161_VcuCycCntr161_wrongvalctr--;
              // if counter becomes zero, update panel controller to zero
             if(VCU_161_VcuCycCntr161_wrongvalctr == 0)
             {
                 putValue(E_pubc_VCU_VCU_161_VcuCycCntr161_wrongvalctr,0);
             } */
        }
        else
        { 
			// do nothing
        }    
        //calculate the CRC CheckSum
        update_VCU_161_CRC_CheckSum();

        output(Msg_VCU_161);        
    }
}
/*@@end*/

/*@@envVar:E_pubc_VCU_VCU_161_Range:*/
on envVar E_pubc_VCU_VCU_161_Range
{
    qword rawstatus = 0ll;
    qword rawValue = 0ll;    
    
    rawstatus = getvalue(this);    
    // set all the signals with min raw /max raw /init raw
    switch (rawstatus) 
    {
     case(0) :
        rawValue= 0;
        putValue(E_pubc_VCU_VCU_161_VcuCalcnAccrPedlPosn_Rv, rawValue);
        rawValue= 0;
        putValue(E_pubc_VCU_VCU_161_VcuOvrdModReq_Rv, rawValue);
        rawValue= 0;
        putValue(E_pubc_VCU_VCU_161_VCUAccPedShield_Rv, rawValue);
        rawValue= 0;
        putValue(E_pubc_VCU_VCU_161_VcuPtTqReqAvl_Rv, rawValue);
        rawValue= 0;
        putValue(E_pubc_VCU_VCU_161_VcuAccrPedlPosnVld_Rv, rawValue);
        rawValue= 0;
        putValue(E_pubc_VCU_VCU_161_VcuPtTqLimMax_Rv, rawValue);
        rawValue= 0;
        putValue(E_pubc_VCU_VCU_161_VcuRdySts_Rv, rawValue);
        rawValue= 0;
        putValue(E_pubc_VCU_VCU_161_VcuVehWhlReqTq_Rv, rawValue);
        rawValue= 0;
        putValue(E_pubc_VCU_VCU_161_VcuPtTqRealVld_Rv, rawValue);
        rawValue= 0;
        putValue(E_pubc_VCU_VCU_161_VCUShiftPostionValid_Rv, rawValue);
        rawValue= 0;
        putValue(E_pubc_VCU_VCU_161_VcuPtTqReal_Rv, rawValue);
        rawValue= 0;
        putValue(E_pubc_VCU_VCU_161_VcuPtTqLimMinVld_Rv, rawValue);
        rawValue= 0;
        putValue(E_pubc_VCU_VCU_161_VcuGearPosn_Rv, rawValue);
        rawValue= 0;
        putValue(E_pubc_VCU_VCU_161_VcuVehWhlReqTqVld_Rv, rawValue);
        rawValue= 0;
        putValue(E_pubc_VCU_VCU_161_VcuSimnEpbSwtStsVld_Rv, rawValue);
        rawValue= 0;
        putValue(E_pubc_VCU_VCU_161_VcuAccrMod_Rv, rawValue);
        rawValue= 0;
        putValue(E_pubc_VCU_VCU_161_VcuAccrPedlPosn_Rv, rawValue);
        rawValue= 0;
        putValue(E_pubc_VCU_VCU_161_VcuPtTqLimMaxVld_Rv, rawValue);
        rawValue= 0;
        putValue(E_pubc_VCU_VCU_161_VcuCalcnAccrPedlPosnVld_Rv, rawValue);
        rawValue= 0;
        putValue(E_pubc_VCU_VCU_161_VcuVehGearPosnVld_Rv, rawValue);
        rawValue= 0;
        putValue(E_pubc_VCU_VCU_161_VcuShiftLvlPosn_Rv, rawValue);
        rawValue= 0;
        putValue(E_pubc_VCU_VCU_161_VcuSimnEpbSwtSts_Rv, rawValue);
        rawValue= 0;
        putValue(E_pubc_VCU_VCU_161_VcuPtTqLimMin_Rv, rawValue);
        rawValue= 0;
        putValue(E_pubc_VCU_VCU_161_VcuComFltSts_Rv, rawValue);
        rawValue= 0;
        putValue(E_pubc_VCU_VCU_161_VcuEnyRecyclMod_Rv, rawValue);
        break;
     case(1) :
        rawValue= 1022;
        putValue(E_pubc_VCU_VCU_161_VcuCalcnAccrPedlPosn_Rv, rawValue);
        rawValue= 1;
        putValue(E_pubc_VCU_VCU_161_VcuOvrdModReq_Rv, rawValue);
        rawValue= 1;
        putValue(E_pubc_VCU_VCU_161_VCUAccPedShield_Rv, rawValue);
        rawValue= 3;
        putValue(E_pubc_VCU_VCU_161_VcuPtTqReqAvl_Rv, rawValue);
        rawValue= 1;
        putValue(E_pubc_VCU_VCU_161_VcuAccrPedlPosnVld_Rv, rawValue);
        rawValue= 65535;
        putValue(E_pubc_VCU_VCU_161_VcuPtTqLimMax_Rv, rawValue);
        rawValue= 1;
        putValue(E_pubc_VCU_VCU_161_VcuRdySts_Rv, rawValue);
        rawValue= 65535;
        putValue(E_pubc_VCU_VCU_161_VcuVehWhlReqTq_Rv, rawValue);
        rawValue= 1;
        putValue(E_pubc_VCU_VCU_161_VcuPtTqRealVld_Rv, rawValue);
        rawValue= 1;
        putValue(E_pubc_VCU_VCU_161_VCUShiftPostionValid_Rv, rawValue);
        rawValue= 65535;
        putValue(E_pubc_VCU_VCU_161_VcuPtTqReal_Rv, rawValue);
        rawValue= 1;
        putValue(E_pubc_VCU_VCU_161_VcuPtTqLimMinVld_Rv, rawValue);
        rawValue= 7;
        putValue(E_pubc_VCU_VCU_161_VcuGearPosn_Rv, rawValue);
        rawValue= 1;
        putValue(E_pubc_VCU_VCU_161_VcuVehWhlReqTqVld_Rv, rawValue);
        rawValue= 1;
        putValue(E_pubc_VCU_VCU_161_VcuSimnEpbSwtStsVld_Rv, rawValue);
        rawValue= 7;
        putValue(E_pubc_VCU_VCU_161_VcuAccrMod_Rv, rawValue);
        rawValue= 1022;
        putValue(E_pubc_VCU_VCU_161_VcuAccrPedlPosn_Rv, rawValue);
        rawValue= 1;
        putValue(E_pubc_VCU_VCU_161_VcuPtTqLimMaxVld_Rv, rawValue);
        rawValue= 1;
        putValue(E_pubc_VCU_VCU_161_VcuCalcnAccrPedlPosnVld_Rv, rawValue);
        rawValue= 1;
        putValue(E_pubc_VCU_VCU_161_VcuVehGearPosnVld_Rv, rawValue);
        rawValue= 15;
        putValue(E_pubc_VCU_VCU_161_VcuShiftLvlPosn_Rv, rawValue);
        rawValue= 3;
        putValue(E_pubc_VCU_VCU_161_VcuSimnEpbSwtSts_Rv, rawValue);
        rawValue= 65535;
        putValue(E_pubc_VCU_VCU_161_VcuPtTqLimMin_Rv, rawValue);
        rawValue= 3;
        putValue(E_pubc_VCU_VCU_161_VcuComFltSts_Rv, rawValue);
        rawValue= 127;
        putValue(E_pubc_VCU_VCU_161_VcuEnyRecyclMod_Rv, rawValue);
        break;
     default :
        rawValue= 0;
        putValue(E_pubc_VCU_VCU_161_VcuCalcnAccrPedlPosn_Rv, rawValue);
        rawValue= 0;
        putValue(E_pubc_VCU_VCU_161_VcuOvrdModReq_Rv, rawValue);
        rawValue= 0;
        putValue(E_pubc_VCU_VCU_161_VCUAccPedShield_Rv, rawValue);
        rawValue= 0;
        putValue(E_pubc_VCU_VCU_161_VcuPtTqReqAvl_Rv, rawValue);
        rawValue= 0;
        putValue(E_pubc_VCU_VCU_161_VcuAccrPedlPosnVld_Rv, rawValue);
        rawValue= 0;
        putValue(E_pubc_VCU_VCU_161_VcuPtTqLimMax_Rv, rawValue);
        rawValue= 0;
        putValue(E_pubc_VCU_VCU_161_VcuRdySts_Rv, rawValue);
        rawValue= 0;
        putValue(E_pubc_VCU_VCU_161_VcuVehWhlReqTq_Rv, rawValue);
        rawValue= 0;
        putValue(E_pubc_VCU_VCU_161_VcuPtTqRealVld_Rv, rawValue);
        rawValue= 0;
        putValue(E_pubc_VCU_VCU_161_VCUShiftPostionValid_Rv, rawValue);
        rawValue= 0;
        putValue(E_pubc_VCU_VCU_161_VcuPtTqReal_Rv, rawValue);
        rawValue= 0;
        putValue(E_pubc_VCU_VCU_161_VcuPtTqLimMinVld_Rv, rawValue);
        rawValue= 0;
        putValue(E_pubc_VCU_VCU_161_VcuGearPosn_Rv, rawValue);
        rawValue= 0;
        putValue(E_pubc_VCU_VCU_161_VcuVehWhlReqTqVld_Rv, rawValue);
        rawValue= 0;
        putValue(E_pubc_VCU_VCU_161_VcuSimnEpbSwtStsVld_Rv, rawValue);
        rawValue= 0;
        putValue(E_pubc_VCU_VCU_161_VcuAccrMod_Rv, rawValue);
        rawValue= 0;
        putValue(E_pubc_VCU_VCU_161_VcuAccrPedlPosn_Rv, rawValue);
        rawValue= 0;
        putValue(E_pubc_VCU_VCU_161_VcuPtTqLimMaxVld_Rv, rawValue);
        rawValue= 0;
        putValue(E_pubc_VCU_VCU_161_VcuCalcnAccrPedlPosnVld_Rv, rawValue);
        rawValue= 0;
        putValue(E_pubc_VCU_VCU_161_VcuVehGearPosnVld_Rv, rawValue);
        rawValue= 0;
        putValue(E_pubc_VCU_VCU_161_VcuShiftLvlPosn_Rv, rawValue);
        rawValue= 0;
        putValue(E_pubc_VCU_VCU_161_VcuSimnEpbSwtSts_Rv, rawValue);
        rawValue= 0;
        putValue(E_pubc_VCU_VCU_161_VcuPtTqLimMin_Rv, rawValue);
        rawValue= 0;
        putValue(E_pubc_VCU_VCU_161_VcuComFltSts_Rv, rawValue);
        rawValue= 0;
        putValue(E_pubc_VCU_VCU_161_VcuEnyRecyclMod_Rv, rawValue);
      break;
   }
}
/*@@end*/

/*@@envVar:E_pubc_VCU_VCU_161_Dlc:*/
on envVar E_pubc_VCU_VCU_161_Dlc
{
    if(getValue(E_pubc_VCU_VCU_161_enDlc))
    {
        Msg_VCU_161.dlc =getValue(this);
    }
    else
    {
       Dbc_dlc = 64;
	   Msg_VCU_161.dlc = Calc_Canfd_dlc(Dbc_dlc);
	   // Msg_VCU_161.dlc = 64;
	   	
  }
}
/*@@end*/

/*@@envVar:E_pubc_VCU_VCU_161_enDlc:*/
on envVar E_pubc_VCU_VCU_161_enDlc
{
    //For Messages with DLC = 8, set wrong DLC to smaller than defined DLC
    //For Messages with DLC < 8 set wrong DLC to smaller/longer than defined DLC
    if(getValue(this))
    {
        Msg_VCU_161.dlc =getValue(E_pubc_VCU_VCU_161_Dlc);
    }
    else
    {
       Dbc_dlc = 64;
	   Msg_VCU_161.dlc = Calc_Canfd_dlc(Dbc_dlc);
	   // Msg_VCU_161.dlc = 64;
    }
}
/*@@end*/

/*@@envVar:E_pubc_VCU_VCU_161_VcuCrcChk161_wrongvalctr:*/
on envVar E_pubc_VCU_VCU_161_VcuCrcChk161_wrongvalctr
{
    //update disturb count
    //disturb value range:(-1 = always send wrong value),( X>0 ,x is the number of Messages with wrong CHK sent)
    VCU_161_VcuCrcChk161_wrongvalctr =getValue(this);    
}
/*@@end*/
/*@@envVar:E_pubc_VCU_VCU_161_VcuCycCntr161_wrongvalctr:*/
on envVar E_pubc_VCU_VCU_161_VcuCycCntr161_wrongvalctr
{
    //update disturb count
    //disturb value range:(-1 = always send wrong value),( X>0 ,x is the number of Messages with wrong CHK sent)
    VCU_161_VcuCycCntr161_wrongvalctr =getValue(this);    
}
/*@@end*/

/*@@envVar:E_pubc_VCU_VCU_161_VcuCalcnAccrPedlPosn_Rv:*/
on envVar E_pubc_VCU_VCU_161_VcuCalcnAccrPedlPosn_Rv
{
    int64 rawValue = 0ll;
    float rawValue_float = 0.0;
    float phyValue = 0.0;        

    //set the signal with updated raw value
    {
        rawValue = getvalue(this);
        if(chgEv_VCU_161_VcuCalcnAccrPedlPosn == 0)
        {
            //type conversion to float
            rawValue_float = rawValue;        
            // raw to physical conversion
            phyValue = ((rawValue_float *0.1)+(0));
            putValue(E_pubc_VCU_VCU_161_VcuCalcnAccrPedlPosn_Pv, phyValue);
            chgEv_VCU_161_VcuCalcnAccrPedlPosn = 1;
        }
        else
        {
            chgEv_VCU_161_VcuCalcnAccrPedlPosn = 0;
        }    
        //update the signal value
        Msg_VCU_161.VcuCalcnAccrPedlPosn=rawValue;        
    }                                                                           
}
/*@@end*/

/*@@envVar:E_pubc_VCU_VCU_161_VcuCalcnAccrPedlPosn_Pv:*/
on envVar E_pubc_VCU_VCU_161_VcuCalcnAccrPedlPosn_Pv
{
    int64 rawValue = 0ll;
    float phyValue = 0.0;
    
    //update the raw value with physical value 
    {
        if(chgEv_VCU_161_VcuCalcnAccrPedlPosn == 0)
        {
            phyValue = getvalue(this);
            // physical to raw conversion
            rawValue = ((phyValue -(0))/0.1);
            putValue(E_pubc_VCU_VCU_161_VcuCalcnAccrPedlPosn_Rv, rawValue);
            chgEv_VCU_161_VcuCalcnAccrPedlPosn = 1;  
        }
        else
        {
            chgEv_VCU_161_VcuCalcnAccrPedlPosn = 0;
        }
    }
}
/*@@end*/


 
/*@@envVar:E_pubc_VCU_VCU_161_VcuOvrdModReq_Rv:*/
on envVar E_pubc_VCU_VCU_161_VcuOvrdModReq_Rv
{
    int64 rawValue = 0ll;
    float rawValue_float = 0.0;
    float phyValue = 0.0;        

    //set the signal with updated raw value
    if(getValue(E_pubc_VCU_VCU_161_VcuOvrdModReq_SetVt)==0)
    {
        rawValue = getvalue(this);
        if(chgEv_VCU_161_VcuOvrdModReq == 0)
        {
            //type conversion to float
            rawValue_float = rawValue;        
            // raw to physical conversion
            phyValue = ((rawValue_float *1)+(0));
            putValue(E_pubc_VCU_VCU_161_VcuOvrdModReq_Pv, phyValue);
            chgEv_VCU_161_VcuOvrdModReq = 1;
        }
        else
        {
            chgEv_VCU_161_VcuOvrdModReq = 0;
        }    
        //update the signal value
        Msg_VCU_161.VcuOvrdModReq=rawValue;        
    }                                                                           
}
/*@@end*/

/*@@envVar:E_pubc_VCU_VCU_161_VcuOvrdModReq_Pv:*/
on envVar E_pubc_VCU_VCU_161_VcuOvrdModReq_Pv
{
    int64 rawValue = 0ll;
    float phyValue = 0.0;
    
    //update the raw value with physical value 
    if(getValue(E_pubc_VCU_VCU_161_VcuOvrdModReq_SetVt)==0)
    {
        if(chgEv_VCU_161_VcuOvrdModReq == 0)
        {
            phyValue = getvalue(this);
            // physical to raw conversion
            rawValue = ((phyValue -(0))/1);
            putValue(E_pubc_VCU_VCU_161_VcuOvrdModReq_Rv, rawValue);
            chgEv_VCU_161_VcuOvrdModReq = 1;  
        }
        else
        {
            chgEv_VCU_161_VcuOvrdModReq = 0;
        }
    }
}
/*@@end*/

/*@@envVar:E_pubc_VCU_VCU_161_VcuOvrdModReq_Vt:*/
on envVar E_pubc_VCU_VCU_161_VcuOvrdModReq_Vt
{
    qword rawValue = 0ll;
    if(getValue(E_pubc_VCU_VCU_161_VcuOvrdModReq_SetVt))
    {
        //update the signal value
        Msg_VCU_161.VcuOvrdModReq=getValue(this);
    }
}
/*@@end*/

/*@@envVar:E_pubc_VCU_VCU_161_VcuOvrdModReq_SetVt:*/
on envVar E_pubc_VCU_VCU_161_VcuOvrdModReq_SetVt
{
    if(getValue(E_pubc_VCU_VCU_161_VcuOvrdModReq_SetVt))
    {
        //update the signal value
        Msg_VCU_161.VcuOvrdModReq=getvalue(E_pubc_VCU_VCU_161_VcuOvrdModReq_Vt);
    }
    else
    {
        Msg_VCU_161.VcuOvrdModReq=getValue(E_pubc_VCU_VCU_161_VcuOvrdModReq_Rv);
    }
}
/*@@end*/
 
/*@@envVar:E_pubc_VCU_VCU_161_VCUAccPedShield_Rv:*/
on envVar E_pubc_VCU_VCU_161_VCUAccPedShield_Rv
{
    int64 rawValue = 0ll;
    float rawValue_float = 0.0;
    float phyValue = 0.0;        

    //set the signal with updated raw value
    if(getValue(E_pubc_VCU_VCU_161_VCUAccPedShield_SetVt)==0)
    {
        rawValue = getvalue(this);
        if(chgEv_VCU_161_VCUAccPedShield == 0)
        {
            //type conversion to float
            rawValue_float = rawValue;        
            // raw to physical conversion
            phyValue = ((rawValue_float *1)+(0));
            putValue(E_pubc_VCU_VCU_161_VCUAccPedShield_Pv, phyValue);
            chgEv_VCU_161_VCUAccPedShield = 1;
        }
        else
        {
            chgEv_VCU_161_VCUAccPedShield = 0;
        }    
        //update the signal value
        Msg_VCU_161.VCUAccPedShield=rawValue;        
    }                                                                           
}
/*@@end*/

/*@@envVar:E_pubc_VCU_VCU_161_VCUAccPedShield_Pv:*/
on envVar E_pubc_VCU_VCU_161_VCUAccPedShield_Pv
{
    int64 rawValue = 0ll;
    float phyValue = 0.0;
    
    //update the raw value with physical value 
    if(getValue(E_pubc_VCU_VCU_161_VCUAccPedShield_SetVt)==0)
    {
        if(chgEv_VCU_161_VCUAccPedShield == 0)
        {
            phyValue = getvalue(this);
            // physical to raw conversion
            rawValue = ((phyValue -(0))/1);
            putValue(E_pubc_VCU_VCU_161_VCUAccPedShield_Rv, rawValue);
            chgEv_VCU_161_VCUAccPedShield = 1;  
        }
        else
        {
            chgEv_VCU_161_VCUAccPedShield = 0;
        }
    }
}
/*@@end*/

/*@@envVar:E_pubc_VCU_VCU_161_VCUAccPedShield_Vt:*/
on envVar E_pubc_VCU_VCU_161_VCUAccPedShield_Vt
{
    qword rawValue = 0ll;
    if(getValue(E_pubc_VCU_VCU_161_VCUAccPedShield_SetVt))
    {
        //update the signal value
        Msg_VCU_161.VCUAccPedShield=getValue(this);
    }
}
/*@@end*/

/*@@envVar:E_pubc_VCU_VCU_161_VCUAccPedShield_SetVt:*/
on envVar E_pubc_VCU_VCU_161_VCUAccPedShield_SetVt
{
    if(getValue(E_pubc_VCU_VCU_161_VCUAccPedShield_SetVt))
    {
        //update the signal value
        Msg_VCU_161.VCUAccPedShield=getvalue(E_pubc_VCU_VCU_161_VCUAccPedShield_Vt);
    }
    else
    {
        Msg_VCU_161.VCUAccPedShield=getValue(E_pubc_VCU_VCU_161_VCUAccPedShield_Rv);
    }
}
/*@@end*/
 
/*@@envVar:E_pubc_VCU_VCU_161_VcuPtTqReqAvl_Rv:*/
on envVar E_pubc_VCU_VCU_161_VcuPtTqReqAvl_Rv
{
    int64 rawValue = 0ll;
    float rawValue_float = 0.0;
    float phyValue = 0.0;        

    //set the signal with updated raw value
    if(getValue(E_pubc_VCU_VCU_161_VcuPtTqReqAvl_SetVt)==0)
    {
        rawValue = getvalue(this);
        if(chgEv_VCU_161_VcuPtTqReqAvl == 0)
        {
            //type conversion to float
            rawValue_float = rawValue;        
            // raw to physical conversion
            phyValue = ((rawValue_float *1)+(0));
            putValue(E_pubc_VCU_VCU_161_VcuPtTqReqAvl_Pv, phyValue);
            chgEv_VCU_161_VcuPtTqReqAvl = 1;
        }
        else
        {
            chgEv_VCU_161_VcuPtTqReqAvl = 0;
        }    
        //update the signal value
        Msg_VCU_161.VcuPtTqReqAvl=rawValue;        
    }                                                                           
}
/*@@end*/

/*@@envVar:E_pubc_VCU_VCU_161_VcuPtTqReqAvl_Pv:*/
on envVar E_pubc_VCU_VCU_161_VcuPtTqReqAvl_Pv
{
    int64 rawValue = 0ll;
    float phyValue = 0.0;
    
    //update the raw value with physical value 
    if(getValue(E_pubc_VCU_VCU_161_VcuPtTqReqAvl_SetVt)==0)
    {
        if(chgEv_VCU_161_VcuPtTqReqAvl == 0)
        {
            phyValue = getvalue(this);
            // physical to raw conversion
            rawValue = ((phyValue -(0))/1);
            putValue(E_pubc_VCU_VCU_161_VcuPtTqReqAvl_Rv, rawValue);
            chgEv_VCU_161_VcuPtTqReqAvl = 1;  
        }
        else
        {
            chgEv_VCU_161_VcuPtTqReqAvl = 0;
        }
    }
}
/*@@end*/

/*@@envVar:E_pubc_VCU_VCU_161_VcuPtTqReqAvl_Vt:*/
on envVar E_pubc_VCU_VCU_161_VcuPtTqReqAvl_Vt
{
    qword rawValue = 0ll;
    if(getValue(E_pubc_VCU_VCU_161_VcuPtTqReqAvl_SetVt))
    {
        //update the signal value
        Msg_VCU_161.VcuPtTqReqAvl=getValue(this);
    }
}
/*@@end*/

/*@@envVar:E_pubc_VCU_VCU_161_VcuPtTqReqAvl_SetVt:*/
on envVar E_pubc_VCU_VCU_161_VcuPtTqReqAvl_SetVt
{
    if(getValue(E_pubc_VCU_VCU_161_VcuPtTqReqAvl_SetVt))
    {
        //update the signal value
        Msg_VCU_161.VcuPtTqReqAvl=getvalue(E_pubc_VCU_VCU_161_VcuPtTqReqAvl_Vt);
    }
    else
    {
        Msg_VCU_161.VcuPtTqReqAvl=getValue(E_pubc_VCU_VCU_161_VcuPtTqReqAvl_Rv);
    }
}
/*@@end*/
 
/*@@envVar:E_pubc_VCU_VCU_161_VcuAccrPedlPosnVld_Rv:*/
on envVar E_pubc_VCU_VCU_161_VcuAccrPedlPosnVld_Rv
{
    int64 rawValue = 0ll;
    float rawValue_float = 0.0;
    float phyValue = 0.0;        

    //set the signal with updated raw value
    if(getValue(E_pubc_VCU_VCU_161_VcuAccrPedlPosnVld_SetVt)==0)
    {
        rawValue = getvalue(this);
        if(chgEv_VCU_161_VcuAccrPedlPosnVld == 0)
        {
            //type conversion to float
            rawValue_float = rawValue;        
            // raw to physical conversion
            phyValue = ((rawValue_float *1)+(0));
            putValue(E_pubc_VCU_VCU_161_VcuAccrPedlPosnVld_Pv, phyValue);
            chgEv_VCU_161_VcuAccrPedlPosnVld = 1;
        }
        else
        {
            chgEv_VCU_161_VcuAccrPedlPosnVld = 0;
        }    
        //update the signal value
        Msg_VCU_161.VcuAccrPedlPosnVld=rawValue;        
    }                                                                           
}
/*@@end*/

/*@@envVar:E_pubc_VCU_VCU_161_VcuAccrPedlPosnVld_Pv:*/
on envVar E_pubc_VCU_VCU_161_VcuAccrPedlPosnVld_Pv
{
    int64 rawValue = 0ll;
    float phyValue = 0.0;
    
    //update the raw value with physical value 
    if(getValue(E_pubc_VCU_VCU_161_VcuAccrPedlPosnVld_SetVt)==0)
    {
        if(chgEv_VCU_161_VcuAccrPedlPosnVld == 0)
        {
            phyValue = getvalue(this);
            // physical to raw conversion
            rawValue = ((phyValue -(0))/1);
            putValue(E_pubc_VCU_VCU_161_VcuAccrPedlPosnVld_Rv, rawValue);
            chgEv_VCU_161_VcuAccrPedlPosnVld = 1;  
        }
        else
        {
            chgEv_VCU_161_VcuAccrPedlPosnVld = 0;
        }
    }
}
/*@@end*/

/*@@envVar:E_pubc_VCU_VCU_161_VcuAccrPedlPosnVld_Vt:*/
on envVar E_pubc_VCU_VCU_161_VcuAccrPedlPosnVld_Vt
{
    qword rawValue = 0ll;
    if(getValue(E_pubc_VCU_VCU_161_VcuAccrPedlPosnVld_SetVt))
    {
        //update the signal value
        Msg_VCU_161.VcuAccrPedlPosnVld=getValue(this);
    }
}
/*@@end*/

/*@@envVar:E_pubc_VCU_VCU_161_VcuAccrPedlPosnVld_SetVt:*/
on envVar E_pubc_VCU_VCU_161_VcuAccrPedlPosnVld_SetVt
{
    if(getValue(E_pubc_VCU_VCU_161_VcuAccrPedlPosnVld_SetVt))
    {
        //update the signal value
        Msg_VCU_161.VcuAccrPedlPosnVld=getvalue(E_pubc_VCU_VCU_161_VcuAccrPedlPosnVld_Vt);
    }
    else
    {
        Msg_VCU_161.VcuAccrPedlPosnVld=getValue(E_pubc_VCU_VCU_161_VcuAccrPedlPosnVld_Rv);
    }
}
/*@@end*/
 
/*@@envVar:E_pubc_VCU_VCU_161_VcuPtTqLimMax_Rv:*/
on envVar E_pubc_VCU_VCU_161_VcuPtTqLimMax_Rv
{
    int64 rawValue = 0ll;
    float rawValue_float = 0.0;
    float phyValue = 0.0;        

    //set the signal with updated raw value
    {
        rawValue = getvalue(this);
        if(chgEv_VCU_161_VcuPtTqLimMax == 0)
        {
            //type conversion to float
            rawValue_float = rawValue;        
            // raw to physical conversion
            phyValue = ((rawValue_float *1)+(-32768));
            putValue(E_pubc_VCU_VCU_161_VcuPtTqLimMax_Pv, phyValue);
            chgEv_VCU_161_VcuPtTqLimMax = 1;
        }
        else
        {
            chgEv_VCU_161_VcuPtTqLimMax = 0;
        }    
        //update the signal value
        Msg_VCU_161.VcuPtTqLimMax=rawValue;        
    }                                                                           
}
/*@@end*/

/*@@envVar:E_pubc_VCU_VCU_161_VcuPtTqLimMax_Pv:*/
on envVar E_pubc_VCU_VCU_161_VcuPtTqLimMax_Pv
{
    int64 rawValue = 0ll;
    float phyValue = 0.0;
    
    //update the raw value with physical value 
    {
        if(chgEv_VCU_161_VcuPtTqLimMax == 0)
        {
            phyValue = getvalue(this);
            // physical to raw conversion
            rawValue = ((phyValue -(-32768))/1);
            putValue(E_pubc_VCU_VCU_161_VcuPtTqLimMax_Rv, rawValue);
            chgEv_VCU_161_VcuPtTqLimMax = 1;  
        }
        else
        {
            chgEv_VCU_161_VcuPtTqLimMax = 0;
        }
    }
}
/*@@end*/


 
/*@@envVar:E_pubc_VCU_VCU_161_VcuRdySts_Rv:*/
on envVar E_pubc_VCU_VCU_161_VcuRdySts_Rv
{
    int64 rawValue = 0ll;
    float rawValue_float = 0.0;
    float phyValue = 0.0;        

    //set the signal with updated raw value
    if(getValue(E_pubc_VCU_VCU_161_VcuRdySts_SetVt)==0)
    {
        rawValue = getvalue(this);
        if(chgEv_VCU_161_VcuRdySts == 0)
        {
            //type conversion to float
            rawValue_float = rawValue;        
            // raw to physical conversion
            phyValue = ((rawValue_float *1)+(0));
            putValue(E_pubc_VCU_VCU_161_VcuRdySts_Pv, phyValue);
            chgEv_VCU_161_VcuRdySts = 1;
        }
        else
        {
            chgEv_VCU_161_VcuRdySts = 0;
        }    
        //update the signal value
        Msg_VCU_161.VcuRdySts=rawValue;        
    }                                                                           
}
/*@@end*/

/*@@envVar:E_pubc_VCU_VCU_161_VcuRdySts_Pv:*/
on envVar E_pubc_VCU_VCU_161_VcuRdySts_Pv
{
    int64 rawValue = 0ll;
    float phyValue = 0.0;
    
    //update the raw value with physical value 
    if(getValue(E_pubc_VCU_VCU_161_VcuRdySts_SetVt)==0)
    {
        if(chgEv_VCU_161_VcuRdySts == 0)
        {
            phyValue = getvalue(this);
            // physical to raw conversion
            rawValue = ((phyValue -(0))/1);
            putValue(E_pubc_VCU_VCU_161_VcuRdySts_Rv, rawValue);
            chgEv_VCU_161_VcuRdySts = 1;  
        }
        else
        {
            chgEv_VCU_161_VcuRdySts = 0;
        }
    }
}
/*@@end*/

/*@@envVar:E_pubc_VCU_VCU_161_VcuRdySts_Vt:*/
on envVar E_pubc_VCU_VCU_161_VcuRdySts_Vt
{
    qword rawValue = 0ll;
    if(getValue(E_pubc_VCU_VCU_161_VcuRdySts_SetVt))
    {
        //update the signal value
        Msg_VCU_161.VcuRdySts=getValue(this);
    }
}
/*@@end*/

/*@@envVar:E_pubc_VCU_VCU_161_VcuRdySts_SetVt:*/
on envVar E_pubc_VCU_VCU_161_VcuRdySts_SetVt
{
    if(getValue(E_pubc_VCU_VCU_161_VcuRdySts_SetVt))
    {
        //update the signal value
        Msg_VCU_161.VcuRdySts=getvalue(E_pubc_VCU_VCU_161_VcuRdySts_Vt);
    }
    else
    {
        Msg_VCU_161.VcuRdySts=getValue(E_pubc_VCU_VCU_161_VcuRdySts_Rv);
    }
}
/*@@end*/
 
/*@@envVar:E_pubc_VCU_VCU_161_VcuVehWhlReqTq_Rv:*/
on envVar E_pubc_VCU_VCU_161_VcuVehWhlReqTq_Rv
{
    int64 rawValue = 0ll;
    float rawValue_float = 0.0;
    float phyValue = 0.0;        

    //set the signal with updated raw value
    {
        rawValue = getvalue(this);
        if(chgEv_VCU_161_VcuVehWhlReqTq == 0)
        {
            //type conversion to float
            rawValue_float = rawValue;        
            // raw to physical conversion
            phyValue = ((rawValue_float *1)+(-32768));
            putValue(E_pubc_VCU_VCU_161_VcuVehWhlReqTq_Pv, phyValue);
            chgEv_VCU_161_VcuVehWhlReqTq = 1;
        }
        else
        {
            chgEv_VCU_161_VcuVehWhlReqTq = 0;
        }    
        //update the signal value
        Msg_VCU_161.VcuVehWhlReqTq=rawValue;        
    }                                                                           
}
/*@@end*/

/*@@envVar:E_pubc_VCU_VCU_161_VcuVehWhlReqTq_Pv:*/
on envVar E_pubc_VCU_VCU_161_VcuVehWhlReqTq_Pv
{
    int64 rawValue = 0ll;
    float phyValue = 0.0;
    
    //update the raw value with physical value 
    {
        if(chgEv_VCU_161_VcuVehWhlReqTq == 0)
        {
            phyValue = getvalue(this);
            // physical to raw conversion
            rawValue = ((phyValue -(-32768))/1);
            putValue(E_pubc_VCU_VCU_161_VcuVehWhlReqTq_Rv, rawValue);
            chgEv_VCU_161_VcuVehWhlReqTq = 1;  
        }
        else
        {
            chgEv_VCU_161_VcuVehWhlReqTq = 0;
        }
    }
}
/*@@end*/


 
/*@@envVar:E_pubc_VCU_VCU_161_VcuPtTqRealVld_Rv:*/
on envVar E_pubc_VCU_VCU_161_VcuPtTqRealVld_Rv
{
    int64 rawValue = 0ll;
    float rawValue_float = 0.0;
    float phyValue = 0.0;        

    //set the signal with updated raw value
    if(getValue(E_pubc_VCU_VCU_161_VcuPtTqRealVld_SetVt)==0)
    {
        rawValue = getvalue(this);
        if(chgEv_VCU_161_VcuPtTqRealVld == 0)
        {
            //type conversion to float
            rawValue_float = rawValue;        
            // raw to physical conversion
            phyValue = ((rawValue_float *1)+(0));
            putValue(E_pubc_VCU_VCU_161_VcuPtTqRealVld_Pv, phyValue);
            chgEv_VCU_161_VcuPtTqRealVld = 1;
        }
        else
        {
            chgEv_VCU_161_VcuPtTqRealVld = 0;
        }    
        //update the signal value
        Msg_VCU_161.VcuPtTqRealVld=rawValue;        
    }                                                                           
}
/*@@end*/

/*@@envVar:E_pubc_VCU_VCU_161_VcuPtTqRealVld_Pv:*/
on envVar E_pubc_VCU_VCU_161_VcuPtTqRealVld_Pv
{
    int64 rawValue = 0ll;
    float phyValue = 0.0;
    
    //update the raw value with physical value 
    if(getValue(E_pubc_VCU_VCU_161_VcuPtTqRealVld_SetVt)==0)
    {
        if(chgEv_VCU_161_VcuPtTqRealVld == 0)
        {
            phyValue = getvalue(this);
            // physical to raw conversion
            rawValue = ((phyValue -(0))/1);
            putValue(E_pubc_VCU_VCU_161_VcuPtTqRealVld_Rv, rawValue);
            chgEv_VCU_161_VcuPtTqRealVld = 1;  
        }
        else
        {
            chgEv_VCU_161_VcuPtTqRealVld = 0;
        }
    }
}
/*@@end*/

/*@@envVar:E_pubc_VCU_VCU_161_VcuPtTqRealVld_Vt:*/
on envVar E_pubc_VCU_VCU_161_VcuPtTqRealVld_Vt
{
    qword rawValue = 0ll;
    if(getValue(E_pubc_VCU_VCU_161_VcuPtTqRealVld_SetVt))
    {
        //update the signal value
        Msg_VCU_161.VcuPtTqRealVld=getValue(this);
    }
}
/*@@end*/

/*@@envVar:E_pubc_VCU_VCU_161_VcuPtTqRealVld_SetVt:*/
on envVar E_pubc_VCU_VCU_161_VcuPtTqRealVld_SetVt
{
    if(getValue(E_pubc_VCU_VCU_161_VcuPtTqRealVld_SetVt))
    {
        //update the signal value
        Msg_VCU_161.VcuPtTqRealVld=getvalue(E_pubc_VCU_VCU_161_VcuPtTqRealVld_Vt);
    }
    else
    {
        Msg_VCU_161.VcuPtTqRealVld=getValue(E_pubc_VCU_VCU_161_VcuPtTqRealVld_Rv);
    }
}
/*@@end*/
 
/*@@envVar:E_pubc_VCU_VCU_161_VCUShiftPostionValid_Rv:*/
on envVar E_pubc_VCU_VCU_161_VCUShiftPostionValid_Rv
{
    int64 rawValue = 0ll;
    float rawValue_float = 0.0;
    float phyValue = 0.0;        

    //set the signal with updated raw value
    if(getValue(E_pubc_VCU_VCU_161_VCUShiftPostionValid_SetVt)==0)
    {
        rawValue = getvalue(this);
        if(chgEv_VCU_161_VCUShiftPostionValid == 0)
        {
            //type conversion to float
            rawValue_float = rawValue;        
            // raw to physical conversion
            phyValue = ((rawValue_float *1)+(0));
            putValue(E_pubc_VCU_VCU_161_VCUShiftPostionValid_Pv, phyValue);
            chgEv_VCU_161_VCUShiftPostionValid = 1;
        }
        else
        {
            chgEv_VCU_161_VCUShiftPostionValid = 0;
        }    
        //update the signal value
        Msg_VCU_161.VCUShiftPostionValid=rawValue;        
    }                                                                           
}
/*@@end*/

/*@@envVar:E_pubc_VCU_VCU_161_VCUShiftPostionValid_Pv:*/
on envVar E_pubc_VCU_VCU_161_VCUShiftPostionValid_Pv
{
    int64 rawValue = 0ll;
    float phyValue = 0.0;
    
    //update the raw value with physical value 
    if(getValue(E_pubc_VCU_VCU_161_VCUShiftPostionValid_SetVt)==0)
    {
        if(chgEv_VCU_161_VCUShiftPostionValid == 0)
        {
            phyValue = getvalue(this);
            // physical to raw conversion
            rawValue = ((phyValue -(0))/1);
            putValue(E_pubc_VCU_VCU_161_VCUShiftPostionValid_Rv, rawValue);
            chgEv_VCU_161_VCUShiftPostionValid = 1;  
        }
        else
        {
            chgEv_VCU_161_VCUShiftPostionValid = 0;
        }
    }
}
/*@@end*/

/*@@envVar:E_pubc_VCU_VCU_161_VCUShiftPostionValid_Vt:*/
on envVar E_pubc_VCU_VCU_161_VCUShiftPostionValid_Vt
{
    qword rawValue = 0ll;
    if(getValue(E_pubc_VCU_VCU_161_VCUShiftPostionValid_SetVt))
    {
        //update the signal value
        Msg_VCU_161.VCUShiftPostionValid=getValue(this);
    }
}
/*@@end*/

/*@@envVar:E_pubc_VCU_VCU_161_VCUShiftPostionValid_SetVt:*/
on envVar E_pubc_VCU_VCU_161_VCUShiftPostionValid_SetVt
{
    if(getValue(E_pubc_VCU_VCU_161_VCUShiftPostionValid_SetVt))
    {
        //update the signal value
        Msg_VCU_161.VCUShiftPostionValid=getvalue(E_pubc_VCU_VCU_161_VCUShiftPostionValid_Vt);
    }
    else
    {
        Msg_VCU_161.VCUShiftPostionValid=getValue(E_pubc_VCU_VCU_161_VCUShiftPostionValid_Rv);
    }
}
/*@@end*/
 
/*@@envVar:E_pubc_VCU_VCU_161_VcuPtTqReal_Rv:*/
on envVar E_pubc_VCU_VCU_161_VcuPtTqReal_Rv
{
    int64 rawValue = 0ll;
    float rawValue_float = 0.0;
    float phyValue = 0.0;        

    //set the signal with updated raw value
    {
        rawValue = getvalue(this);
        if(chgEv_VCU_161_VcuPtTqReal == 0)
        {
            //type conversion to float
            rawValue_float = rawValue;        
            // raw to physical conversion
            phyValue = ((rawValue_float *1)+(-32768));
            putValue(E_pubc_VCU_VCU_161_VcuPtTqReal_Pv, phyValue);
            chgEv_VCU_161_VcuPtTqReal = 1;
        }
        else
        {
            chgEv_VCU_161_VcuPtTqReal = 0;
        }    
        //update the signal value
        Msg_VCU_161.VcuPtTqReal=rawValue;        
    }                                                                           
}
/*@@end*/

/*@@envVar:E_pubc_VCU_VCU_161_VcuPtTqReal_Pv:*/
on envVar E_pubc_VCU_VCU_161_VcuPtTqReal_Pv
{
    int64 rawValue = 0ll;
    float phyValue = 0.0;
    
    //update the raw value with physical value 
    {
        if(chgEv_VCU_161_VcuPtTqReal == 0)
        {
            phyValue = getvalue(this);
            // physical to raw conversion
            rawValue = ((phyValue -(-32768))/1);
            putValue(E_pubc_VCU_VCU_161_VcuPtTqReal_Rv, rawValue);
            chgEv_VCU_161_VcuPtTqReal = 1;  
        }
        else
        {
            chgEv_VCU_161_VcuPtTqReal = 0;
        }
    }
}
/*@@end*/


 
/*@@envVar:E_pubc_VCU_VCU_161_VcuPtTqLimMinVld_Rv:*/
on envVar E_pubc_VCU_VCU_161_VcuPtTqLimMinVld_Rv
{
    int64 rawValue = 0ll;
    float rawValue_float = 0.0;
    float phyValue = 0.0;        

    //set the signal with updated raw value
    if(getValue(E_pubc_VCU_VCU_161_VcuPtTqLimMinVld_SetVt)==0)
    {
        rawValue = getvalue(this);
        if(chgEv_VCU_161_VcuPtTqLimMinVld == 0)
        {
            //type conversion to float
            rawValue_float = rawValue;        
            // raw to physical conversion
            phyValue = ((rawValue_float *1)+(0));
            putValue(E_pubc_VCU_VCU_161_VcuPtTqLimMinVld_Pv, phyValue);
            chgEv_VCU_161_VcuPtTqLimMinVld = 1;
        }
        else
        {
            chgEv_VCU_161_VcuPtTqLimMinVld = 0;
        }    
        //update the signal value
        Msg_VCU_161.VcuPtTqLimMinVld=rawValue;        
    }                                                                           
}
/*@@end*/

/*@@envVar:E_pubc_VCU_VCU_161_VcuPtTqLimMinVld_Pv:*/
on envVar E_pubc_VCU_VCU_161_VcuPtTqLimMinVld_Pv
{
    int64 rawValue = 0ll;
    float phyValue = 0.0;
    
    //update the raw value with physical value 
    if(getValue(E_pubc_VCU_VCU_161_VcuPtTqLimMinVld_SetVt)==0)
    {
        if(chgEv_VCU_161_VcuPtTqLimMinVld == 0)
        {
            phyValue = getvalue(this);
            // physical to raw conversion
            rawValue = ((phyValue -(0))/1);
            putValue(E_pubc_VCU_VCU_161_VcuPtTqLimMinVld_Rv, rawValue);
            chgEv_VCU_161_VcuPtTqLimMinVld = 1;  
        }
        else
        {
            chgEv_VCU_161_VcuPtTqLimMinVld = 0;
        }
    }
}
/*@@end*/

/*@@envVar:E_pubc_VCU_VCU_161_VcuPtTqLimMinVld_Vt:*/
on envVar E_pubc_VCU_VCU_161_VcuPtTqLimMinVld_Vt
{
    qword rawValue = 0ll;
    if(getValue(E_pubc_VCU_VCU_161_VcuPtTqLimMinVld_SetVt))
    {
        //update the signal value
        Msg_VCU_161.VcuPtTqLimMinVld=getValue(this);
    }
}
/*@@end*/

/*@@envVar:E_pubc_VCU_VCU_161_VcuPtTqLimMinVld_SetVt:*/
on envVar E_pubc_VCU_VCU_161_VcuPtTqLimMinVld_SetVt
{
    if(getValue(E_pubc_VCU_VCU_161_VcuPtTqLimMinVld_SetVt))
    {
        //update the signal value
        Msg_VCU_161.VcuPtTqLimMinVld=getvalue(E_pubc_VCU_VCU_161_VcuPtTqLimMinVld_Vt);
    }
    else
    {
        Msg_VCU_161.VcuPtTqLimMinVld=getValue(E_pubc_VCU_VCU_161_VcuPtTqLimMinVld_Rv);
    }
}
/*@@end*/
 
/*@@envVar:E_pubc_VCU_VCU_161_VcuGearPosn_Rv:*/
on envVar E_pubc_VCU_VCU_161_VcuGearPosn_Rv
{
    int64 rawValue = 0ll;
    float rawValue_float = 0.0;
    float phyValue = 0.0;        

    //set the signal with updated raw value
    if(getValue(E_pubc_VCU_VCU_161_VcuGearPosn_SetVt)==0)
    {
        rawValue = getvalue(this);
        if(chgEv_VCU_161_VcuGearPosn == 0)
        {
            //type conversion to float
            rawValue_float = rawValue;        
            // raw to physical conversion
            phyValue = ((rawValue_float *1)+(0));
            putValue(E_pubc_VCU_VCU_161_VcuGearPosn_Pv, phyValue);
            chgEv_VCU_161_VcuGearPosn = 1;
        }
        else
        {
            chgEv_VCU_161_VcuGearPosn = 0;
        }    
        //update the signal value
        Msg_VCU_161.VcuGearPosn=rawValue;        
    }                                                                           
}
/*@@end*/

/*@@envVar:E_pubc_VCU_VCU_161_VcuGearPosn_Pv:*/
on envVar E_pubc_VCU_VCU_161_VcuGearPosn_Pv
{
    int64 rawValue = 0ll;
    float phyValue = 0.0;
    
    //update the raw value with physical value 
    if(getValue(E_pubc_VCU_VCU_161_VcuGearPosn_SetVt)==0)
    {
        if(chgEv_VCU_161_VcuGearPosn == 0)
        {
            phyValue = getvalue(this);
            // physical to raw conversion
            rawValue = ((phyValue -(0))/1);
            putValue(E_pubc_VCU_VCU_161_VcuGearPosn_Rv, rawValue);
            chgEv_VCU_161_VcuGearPosn = 1;  
        }
        else
        {
            chgEv_VCU_161_VcuGearPosn = 0;
        }
    }
}
/*@@end*/

/*@@envVar:E_pubc_VCU_VCU_161_VcuGearPosn_Vt:*/
on envVar E_pubc_VCU_VCU_161_VcuGearPosn_Vt
{
    qword rawValue = 0ll;
    if(getValue(E_pubc_VCU_VCU_161_VcuGearPosn_SetVt))
    {
        //update the signal value
        Msg_VCU_161.VcuGearPosn=getValue(this);
    }
}
/*@@end*/

/*@@envVar:E_pubc_VCU_VCU_161_VcuGearPosn_SetVt:*/
on envVar E_pubc_VCU_VCU_161_VcuGearPosn_SetVt
{
    if(getValue(E_pubc_VCU_VCU_161_VcuGearPosn_SetVt))
    {
        //update the signal value
        Msg_VCU_161.VcuGearPosn=getvalue(E_pubc_VCU_VCU_161_VcuGearPosn_Vt);
    }
    else
    {
        Msg_VCU_161.VcuGearPosn=getValue(E_pubc_VCU_VCU_161_VcuGearPosn_Rv);
    }
}
/*@@end*/
 
/*@@envVar:E_pubc_VCU_VCU_161_VcuVehWhlReqTqVld_Rv:*/
on envVar E_pubc_VCU_VCU_161_VcuVehWhlReqTqVld_Rv
{
    int64 rawValue = 0ll;
    float rawValue_float = 0.0;
    float phyValue = 0.0;        

    //set the signal with updated raw value
    if(getValue(E_pubc_VCU_VCU_161_VcuVehWhlReqTqVld_SetVt)==0)
    {
        rawValue = getvalue(this);
        if(chgEv_VCU_161_VcuVehWhlReqTqVld == 0)
        {
            //type conversion to float
            rawValue_float = rawValue;        
            // raw to physical conversion
            phyValue = ((rawValue_float *1)+(0));
            putValue(E_pubc_VCU_VCU_161_VcuVehWhlReqTqVld_Pv, phyValue);
            chgEv_VCU_161_VcuVehWhlReqTqVld = 1;
        }
        else
        {
            chgEv_VCU_161_VcuVehWhlReqTqVld = 0;
        }    
        //update the signal value
        Msg_VCU_161.VcuVehWhlReqTqVld=rawValue;        
    }                                                                           
}
/*@@end*/

/*@@envVar:E_pubc_VCU_VCU_161_VcuVehWhlReqTqVld_Pv:*/
on envVar E_pubc_VCU_VCU_161_VcuVehWhlReqTqVld_Pv
{
    int64 rawValue = 0ll;
    float phyValue = 0.0;
    
    //update the raw value with physical value 
    if(getValue(E_pubc_VCU_VCU_161_VcuVehWhlReqTqVld_SetVt)==0)
    {
        if(chgEv_VCU_161_VcuVehWhlReqTqVld == 0)
        {
            phyValue = getvalue(this);
            // physical to raw conversion
            rawValue = ((phyValue -(0))/1);
            putValue(E_pubc_VCU_VCU_161_VcuVehWhlReqTqVld_Rv, rawValue);
            chgEv_VCU_161_VcuVehWhlReqTqVld = 1;  
        }
        else
        {
            chgEv_VCU_161_VcuVehWhlReqTqVld = 0;
        }
    }
}
/*@@end*/

/*@@envVar:E_pubc_VCU_VCU_161_VcuVehWhlReqTqVld_Vt:*/
on envVar E_pubc_VCU_VCU_161_VcuVehWhlReqTqVld_Vt
{
    qword rawValue = 0ll;
    if(getValue(E_pubc_VCU_VCU_161_VcuVehWhlReqTqVld_SetVt))
    {
        //update the signal value
        Msg_VCU_161.VcuVehWhlReqTqVld=getValue(this);
    }
}
/*@@end*/

/*@@envVar:E_pubc_VCU_VCU_161_VcuVehWhlReqTqVld_SetVt:*/
on envVar E_pubc_VCU_VCU_161_VcuVehWhlReqTqVld_SetVt
{
    if(getValue(E_pubc_VCU_VCU_161_VcuVehWhlReqTqVld_SetVt))
    {
        //update the signal value
        Msg_VCU_161.VcuVehWhlReqTqVld=getvalue(E_pubc_VCU_VCU_161_VcuVehWhlReqTqVld_Vt);
    }
    else
    {
        Msg_VCU_161.VcuVehWhlReqTqVld=getValue(E_pubc_VCU_VCU_161_VcuVehWhlReqTqVld_Rv);
    }
}
/*@@end*/
 
/*@@envVar:E_pubc_VCU_VCU_161_VcuSimnEpbSwtStsVld_Rv:*/
on envVar E_pubc_VCU_VCU_161_VcuSimnEpbSwtStsVld_Rv
{
    int64 rawValue = 0ll;
    float rawValue_float = 0.0;
    float phyValue = 0.0;        

    //set the signal with updated raw value
    if(getValue(E_pubc_VCU_VCU_161_VcuSimnEpbSwtStsVld_SetVt)==0)
    {
        rawValue = getvalue(this);
        if(chgEv_VCU_161_VcuSimnEpbSwtStsVld == 0)
        {
            //type conversion to float
            rawValue_float = rawValue;        
            // raw to physical conversion
            phyValue = ((rawValue_float *1)+(0));
            putValue(E_pubc_VCU_VCU_161_VcuSimnEpbSwtStsVld_Pv, phyValue);
            chgEv_VCU_161_VcuSimnEpbSwtStsVld = 1;
        }
        else
        {
            chgEv_VCU_161_VcuSimnEpbSwtStsVld = 0;
        }    
        //update the signal value
        Msg_VCU_161.VcuSimnEpbSwtStsVld=rawValue;        
    }                                                                           
}
/*@@end*/

/*@@envVar:E_pubc_VCU_VCU_161_VcuSimnEpbSwtStsVld_Pv:*/
on envVar E_pubc_VCU_VCU_161_VcuSimnEpbSwtStsVld_Pv
{
    int64 rawValue = 0ll;
    float phyValue = 0.0;
    
    //update the raw value with physical value 
    if(getValue(E_pubc_VCU_VCU_161_VcuSimnEpbSwtStsVld_SetVt)==0)
    {
        if(chgEv_VCU_161_VcuSimnEpbSwtStsVld == 0)
        {
            phyValue = getvalue(this);
            // physical to raw conversion
            rawValue = ((phyValue -(0))/1);
            putValue(E_pubc_VCU_VCU_161_VcuSimnEpbSwtStsVld_Rv, rawValue);
            chgEv_VCU_161_VcuSimnEpbSwtStsVld = 1;  
        }
        else
        {
            chgEv_VCU_161_VcuSimnEpbSwtStsVld = 0;
        }
    }
}
/*@@end*/

/*@@envVar:E_pubc_VCU_VCU_161_VcuSimnEpbSwtStsVld_Vt:*/
on envVar E_pubc_VCU_VCU_161_VcuSimnEpbSwtStsVld_Vt
{
    qword rawValue = 0ll;
    if(getValue(E_pubc_VCU_VCU_161_VcuSimnEpbSwtStsVld_SetVt))
    {
        //update the signal value
        Msg_VCU_161.VcuSimnEpbSwtStsVld=getValue(this);
    }
}
/*@@end*/

/*@@envVar:E_pubc_VCU_VCU_161_VcuSimnEpbSwtStsVld_SetVt:*/
on envVar E_pubc_VCU_VCU_161_VcuSimnEpbSwtStsVld_SetVt
{
    if(getValue(E_pubc_VCU_VCU_161_VcuSimnEpbSwtStsVld_SetVt))
    {
        //update the signal value
        Msg_VCU_161.VcuSimnEpbSwtStsVld=getvalue(E_pubc_VCU_VCU_161_VcuSimnEpbSwtStsVld_Vt);
    }
    else
    {
        Msg_VCU_161.VcuSimnEpbSwtStsVld=getValue(E_pubc_VCU_VCU_161_VcuSimnEpbSwtStsVld_Rv);
    }
}
/*@@end*/
 
/*@@envVar:E_pubc_VCU_VCU_161_VcuAccrMod_Rv:*/
on envVar E_pubc_VCU_VCU_161_VcuAccrMod_Rv
{
    int64 rawValue = 0ll;
    float rawValue_float = 0.0;
    float phyValue = 0.0;        

    //set the signal with updated raw value
    if(getValue(E_pubc_VCU_VCU_161_VcuAccrMod_SetVt)==0)
    {
        rawValue = getvalue(this);
        if(chgEv_VCU_161_VcuAccrMod == 0)
        {
            //type conversion to float
            rawValue_float = rawValue;        
            // raw to physical conversion
            phyValue = ((rawValue_float *1)+(0));
            putValue(E_pubc_VCU_VCU_161_VcuAccrMod_Pv, phyValue);
            chgEv_VCU_161_VcuAccrMod = 1;
        }
        else
        {
            chgEv_VCU_161_VcuAccrMod = 0;
        }    
        //update the signal value
        Msg_VCU_161.VcuAccrMod=rawValue;        
    }                                                                           
}
/*@@end*/

/*@@envVar:E_pubc_VCU_VCU_161_VcuAccrMod_Pv:*/
on envVar E_pubc_VCU_VCU_161_VcuAccrMod_Pv
{
    int64 rawValue = 0ll;
    float phyValue = 0.0;
    
    //update the raw value with physical value 
    if(getValue(E_pubc_VCU_VCU_161_VcuAccrMod_SetVt)==0)
    {
        if(chgEv_VCU_161_VcuAccrMod == 0)
        {
            phyValue = getvalue(this);
            // physical to raw conversion
            rawValue = ((phyValue -(0))/1);
            putValue(E_pubc_VCU_VCU_161_VcuAccrMod_Rv, rawValue);
            chgEv_VCU_161_VcuAccrMod = 1;  
        }
        else
        {
            chgEv_VCU_161_VcuAccrMod = 0;
        }
    }
}
/*@@end*/

/*@@envVar:E_pubc_VCU_VCU_161_VcuAccrMod_Vt:*/
on envVar E_pubc_VCU_VCU_161_VcuAccrMod_Vt
{
    qword rawValue = 0ll;
    if(getValue(E_pubc_VCU_VCU_161_VcuAccrMod_SetVt))
    {
        //update the signal value
        Msg_VCU_161.VcuAccrMod=getValue(this);
    }
}
/*@@end*/

/*@@envVar:E_pubc_VCU_VCU_161_VcuAccrMod_SetVt:*/
on envVar E_pubc_VCU_VCU_161_VcuAccrMod_SetVt
{
    if(getValue(E_pubc_VCU_VCU_161_VcuAccrMod_SetVt))
    {
        //update the signal value
        Msg_VCU_161.VcuAccrMod=getvalue(E_pubc_VCU_VCU_161_VcuAccrMod_Vt);
    }
    else
    {
        Msg_VCU_161.VcuAccrMod=getValue(E_pubc_VCU_VCU_161_VcuAccrMod_Rv);
    }
}
/*@@end*/
 
/*@@envVar:E_pubc_VCU_VCU_161_VcuAccrPedlPosn_Rv:*/
on envVar E_pubc_VCU_VCU_161_VcuAccrPedlPosn_Rv
{
    int64 rawValue = 0ll;
    float rawValue_float = 0.0;
    float phyValue = 0.0;        

    //set the signal with updated raw value
    {
        rawValue = getvalue(this);
        if(chgEv_VCU_161_VcuAccrPedlPosn == 0)
        {
            //type conversion to float
            rawValue_float = rawValue;        
            // raw to physical conversion
            phyValue = ((rawValue_float *0.1)+(0));
            putValue(E_pubc_VCU_VCU_161_VcuAccrPedlPosn_Pv, phyValue);
            chgEv_VCU_161_VcuAccrPedlPosn = 1;
        }
        else
        {
            chgEv_VCU_161_VcuAccrPedlPosn = 0;
        }    
        //update the signal value
        Msg_VCU_161.VcuAccrPedlPosn=rawValue;        
    }                                                                           
}
/*@@end*/

/*@@envVar:E_pubc_VCU_VCU_161_VcuAccrPedlPosn_Pv:*/
on envVar E_pubc_VCU_VCU_161_VcuAccrPedlPosn_Pv
{
    int64 rawValue = 0ll;
    float phyValue = 0.0;
    
    //update the raw value with physical value 
    {
        if(chgEv_VCU_161_VcuAccrPedlPosn == 0)
        {
            phyValue = getvalue(this);
            // physical to raw conversion
            rawValue = ((phyValue -(0))/0.1);
            putValue(E_pubc_VCU_VCU_161_VcuAccrPedlPosn_Rv, rawValue);
            chgEv_VCU_161_VcuAccrPedlPosn = 1;  
        }
        else
        {
            chgEv_VCU_161_VcuAccrPedlPosn = 0;
        }
    }
}
/*@@end*/


 
/*@@envVar:E_pubc_VCU_VCU_161_VcuPtTqLimMaxVld_Rv:*/
on envVar E_pubc_VCU_VCU_161_VcuPtTqLimMaxVld_Rv
{
    int64 rawValue = 0ll;
    float rawValue_float = 0.0;
    float phyValue = 0.0;        

    //set the signal with updated raw value
    if(getValue(E_pubc_VCU_VCU_161_VcuPtTqLimMaxVld_SetVt)==0)
    {
        rawValue = getvalue(this);
        if(chgEv_VCU_161_VcuPtTqLimMaxVld == 0)
        {
            //type conversion to float
            rawValue_float = rawValue;        
            // raw to physical conversion
            phyValue = ((rawValue_float *1)+(0));
            putValue(E_pubc_VCU_VCU_161_VcuPtTqLimMaxVld_Pv, phyValue);
            chgEv_VCU_161_VcuPtTqLimMaxVld = 1;
        }
        else
        {
            chgEv_VCU_161_VcuPtTqLimMaxVld = 0;
        }    
        //update the signal value
        Msg_VCU_161.VcuPtTqLimMaxVld=rawValue;        
    }                                                                           
}
/*@@end*/

/*@@envVar:E_pubc_VCU_VCU_161_VcuPtTqLimMaxVld_Pv:*/
on envVar E_pubc_VCU_VCU_161_VcuPtTqLimMaxVld_Pv
{
    int64 rawValue = 0ll;
    float phyValue = 0.0;
    
    //update the raw value with physical value 
    if(getValue(E_pubc_VCU_VCU_161_VcuPtTqLimMaxVld_SetVt)==0)
    {
        if(chgEv_VCU_161_VcuPtTqLimMaxVld == 0)
        {
            phyValue = getvalue(this);
            // physical to raw conversion
            rawValue = ((phyValue -(0))/1);
            putValue(E_pubc_VCU_VCU_161_VcuPtTqLimMaxVld_Rv, rawValue);
            chgEv_VCU_161_VcuPtTqLimMaxVld = 1;  
        }
        else
        {
            chgEv_VCU_161_VcuPtTqLimMaxVld = 0;
        }
    }
}
/*@@end*/

/*@@envVar:E_pubc_VCU_VCU_161_VcuPtTqLimMaxVld_Vt:*/
on envVar E_pubc_VCU_VCU_161_VcuPtTqLimMaxVld_Vt
{
    qword rawValue = 0ll;
    if(getValue(E_pubc_VCU_VCU_161_VcuPtTqLimMaxVld_SetVt))
    {
        //update the signal value
        Msg_VCU_161.VcuPtTqLimMaxVld=getValue(this);
    }
}
/*@@end*/

/*@@envVar:E_pubc_VCU_VCU_161_VcuPtTqLimMaxVld_SetVt:*/
on envVar E_pubc_VCU_VCU_161_VcuPtTqLimMaxVld_SetVt
{
    if(getValue(E_pubc_VCU_VCU_161_VcuPtTqLimMaxVld_SetVt))
    {
        //update the signal value
        Msg_VCU_161.VcuPtTqLimMaxVld=getvalue(E_pubc_VCU_VCU_161_VcuPtTqLimMaxVld_Vt);
    }
    else
    {
        Msg_VCU_161.VcuPtTqLimMaxVld=getValue(E_pubc_VCU_VCU_161_VcuPtTqLimMaxVld_Rv);
    }
}
/*@@end*/
 
/*@@envVar:E_pubc_VCU_VCU_161_VcuCalcnAccrPedlPosnVld_Rv:*/
on envVar E_pubc_VCU_VCU_161_VcuCalcnAccrPedlPosnVld_Rv
{
    int64 rawValue = 0ll;
    float rawValue_float = 0.0;
    float phyValue = 0.0;        

    //set the signal with updated raw value
    if(getValue(E_pubc_VCU_VCU_161_VcuCalcnAccrPedlPosnVld_SetVt)==0)
    {
        rawValue = getvalue(this);
        if(chgEv_VCU_161_VcuCalcnAccrPedlPosnVld == 0)
        {
            //type conversion to float
            rawValue_float = rawValue;        
            // raw to physical conversion
            phyValue = ((rawValue_float *1)+(0));
            putValue(E_pubc_VCU_VCU_161_VcuCalcnAccrPedlPosnVld_Pv, phyValue);
            chgEv_VCU_161_VcuCalcnAccrPedlPosnVld = 1;
        }
        else
        {
            chgEv_VCU_161_VcuCalcnAccrPedlPosnVld = 0;
        }    
        //update the signal value
        Msg_VCU_161.VcuCalcnAccrPedlPosnVld=rawValue;        
    }                                                                           
}
/*@@end*/

/*@@envVar:E_pubc_VCU_VCU_161_VcuCalcnAccrPedlPosnVld_Pv:*/
on envVar E_pubc_VCU_VCU_161_VcuCalcnAccrPedlPosnVld_Pv
{
    int64 rawValue = 0ll;
    float phyValue = 0.0;
    
    //update the raw value with physical value 
    if(getValue(E_pubc_VCU_VCU_161_VcuCalcnAccrPedlPosnVld_SetVt)==0)
    {
        if(chgEv_VCU_161_VcuCalcnAccrPedlPosnVld == 0)
        {
            phyValue = getvalue(this);
            // physical to raw conversion
            rawValue = ((phyValue -(0))/1);
            putValue(E_pubc_VCU_VCU_161_VcuCalcnAccrPedlPosnVld_Rv, rawValue);
            chgEv_VCU_161_VcuCalcnAccrPedlPosnVld = 1;  
        }
        else
        {
            chgEv_VCU_161_VcuCalcnAccrPedlPosnVld = 0;
        }
    }
}
/*@@end*/

/*@@envVar:E_pubc_VCU_VCU_161_VcuCalcnAccrPedlPosnVld_Vt:*/
on envVar E_pubc_VCU_VCU_161_VcuCalcnAccrPedlPosnVld_Vt
{
    qword rawValue = 0ll;
    if(getValue(E_pubc_VCU_VCU_161_VcuCalcnAccrPedlPosnVld_SetVt))
    {
        //update the signal value
        Msg_VCU_161.VcuCalcnAccrPedlPosnVld=getValue(this);
    }
}
/*@@end*/

/*@@envVar:E_pubc_VCU_VCU_161_VcuCalcnAccrPedlPosnVld_SetVt:*/
on envVar E_pubc_VCU_VCU_161_VcuCalcnAccrPedlPosnVld_SetVt
{
    if(getValue(E_pubc_VCU_VCU_161_VcuCalcnAccrPedlPosnVld_SetVt))
    {
        //update the signal value
        Msg_VCU_161.VcuCalcnAccrPedlPosnVld=getvalue(E_pubc_VCU_VCU_161_VcuCalcnAccrPedlPosnVld_Vt);
    }
    else
    {
        Msg_VCU_161.VcuCalcnAccrPedlPosnVld=getValue(E_pubc_VCU_VCU_161_VcuCalcnAccrPedlPosnVld_Rv);
    }
}
/*@@end*/
 
/*@@envVar:E_pubc_VCU_VCU_161_VcuVehGearPosnVld_Rv:*/
on envVar E_pubc_VCU_VCU_161_VcuVehGearPosnVld_Rv
{
    int64 rawValue = 0ll;
    float rawValue_float = 0.0;
    float phyValue = 0.0;        

    //set the signal with updated raw value
    if(getValue(E_pubc_VCU_VCU_161_VcuVehGearPosnVld_SetVt)==0)
    {
        rawValue = getvalue(this);
        if(chgEv_VCU_161_VcuVehGearPosnVld == 0)
        {
            //type conversion to float
            rawValue_float = rawValue;        
            // raw to physical conversion
            phyValue = ((rawValue_float *1)+(0));
            putValue(E_pubc_VCU_VCU_161_VcuVehGearPosnVld_Pv, phyValue);
            chgEv_VCU_161_VcuVehGearPosnVld = 1;
        }
        else
        {
            chgEv_VCU_161_VcuVehGearPosnVld = 0;
        }    
        //update the signal value
        Msg_VCU_161.VcuVehGearPosnVld=rawValue;        
    }                                                                           
}
/*@@end*/

/*@@envVar:E_pubc_VCU_VCU_161_VcuVehGearPosnVld_Pv:*/
on envVar E_pubc_VCU_VCU_161_VcuVehGearPosnVld_Pv
{
    int64 rawValue = 0ll;
    float phyValue = 0.0;
    
    //update the raw value with physical value 
    if(getValue(E_pubc_VCU_VCU_161_VcuVehGearPosnVld_SetVt)==0)
    {
        if(chgEv_VCU_161_VcuVehGearPosnVld == 0)
        {
            phyValue = getvalue(this);
            // physical to raw conversion
            rawValue = ((phyValue -(0))/1);
            putValue(E_pubc_VCU_VCU_161_VcuVehGearPosnVld_Rv, rawValue);
            chgEv_VCU_161_VcuVehGearPosnVld = 1;  
        }
        else
        {
            chgEv_VCU_161_VcuVehGearPosnVld = 0;
        }
    }
}
/*@@end*/

/*@@envVar:E_pubc_VCU_VCU_161_VcuVehGearPosnVld_Vt:*/
on envVar E_pubc_VCU_VCU_161_VcuVehGearPosnVld_Vt
{
    qword rawValue = 0ll;
    if(getValue(E_pubc_VCU_VCU_161_VcuVehGearPosnVld_SetVt))
    {
        //update the signal value
        Msg_VCU_161.VcuVehGearPosnVld=getValue(this);
    }
}
/*@@end*/

/*@@envVar:E_pubc_VCU_VCU_161_VcuVehGearPosnVld_SetVt:*/
on envVar E_pubc_VCU_VCU_161_VcuVehGearPosnVld_SetVt
{
    if(getValue(E_pubc_VCU_VCU_161_VcuVehGearPosnVld_SetVt))
    {
        //update the signal value
        Msg_VCU_161.VcuVehGearPosnVld=getvalue(E_pubc_VCU_VCU_161_VcuVehGearPosnVld_Vt);
    }
    else
    {
        Msg_VCU_161.VcuVehGearPosnVld=getValue(E_pubc_VCU_VCU_161_VcuVehGearPosnVld_Rv);
    }
}
/*@@end*/
 
/*@@envVar:E_pubc_VCU_VCU_161_VcuShiftLvlPosn_Rv:*/
on envVar E_pubc_VCU_VCU_161_VcuShiftLvlPosn_Rv
{
    int64 rawValue = 0ll;
    float rawValue_float = 0.0;
    float phyValue = 0.0;        

    //set the signal with updated raw value
    if(getValue(E_pubc_VCU_VCU_161_VcuShiftLvlPosn_SetVt)==0)
    {
        rawValue = getvalue(this);
        if(chgEv_VCU_161_VcuShiftLvlPosn == 0)
        {
            //type conversion to float
            rawValue_float = rawValue;        
            // raw to physical conversion
            phyValue = ((rawValue_float *1)+(0));
            putValue(E_pubc_VCU_VCU_161_VcuShiftLvlPosn_Pv, phyValue);
            chgEv_VCU_161_VcuShiftLvlPosn = 1;
        }
        else
        {
            chgEv_VCU_161_VcuShiftLvlPosn = 0;
        }    
        //update the signal value
        Msg_VCU_161.VcuShiftLvlPosn=rawValue;        
    }                                                                           
}
/*@@end*/

/*@@envVar:E_pubc_VCU_VCU_161_VcuShiftLvlPosn_Pv:*/
on envVar E_pubc_VCU_VCU_161_VcuShiftLvlPosn_Pv
{
    int64 rawValue = 0ll;
    float phyValue = 0.0;
    
    //update the raw value with physical value 
    if(getValue(E_pubc_VCU_VCU_161_VcuShiftLvlPosn_SetVt)==0)
    {
        if(chgEv_VCU_161_VcuShiftLvlPosn == 0)
        {
            phyValue = getvalue(this);
            // physical to raw conversion
            rawValue = ((phyValue -(0))/1);
            putValue(E_pubc_VCU_VCU_161_VcuShiftLvlPosn_Rv, rawValue);
            chgEv_VCU_161_VcuShiftLvlPosn = 1;  
        }
        else
        {
            chgEv_VCU_161_VcuShiftLvlPosn = 0;
        }
    }
}
/*@@end*/

/*@@envVar:E_pubc_VCU_VCU_161_VcuShiftLvlPosn_Vt:*/
on envVar E_pubc_VCU_VCU_161_VcuShiftLvlPosn_Vt
{
    qword rawValue = 0ll;
    if(getValue(E_pubc_VCU_VCU_161_VcuShiftLvlPosn_SetVt))
    {
        //update the signal value
        Msg_VCU_161.VcuShiftLvlPosn=getValue(this);
    }
}
/*@@end*/

/*@@envVar:E_pubc_VCU_VCU_161_VcuShiftLvlPosn_SetVt:*/
on envVar E_pubc_VCU_VCU_161_VcuShiftLvlPosn_SetVt
{
    if(getValue(E_pubc_VCU_VCU_161_VcuShiftLvlPosn_SetVt))
    {
        //update the signal value
        Msg_VCU_161.VcuShiftLvlPosn=getvalue(E_pubc_VCU_VCU_161_VcuShiftLvlPosn_Vt);
    }
    else
    {
        Msg_VCU_161.VcuShiftLvlPosn=getValue(E_pubc_VCU_VCU_161_VcuShiftLvlPosn_Rv);
    }
}
/*@@end*/
 
/*@@envVar:E_pubc_VCU_VCU_161_VcuSimnEpbSwtSts_Rv:*/
on envVar E_pubc_VCU_VCU_161_VcuSimnEpbSwtSts_Rv
{
    int64 rawValue = 0ll;
    float rawValue_float = 0.0;
    float phyValue = 0.0;        

    //set the signal with updated raw value
    if(getValue(E_pubc_VCU_VCU_161_VcuSimnEpbSwtSts_SetVt)==0)
    {
        rawValue = getvalue(this);
        if(chgEv_VCU_161_VcuSimnEpbSwtSts == 0)
        {
            //type conversion to float
            rawValue_float = rawValue;        
            // raw to physical conversion
            phyValue = ((rawValue_float *1)+(0));
            putValue(E_pubc_VCU_VCU_161_VcuSimnEpbSwtSts_Pv, phyValue);
            chgEv_VCU_161_VcuSimnEpbSwtSts = 1;
        }
        else
        {
            chgEv_VCU_161_VcuSimnEpbSwtSts = 0;
        }    
        //update the signal value
        Msg_VCU_161.VcuSimnEpbSwtSts=rawValue;        
    }                                                                           
}
/*@@end*/

/*@@envVar:E_pubc_VCU_VCU_161_VcuSimnEpbSwtSts_Pv:*/
on envVar E_pubc_VCU_VCU_161_VcuSimnEpbSwtSts_Pv
{
    int64 rawValue = 0ll;
    float phyValue = 0.0;
    
    //update the raw value with physical value 
    if(getValue(E_pubc_VCU_VCU_161_VcuSimnEpbSwtSts_SetVt)==0)
    {
        if(chgEv_VCU_161_VcuSimnEpbSwtSts == 0)
        {
            phyValue = getvalue(this);
            // physical to raw conversion
            rawValue = ((phyValue -(0))/1);
            putValue(E_pubc_VCU_VCU_161_VcuSimnEpbSwtSts_Rv, rawValue);
            chgEv_VCU_161_VcuSimnEpbSwtSts = 1;  
        }
        else
        {
            chgEv_VCU_161_VcuSimnEpbSwtSts = 0;
        }
    }
}
/*@@end*/

/*@@envVar:E_pubc_VCU_VCU_161_VcuSimnEpbSwtSts_Vt:*/
on envVar E_pubc_VCU_VCU_161_VcuSimnEpbSwtSts_Vt
{
    qword rawValue = 0ll;
    if(getValue(E_pubc_VCU_VCU_161_VcuSimnEpbSwtSts_SetVt))
    {
        //update the signal value
        Msg_VCU_161.VcuSimnEpbSwtSts=getValue(this);
    }
}
/*@@end*/

/*@@envVar:E_pubc_VCU_VCU_161_VcuSimnEpbSwtSts_SetVt:*/
on envVar E_pubc_VCU_VCU_161_VcuSimnEpbSwtSts_SetVt
{
    if(getValue(E_pubc_VCU_VCU_161_VcuSimnEpbSwtSts_SetVt))
    {
        //update the signal value
        Msg_VCU_161.VcuSimnEpbSwtSts=getvalue(E_pubc_VCU_VCU_161_VcuSimnEpbSwtSts_Vt);
    }
    else
    {
        Msg_VCU_161.VcuSimnEpbSwtSts=getValue(E_pubc_VCU_VCU_161_VcuSimnEpbSwtSts_Rv);
    }
}
/*@@end*/
 
/*@@envVar:E_pubc_VCU_VCU_161_VcuPtTqLimMin_Rv:*/
on envVar E_pubc_VCU_VCU_161_VcuPtTqLimMin_Rv
{
    int64 rawValue = 0ll;
    float rawValue_float = 0.0;
    float phyValue = 0.0;        

    //set the signal with updated raw value
    {
        rawValue = getvalue(this);
        if(chgEv_VCU_161_VcuPtTqLimMin == 0)
        {
            //type conversion to float
            rawValue_float = rawValue;        
            // raw to physical conversion
            phyValue = ((rawValue_float *1)+(-32768));
            putValue(E_pubc_VCU_VCU_161_VcuPtTqLimMin_Pv, phyValue);
            chgEv_VCU_161_VcuPtTqLimMin = 1;
        }
        else
        {
            chgEv_VCU_161_VcuPtTqLimMin = 0;
        }    
        //update the signal value
        Msg_VCU_161.VcuPtTqLimMin=rawValue;        
    }                                                                           
}
/*@@end*/

/*@@envVar:E_pubc_VCU_VCU_161_VcuPtTqLimMin_Pv:*/
on envVar E_pubc_VCU_VCU_161_VcuPtTqLimMin_Pv
{
    int64 rawValue = 0ll;
    float phyValue = 0.0;
    
    //update the raw value with physical value 
    {
        if(chgEv_VCU_161_VcuPtTqLimMin == 0)
        {
            phyValue = getvalue(this);
            // physical to raw conversion
            rawValue = ((phyValue -(-32768))/1);
            putValue(E_pubc_VCU_VCU_161_VcuPtTqLimMin_Rv, rawValue);
            chgEv_VCU_161_VcuPtTqLimMin = 1;  
        }
        else
        {
            chgEv_VCU_161_VcuPtTqLimMin = 0;
        }
    }
}
/*@@end*/


 
/*@@envVar:E_pubc_VCU_VCU_161_VcuComFltSts_Rv:*/
on envVar E_pubc_VCU_VCU_161_VcuComFltSts_Rv
{
    int64 rawValue = 0ll;
    float rawValue_float = 0.0;
    float phyValue = 0.0;        

    //set the signal with updated raw value
    if(getValue(E_pubc_VCU_VCU_161_VcuComFltSts_SetVt)==0)
    {
        rawValue = getvalue(this);
        if(chgEv_VCU_161_VcuComFltSts == 0)
        {
            //type conversion to float
            rawValue_float = rawValue;        
            // raw to physical conversion
            phyValue = ((rawValue_float *1)+(0));
            putValue(E_pubc_VCU_VCU_161_VcuComFltSts_Pv, phyValue);
            chgEv_VCU_161_VcuComFltSts = 1;
        }
        else
        {
            chgEv_VCU_161_VcuComFltSts = 0;
        }    
        //update the signal value
        Msg_VCU_161.VcuComFltSts=rawValue;        
    }                                                                           
}
/*@@end*/

/*@@envVar:E_pubc_VCU_VCU_161_VcuComFltSts_Pv:*/
on envVar E_pubc_VCU_VCU_161_VcuComFltSts_Pv
{
    int64 rawValue = 0ll;
    float phyValue = 0.0;
    
    //update the raw value with physical value 
    if(getValue(E_pubc_VCU_VCU_161_VcuComFltSts_SetVt)==0)
    {
        if(chgEv_VCU_161_VcuComFltSts == 0)
        {
            phyValue = getvalue(this);
            // physical to raw conversion
            rawValue = ((phyValue -(0))/1);
            putValue(E_pubc_VCU_VCU_161_VcuComFltSts_Rv, rawValue);
            chgEv_VCU_161_VcuComFltSts = 1;  
        }
        else
        {
            chgEv_VCU_161_VcuComFltSts = 0;
        }
    }
}
/*@@end*/

/*@@envVar:E_pubc_VCU_VCU_161_VcuComFltSts_Vt:*/
on envVar E_pubc_VCU_VCU_161_VcuComFltSts_Vt
{
    qword rawValue = 0ll;
    if(getValue(E_pubc_VCU_VCU_161_VcuComFltSts_SetVt))
    {
        //update the signal value
        Msg_VCU_161.VcuComFltSts=getValue(this);
    }
}
/*@@end*/

/*@@envVar:E_pubc_VCU_VCU_161_VcuComFltSts_SetVt:*/
on envVar E_pubc_VCU_VCU_161_VcuComFltSts_SetVt
{
    if(getValue(E_pubc_VCU_VCU_161_VcuComFltSts_SetVt))
    {
        //update the signal value
        Msg_VCU_161.VcuComFltSts=getvalue(E_pubc_VCU_VCU_161_VcuComFltSts_Vt);
    }
    else
    {
        Msg_VCU_161.VcuComFltSts=getValue(E_pubc_VCU_VCU_161_VcuComFltSts_Rv);
    }
}
/*@@end*/
 
/*@@envVar:E_pubc_VCU_VCU_161_VcuEnyRecyclMod_Rv:*/
on envVar E_pubc_VCU_VCU_161_VcuEnyRecyclMod_Rv
{
    int64 rawValue = 0ll;
    float rawValue_float = 0.0;
    float phyValue = 0.0;        

    //set the signal with updated raw value
    if(getValue(E_pubc_VCU_VCU_161_VcuEnyRecyclMod_SetVt)==0)
    {
        rawValue = getvalue(this);
        if(chgEv_VCU_161_VcuEnyRecyclMod == 0)
        {
            //type conversion to float
            rawValue_float = rawValue;        
            // raw to physical conversion
            phyValue = ((rawValue_float *1)+(0));
            putValue(E_pubc_VCU_VCU_161_VcuEnyRecyclMod_Pv, phyValue);
            chgEv_VCU_161_VcuEnyRecyclMod = 1;
        }
        else
        {
            chgEv_VCU_161_VcuEnyRecyclMod = 0;
        }    
        //update the signal value
        Msg_VCU_161.VcuEnyRecyclMod=rawValue;        
    }                                                                           
}
/*@@end*/

/*@@envVar:E_pubc_VCU_VCU_161_VcuEnyRecyclMod_Pv:*/
on envVar E_pubc_VCU_VCU_161_VcuEnyRecyclMod_Pv
{
    int64 rawValue = 0ll;
    float phyValue = 0.0;
    
    //update the raw value with physical value 
    if(getValue(E_pubc_VCU_VCU_161_VcuEnyRecyclMod_SetVt)==0)
    {
        if(chgEv_VCU_161_VcuEnyRecyclMod == 0)
        {
            phyValue = getvalue(this);
            // physical to raw conversion
            rawValue = ((phyValue -(0))/1);
            putValue(E_pubc_VCU_VCU_161_VcuEnyRecyclMod_Rv, rawValue);
            chgEv_VCU_161_VcuEnyRecyclMod = 1;  
        }
        else
        {
            chgEv_VCU_161_VcuEnyRecyclMod = 0;
        }
    }
}
/*@@end*/

/*@@envVar:E_pubc_VCU_VCU_161_VcuEnyRecyclMod_Vt:*/
on envVar E_pubc_VCU_VCU_161_VcuEnyRecyclMod_Vt
{
    qword rawValue = 0ll;
    if(getValue(E_pubc_VCU_VCU_161_VcuEnyRecyclMod_SetVt))
    {
        //update the signal value
        Msg_VCU_161.VcuEnyRecyclMod=getValue(this);
    }
}
/*@@end*/

/*@@envVar:E_pubc_VCU_VCU_161_VcuEnyRecyclMod_SetVt:*/
on envVar E_pubc_VCU_VCU_161_VcuEnyRecyclMod_SetVt
{
    if(getValue(E_pubc_VCU_VCU_161_VcuEnyRecyclMod_SetVt))
    {
        //update the signal value
        Msg_VCU_161.VcuEnyRecyclMod=getvalue(E_pubc_VCU_VCU_161_VcuEnyRecyclMod_Vt);
    }
    else
    {
        Msg_VCU_161.VcuEnyRecyclMod=getValue(E_pubc_VCU_VCU_161_VcuEnyRecyclMod_Rv);
    }
}
/*@@end*/
 

/*@@caplFunc:update_VCU_38A_VcuRollingCounter_38A_counter():*///function
update_VCU_38A_VcuRollingCounter_38A_counter()
{
    //update the signal value
    Msg_VCU_38A.VcuRollingCounter_38A=VCU_38A_VcuRollingCounter_38A_counter;
    
    if(VCU_38A_VcuRollingCounter_38A_counter == 15)
    {
        VCU_38A_VcuRollingCounter_38A_counter =0;
    }
    else
    {
        VCU_38A_VcuRollingCounter_38A_counter =VCU_38A_VcuRollingCounter_38A_counter+1;
    }    
    
}
/*@@end*/
/*@@caplFunc:update_VCU_161_VcuCycCntr161_counter():*///function
update_VCU_161_VcuCycCntr161_counter()
{
    //update the signal value
    Msg_VCU_161.VcuCycCntr161=VCU_161_VcuCycCntr161_counter;
    
    if(VCU_161_VcuCycCntr161_counter == 15)
    {
        VCU_161_VcuCycCntr161_counter =0;
    }
    else
    {
        VCU_161_VcuCycCntr161_counter =VCU_161_VcuCycCntr161_counter+1;
    }    
    
}
/*@@end*/


/*@@caplFunc:update_VCU_38A_CRC_CheckSum():*///function
update_VCU_38A_CRC_CheckSum()
{
  int l_Crc_Len=0,l_count=0;
  int l_data[8];
 
  l_Crc_Len = 8-1;
  for (l_count=0;l_count<l_Crc_Len;l_count++)
    {
      l_data[l_count] = Msg_VCU_38A.BYTE(l_count);    
    }
       
	Msg_VCU_38A.BYTE(l_Crc_Len) = calc_SAE_J1850(l_data,l_Crc_Len); 

	
	if(VCU_38A_VcuCRCCheck_38A_wrongvalctr != 0)
    {
		Msg_VCU_38A.VcuCRCCheck_38A+=1; 
        //update signal with wrong CRC value
		if(VCU_38A_VcuCRCCheck_38A_wrongvalctr > 0)
        {
             VCU_38A_VcuCRCCheck_38A_wrongvalctr--;
              // if counter becomes zero, update panel controller to zero
             if(VCU_38A_VcuCRCCheck_38A_wrongvalctr == 0)
             {
                 putValue(E_pubc_VCU_VCU_38A_VcuCRCCheck_38A_wrongvalctr,0);
             }
        }
	}
}
update_VCU_161_CRC_CheckSum()
{
  int l_Crc_Len=0,l_count=0;
  int l_data[64];
 
  l_Crc_Len = 64-2;
  for (l_count=0;l_count<l_Crc_Len;l_count++)
    {
      l_data[l_count] = Msg_VCU_161.BYTE(l_count); 
	  
    }
        
	Msg_VCU_161.VcuCrcChk161 = calc_CRC16_CCITT_FALSE_H1021(l_data,62); 
	
	if(VCU_161_VcuCrcChk161_wrongvalctr != 0)
    {
		Msg_VCU_161.VcuCrcChk161+=1; 
        //update signal with wrong CRC value
		if(VCU_161_VcuCrcChk161_wrongvalctr > 0)
        {
             VCU_161_VcuCrcChk161_wrongvalctr--;
              // if counter becomes zero, update panel controller to zero
             if(VCU_161_VcuCrcChk161_wrongvalctr == 0)
             {
                 putValue(E_pubc_VCU_VCU_161_VcuCrcChk161_wrongvalctr,0);
             }
        }
	}
}



int calc_SAE_J1850(int data[], int Crc_len)
	{
		int idx,crc,temp,temp1;
		crc = 0xFF;
        idx = 0;
        temp = 0;
        temp1 = 0;
	
        for(idx=0;idx < Crc_len;idx++)
        {
			temp1 = data[idx];
			temp = (crc^temp1);
			crc = CRC_J1850_Table[temp];
        }
		crc ^= 0xFF;
		return crc;
	}


/*	int calc_SAE_J1851(int data[], int Crc_len)
	{
		int crc;
		
        crc = (data[0]+data[1]+data[2]+data[3]+data[4]+data[5]+data[6]) ;
          
		crc ^= 255;
		return crc;
	}*/

	

/* 	int calc_SAE_J1850(int data[], int Crc_len)
	{
		int idx,crc,temp,temp1,temp2,idy;
		crc = 0xFF;
        idx = 0;
        idy = 0;
        temp = 0;
        temp1 = 0;
        temp2 = 0;
	
        for(idx=0;idx < Crc_len;idx++)
        {
         temp1 = data[idx];
         crc = (crc^temp1);
          for (idy=8; idy>0; idy--)
          {
              // Save the value before the top bit is shifted out.
              temp2 = crc;
              crc <<= 1;
              if (0 != (temp2 & 128))
              {
                  crc ^= 0x2f;
              }
          } 
          
         //crc = CRC_J1850_Table[temp];
        }
		crc ^= 0xFF;
		return crc;
	} */

int Calc_Canfd_dlc(byte Dbc_dlc1)
	{
		if(Dbc_dlc > 8)
		    {
			 while (i<=7)
			  {
				if (CANFD_DLC[i]==Dbc_dlc)
				{
				return CAN_DLC[i];
				 break;
				}
				i++ ;
			}
		}
    else
	
	return Dbc_dlc1 ;
	
		
	}
	
	//CRC16
int calc_CRC16_CCITT_FALSE_H1021(int data[], int Crc_len)
{
	int idx, crc;

	crc = 0xFFFF;
	
    for (idx=0; idx<Crc_len; idx++)
    {
        /* Impact of temporary rest on next crc rest */
        /* MISRA RULE 12.8 VIOLATION: Shift is performed in the context of a data stream */
        crc ^= data[idx] << 8;

        /* Next temporary crc rest */
        /* MISRA RULE 12.8 VIOLATION: Shift is performed in the context of a data stream */
        crc = (crc << (8)) ^ CRC16_CCITT_FALSE_H1021_Table[(crc >> (8)) & (0xFF)];
    }
	return crc;
}
	
	//For Messages with DLC = 8, CAN FD data length =8
	//For Messages with DLC = 9, CAN FD data length =12
	//For Messages with DLC = 10, CAN FD data length =16
	//For Messages with DLC = 11, CAN FD data length =20
	//For Messages with DLC = 12, CAN FD data length =24
	//For Messages with DLC = 13, CAN FD data length =32
	//For Messages with DLC = 14, CAN FD data length =48
	//For Messages with DLC = 15, CAN FD data length =64
	

