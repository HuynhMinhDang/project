/*@!Encoding:1252*/

variables
{
   msTimer error_free;
}
on start
{
    //Enable error free signal swirch 
    putValue(Env_error_free_switch,1);
}

on envVar Env_error_free_switch
{
  SetTimer( error_free,500);
  
 }
 On timer error_free
    {
       if (getValue(Env_error_free_switch)==1)
  {
   //Add error free signals
  //  putValue (E_pubc_GW_GW_3BB_HU_SpeedLimitDistance_Rv,0);
	putValue (E_pubc_GW_GW_180_SAS_SteeringAngle_Pv,0);
	putValue (E_pubc_EPBi_EPBi_15D_ESP_LatAccel_Pv,0);
	putValue (E_pubc_EPBi_EPBi_15D_ESP_YawRate_Pv,0);
	putValue (E_pubc_EPBi_EPBi_15D_ESP_YawRateValid_Pv,0);
	putValue (E_pubc_EPBi_EPBi_15D_ESP_LongAccel_Pv,0);
	putValue (E_pubc_IBCU_IBCU_17A_ESP_VehicleSpeedValid_Pv,0);
	putValue (E_pubc_GW_GW_1A8_TCU_ShiftInProgressVld_Pv,1);
  }
  
 
  }





