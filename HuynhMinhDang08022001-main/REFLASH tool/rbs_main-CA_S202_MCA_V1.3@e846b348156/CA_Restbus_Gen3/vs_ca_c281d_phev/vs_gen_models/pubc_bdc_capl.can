
/*@@var:*/
variables
{
    //Used interact between raw and the physical environment variables
    byte chgEv_BDC_387_BCM_FrontWiperStatus = 0;
    byte chgEv_BDC_387_BCM_RainfallLevel = 0;
    byte chgEv_BDC_390_BCM_SOH_LifePercent = 0;
    byte chgEv_BDC_390_BCM_PMSLevel = 0;
    byte chgEv_BDC_3FF_BCM_FrontFoglampStatus = 0;
    byte chgEv_BDC_3FF_BCM_RearFoglampStatus = 0;
    byte chgEv_BDC_3FF_BCM_AutoHeadlightSts = 0;
    byte chgEv_BDC_3E7_BCM_Status_Temp = 0;
    byte chgEv_BDC_3E7_BCM_T_BATT = 0;
    byte chgEv_BDC_3E8_BCM_SOF_Q_STATE = 0;
    byte chgEv_BDC_3E8_BCM_SOF_Q = 0;
    byte chgEv_BDC_28B_LCM_LASSwitch = 0;
    byte chgEv_BDC_28B_BCM_DriverDoorStatus = 0;
    byte chgEv_BDC_28B_BCM_emergencylightstatus = 0;
    byte chgEv_BDC_28B_BCM_LowBeamStatus = 0;
    byte chgEv_BDC_28B_BCM_TurnIndicatorLeft = 0;
    byte chgEv_BDC_28B_BCM_TurnLightSwitchSts = 0;
    byte chgEv_BDC_28B_BCM_HighBeamStatus = 0;
    byte chgEv_BDC_28B_BCM_TurnIndicatorRight = 0;
    byte chgEv_BDC_28B_BCM_HoodStatus = 0;
    
    message BDC_387        Msg_BDC_387;
    msTimer Tm_BDC_387;
    int Cycle_BDC_387 = 100;
    message BDC_390        Msg_BDC_390;
    msTimer Tm_BDC_390;
    int Cycle_BDC_390 = 500;
    message BDC_3FF        Msg_BDC_3FF;
    msTimer Tm_BDC_3FF;
    int Cycle_BDC_3FF = 100;
    message BDC_3E7        Msg_BDC_3E7;
    msTimer Tm_BDC_3E7;
    int Cycle_BDC_3E7 = 100;
    message BDC_3E8        Msg_BDC_3E8;
    msTimer Tm_BDC_3E8;
    int Cycle_BDC_3E8 = 100;
    message BDC_28B        Msg_BDC_28B;
    msTimer Tm_BDC_28B;
    int Cycle_BDC_28B = 40;
    
    
    //CRC Polynomial for MQB     
    byte cb_ChkSum_POLY_MQB =0x2F;
	// CANFD DLC
	byte Dbc_dlc;
	int i=0;
	char CAN_DLC[7]={9,10,11,12,13,14,15};
	char CANFD_DLC[7]={12,16,20,24,32,48,64};
    

    
        byte CRC_J1850_Table[256] = {
 /*0 - 7*/  0x00, 0x1D, 0x3A, 0x27, 0x74, 0x69, 0x4E, 0x53,
 /*8 - 15*/ 0xE8, 0xF5, 0xD2, 0xCF, 0x9C, 0x81, 0xA6, 0xBB,
 /*16 - 23*/ 0xCD, 0xD0, 0xF7, 0xEA, 0xB9, 0xA4, 0x83, 0x9E,
 /*24 - 31*/ 0x25, 0x38, 0x1F, 0x02, 0x51, 0x4C, 0x6B, 0x76,
 /*32 - 39*/ 0x87, 0x9A, 0xBD, 0xA0, 0xF3, 0xEE, 0xC9, 0xD4,
 /*40 - 47*/ 0x6F, 0x72, 0x55, 0x48, 0x1B, 0x06, 0x21, 0x3C,
 /*48 - 55*/ 0x4A, 0x57, 0x70, 0x6D, 0x3E, 0x23, 0x04, 0x19,
 /*56 - 63*/ 0xA2, 0xBF, 0x98, 0x85, 0xD6, 0xCB, 0xEC, 0xF1,
 /*64 - 71*/  0x13, 0x0E, 0x29, 0x34, 0x67, 0x7A, 0x5D, 0x40,
 /*72 - 79*/ 0xFB, 0xE6, 0xC1, 0xDC, 0x8F, 0x92, 0xB5, 0xA8,
 /*80 - 87*/ 0xDE, 0xC3, 0xE4, 0xF9, 0xAA, 0xB7, 0x90, 0x8D,
 /*88 - 95*/ 0x36, 0x2B, 0x0C, 0x11, 0x42, 0x5F, 0x78, 0x65,
 /*96 - 103*/ 0x94, 0x89, 0xAE, 0xB3, 0xE0, 0xFD, 0xDA, 0xC7,
 /*104 - 111*/ 0x7C, 0x61, 0x46, 0x5B, 0x08, 0x15, 0x32, 0x2F,
 /*112 - 119*/ 0x59, 0x44, 0x63, 0x7E, 0x2D, 0x30, 0x17, 0x0A,
 /*120 - 127*/ 0xB1, 0xAC, 0x8B, 0x96, 0xC5, 0xD8, 0xFF, 0xE2,
 /*128 - 135*/ 0x26, 0x3B, 0x1C, 0x01, 0x52, 0x4F, 0x68, 0x75,
 /*136 - 143*/ 0xCE, 0xD3, 0xF4, 0xE9, 0xBA, 0xA7, 0x80, 0x9D,
 /*144 - 151*/ 0xEB, 0xF6, 0xD1, 0xCC, 0x9F, 0x82, 0xA5, 0xB8,
 /*152 - 159*/ 0x03, 0x1E, 0x39, 0x24, 0x77, 0x6A, 0x4D, 0x50,
 /*160 - 167*/ 0xA1, 0xBC, 0x9B, 0x86, 0xD5, 0xC8, 0xEF, 0xF2,
 /*168 - 175*/ 0x49, 0x54, 0x73, 0x6E, 0x3D, 0x20, 0x07, 0x1A,
 /*176 - 183*/ 0x6C, 0x71, 0x56, 0x4B, 0x18, 0x05, 0x22, 0x3F,
 /*184 - 191*/ 0x84, 0x99, 0xBE, 0xA3, 0xF0, 0xED, 0xCA, 0xD7,
 /*192 - 199*/ 0x35, 0x28, 0x0F, 0x12, 0x41, 0x5C, 0x7B, 0x66,
 /*200 - 207*/ 0xDD, 0xC0, 0xE7, 0xFA, 0xA9, 0xB4, 0x93, 0x8E,
 /*208 - 215*/ 0xF8, 0xE5, 0xC2, 0xDF, 0x8C, 0x91, 0xB6, 0xAB,
 /*216 - 223*/ 0x10, 0x0D, 0x2A, 0x37, 0x64, 0x79, 0x5E, 0x43,
 /*224 - 231*/ 0xB2, 0xAF, 0x88, 0x95, 0xC6, 0xDB, 0xFC, 0xE1,
 /*232 - 239*/ 0x5A, 0x47, 0x60, 0x7D, 0x2E, 0x33, 0x14, 0x09,
 /*240 - 247*/ 0x7F, 0x62, 0x45, 0x58, 0x0B, 0x16, 0x31, 0x2C,
 /*248 - 255*/ 0x97, 0x8A, 0xAD, 0xB0, 0xE3, 0xFE, 0xD9, 0xC4
};

         
}
/*@@end*/


/*@@startStart:Start:*/
on start
{
    //Initialise cycle time and message timer 
    putValue(E_pubc_BDC_BDC_387_cycleTm,Cycle_BDC_387);
    SetTimer( Tm_BDC_387,100);
    putValue(E_pubc_BDC_BDC_387_Tm,1);
    putValue(E_pubc_BDC_BDC_390_cycleTm,Cycle_BDC_390);
    SetTimer( Tm_BDC_390,101);
    putValue(E_pubc_BDC_BDC_390_Tm,1);
    putValue(E_pubc_BDC_BDC_3FF_cycleTm,Cycle_BDC_3FF);
    SetTimer( Tm_BDC_3FF,102);
    putValue(E_pubc_BDC_BDC_3FF_Tm,1);
    putValue(E_pubc_BDC_BDC_3E7_cycleTm,Cycle_BDC_3E7);
    SetTimer( Tm_BDC_3E7,103);
    putValue(E_pubc_BDC_BDC_3E7_Tm,1);
    putValue(E_pubc_BDC_BDC_3E8_cycleTm,Cycle_BDC_3E8);
    SetTimer( Tm_BDC_3E8,104);
    putValue(E_pubc_BDC_BDC_3E8_Tm,1);
    putValue(E_pubc_BDC_BDC_28B_cycleTm,Cycle_BDC_28B);
    SetTimer( Tm_BDC_28B,105);
    putValue(E_pubc_BDC_BDC_28B_Tm,1);
    
    //Initialise signals with init raw value
    Msg_BDC_387.BCM_FrontWiperStatus   =getvalue(E_pubc_BDC_BDC_387_BCM_FrontWiperStatus_Rv);
    Msg_BDC_387.BCM_RainfallLevel   =getvalue(E_pubc_BDC_BDC_387_BCM_RainfallLevel_Rv);
    Msg_BDC_390.BCM_SOH_LifePercent   =getvalue(E_pubc_BDC_BDC_390_BCM_SOH_LifePercent_Rv);
    Msg_BDC_390.BCM_PMSLevel   =getvalue(E_pubc_BDC_BDC_390_BCM_PMSLevel_Rv);
    Msg_BDC_3FF.BCM_FrontFoglampStatus   =getvalue(E_pubc_BDC_BDC_3FF_BCM_FrontFoglampStatus_Rv);
    Msg_BDC_3FF.BCM_RearFoglampStatus   =getvalue(E_pubc_BDC_BDC_3FF_BCM_RearFoglampStatus_Rv);
    Msg_BDC_3FF.BCM_AutoHeadlightSts   =getvalue(E_pubc_BDC_BDC_3FF_BCM_AutoHeadlightSts_Rv);
    Msg_BDC_3E7.BCM_Status_Temp   =getvalue(E_pubc_BDC_BDC_3E7_BCM_Status_Temp_Rv);
    Msg_BDC_3E7.BCM_T_BATT   =getvalue(E_pubc_BDC_BDC_3E7_BCM_T_BATT_Rv);
    Msg_BDC_3E8.BCM_SOF_Q_STATE   =getvalue(E_pubc_BDC_BDC_3E8_BCM_SOF_Q_STATE_Rv);
    Msg_BDC_3E8.BCM_SOF_Q   =getvalue(E_pubc_BDC_BDC_3E8_BCM_SOF_Q_Rv);
    Msg_BDC_28B.LCM_LASSwitch   =getvalue(E_pubc_BDC_BDC_28B_LCM_LASSwitch_Rv);
    Msg_BDC_28B.BCM_DriverDoorStatus   =getvalue(E_pubc_BDC_BDC_28B_BCM_DriverDoorStatus_Rv);
    Msg_BDC_28B.BCM_emergencylightstatus   =getvalue(E_pubc_BDC_BDC_28B_BCM_emergencylightstatus_Rv);
    Msg_BDC_28B.BCM_LowBeamStatus   =getvalue(E_pubc_BDC_BDC_28B_BCM_LowBeamStatus_Rv);
    Msg_BDC_28B.BCM_TurnIndicatorLeft   =getvalue(E_pubc_BDC_BDC_28B_BCM_TurnIndicatorLeft_Rv);
    Msg_BDC_28B.BCM_TurnLightSwitchSts   =getvalue(E_pubc_BDC_BDC_28B_BCM_TurnLightSwitchSts_Rv);
    Msg_BDC_28B.BCM_HighBeamStatus   =getvalue(E_pubc_BDC_BDC_28B_BCM_HighBeamStatus_Rv);
    Msg_BDC_28B.BCM_TurnIndicatorRight   =getvalue(E_pubc_BDC_BDC_28B_BCM_TurnIndicatorRight_Rv);
    Msg_BDC_28B.BCM_HoodStatus   =getvalue(E_pubc_BDC_BDC_28B_BCM_HoodStatus_Rv);
}
/*@@end*/

/*@@envVar:E_pubc_BDC_CycMsgsON:*/
on envVar E_pubc_BDC_CycMsgsON
{
    // enable all the cyclic messages 
    putValue(E_pubc_BDC_BDC_387_Tm,1);
    putValue(E_pubc_BDC_BDC_390_Tm,1);
    putValue(E_pubc_BDC_BDC_3FF_Tm,1);
    putValue(E_pubc_BDC_BDC_3E7_Tm,1);
    putValue(E_pubc_BDC_BDC_3E8_Tm,1);
    putValue(E_pubc_BDC_BDC_28B_Tm,1);
}
/*@@end*/

/*@@envVar:E_pubc_BDC_CycMsgsOFF:*/
on envVar E_pubc_BDC_CycMsgsOFF
{
    // disable all the cyclic messages
    putValue(E_pubc_BDC_BDC_387_Tm,0);
    putValue(E_pubc_BDC_BDC_390_Tm,0);
    putValue(E_pubc_BDC_BDC_3FF_Tm,0);
    putValue(E_pubc_BDC_BDC_3E7_Tm,0);
    putValue(E_pubc_BDC_BDC_3E8_Tm,0);
    putValue(E_pubc_BDC_BDC_28B_Tm,0);
    
}
/*@@end*/
/*@@timer:Tm_BDC_387:*/
on timer Tm_BDC_387
{
    //cyclic message timer 
    if(getValue(E_pubc_BDC_BDC_387_Tm) == 1)
    {
        
		//update the BZ Signal
	
        output(Msg_BDC_387);
        
    }
    //Reset Timer
    SetTimer(Tm_BDC_387,Cycle_BDC_387);
}
/*@@end*/

/*@@envVar:E_pubc_BDC_BDC_387_cycleTm:*/
on envVar E_pubc_BDC_BDC_387_cycleTm
{
    // update the cycle time 
    Cycle_BDC_387=getvalue(this);
}
/*@@end*/
/*@@timer:Tm_BDC_390:*/
on timer Tm_BDC_390
{
    //cyclic message timer 
    if(getValue(E_pubc_BDC_BDC_390_Tm) == 1)
    {
        
		//update the BZ Signal
	
        output(Msg_BDC_390);
        
    }
    //Reset Timer
    SetTimer(Tm_BDC_390,Cycle_BDC_390);
}
/*@@end*/

/*@@envVar:E_pubc_BDC_BDC_390_cycleTm:*/
on envVar E_pubc_BDC_BDC_390_cycleTm
{
    // update the cycle time 
    Cycle_BDC_390=getvalue(this);
}
/*@@end*/
/*@@timer:Tm_BDC_3FF:*/
on timer Tm_BDC_3FF
{
    //cyclic message timer 
    if(getValue(E_pubc_BDC_BDC_3FF_Tm) == 1)
    {
        
		//update the BZ Signal
	
        output(Msg_BDC_3FF);
        
    }
    //Reset Timer
    SetTimer(Tm_BDC_3FF,Cycle_BDC_3FF);
}
/*@@end*/

/*@@envVar:E_pubc_BDC_BDC_3FF_cycleTm:*/
on envVar E_pubc_BDC_BDC_3FF_cycleTm
{
    // update the cycle time 
    Cycle_BDC_3FF=getvalue(this);
}
/*@@end*/
/*@@timer:Tm_BDC_3E7:*/
on timer Tm_BDC_3E7
{
    //cyclic message timer 
    if(getValue(E_pubc_BDC_BDC_3E7_Tm) == 1)
    {
        
		//update the BZ Signal
	
        output(Msg_BDC_3E7);
        
    }
    //Reset Timer
    SetTimer(Tm_BDC_3E7,Cycle_BDC_3E7);
}
/*@@end*/

/*@@envVar:E_pubc_BDC_BDC_3E7_cycleTm:*/
on envVar E_pubc_BDC_BDC_3E7_cycleTm
{
    // update the cycle time 
    Cycle_BDC_3E7=getvalue(this);
}
/*@@end*/
/*@@timer:Tm_BDC_3E8:*/
on timer Tm_BDC_3E8
{
    //cyclic message timer 
    if(getValue(E_pubc_BDC_BDC_3E8_Tm) == 1)
    {
        
		//update the BZ Signal
	
        output(Msg_BDC_3E8);
        
    }
    //Reset Timer
    SetTimer(Tm_BDC_3E8,Cycle_BDC_3E8);
}
/*@@end*/

/*@@envVar:E_pubc_BDC_BDC_3E8_cycleTm:*/
on envVar E_pubc_BDC_BDC_3E8_cycleTm
{
    // update the cycle time 
    Cycle_BDC_3E8=getvalue(this);
}
/*@@end*/
/*@@timer:Tm_BDC_28B:*/
on timer Tm_BDC_28B
{
    //cyclic message timer 
    if(getValue(E_pubc_BDC_BDC_28B_Tm) == 1)
    {
        
		//update the BZ Signal
	
        output(Msg_BDC_28B);
        
    }
    //Reset Timer
    SetTimer(Tm_BDC_28B,Cycle_BDC_28B);
}
/*@@end*/

/*@@envVar:E_pubc_BDC_BDC_28B_cycleTm:*/
on envVar E_pubc_BDC_BDC_28B_cycleTm
{
    // update the cycle time 
    Cycle_BDC_28B=getvalue(this);
}
/*@@end*/

/*@@envVar:E_pubc_BDC_BDC_387_tx:*/
on envVar E_pubc_BDC_BDC_387_tx
{
    if(getValue(this))
    {       
        

        output(Msg_BDC_387);        
    }
}
/*@@end*/

/*@@envVar:E_pubc_BDC_BDC_387_Range:*/
on envVar E_pubc_BDC_BDC_387_Range
{
    qword rawstatus = 0ll;
    qword rawValue = 0ll;    
    
    rawstatus = getvalue(this);    
    // set all the signals with min raw /max raw /init raw
    switch (rawstatus) 
    {
     case(0) :
        rawValue= 0;
        putValue(E_pubc_BDC_BDC_387_BCM_FrontWiperStatus_Rv, rawValue);
        rawValue= 0;
        putValue(E_pubc_BDC_BDC_387_BCM_RainfallLevel_Rv, rawValue);
        break;
     case(1) :
        rawValue= 3;
        putValue(E_pubc_BDC_BDC_387_BCM_FrontWiperStatus_Rv, rawValue);
        rawValue= 15;
        putValue(E_pubc_BDC_BDC_387_BCM_RainfallLevel_Rv, rawValue);
        break;
     default :
        rawValue= 0;
        putValue(E_pubc_BDC_BDC_387_BCM_FrontWiperStatus_Rv, rawValue);
        rawValue= 0;
        putValue(E_pubc_BDC_BDC_387_BCM_RainfallLevel_Rv, rawValue);
      break;
   }
}
/*@@end*/

/*@@envVar:E_pubc_BDC_BDC_387_Dlc:*/
on envVar E_pubc_BDC_BDC_387_Dlc
{
    if(getValue(E_pubc_BDC_BDC_387_enDlc))
    {
        Msg_BDC_387.dlc =getValue(this);
    }
    else
    {   
	   Msg_BDC_387.dlc = 8;
	   	
  }
}
/*@@end*/

/*@@envVar:E_pubc_BDC_BDC_387_enDlc:*/
on envVar E_pubc_BDC_BDC_387_enDlc
{
    //For Messages with DLC = 8, set wrong DLC to smaller than defined DLC
    //For Messages with DLC < 8 set wrong DLC to smaller/longer than defined DLC
    if(getValue(this))
    {
        Msg_BDC_387.dlc =getValue(E_pubc_BDC_BDC_387_Dlc);
    }
    else
    {
	   Msg_BDC_387.dlc = 8;
			
    }
}
/*@@end*/


/*@@envVar:E_pubc_BDC_BDC_387_BCM_FrontWiperStatus_Rv:*/
on envVar E_pubc_BDC_BDC_387_BCM_FrontWiperStatus_Rv
{
    int64 rawValue = 0ll;
    float rawValue_float = 0.0;
    float phyValue = 0.0;        

    //set the signal with updated raw value
    if(getValue(E_pubc_BDC_BDC_387_BCM_FrontWiperStatus_SetVt)==0)
    {
        rawValue = getvalue(this);
        if(chgEv_BDC_387_BCM_FrontWiperStatus == 0)
        {
            //type conversion to float
            rawValue_float = rawValue;        
            // raw to physical conversion
            phyValue = ((rawValue_float *1)+(0));
            putValue(E_pubc_BDC_BDC_387_BCM_FrontWiperStatus_Pv, phyValue);
            chgEv_BDC_387_BCM_FrontWiperStatus = 1;
        }
        else
        {
            chgEv_BDC_387_BCM_FrontWiperStatus = 0;
        }    
        //update the signal value
        Msg_BDC_387.BCM_FrontWiperStatus=rawValue;        
    }                                                                           
}
/*@@end*/

/*@@envVar:E_pubc_BDC_BDC_387_BCM_FrontWiperStatus_Pv:*/
on envVar E_pubc_BDC_BDC_387_BCM_FrontWiperStatus_Pv
{
    int64 rawValue = 0ll;
    float phyValue = 0.0;
    
    //update the raw value with physical value 
    if(getValue(E_pubc_BDC_BDC_387_BCM_FrontWiperStatus_SetVt)==0)
    {
        if(chgEv_BDC_387_BCM_FrontWiperStatus == 0)
        {
            phyValue = getvalue(this);
            // physical to raw conversion
            rawValue = ((phyValue -(0))/1);
            putValue(E_pubc_BDC_BDC_387_BCM_FrontWiperStatus_Rv, rawValue);
            chgEv_BDC_387_BCM_FrontWiperStatus = 1;  
        }
        else
        {
            chgEv_BDC_387_BCM_FrontWiperStatus = 0;
        }
    }
}
/*@@end*/

/*@@envVar:E_pubc_BDC_BDC_387_BCM_FrontWiperStatus_Vt:*/
on envVar E_pubc_BDC_BDC_387_BCM_FrontWiperStatus_Vt
{
    qword rawValue = 0ll;
    if(getValue(E_pubc_BDC_BDC_387_BCM_FrontWiperStatus_SetVt))
    {
        //update the signal value
        Msg_BDC_387.BCM_FrontWiperStatus=getValue(this);
    }
}
/*@@end*/

/*@@envVar:E_pubc_BDC_BDC_387_BCM_FrontWiperStatus_SetVt:*/
on envVar E_pubc_BDC_BDC_387_BCM_FrontWiperStatus_SetVt
{
    if(getValue(E_pubc_BDC_BDC_387_BCM_FrontWiperStatus_SetVt))
    {
        //update the signal value
        Msg_BDC_387.BCM_FrontWiperStatus=getvalue(E_pubc_BDC_BDC_387_BCM_FrontWiperStatus_Vt);
    }
    else
    {
        Msg_BDC_387.BCM_FrontWiperStatus=getValue(E_pubc_BDC_BDC_387_BCM_FrontWiperStatus_Rv);
    }
}
/*@@end*/
 
/*@@envVar:E_pubc_BDC_BDC_387_BCM_RainfallLevel_Rv:*/
on envVar E_pubc_BDC_BDC_387_BCM_RainfallLevel_Rv
{
    int64 rawValue = 0ll;
    float rawValue_float = 0.0;
    float phyValue = 0.0;        

    //set the signal with updated raw value
    if(getValue(E_pubc_BDC_BDC_387_BCM_RainfallLevel_SetVt)==0)
    {
        rawValue = getvalue(this);
        if(chgEv_BDC_387_BCM_RainfallLevel == 0)
        {
            //type conversion to float
            rawValue_float = rawValue;        
            // raw to physical conversion
            phyValue = ((rawValue_float *1)+(0));
            putValue(E_pubc_BDC_BDC_387_BCM_RainfallLevel_Pv, phyValue);
            chgEv_BDC_387_BCM_RainfallLevel = 1;
        }
        else
        {
            chgEv_BDC_387_BCM_RainfallLevel = 0;
        }    
        //update the signal value
        Msg_BDC_387.BCM_RainfallLevel=rawValue;        
    }                                                                           
}
/*@@end*/

/*@@envVar:E_pubc_BDC_BDC_387_BCM_RainfallLevel_Pv:*/
on envVar E_pubc_BDC_BDC_387_BCM_RainfallLevel_Pv
{
    int64 rawValue = 0ll;
    float phyValue = 0.0;
    
    //update the raw value with physical value 
    if(getValue(E_pubc_BDC_BDC_387_BCM_RainfallLevel_SetVt)==0)
    {
        if(chgEv_BDC_387_BCM_RainfallLevel == 0)
        {
            phyValue = getvalue(this);
            // physical to raw conversion
            rawValue = ((phyValue -(0))/1);
            putValue(E_pubc_BDC_BDC_387_BCM_RainfallLevel_Rv, rawValue);
            chgEv_BDC_387_BCM_RainfallLevel = 1;  
        }
        else
        {
            chgEv_BDC_387_BCM_RainfallLevel = 0;
        }
    }
}
/*@@end*/

/*@@envVar:E_pubc_BDC_BDC_387_BCM_RainfallLevel_Vt:*/
on envVar E_pubc_BDC_BDC_387_BCM_RainfallLevel_Vt
{
    qword rawValue = 0ll;
    if(getValue(E_pubc_BDC_BDC_387_BCM_RainfallLevel_SetVt))
    {
        //update the signal value
        Msg_BDC_387.BCM_RainfallLevel=getValue(this);
    }
}
/*@@end*/

/*@@envVar:E_pubc_BDC_BDC_387_BCM_RainfallLevel_SetVt:*/
on envVar E_pubc_BDC_BDC_387_BCM_RainfallLevel_SetVt
{
    if(getValue(E_pubc_BDC_BDC_387_BCM_RainfallLevel_SetVt))
    {
        //update the signal value
        Msg_BDC_387.BCM_RainfallLevel=getvalue(E_pubc_BDC_BDC_387_BCM_RainfallLevel_Vt);
    }
    else
    {
        Msg_BDC_387.BCM_RainfallLevel=getValue(E_pubc_BDC_BDC_387_BCM_RainfallLevel_Rv);
    }
}
/*@@end*/
 
/*@@envVar:E_pubc_BDC_BDC_390_tx:*/
on envVar E_pubc_BDC_BDC_390_tx
{
    if(getValue(this))
    {       
        

        output(Msg_BDC_390);        
    }
}
/*@@end*/

/*@@envVar:E_pubc_BDC_BDC_390_Range:*/
on envVar E_pubc_BDC_BDC_390_Range
{
    qword rawstatus = 0ll;
    qword rawValue = 0ll;    
    
    rawstatus = getvalue(this);    
    // set all the signals with min raw /max raw /init raw
    switch (rawstatus) 
    {
     case(0) :
        rawValue= 0;
        putValue(E_pubc_BDC_BDC_390_BCM_SOH_LifePercent_Rv, rawValue);
        rawValue= 0;
        putValue(E_pubc_BDC_BDC_390_BCM_PMSLevel_Rv, rawValue);
        break;
     case(1) :
        rawValue= 100;
        putValue(E_pubc_BDC_BDC_390_BCM_SOH_LifePercent_Rv, rawValue);
        rawValue= 7;
        putValue(E_pubc_BDC_BDC_390_BCM_PMSLevel_Rv, rawValue);
        break;
     default :
        rawValue= 0;
        putValue(E_pubc_BDC_BDC_390_BCM_SOH_LifePercent_Rv, rawValue);
        rawValue= 0;
        putValue(E_pubc_BDC_BDC_390_BCM_PMSLevel_Rv, rawValue);
      break;
   }
}
/*@@end*/

/*@@envVar:E_pubc_BDC_BDC_390_Dlc:*/
on envVar E_pubc_BDC_BDC_390_Dlc
{
    if(getValue(E_pubc_BDC_BDC_390_enDlc))
    {
        Msg_BDC_390.dlc =getValue(this);
    }
    else
    {   
	   Msg_BDC_390.dlc = 8;
	   	
  }
}
/*@@end*/

/*@@envVar:E_pubc_BDC_BDC_390_enDlc:*/
on envVar E_pubc_BDC_BDC_390_enDlc
{
    //For Messages with DLC = 8, set wrong DLC to smaller than defined DLC
    //For Messages with DLC < 8 set wrong DLC to smaller/longer than defined DLC
    if(getValue(this))
    {
        Msg_BDC_390.dlc =getValue(E_pubc_BDC_BDC_390_Dlc);
    }
    else
    {
	   Msg_BDC_390.dlc = 8;
			
    }
}
/*@@end*/


/*@@envVar:E_pubc_BDC_BDC_390_BCM_SOH_LifePercent_Rv:*/
on envVar E_pubc_BDC_BDC_390_BCM_SOH_LifePercent_Rv
{
    int64 rawValue = 0ll;
    float rawValue_float = 0.0;
    float phyValue = 0.0;        

    //set the signal with updated raw value
    if(getValue(E_pubc_BDC_BDC_390_BCM_SOH_LifePercent_SetVt)==0)
    {
        rawValue = getvalue(this);
        if(chgEv_BDC_390_BCM_SOH_LifePercent == 0)
        {
            //type conversion to float
            rawValue_float = rawValue;        
            // raw to physical conversion
            phyValue = ((rawValue_float *1)+(0));
            putValue(E_pubc_BDC_BDC_390_BCM_SOH_LifePercent_Pv, phyValue);
            chgEv_BDC_390_BCM_SOH_LifePercent = 1;
        }
        else
        {
            chgEv_BDC_390_BCM_SOH_LifePercent = 0;
        }    
        //update the signal value
        Msg_BDC_390.BCM_SOH_LifePercent=rawValue;        
    }                                                                           
}
/*@@end*/

/*@@envVar:E_pubc_BDC_BDC_390_BCM_SOH_LifePercent_Pv:*/
on envVar E_pubc_BDC_BDC_390_BCM_SOH_LifePercent_Pv
{
    int64 rawValue = 0ll;
    float phyValue = 0.0;
    
    //update the raw value with physical value 
    if(getValue(E_pubc_BDC_BDC_390_BCM_SOH_LifePercent_SetVt)==0)
    {
        if(chgEv_BDC_390_BCM_SOH_LifePercent == 0)
        {
            phyValue = getvalue(this);
            // physical to raw conversion
            rawValue = ((phyValue -(0))/1);
            putValue(E_pubc_BDC_BDC_390_BCM_SOH_LifePercent_Rv, rawValue);
            chgEv_BDC_390_BCM_SOH_LifePercent = 1;  
        }
        else
        {
            chgEv_BDC_390_BCM_SOH_LifePercent = 0;
        }
    }
}
/*@@end*/

/*@@envVar:E_pubc_BDC_BDC_390_BCM_SOH_LifePercent_Vt:*/
on envVar E_pubc_BDC_BDC_390_BCM_SOH_LifePercent_Vt
{
    qword rawValue = 0ll;
    if(getValue(E_pubc_BDC_BDC_390_BCM_SOH_LifePercent_SetVt))
    {
        //update the signal value
        Msg_BDC_390.BCM_SOH_LifePercent=getValue(this);
    }
}
/*@@end*/

/*@@envVar:E_pubc_BDC_BDC_390_BCM_SOH_LifePercent_SetVt:*/
on envVar E_pubc_BDC_BDC_390_BCM_SOH_LifePercent_SetVt
{
    if(getValue(E_pubc_BDC_BDC_390_BCM_SOH_LifePercent_SetVt))
    {
        //update the signal value
        Msg_BDC_390.BCM_SOH_LifePercent=getvalue(E_pubc_BDC_BDC_390_BCM_SOH_LifePercent_Vt);
    }
    else
    {
        Msg_BDC_390.BCM_SOH_LifePercent=getValue(E_pubc_BDC_BDC_390_BCM_SOH_LifePercent_Rv);
    }
}
/*@@end*/
 
/*@@envVar:E_pubc_BDC_BDC_390_BCM_PMSLevel_Rv:*/
on envVar E_pubc_BDC_BDC_390_BCM_PMSLevel_Rv
{
    int64 rawValue = 0ll;
    float rawValue_float = 0.0;
    float phyValue = 0.0;        

    //set the signal with updated raw value
    if(getValue(E_pubc_BDC_BDC_390_BCM_PMSLevel_SetVt)==0)
    {
        rawValue = getvalue(this);
        if(chgEv_BDC_390_BCM_PMSLevel == 0)
        {
            //type conversion to float
            rawValue_float = rawValue;        
            // raw to physical conversion
            phyValue = ((rawValue_float *1)+(0));
            putValue(E_pubc_BDC_BDC_390_BCM_PMSLevel_Pv, phyValue);
            chgEv_BDC_390_BCM_PMSLevel = 1;
        }
        else
        {
            chgEv_BDC_390_BCM_PMSLevel = 0;
        }    
        //update the signal value
        Msg_BDC_390.BCM_PMSLevel=rawValue;        
    }                                                                           
}
/*@@end*/

/*@@envVar:E_pubc_BDC_BDC_390_BCM_PMSLevel_Pv:*/
on envVar E_pubc_BDC_BDC_390_BCM_PMSLevel_Pv
{
    int64 rawValue = 0ll;
    float phyValue = 0.0;
    
    //update the raw value with physical value 
    if(getValue(E_pubc_BDC_BDC_390_BCM_PMSLevel_SetVt)==0)
    {
        if(chgEv_BDC_390_BCM_PMSLevel == 0)
        {
            phyValue = getvalue(this);
            // physical to raw conversion
            rawValue = ((phyValue -(0))/1);
            putValue(E_pubc_BDC_BDC_390_BCM_PMSLevel_Rv, rawValue);
            chgEv_BDC_390_BCM_PMSLevel = 1;  
        }
        else
        {
            chgEv_BDC_390_BCM_PMSLevel = 0;
        }
    }
}
/*@@end*/

/*@@envVar:E_pubc_BDC_BDC_390_BCM_PMSLevel_Vt:*/
on envVar E_pubc_BDC_BDC_390_BCM_PMSLevel_Vt
{
    qword rawValue = 0ll;
    if(getValue(E_pubc_BDC_BDC_390_BCM_PMSLevel_SetVt))
    {
        //update the signal value
        Msg_BDC_390.BCM_PMSLevel=getValue(this);
    }
}
/*@@end*/

/*@@envVar:E_pubc_BDC_BDC_390_BCM_PMSLevel_SetVt:*/
on envVar E_pubc_BDC_BDC_390_BCM_PMSLevel_SetVt
{
    if(getValue(E_pubc_BDC_BDC_390_BCM_PMSLevel_SetVt))
    {
        //update the signal value
        Msg_BDC_390.BCM_PMSLevel=getvalue(E_pubc_BDC_BDC_390_BCM_PMSLevel_Vt);
    }
    else
    {
        Msg_BDC_390.BCM_PMSLevel=getValue(E_pubc_BDC_BDC_390_BCM_PMSLevel_Rv);
    }
}
/*@@end*/
 
/*@@envVar:E_pubc_BDC_BDC_3FF_tx:*/
on envVar E_pubc_BDC_BDC_3FF_tx
{
    if(getValue(this))
    {       
        

        output(Msg_BDC_3FF);        
    }
}
/*@@end*/

/*@@envVar:E_pubc_BDC_BDC_3FF_Range:*/
on envVar E_pubc_BDC_BDC_3FF_Range
{
    qword rawstatus = 0ll;
    qword rawValue = 0ll;    
    
    rawstatus = getvalue(this);    
    // set all the signals with min raw /max raw /init raw
    switch (rawstatus) 
    {
     case(0) :
        rawValue= 0;
        putValue(E_pubc_BDC_BDC_3FF_BCM_FrontFoglampStatus_Rv, rawValue);
        rawValue= 0;
        putValue(E_pubc_BDC_BDC_3FF_BCM_RearFoglampStatus_Rv, rawValue);
        rawValue= 0;
        putValue(E_pubc_BDC_BDC_3FF_BCM_AutoHeadlightSts_Rv, rawValue);
        break;
     case(1) :
        rawValue= 3;
        putValue(E_pubc_BDC_BDC_3FF_BCM_FrontFoglampStatus_Rv, rawValue);
        rawValue= 3;
        putValue(E_pubc_BDC_BDC_3FF_BCM_RearFoglampStatus_Rv, rawValue);
        rawValue= 1;
        putValue(E_pubc_BDC_BDC_3FF_BCM_AutoHeadlightSts_Rv, rawValue);
        break;
     default :
        rawValue= 0;
        putValue(E_pubc_BDC_BDC_3FF_BCM_FrontFoglampStatus_Rv, rawValue);
        rawValue= 0;
        putValue(E_pubc_BDC_BDC_3FF_BCM_RearFoglampStatus_Rv, rawValue);
        rawValue= 0;
        putValue(E_pubc_BDC_BDC_3FF_BCM_AutoHeadlightSts_Rv, rawValue);
      break;
   }
}
/*@@end*/

/*@@envVar:E_pubc_BDC_BDC_3FF_Dlc:*/
on envVar E_pubc_BDC_BDC_3FF_Dlc
{
    if(getValue(E_pubc_BDC_BDC_3FF_enDlc))
    {
        Msg_BDC_3FF.dlc =getValue(this);
    }
    else
    {   
	   Msg_BDC_3FF.dlc = 8;
	   	
  }
}
/*@@end*/

/*@@envVar:E_pubc_BDC_BDC_3FF_enDlc:*/
on envVar E_pubc_BDC_BDC_3FF_enDlc
{
    //For Messages with DLC = 8, set wrong DLC to smaller than defined DLC
    //For Messages with DLC < 8 set wrong DLC to smaller/longer than defined DLC
    if(getValue(this))
    {
        Msg_BDC_3FF.dlc =getValue(E_pubc_BDC_BDC_3FF_Dlc);
    }
    else
    {
	   Msg_BDC_3FF.dlc = 8;
			
    }
}
/*@@end*/


/*@@envVar:E_pubc_BDC_BDC_3FF_BCM_FrontFoglampStatus_Rv:*/
on envVar E_pubc_BDC_BDC_3FF_BCM_FrontFoglampStatus_Rv
{
    int64 rawValue = 0ll;
    float rawValue_float = 0.0;
    float phyValue = 0.0;        

    //set the signal with updated raw value
    if(getValue(E_pubc_BDC_BDC_3FF_BCM_FrontFoglampStatus_SetVt)==0)
    {
        rawValue = getvalue(this);
        if(chgEv_BDC_3FF_BCM_FrontFoglampStatus == 0)
        {
            //type conversion to float
            rawValue_float = rawValue;        
            // raw to physical conversion
            phyValue = ((rawValue_float *1)+(0));
            putValue(E_pubc_BDC_BDC_3FF_BCM_FrontFoglampStatus_Pv, phyValue);
            chgEv_BDC_3FF_BCM_FrontFoglampStatus = 1;
        }
        else
        {
            chgEv_BDC_3FF_BCM_FrontFoglampStatus = 0;
        }    
        //update the signal value
        Msg_BDC_3FF.BCM_FrontFoglampStatus=rawValue;        
    }                                                                           
}
/*@@end*/

/*@@envVar:E_pubc_BDC_BDC_3FF_BCM_FrontFoglampStatus_Pv:*/
on envVar E_pubc_BDC_BDC_3FF_BCM_FrontFoglampStatus_Pv
{
    int64 rawValue = 0ll;
    float phyValue = 0.0;
    
    //update the raw value with physical value 
    if(getValue(E_pubc_BDC_BDC_3FF_BCM_FrontFoglampStatus_SetVt)==0)
    {
        if(chgEv_BDC_3FF_BCM_FrontFoglampStatus == 0)
        {
            phyValue = getvalue(this);
            // physical to raw conversion
            rawValue = ((phyValue -(0))/1);
            putValue(E_pubc_BDC_BDC_3FF_BCM_FrontFoglampStatus_Rv, rawValue);
            chgEv_BDC_3FF_BCM_FrontFoglampStatus = 1;  
        }
        else
        {
            chgEv_BDC_3FF_BCM_FrontFoglampStatus = 0;
        }
    }
}
/*@@end*/

/*@@envVar:E_pubc_BDC_BDC_3FF_BCM_FrontFoglampStatus_Vt:*/
on envVar E_pubc_BDC_BDC_3FF_BCM_FrontFoglampStatus_Vt
{
    qword rawValue = 0ll;
    if(getValue(E_pubc_BDC_BDC_3FF_BCM_FrontFoglampStatus_SetVt))
    {
        //update the signal value
        Msg_BDC_3FF.BCM_FrontFoglampStatus=getValue(this);
    }
}
/*@@end*/

/*@@envVar:E_pubc_BDC_BDC_3FF_BCM_FrontFoglampStatus_SetVt:*/
on envVar E_pubc_BDC_BDC_3FF_BCM_FrontFoglampStatus_SetVt
{
    if(getValue(E_pubc_BDC_BDC_3FF_BCM_FrontFoglampStatus_SetVt))
    {
        //update the signal value
        Msg_BDC_3FF.BCM_FrontFoglampStatus=getvalue(E_pubc_BDC_BDC_3FF_BCM_FrontFoglampStatus_Vt);
    }
    else
    {
        Msg_BDC_3FF.BCM_FrontFoglampStatus=getValue(E_pubc_BDC_BDC_3FF_BCM_FrontFoglampStatus_Rv);
    }
}
/*@@end*/
 
/*@@envVar:E_pubc_BDC_BDC_3FF_BCM_RearFoglampStatus_Rv:*/
on envVar E_pubc_BDC_BDC_3FF_BCM_RearFoglampStatus_Rv
{
    int64 rawValue = 0ll;
    float rawValue_float = 0.0;
    float phyValue = 0.0;        

    //set the signal with updated raw value
    if(getValue(E_pubc_BDC_BDC_3FF_BCM_RearFoglampStatus_SetVt)==0)
    {
        rawValue = getvalue(this);
        if(chgEv_BDC_3FF_BCM_RearFoglampStatus == 0)
        {
            //type conversion to float
            rawValue_float = rawValue;        
            // raw to physical conversion
            phyValue = ((rawValue_float *1)+(0));
            putValue(E_pubc_BDC_BDC_3FF_BCM_RearFoglampStatus_Pv, phyValue);
            chgEv_BDC_3FF_BCM_RearFoglampStatus = 1;
        }
        else
        {
            chgEv_BDC_3FF_BCM_RearFoglampStatus = 0;
        }    
        //update the signal value
        Msg_BDC_3FF.BCM_RearFoglampStatus=rawValue;        
    }                                                                           
}
/*@@end*/

/*@@envVar:E_pubc_BDC_BDC_3FF_BCM_RearFoglampStatus_Pv:*/
on envVar E_pubc_BDC_BDC_3FF_BCM_RearFoglampStatus_Pv
{
    int64 rawValue = 0ll;
    float phyValue = 0.0;
    
    //update the raw value with physical value 
    if(getValue(E_pubc_BDC_BDC_3FF_BCM_RearFoglampStatus_SetVt)==0)
    {
        if(chgEv_BDC_3FF_BCM_RearFoglampStatus == 0)
        {
            phyValue = getvalue(this);
            // physical to raw conversion
            rawValue = ((phyValue -(0))/1);
            putValue(E_pubc_BDC_BDC_3FF_BCM_RearFoglampStatus_Rv, rawValue);
            chgEv_BDC_3FF_BCM_RearFoglampStatus = 1;  
        }
        else
        {
            chgEv_BDC_3FF_BCM_RearFoglampStatus = 0;
        }
    }
}
/*@@end*/

/*@@envVar:E_pubc_BDC_BDC_3FF_BCM_RearFoglampStatus_Vt:*/
on envVar E_pubc_BDC_BDC_3FF_BCM_RearFoglampStatus_Vt
{
    qword rawValue = 0ll;
    if(getValue(E_pubc_BDC_BDC_3FF_BCM_RearFoglampStatus_SetVt))
    {
        //update the signal value
        Msg_BDC_3FF.BCM_RearFoglampStatus=getValue(this);
    }
}
/*@@end*/

/*@@envVar:E_pubc_BDC_BDC_3FF_BCM_RearFoglampStatus_SetVt:*/
on envVar E_pubc_BDC_BDC_3FF_BCM_RearFoglampStatus_SetVt
{
    if(getValue(E_pubc_BDC_BDC_3FF_BCM_RearFoglampStatus_SetVt))
    {
        //update the signal value
        Msg_BDC_3FF.BCM_RearFoglampStatus=getvalue(E_pubc_BDC_BDC_3FF_BCM_RearFoglampStatus_Vt);
    }
    else
    {
        Msg_BDC_3FF.BCM_RearFoglampStatus=getValue(E_pubc_BDC_BDC_3FF_BCM_RearFoglampStatus_Rv);
    }
}
/*@@end*/
 
/*@@envVar:E_pubc_BDC_BDC_3FF_BCM_AutoHeadlightSts_Rv:*/
on envVar E_pubc_BDC_BDC_3FF_BCM_AutoHeadlightSts_Rv
{
    int64 rawValue = 0ll;
    float rawValue_float = 0.0;
    float phyValue = 0.0;        

    //set the signal with updated raw value
    if(getValue(E_pubc_BDC_BDC_3FF_BCM_AutoHeadlightSts_SetVt)==0)
    {
        rawValue = getvalue(this);
        if(chgEv_BDC_3FF_BCM_AutoHeadlightSts == 0)
        {
            //type conversion to float
            rawValue_float = rawValue;        
            // raw to physical conversion
            phyValue = ((rawValue_float *1)+(0));
            putValue(E_pubc_BDC_BDC_3FF_BCM_AutoHeadlightSts_Pv, phyValue);
            chgEv_BDC_3FF_BCM_AutoHeadlightSts = 1;
        }
        else
        {
            chgEv_BDC_3FF_BCM_AutoHeadlightSts = 0;
        }    
        //update the signal value
        Msg_BDC_3FF.BCM_AutoHeadlightSts=rawValue;        
    }                                                                           
}
/*@@end*/

/*@@envVar:E_pubc_BDC_BDC_3FF_BCM_AutoHeadlightSts_Pv:*/
on envVar E_pubc_BDC_BDC_3FF_BCM_AutoHeadlightSts_Pv
{
    int64 rawValue = 0ll;
    float phyValue = 0.0;
    
    //update the raw value with physical value 
    if(getValue(E_pubc_BDC_BDC_3FF_BCM_AutoHeadlightSts_SetVt)==0)
    {
        if(chgEv_BDC_3FF_BCM_AutoHeadlightSts == 0)
        {
            phyValue = getvalue(this);
            // physical to raw conversion
            rawValue = ((phyValue -(0))/1);
            putValue(E_pubc_BDC_BDC_3FF_BCM_AutoHeadlightSts_Rv, rawValue);
            chgEv_BDC_3FF_BCM_AutoHeadlightSts = 1;  
        }
        else
        {
            chgEv_BDC_3FF_BCM_AutoHeadlightSts = 0;
        }
    }
}
/*@@end*/

/*@@envVar:E_pubc_BDC_BDC_3FF_BCM_AutoHeadlightSts_Vt:*/
on envVar E_pubc_BDC_BDC_3FF_BCM_AutoHeadlightSts_Vt
{
    qword rawValue = 0ll;
    if(getValue(E_pubc_BDC_BDC_3FF_BCM_AutoHeadlightSts_SetVt))
    {
        //update the signal value
        Msg_BDC_3FF.BCM_AutoHeadlightSts=getValue(this);
    }
}
/*@@end*/

/*@@envVar:E_pubc_BDC_BDC_3FF_BCM_AutoHeadlightSts_SetVt:*/
on envVar E_pubc_BDC_BDC_3FF_BCM_AutoHeadlightSts_SetVt
{
    if(getValue(E_pubc_BDC_BDC_3FF_BCM_AutoHeadlightSts_SetVt))
    {
        //update the signal value
        Msg_BDC_3FF.BCM_AutoHeadlightSts=getvalue(E_pubc_BDC_BDC_3FF_BCM_AutoHeadlightSts_Vt);
    }
    else
    {
        Msg_BDC_3FF.BCM_AutoHeadlightSts=getValue(E_pubc_BDC_BDC_3FF_BCM_AutoHeadlightSts_Rv);
    }
}
/*@@end*/
 
/*@@envVar:E_pubc_BDC_BDC_3E7_tx:*/
on envVar E_pubc_BDC_BDC_3E7_tx
{
    if(getValue(this))
    {       
        

        output(Msg_BDC_3E7);        
    }
}
/*@@end*/

/*@@envVar:E_pubc_BDC_BDC_3E7_Range:*/
on envVar E_pubc_BDC_BDC_3E7_Range
{
    qword rawstatus = 0ll;
    qword rawValue = 0ll;    
    
    rawstatus = getvalue(this);    
    // set all the signals with min raw /max raw /init raw
    switch (rawstatus) 
    {
     case(0) :
        rawValue= 0;
        putValue(E_pubc_BDC_BDC_3E7_BCM_Status_Temp_Rv, rawValue);
        rawValue= 0;
        putValue(E_pubc_BDC_BDC_3E7_BCM_T_BATT_Rv, rawValue);
        break;
     case(1) :
        rawValue= 3;
        putValue(E_pubc_BDC_BDC_3E7_BCM_Status_Temp_Rv, rawValue);
        rawValue= 145;
        putValue(E_pubc_BDC_BDC_3E7_BCM_T_BATT_Rv, rawValue);
        break;
     default :
        rawValue= 0;
        putValue(E_pubc_BDC_BDC_3E7_BCM_Status_Temp_Rv, rawValue);
        rawValue= 0;
        putValue(E_pubc_BDC_BDC_3E7_BCM_T_BATT_Rv, rawValue);
      break;
   }
}
/*@@end*/

/*@@envVar:E_pubc_BDC_BDC_3E7_Dlc:*/
on envVar E_pubc_BDC_BDC_3E7_Dlc
{
    if(getValue(E_pubc_BDC_BDC_3E7_enDlc))
    {
        Msg_BDC_3E7.dlc =getValue(this);
    }
    else
    {   
	   Msg_BDC_3E7.dlc = 8;
	   	
  }
}
/*@@end*/

/*@@envVar:E_pubc_BDC_BDC_3E7_enDlc:*/
on envVar E_pubc_BDC_BDC_3E7_enDlc
{
    //For Messages with DLC = 8, set wrong DLC to smaller than defined DLC
    //For Messages with DLC < 8 set wrong DLC to smaller/longer than defined DLC
    if(getValue(this))
    {
        Msg_BDC_3E7.dlc =getValue(E_pubc_BDC_BDC_3E7_Dlc);
    }
    else
    {
	   Msg_BDC_3E7.dlc = 8;
			
    }
}
/*@@end*/


/*@@envVar:E_pubc_BDC_BDC_3E7_BCM_Status_Temp_Rv:*/
on envVar E_pubc_BDC_BDC_3E7_BCM_Status_Temp_Rv
{
    int64 rawValue = 0ll;
    float rawValue_float = 0.0;
    float phyValue = 0.0;        

    //set the signal with updated raw value
    if(getValue(E_pubc_BDC_BDC_3E7_BCM_Status_Temp_SetVt)==0)
    {
        rawValue = getvalue(this);
        if(chgEv_BDC_3E7_BCM_Status_Temp == 0)
        {
            //type conversion to float
            rawValue_float = rawValue;        
            // raw to physical conversion
            phyValue = ((rawValue_float *1)+(0));
            putValue(E_pubc_BDC_BDC_3E7_BCM_Status_Temp_Pv, phyValue);
            chgEv_BDC_3E7_BCM_Status_Temp = 1;
        }
        else
        {
            chgEv_BDC_3E7_BCM_Status_Temp = 0;
        }    
        //update the signal value
        Msg_BDC_3E7.BCM_Status_Temp=rawValue;        
    }                                                                           
}
/*@@end*/

/*@@envVar:E_pubc_BDC_BDC_3E7_BCM_Status_Temp_Pv:*/
on envVar E_pubc_BDC_BDC_3E7_BCM_Status_Temp_Pv
{
    int64 rawValue = 0ll;
    float phyValue = 0.0;
    
    //update the raw value with physical value 
    if(getValue(E_pubc_BDC_BDC_3E7_BCM_Status_Temp_SetVt)==0)
    {
        if(chgEv_BDC_3E7_BCM_Status_Temp == 0)
        {
            phyValue = getvalue(this);
            // physical to raw conversion
            rawValue = ((phyValue -(0))/1);
            putValue(E_pubc_BDC_BDC_3E7_BCM_Status_Temp_Rv, rawValue);
            chgEv_BDC_3E7_BCM_Status_Temp = 1;  
        }
        else
        {
            chgEv_BDC_3E7_BCM_Status_Temp = 0;
        }
    }
}
/*@@end*/

/*@@envVar:E_pubc_BDC_BDC_3E7_BCM_Status_Temp_Vt:*/
on envVar E_pubc_BDC_BDC_3E7_BCM_Status_Temp_Vt
{
    qword rawValue = 0ll;
    if(getValue(E_pubc_BDC_BDC_3E7_BCM_Status_Temp_SetVt))
    {
        //update the signal value
        Msg_BDC_3E7.BCM_Status_Temp=getValue(this);
    }
}
/*@@end*/

/*@@envVar:E_pubc_BDC_BDC_3E7_BCM_Status_Temp_SetVt:*/
on envVar E_pubc_BDC_BDC_3E7_BCM_Status_Temp_SetVt
{
    if(getValue(E_pubc_BDC_BDC_3E7_BCM_Status_Temp_SetVt))
    {
        //update the signal value
        Msg_BDC_3E7.BCM_Status_Temp=getvalue(E_pubc_BDC_BDC_3E7_BCM_Status_Temp_Vt);
    }
    else
    {
        Msg_BDC_3E7.BCM_Status_Temp=getValue(E_pubc_BDC_BDC_3E7_BCM_Status_Temp_Rv);
    }
}
/*@@end*/
 
/*@@envVar:E_pubc_BDC_BDC_3E7_BCM_T_BATT_Rv:*/
on envVar E_pubc_BDC_BDC_3E7_BCM_T_BATT_Rv
{
    int64 rawValue = 0ll;
    float rawValue_float = 0.0;
    float phyValue = 0.0;        

    //set the signal with updated raw value
    if(getValue(E_pubc_BDC_BDC_3E7_BCM_T_BATT_SetVt)==0)
    {
        rawValue = getvalue(this);
        if(chgEv_BDC_3E7_BCM_T_BATT == 0)
        {
            //type conversion to float
            rawValue_float = rawValue;        
            // raw to physical conversion
            phyValue = ((rawValue_float *1)+(-40));
            putValue(E_pubc_BDC_BDC_3E7_BCM_T_BATT_Pv, phyValue);
            chgEv_BDC_3E7_BCM_T_BATT = 1;
        }
        else
        {
            chgEv_BDC_3E7_BCM_T_BATT = 0;
        }    
        //update the signal value
        Msg_BDC_3E7.BCM_T_BATT=rawValue;        
    }                                                                           
}
/*@@end*/

/*@@envVar:E_pubc_BDC_BDC_3E7_BCM_T_BATT_Pv:*/
on envVar E_pubc_BDC_BDC_3E7_BCM_T_BATT_Pv
{
    int64 rawValue = 0ll;
    float phyValue = 0.0;
    
    //update the raw value with physical value 
    if(getValue(E_pubc_BDC_BDC_3E7_BCM_T_BATT_SetVt)==0)
    {
        if(chgEv_BDC_3E7_BCM_T_BATT == 0)
        {
            phyValue = getvalue(this);
            // physical to raw conversion
            rawValue = ((phyValue -(-40))/1);
            putValue(E_pubc_BDC_BDC_3E7_BCM_T_BATT_Rv, rawValue);
            chgEv_BDC_3E7_BCM_T_BATT = 1;  
        }
        else
        {
            chgEv_BDC_3E7_BCM_T_BATT = 0;
        }
    }
}
/*@@end*/

/*@@envVar:E_pubc_BDC_BDC_3E7_BCM_T_BATT_Vt:*/
on envVar E_pubc_BDC_BDC_3E7_BCM_T_BATT_Vt
{
    qword rawValue = 0ll;
    if(getValue(E_pubc_BDC_BDC_3E7_BCM_T_BATT_SetVt))
    {
        //update the signal value
        Msg_BDC_3E7.BCM_T_BATT=getValue(this);
    }
}
/*@@end*/

/*@@envVar:E_pubc_BDC_BDC_3E7_BCM_T_BATT_SetVt:*/
on envVar E_pubc_BDC_BDC_3E7_BCM_T_BATT_SetVt
{
    if(getValue(E_pubc_BDC_BDC_3E7_BCM_T_BATT_SetVt))
    {
        //update the signal value
        Msg_BDC_3E7.BCM_T_BATT=getvalue(E_pubc_BDC_BDC_3E7_BCM_T_BATT_Vt);
    }
    else
    {
        Msg_BDC_3E7.BCM_T_BATT=getValue(E_pubc_BDC_BDC_3E7_BCM_T_BATT_Rv);
    }
}
/*@@end*/
 
/*@@envVar:E_pubc_BDC_BDC_3E8_tx:*/
on envVar E_pubc_BDC_BDC_3E8_tx
{
    if(getValue(this))
    {       
        

        output(Msg_BDC_3E8);        
    }
}
/*@@end*/

/*@@envVar:E_pubc_BDC_BDC_3E8_Range:*/
on envVar E_pubc_BDC_BDC_3E8_Range
{
    qword rawstatus = 0ll;
    qword rawValue = 0ll;    
    
    rawstatus = getvalue(this);    
    // set all the signals with min raw /max raw /init raw
    switch (rawstatus) 
    {
     case(0) :
        rawValue= 0;
        putValue(E_pubc_BDC_BDC_3E8_BCM_SOF_Q_STATE_Rv, rawValue);
        rawValue= 0;
        putValue(E_pubc_BDC_BDC_3E8_BCM_SOF_Q_Rv, rawValue);
        break;
     case(1) :
        rawValue= 3;
        putValue(E_pubc_BDC_BDC_3E8_BCM_SOF_Q_STATE_Rv, rawValue);
        rawValue= 254;
        putValue(E_pubc_BDC_BDC_3E8_BCM_SOF_Q_Rv, rawValue);
        break;
     default :
        rawValue= 0;
        putValue(E_pubc_BDC_BDC_3E8_BCM_SOF_Q_STATE_Rv, rawValue);
        rawValue= 0;
        putValue(E_pubc_BDC_BDC_3E8_BCM_SOF_Q_Rv, rawValue);
      break;
   }
}
/*@@end*/

/*@@envVar:E_pubc_BDC_BDC_3E8_Dlc:*/
on envVar E_pubc_BDC_BDC_3E8_Dlc
{
    if(getValue(E_pubc_BDC_BDC_3E8_enDlc))
    {
        Msg_BDC_3E8.dlc =getValue(this);
    }
    else
    {   
	   Msg_BDC_3E8.dlc = 8;
	   	
  }
}
/*@@end*/

/*@@envVar:E_pubc_BDC_BDC_3E8_enDlc:*/
on envVar E_pubc_BDC_BDC_3E8_enDlc
{
    //For Messages with DLC = 8, set wrong DLC to smaller than defined DLC
    //For Messages with DLC < 8 set wrong DLC to smaller/longer than defined DLC
    if(getValue(this))
    {
        Msg_BDC_3E8.dlc =getValue(E_pubc_BDC_BDC_3E8_Dlc);
    }
    else
    {
	   Msg_BDC_3E8.dlc = 8;
			
    }
}
/*@@end*/


/*@@envVar:E_pubc_BDC_BDC_3E8_BCM_SOF_Q_STATE_Rv:*/
on envVar E_pubc_BDC_BDC_3E8_BCM_SOF_Q_STATE_Rv
{
    int64 rawValue = 0ll;
    float rawValue_float = 0.0;
    float phyValue = 0.0;        

    //set the signal with updated raw value
    if(getValue(E_pubc_BDC_BDC_3E8_BCM_SOF_Q_STATE_SetVt)==0)
    {
        rawValue = getvalue(this);
        if(chgEv_BDC_3E8_BCM_SOF_Q_STATE == 0)
        {
            //type conversion to float
            rawValue_float = rawValue;        
            // raw to physical conversion
            phyValue = ((rawValue_float *1)+(0));
            putValue(E_pubc_BDC_BDC_3E8_BCM_SOF_Q_STATE_Pv, phyValue);
            chgEv_BDC_3E8_BCM_SOF_Q_STATE = 1;
        }
        else
        {
            chgEv_BDC_3E8_BCM_SOF_Q_STATE = 0;
        }    
        //update the signal value
        Msg_BDC_3E8.BCM_SOF_Q_STATE=rawValue;        
    }                                                                           
}
/*@@end*/

/*@@envVar:E_pubc_BDC_BDC_3E8_BCM_SOF_Q_STATE_Pv:*/
on envVar E_pubc_BDC_BDC_3E8_BCM_SOF_Q_STATE_Pv
{
    int64 rawValue = 0ll;
    float phyValue = 0.0;
    
    //update the raw value with physical value 
    if(getValue(E_pubc_BDC_BDC_3E8_BCM_SOF_Q_STATE_SetVt)==0)
    {
        if(chgEv_BDC_3E8_BCM_SOF_Q_STATE == 0)
        {
            phyValue = getvalue(this);
            // physical to raw conversion
            rawValue = ((phyValue -(0))/1);
            putValue(E_pubc_BDC_BDC_3E8_BCM_SOF_Q_STATE_Rv, rawValue);
            chgEv_BDC_3E8_BCM_SOF_Q_STATE = 1;  
        }
        else
        {
            chgEv_BDC_3E8_BCM_SOF_Q_STATE = 0;
        }
    }
}
/*@@end*/

/*@@envVar:E_pubc_BDC_BDC_3E8_BCM_SOF_Q_STATE_Vt:*/
on envVar E_pubc_BDC_BDC_3E8_BCM_SOF_Q_STATE_Vt
{
    qword rawValue = 0ll;
    if(getValue(E_pubc_BDC_BDC_3E8_BCM_SOF_Q_STATE_SetVt))
    {
        //update the signal value
        Msg_BDC_3E8.BCM_SOF_Q_STATE=getValue(this);
    }
}
/*@@end*/

/*@@envVar:E_pubc_BDC_BDC_3E8_BCM_SOF_Q_STATE_SetVt:*/
on envVar E_pubc_BDC_BDC_3E8_BCM_SOF_Q_STATE_SetVt
{
    if(getValue(E_pubc_BDC_BDC_3E8_BCM_SOF_Q_STATE_SetVt))
    {
        //update the signal value
        Msg_BDC_3E8.BCM_SOF_Q_STATE=getvalue(E_pubc_BDC_BDC_3E8_BCM_SOF_Q_STATE_Vt);
    }
    else
    {
        Msg_BDC_3E8.BCM_SOF_Q_STATE=getValue(E_pubc_BDC_BDC_3E8_BCM_SOF_Q_STATE_Rv);
    }
}
/*@@end*/
 
/*@@envVar:E_pubc_BDC_BDC_3E8_BCM_SOF_Q_Rv:*/
on envVar E_pubc_BDC_BDC_3E8_BCM_SOF_Q_Rv
{
    int64 rawValue = 0ll;
    float rawValue_float = 0.0;
    float phyValue = 0.0;        

    //set the signal with updated raw value
    if(getValue(E_pubc_BDC_BDC_3E8_BCM_SOF_Q_SetVt)==0)
    {
        rawValue = getvalue(this);
        if(chgEv_BDC_3E8_BCM_SOF_Q == 0)
        {
            //type conversion to float
            rawValue_float = rawValue;        
            // raw to physical conversion
            phyValue = ((rawValue_float *0.5)+(0));
            putValue(E_pubc_BDC_BDC_3E8_BCM_SOF_Q_Pv, phyValue);
            chgEv_BDC_3E8_BCM_SOF_Q = 1;
        }
        else
        {
            chgEv_BDC_3E8_BCM_SOF_Q = 0;
        }    
        //update the signal value
        Msg_BDC_3E8.BCM_SOF_Q=rawValue;        
    }                                                                           
}
/*@@end*/

/*@@envVar:E_pubc_BDC_BDC_3E8_BCM_SOF_Q_Pv:*/
on envVar E_pubc_BDC_BDC_3E8_BCM_SOF_Q_Pv
{
    int64 rawValue = 0ll;
    float phyValue = 0.0;
    
    //update the raw value with physical value 
    if(getValue(E_pubc_BDC_BDC_3E8_BCM_SOF_Q_SetVt)==0)
    {
        if(chgEv_BDC_3E8_BCM_SOF_Q == 0)
        {
            phyValue = getvalue(this);
            // physical to raw conversion
            rawValue = ((phyValue -(0))/0.5);
            putValue(E_pubc_BDC_BDC_3E8_BCM_SOF_Q_Rv, rawValue);
            chgEv_BDC_3E8_BCM_SOF_Q = 1;  
        }
        else
        {
            chgEv_BDC_3E8_BCM_SOF_Q = 0;
        }
    }
}
/*@@end*/

/*@@envVar:E_pubc_BDC_BDC_3E8_BCM_SOF_Q_Vt:*/
on envVar E_pubc_BDC_BDC_3E8_BCM_SOF_Q_Vt
{
    qword rawValue = 0ll;
    if(getValue(E_pubc_BDC_BDC_3E8_BCM_SOF_Q_SetVt))
    {
        //update the signal value
        Msg_BDC_3E8.BCM_SOF_Q=getValue(this);
    }
}
/*@@end*/

/*@@envVar:E_pubc_BDC_BDC_3E8_BCM_SOF_Q_SetVt:*/
on envVar E_pubc_BDC_BDC_3E8_BCM_SOF_Q_SetVt
{
    if(getValue(E_pubc_BDC_BDC_3E8_BCM_SOF_Q_SetVt))
    {
        //update the signal value
        Msg_BDC_3E8.BCM_SOF_Q=getvalue(E_pubc_BDC_BDC_3E8_BCM_SOF_Q_Vt);
    }
    else
    {
        Msg_BDC_3E8.BCM_SOF_Q=getValue(E_pubc_BDC_BDC_3E8_BCM_SOF_Q_Rv);
    }
}
/*@@end*/
 
/*@@envVar:E_pubc_BDC_BDC_28B_tx:*/
on envVar E_pubc_BDC_BDC_28B_tx
{
    if(getValue(this))
    {       
        

        output(Msg_BDC_28B);        
    }
}
/*@@end*/

/*@@envVar:E_pubc_BDC_BDC_28B_Range:*/
on envVar E_pubc_BDC_BDC_28B_Range
{
    qword rawstatus = 0ll;
    qword rawValue = 0ll;    
    
    rawstatus = getvalue(this);    
    // set all the signals with min raw /max raw /init raw
    switch (rawstatus) 
    {
     case(0) :
        rawValue= 0;
        putValue(E_pubc_BDC_BDC_28B_LCM_LASSwitch_Rv, rawValue);
        rawValue= 0;
        putValue(E_pubc_BDC_BDC_28B_BCM_DriverDoorStatus_Rv, rawValue);
        rawValue= 0;
        putValue(E_pubc_BDC_BDC_28B_BCM_emergencylightstatus_Rv, rawValue);
        rawValue= 0;
        putValue(E_pubc_BDC_BDC_28B_BCM_LowBeamStatus_Rv, rawValue);
        rawValue= 0;
        putValue(E_pubc_BDC_BDC_28B_BCM_TurnIndicatorLeft_Rv, rawValue);
        rawValue= 0;
        putValue(E_pubc_BDC_BDC_28B_BCM_TurnLightSwitchSts_Rv, rawValue);
        rawValue= 0;
        putValue(E_pubc_BDC_BDC_28B_BCM_HighBeamStatus_Rv, rawValue);
        rawValue= 0;
        putValue(E_pubc_BDC_BDC_28B_BCM_TurnIndicatorRight_Rv, rawValue);
        rawValue= 0;
        putValue(E_pubc_BDC_BDC_28B_BCM_HoodStatus_Rv, rawValue);
        break;
     case(1) :
        rawValue= 3;
        putValue(E_pubc_BDC_BDC_28B_LCM_LASSwitch_Rv, rawValue);
        rawValue= 1;
        putValue(E_pubc_BDC_BDC_28B_BCM_DriverDoorStatus_Rv, rawValue);
        rawValue= 3;
        putValue(E_pubc_BDC_BDC_28B_BCM_emergencylightstatus_Rv, rawValue);
        rawValue= 3;
        putValue(E_pubc_BDC_BDC_28B_BCM_LowBeamStatus_Rv, rawValue);
        rawValue= 3;
        putValue(E_pubc_BDC_BDC_28B_BCM_TurnIndicatorLeft_Rv, rawValue);
        rawValue= 3;
        putValue(E_pubc_BDC_BDC_28B_BCM_TurnLightSwitchSts_Rv, rawValue);
        rawValue= 3;
        putValue(E_pubc_BDC_BDC_28B_BCM_HighBeamStatus_Rv, rawValue);
        rawValue= 3;
        putValue(E_pubc_BDC_BDC_28B_BCM_TurnIndicatorRight_Rv, rawValue);
        rawValue= 1;
        putValue(E_pubc_BDC_BDC_28B_BCM_HoodStatus_Rv, rawValue);
        break;
     default :
        rawValue= 0;
        putValue(E_pubc_BDC_BDC_28B_LCM_LASSwitch_Rv, rawValue);
        rawValue= 0;
        putValue(E_pubc_BDC_BDC_28B_BCM_DriverDoorStatus_Rv, rawValue);
        rawValue= 0;
        putValue(E_pubc_BDC_BDC_28B_BCM_emergencylightstatus_Rv, rawValue);
        rawValue= 0;
        putValue(E_pubc_BDC_BDC_28B_BCM_LowBeamStatus_Rv, rawValue);
        rawValue= 0;
        putValue(E_pubc_BDC_BDC_28B_BCM_TurnIndicatorLeft_Rv, rawValue);
        rawValue= 0;
        putValue(E_pubc_BDC_BDC_28B_BCM_TurnLightSwitchSts_Rv, rawValue);
        rawValue= 0;
        putValue(E_pubc_BDC_BDC_28B_BCM_HighBeamStatus_Rv, rawValue);
        rawValue= 0;
        putValue(E_pubc_BDC_BDC_28B_BCM_TurnIndicatorRight_Rv, rawValue);
        rawValue= 0;
        putValue(E_pubc_BDC_BDC_28B_BCM_HoodStatus_Rv, rawValue);
      break;
   }
}
/*@@end*/

/*@@envVar:E_pubc_BDC_BDC_28B_Dlc:*/
on envVar E_pubc_BDC_BDC_28B_Dlc
{
    if(getValue(E_pubc_BDC_BDC_28B_enDlc))
    {
        Msg_BDC_28B.dlc =getValue(this);
    }
    else
    {   
	   Msg_BDC_28B.dlc = 8;
	   	
  }
}
/*@@end*/

/*@@envVar:E_pubc_BDC_BDC_28B_enDlc:*/
on envVar E_pubc_BDC_BDC_28B_enDlc
{
    //For Messages with DLC = 8, set wrong DLC to smaller than defined DLC
    //For Messages with DLC < 8 set wrong DLC to smaller/longer than defined DLC
    if(getValue(this))
    {
        Msg_BDC_28B.dlc =getValue(E_pubc_BDC_BDC_28B_Dlc);
    }
    else
    {
	   Msg_BDC_28B.dlc = 8;
			
    }
}
/*@@end*/


/*@@envVar:E_pubc_BDC_BDC_28B_LCM_LASSwitch_Rv:*/
on envVar E_pubc_BDC_BDC_28B_LCM_LASSwitch_Rv
{
    int64 rawValue = 0ll;
    float rawValue_float = 0.0;
    float phyValue = 0.0;        

    //set the signal with updated raw value
    if(getValue(E_pubc_BDC_BDC_28B_LCM_LASSwitch_SetVt)==0)
    {
        rawValue = getvalue(this);
        if(chgEv_BDC_28B_LCM_LASSwitch == 0)
        {
            //type conversion to float
            rawValue_float = rawValue;        
            // raw to physical conversion
            phyValue = ((rawValue_float *1)+(0));
            putValue(E_pubc_BDC_BDC_28B_LCM_LASSwitch_Pv, phyValue);
            chgEv_BDC_28B_LCM_LASSwitch = 1;
        }
        else
        {
            chgEv_BDC_28B_LCM_LASSwitch = 0;
        }    
        //update the signal value
        Msg_BDC_28B.LCM_LASSwitch=rawValue;        
    }                                                                           
}
/*@@end*/

/*@@envVar:E_pubc_BDC_BDC_28B_LCM_LASSwitch_Pv:*/
on envVar E_pubc_BDC_BDC_28B_LCM_LASSwitch_Pv
{
    int64 rawValue = 0ll;
    float phyValue = 0.0;
    
    //update the raw value with physical value 
    if(getValue(E_pubc_BDC_BDC_28B_LCM_LASSwitch_SetVt)==0)
    {
        if(chgEv_BDC_28B_LCM_LASSwitch == 0)
        {
            phyValue = getvalue(this);
            // physical to raw conversion
            rawValue = ((phyValue -(0))/1);
            putValue(E_pubc_BDC_BDC_28B_LCM_LASSwitch_Rv, rawValue);
            chgEv_BDC_28B_LCM_LASSwitch = 1;  
        }
        else
        {
            chgEv_BDC_28B_LCM_LASSwitch = 0;
        }
    }
}
/*@@end*/

/*@@envVar:E_pubc_BDC_BDC_28B_LCM_LASSwitch_Vt:*/
on envVar E_pubc_BDC_BDC_28B_LCM_LASSwitch_Vt
{
    qword rawValue = 0ll;
    if(getValue(E_pubc_BDC_BDC_28B_LCM_LASSwitch_SetVt))
    {
        //update the signal value
        Msg_BDC_28B.LCM_LASSwitch=getValue(this);
    }
}
/*@@end*/

/*@@envVar:E_pubc_BDC_BDC_28B_LCM_LASSwitch_SetVt:*/
on envVar E_pubc_BDC_BDC_28B_LCM_LASSwitch_SetVt
{
    if(getValue(E_pubc_BDC_BDC_28B_LCM_LASSwitch_SetVt))
    {
        //update the signal value
        Msg_BDC_28B.LCM_LASSwitch=getvalue(E_pubc_BDC_BDC_28B_LCM_LASSwitch_Vt);
    }
    else
    {
        Msg_BDC_28B.LCM_LASSwitch=getValue(E_pubc_BDC_BDC_28B_LCM_LASSwitch_Rv);
    }
}
/*@@end*/
 
/*@@envVar:E_pubc_BDC_BDC_28B_BCM_DriverDoorStatus_Rv:*/
on envVar E_pubc_BDC_BDC_28B_BCM_DriverDoorStatus_Rv
{
    int64 rawValue = 0ll;
    float rawValue_float = 0.0;
    float phyValue = 0.0;        

    //set the signal with updated raw value
    if(getValue(E_pubc_BDC_BDC_28B_BCM_DriverDoorStatus_SetVt)==0)
    {
        rawValue = getvalue(this);
        if(chgEv_BDC_28B_BCM_DriverDoorStatus == 0)
        {
            //type conversion to float
            rawValue_float = rawValue;        
            // raw to physical conversion
            phyValue = ((rawValue_float *1)+(0));
            putValue(E_pubc_BDC_BDC_28B_BCM_DriverDoorStatus_Pv, phyValue);
            chgEv_BDC_28B_BCM_DriverDoorStatus = 1;
        }
        else
        {
            chgEv_BDC_28B_BCM_DriverDoorStatus = 0;
        }    
        //update the signal value
        Msg_BDC_28B.BCM_DriverDoorStatus=rawValue;        
    }                                                                           
}
/*@@end*/

/*@@envVar:E_pubc_BDC_BDC_28B_BCM_DriverDoorStatus_Pv:*/
on envVar E_pubc_BDC_BDC_28B_BCM_DriverDoorStatus_Pv
{
    int64 rawValue = 0ll;
    float phyValue = 0.0;
    
    //update the raw value with physical value 
    if(getValue(E_pubc_BDC_BDC_28B_BCM_DriverDoorStatus_SetVt)==0)
    {
        if(chgEv_BDC_28B_BCM_DriverDoorStatus == 0)
        {
            phyValue = getvalue(this);
            // physical to raw conversion
            rawValue = ((phyValue -(0))/1);
            putValue(E_pubc_BDC_BDC_28B_BCM_DriverDoorStatus_Rv, rawValue);
            chgEv_BDC_28B_BCM_DriverDoorStatus = 1;  
        }
        else
        {
            chgEv_BDC_28B_BCM_DriverDoorStatus = 0;
        }
    }
}
/*@@end*/

/*@@envVar:E_pubc_BDC_BDC_28B_BCM_DriverDoorStatus_Vt:*/
on envVar E_pubc_BDC_BDC_28B_BCM_DriverDoorStatus_Vt
{
    qword rawValue = 0ll;
    if(getValue(E_pubc_BDC_BDC_28B_BCM_DriverDoorStatus_SetVt))
    {
        //update the signal value
        Msg_BDC_28B.BCM_DriverDoorStatus=getValue(this);
    }
}
/*@@end*/

/*@@envVar:E_pubc_BDC_BDC_28B_BCM_DriverDoorStatus_SetVt:*/
on envVar E_pubc_BDC_BDC_28B_BCM_DriverDoorStatus_SetVt
{
    if(getValue(E_pubc_BDC_BDC_28B_BCM_DriverDoorStatus_SetVt))
    {
        //update the signal value
        Msg_BDC_28B.BCM_DriverDoorStatus=getvalue(E_pubc_BDC_BDC_28B_BCM_DriverDoorStatus_Vt);
    }
    else
    {
        Msg_BDC_28B.BCM_DriverDoorStatus=getValue(E_pubc_BDC_BDC_28B_BCM_DriverDoorStatus_Rv);
    }
}
/*@@end*/
/*@@envVar:E_pubc_BDC_BDC_28B_BCM_emergencylightstatus_Rv:*/
on envVar E_pubc_BDC_BDC_28B_BCM_emergencylightstatus_Rv
{
    int64 rawValue = 0ll;
    float rawValue_float = 0.0;
    float phyValue = 0.0;        

    //set the signal with updated raw value
    if(getValue(E_pubc_BDC_BDC_28B_BCM_emergencylightstatus_SetVt)==0)
    {
        rawValue = getvalue(this);
        if(chgEv_BDC_28B_BCM_emergencylightstatus == 0)
        {
            //type conversion to float
            rawValue_float = rawValue;        
            // raw to physical conversion
            phyValue = ((rawValue_float *1)+(0));
            putValue(E_pubc_BDC_BDC_28B_BCM_emergencylightstatus_Pv, phyValue);
            chgEv_BDC_28B_BCM_emergencylightstatus = 1;
        }
        else
        {
            chgEv_BDC_28B_BCM_emergencylightstatus = 0;
        }    
        //update the signal value
        Msg_BDC_28B.BCM_emergencylightstatus=rawValue;        
    }                                                                           
}
/*@@end*/

/*@@envVar:E_pubc_BDC_BDC_28B_BCM_emergencylightstatus_Pv:*/
on envVar E_pubc_BDC_BDC_28B_BCM_emergencylightstatus_Pv
{
    int64 rawValue = 0ll;
    float phyValue = 0.0;
    
    //update the raw value with physical value 
    if(getValue(E_pubc_BDC_BDC_28B_BCM_emergencylightstatus_SetVt)==0)
    {
        if(chgEv_BDC_28B_BCM_emergencylightstatus == 0)
        {
            phyValue = getvalue(this);
            // physical to raw conversion
            rawValue = ((phyValue -(0))/1);
            putValue(E_pubc_BDC_BDC_28B_BCM_emergencylightstatus_Rv, rawValue);
            chgEv_BDC_28B_BCM_emergencylightstatus = 1;  
        }
        else
        {
            chgEv_BDC_28B_BCM_emergencylightstatus = 0;
        }
    }
}
/*@@end*/

/*@@envVar:E_pubc_BDC_BDC_28B_BCM_emergencylightstatus_Vt:*/
on envVar E_pubc_BDC_BDC_28B_BCM_emergencylightstatus_Vt
{
    qword rawValue = 0ll;
    if(getValue(E_pubc_BDC_BDC_28B_BCM_emergencylightstatus_SetVt))
    {
        //update the signal value
        Msg_BDC_28B.BCM_emergencylightstatus=getValue(this);
    }
}
/*@@end*/

/*@@envVar:E_pubc_BDC_BDC_28B_BCM_emergencylightstatus_SetVt:*/
on envVar E_pubc_BDC_BDC_28B_BCM_emergencylightstatus_SetVt
{
    if(getValue(E_pubc_BDC_BDC_28B_BCM_emergencylightstatus_SetVt))
    {
        //update the signal value
        Msg_BDC_28B.BCM_emergencylightstatus=getvalue(E_pubc_BDC_BDC_28B_BCM_emergencylightstatus_Vt);
    }
    else
    {
        Msg_BDC_28B.BCM_emergencylightstatus=getValue(E_pubc_BDC_BDC_28B_BCM_emergencylightstatus_Rv);
    }
}
/*@@end*/
 
/*@@envVar:E_pubc_BDC_BDC_28B_BCM_LowBeamStatus_Rv:*/
on envVar E_pubc_BDC_BDC_28B_BCM_LowBeamStatus_Rv
{
    int64 rawValue = 0ll;
    float rawValue_float = 0.0;
    float phyValue = 0.0;        

    //set the signal with updated raw value
    if(getValue(E_pubc_BDC_BDC_28B_BCM_LowBeamStatus_SetVt)==0)
    {
        rawValue = getvalue(this);
        if(chgEv_BDC_28B_BCM_LowBeamStatus == 0)
        {
            //type conversion to float
            rawValue_float = rawValue;        
            // raw to physical conversion
            phyValue = ((rawValue_float *1)+(0));
            putValue(E_pubc_BDC_BDC_28B_BCM_LowBeamStatus_Pv, phyValue);
            chgEv_BDC_28B_BCM_LowBeamStatus = 1;
        }
        else
        {
            chgEv_BDC_28B_BCM_LowBeamStatus = 0;
        }    
        //update the signal value
        Msg_BDC_28B.BCM_LowBeamStatus=rawValue;        
    }                                                                           
}
/*@@end*/

/*@@envVar:E_pubc_BDC_BDC_28B_BCM_LowBeamStatus_Pv:*/
on envVar E_pubc_BDC_BDC_28B_BCM_LowBeamStatus_Pv
{
    int64 rawValue = 0ll;
    float phyValue = 0.0;
    
    //update the raw value with physical value 
    if(getValue(E_pubc_BDC_BDC_28B_BCM_LowBeamStatus_SetVt)==0)
    {
        if(chgEv_BDC_28B_BCM_LowBeamStatus == 0)
        {
            phyValue = getvalue(this);
            // physical to raw conversion
            rawValue = ((phyValue -(0))/1);
            putValue(E_pubc_BDC_BDC_28B_BCM_LowBeamStatus_Rv, rawValue);
            chgEv_BDC_28B_BCM_LowBeamStatus = 1;  
        }
        else
        {
            chgEv_BDC_28B_BCM_LowBeamStatus = 0;
        }
    }
}
/*@@end*/

/*@@envVar:E_pubc_BDC_BDC_28B_BCM_LowBeamStatus_Vt:*/
on envVar E_pubc_BDC_BDC_28B_BCM_LowBeamStatus_Vt
{
    qword rawValue = 0ll;
    if(getValue(E_pubc_BDC_BDC_28B_BCM_LowBeamStatus_SetVt))
    {
        //update the signal value
        Msg_BDC_28B.BCM_LowBeamStatus=getValue(this);
    }
}
/*@@end*/

/*@@envVar:E_pubc_BDC_BDC_28B_BCM_LowBeamStatus_SetVt:*/
on envVar E_pubc_BDC_BDC_28B_BCM_LowBeamStatus_SetVt
{
    if(getValue(E_pubc_BDC_BDC_28B_BCM_LowBeamStatus_SetVt))
    {
        //update the signal value
        Msg_BDC_28B.BCM_LowBeamStatus=getvalue(E_pubc_BDC_BDC_28B_BCM_LowBeamStatus_Vt);
    }
    else
    {
        Msg_BDC_28B.BCM_LowBeamStatus=getValue(E_pubc_BDC_BDC_28B_BCM_LowBeamStatus_Rv);
    }
}
/*@@end*/
 
/*@@envVar:E_pubc_BDC_BDC_28B_BCM_TurnIndicatorLeft_Rv:*/
on envVar E_pubc_BDC_BDC_28B_BCM_TurnIndicatorLeft_Rv
{
    int64 rawValue = 0ll;
    float rawValue_float = 0.0;
    float phyValue = 0.0;        

    //set the signal with updated raw value
    if(getValue(E_pubc_BDC_BDC_28B_BCM_TurnIndicatorLeft_SetVt)==0)
    {
        rawValue = getvalue(this);
        if(chgEv_BDC_28B_BCM_TurnIndicatorLeft == 0)
        {
            //type conversion to float
            rawValue_float = rawValue;        
            // raw to physical conversion
            phyValue = ((rawValue_float *1)+(0));
            putValue(E_pubc_BDC_BDC_28B_BCM_TurnIndicatorLeft_Pv, phyValue);
            chgEv_BDC_28B_BCM_TurnIndicatorLeft = 1;
        }
        else
        {
            chgEv_BDC_28B_BCM_TurnIndicatorLeft = 0;
        }    
        //update the signal value
        Msg_BDC_28B.BCM_TurnIndicatorLeft=rawValue;        
    }                                                                           
}
/*@@end*/

/*@@envVar:E_pubc_BDC_BDC_28B_BCM_TurnIndicatorLeft_Pv:*/
on envVar E_pubc_BDC_BDC_28B_BCM_TurnIndicatorLeft_Pv
{
    int64 rawValue = 0ll;
    float phyValue = 0.0;
    
    //update the raw value with physical value 
    if(getValue(E_pubc_BDC_BDC_28B_BCM_TurnIndicatorLeft_SetVt)==0)
    {
        if(chgEv_BDC_28B_BCM_TurnIndicatorLeft == 0)
        {
            phyValue = getvalue(this);
            // physical to raw conversion
            rawValue = ((phyValue -(0))/1);
            putValue(E_pubc_BDC_BDC_28B_BCM_TurnIndicatorLeft_Rv, rawValue);
            chgEv_BDC_28B_BCM_TurnIndicatorLeft = 1;  
        }
        else
        {
            chgEv_BDC_28B_BCM_TurnIndicatorLeft = 0;
        }
    }
}
/*@@end*/

/*@@envVar:E_pubc_BDC_BDC_28B_BCM_TurnIndicatorLeft_Vt:*/
on envVar E_pubc_BDC_BDC_28B_BCM_TurnIndicatorLeft_Vt
{
    qword rawValue = 0ll;
    if(getValue(E_pubc_BDC_BDC_28B_BCM_TurnIndicatorLeft_SetVt))
    {
        //update the signal value
        Msg_BDC_28B.BCM_TurnIndicatorLeft=getValue(this);
    }
}
/*@@end*/

/*@@envVar:E_pubc_BDC_BDC_28B_BCM_TurnIndicatorLeft_SetVt:*/
on envVar E_pubc_BDC_BDC_28B_BCM_TurnIndicatorLeft_SetVt
{
    if(getValue(E_pubc_BDC_BDC_28B_BCM_TurnIndicatorLeft_SetVt))
    {
        //update the signal value
        Msg_BDC_28B.BCM_TurnIndicatorLeft=getvalue(E_pubc_BDC_BDC_28B_BCM_TurnIndicatorLeft_Vt);
    }
    else
    {
        Msg_BDC_28B.BCM_TurnIndicatorLeft=getValue(E_pubc_BDC_BDC_28B_BCM_TurnIndicatorLeft_Rv);
    }
}
/*@@end*/
 
/*@@envVar:E_pubc_BDC_BDC_28B_BCM_TurnLightSwitchSts_Rv:*/
on envVar E_pubc_BDC_BDC_28B_BCM_TurnLightSwitchSts_Rv
{
    int64 rawValue = 0ll;
    float rawValue_float = 0.0;
    float phyValue = 0.0;        

    //set the signal with updated raw value
    if(getValue(E_pubc_BDC_BDC_28B_BCM_TurnLightSwitchSts_SetVt)==0)
    {
        rawValue = getvalue(this);
        if(chgEv_BDC_28B_BCM_TurnLightSwitchSts == 0)
        {
            //type conversion to float
            rawValue_float = rawValue;        
            // raw to physical conversion
            phyValue = ((rawValue_float *1)+(0));
            putValue(E_pubc_BDC_BDC_28B_BCM_TurnLightSwitchSts_Pv, phyValue);
            chgEv_BDC_28B_BCM_TurnLightSwitchSts = 1;
        }
        else
        {
            chgEv_BDC_28B_BCM_TurnLightSwitchSts = 0;
        }    
        //update the signal value
        Msg_BDC_28B.BCM_TurnLightSwitchSts=rawValue;        
    }                                                                           
}
/*@@end*/

/*@@envVar:E_pubc_BDC_BDC_28B_BCM_TurnLightSwitchSts_Pv:*/
on envVar E_pubc_BDC_BDC_28B_BCM_TurnLightSwitchSts_Pv
{
    int64 rawValue = 0ll;
    float phyValue = 0.0;
    
    //update the raw value with physical value 
    if(getValue(E_pubc_BDC_BDC_28B_BCM_TurnLightSwitchSts_SetVt)==0)
    {
        if(chgEv_BDC_28B_BCM_TurnLightSwitchSts == 0)
        {
            phyValue = getvalue(this);
            // physical to raw conversion
            rawValue = ((phyValue -(0))/1);
            putValue(E_pubc_BDC_BDC_28B_BCM_TurnLightSwitchSts_Rv, rawValue);
            chgEv_BDC_28B_BCM_TurnLightSwitchSts = 1;  
        }
        else
        {
            chgEv_BDC_28B_BCM_TurnLightSwitchSts = 0;
        }
    }
}
/*@@end*/

/*@@envVar:E_pubc_BDC_BDC_28B_BCM_TurnLightSwitchSts_Vt:*/
on envVar E_pubc_BDC_BDC_28B_BCM_TurnLightSwitchSts_Vt
{
    qword rawValue = 0ll;
    if(getValue(E_pubc_BDC_BDC_28B_BCM_TurnLightSwitchSts_SetVt))
    {
        //update the signal value
        Msg_BDC_28B.BCM_TurnLightSwitchSts=getValue(this);
    }
}
/*@@end*/

/*@@envVar:E_pubc_BDC_BDC_28B_BCM_TurnLightSwitchSts_SetVt:*/
on envVar E_pubc_BDC_BDC_28B_BCM_TurnLightSwitchSts_SetVt
{
    if(getValue(E_pubc_BDC_BDC_28B_BCM_TurnLightSwitchSts_SetVt))
    {
        //update the signal value
        Msg_BDC_28B.BCM_TurnLightSwitchSts=getvalue(E_pubc_BDC_BDC_28B_BCM_TurnLightSwitchSts_Vt);
    }
    else
    {
        Msg_BDC_28B.BCM_TurnLightSwitchSts=getValue(E_pubc_BDC_BDC_28B_BCM_TurnLightSwitchSts_Rv);
    }
}
/*@@end*/
 
/*@@envVar:E_pubc_BDC_BDC_28B_BCM_HighBeamStatus_Rv:*/
on envVar E_pubc_BDC_BDC_28B_BCM_HighBeamStatus_Rv
{
    int64 rawValue = 0ll;
    float rawValue_float = 0.0;
    float phyValue = 0.0;        

    //set the signal with updated raw value
    if(getValue(E_pubc_BDC_BDC_28B_BCM_HighBeamStatus_SetVt)==0)
    {
        rawValue = getvalue(this);
        if(chgEv_BDC_28B_BCM_HighBeamStatus == 0)
        {
            //type conversion to float
            rawValue_float = rawValue;        
            // raw to physical conversion
            phyValue = ((rawValue_float *1)+(0));
            putValue(E_pubc_BDC_BDC_28B_BCM_HighBeamStatus_Pv, phyValue);
            chgEv_BDC_28B_BCM_HighBeamStatus = 1;
        }
        else
        {
            chgEv_BDC_28B_BCM_HighBeamStatus = 0;
        }    
        //update the signal value
        Msg_BDC_28B.BCM_HighBeamStatus=rawValue;        
    }                                                                           
}
/*@@end*/

/*@@envVar:E_pubc_BDC_BDC_28B_BCM_HighBeamStatus_Pv:*/
on envVar E_pubc_BDC_BDC_28B_BCM_HighBeamStatus_Pv
{
    int64 rawValue = 0ll;
    float phyValue = 0.0;
    
    //update the raw value with physical value 
    if(getValue(E_pubc_BDC_BDC_28B_BCM_HighBeamStatus_SetVt)==0)
    {
        if(chgEv_BDC_28B_BCM_HighBeamStatus == 0)
        {
            phyValue = getvalue(this);
            // physical to raw conversion
            rawValue = ((phyValue -(0))/1);
            putValue(E_pubc_BDC_BDC_28B_BCM_HighBeamStatus_Rv, rawValue);
            chgEv_BDC_28B_BCM_HighBeamStatus = 1;  
        }
        else
        {
            chgEv_BDC_28B_BCM_HighBeamStatus = 0;
        }
    }
}
/*@@end*/

/*@@envVar:E_pubc_BDC_BDC_28B_BCM_HighBeamStatus_Vt:*/
on envVar E_pubc_BDC_BDC_28B_BCM_HighBeamStatus_Vt
{
    qword rawValue = 0ll;
    if(getValue(E_pubc_BDC_BDC_28B_BCM_HighBeamStatus_SetVt))
    {
        //update the signal value
        Msg_BDC_28B.BCM_HighBeamStatus=getValue(this);
    }
}
/*@@end*/

/*@@envVar:E_pubc_BDC_BDC_28B_BCM_HighBeamStatus_SetVt:*/
on envVar E_pubc_BDC_BDC_28B_BCM_HighBeamStatus_SetVt
{
    if(getValue(E_pubc_BDC_BDC_28B_BCM_HighBeamStatus_SetVt))
    {
        //update the signal value
        Msg_BDC_28B.BCM_HighBeamStatus=getvalue(E_pubc_BDC_BDC_28B_BCM_HighBeamStatus_Vt);
    }
    else
    {
        Msg_BDC_28B.BCM_HighBeamStatus=getValue(E_pubc_BDC_BDC_28B_BCM_HighBeamStatus_Rv);
    }
}
/*@@end*/
 
/*@@envVar:E_pubc_BDC_BDC_28B_BCM_TurnIndicatorRight_Rv:*/
on envVar E_pubc_BDC_BDC_28B_BCM_TurnIndicatorRight_Rv
{
    int64 rawValue = 0ll;
    float rawValue_float = 0.0;
    float phyValue = 0.0;        

    //set the signal with updated raw value
    if(getValue(E_pubc_BDC_BDC_28B_BCM_TurnIndicatorRight_SetVt)==0)
    {
        rawValue = getvalue(this);
        if(chgEv_BDC_28B_BCM_TurnIndicatorRight == 0)
        {
            //type conversion to float
            rawValue_float = rawValue;        
            // raw to physical conversion
            phyValue = ((rawValue_float *1)+(0));
            putValue(E_pubc_BDC_BDC_28B_BCM_TurnIndicatorRight_Pv, phyValue);
            chgEv_BDC_28B_BCM_TurnIndicatorRight = 1;
        }
        else
        {
            chgEv_BDC_28B_BCM_TurnIndicatorRight = 0;
        }    
        //update the signal value
        Msg_BDC_28B.BCM_TurnIndicatorRight=rawValue;        
    }                                                                           
}
/*@@end*/

/*@@envVar:E_pubc_BDC_BDC_28B_BCM_TurnIndicatorRight_Pv:*/
on envVar E_pubc_BDC_BDC_28B_BCM_TurnIndicatorRight_Pv
{
    int64 rawValue = 0ll;
    float phyValue = 0.0;
    
    //update the raw value with physical value 
    if(getValue(E_pubc_BDC_BDC_28B_BCM_TurnIndicatorRight_SetVt)==0)
    {
        if(chgEv_BDC_28B_BCM_TurnIndicatorRight == 0)
        {
            phyValue = getvalue(this);
            // physical to raw conversion
            rawValue = ((phyValue -(0))/1);
            putValue(E_pubc_BDC_BDC_28B_BCM_TurnIndicatorRight_Rv, rawValue);
            chgEv_BDC_28B_BCM_TurnIndicatorRight = 1;  
        }
        else
        {
            chgEv_BDC_28B_BCM_TurnIndicatorRight = 0;
        }
    }
}
/*@@end*/

/*@@envVar:E_pubc_BDC_BDC_28B_BCM_TurnIndicatorRight_Vt:*/
on envVar E_pubc_BDC_BDC_28B_BCM_TurnIndicatorRight_Vt
{
    qword rawValue = 0ll;
    if(getValue(E_pubc_BDC_BDC_28B_BCM_TurnIndicatorRight_SetVt))
    {
        //update the signal value
        Msg_BDC_28B.BCM_TurnIndicatorRight=getValue(this);
    }
}
/*@@end*/

/*@@envVar:E_pubc_BDC_BDC_28B_BCM_TurnIndicatorRight_SetVt:*/
on envVar E_pubc_BDC_BDC_28B_BCM_TurnIndicatorRight_SetVt
{
    if(getValue(E_pubc_BDC_BDC_28B_BCM_TurnIndicatorRight_SetVt))
    {
        //update the signal value
        Msg_BDC_28B.BCM_TurnIndicatorRight=getvalue(E_pubc_BDC_BDC_28B_BCM_TurnIndicatorRight_Vt);
    }
    else
    {
        Msg_BDC_28B.BCM_TurnIndicatorRight=getValue(E_pubc_BDC_BDC_28B_BCM_TurnIndicatorRight_Rv);
    }
}
/*@@end*/
 
/*@@envVar:E_pubc_BDC_BDC_28B_BCM_HoodStatus_Rv:*/
on envVar E_pubc_BDC_BDC_28B_BCM_HoodStatus_Rv
{
    int64 rawValue = 0ll;
    float rawValue_float = 0.0;
    float phyValue = 0.0;        

    //set the signal with updated raw value
    if(getValue(E_pubc_BDC_BDC_28B_BCM_HoodStatus_SetVt)==0)
    {
        rawValue = getvalue(this);
        if(chgEv_BDC_28B_BCM_HoodStatus == 0)
        {
            //type conversion to float
            rawValue_float = rawValue;        
            // raw to physical conversion
            phyValue = ((rawValue_float *1)+(0));
            putValue(E_pubc_BDC_BDC_28B_BCM_HoodStatus_Pv, phyValue);
            chgEv_BDC_28B_BCM_HoodStatus = 1;
        }
        else
        {
            chgEv_BDC_28B_BCM_HoodStatus = 0;
        }    
        //update the signal value
        Msg_BDC_28B.BCM_HoodStatus=rawValue;        
    }                                                                           
}
/*@@end*/

/*@@envVar:E_pubc_BDC_BDC_28B_BCM_HoodStatus_Pv:*/
on envVar E_pubc_BDC_BDC_28B_BCM_HoodStatus_Pv
{
    int64 rawValue = 0ll;
    float phyValue = 0.0;
    
    //update the raw value with physical value 
    if(getValue(E_pubc_BDC_BDC_28B_BCM_HoodStatus_SetVt)==0)
    {
        if(chgEv_BDC_28B_BCM_HoodStatus == 0)
        {
            phyValue = getvalue(this);
            // physical to raw conversion
            rawValue = ((phyValue -(0))/1);
            putValue(E_pubc_BDC_BDC_28B_BCM_HoodStatus_Rv, rawValue);
            chgEv_BDC_28B_BCM_HoodStatus = 1;  
        }
        else
        {
            chgEv_BDC_28B_BCM_HoodStatus = 0;
        }
    }
}
/*@@end*/

/*@@envVar:E_pubc_BDC_BDC_28B_BCM_HoodStatus_Vt:*/
on envVar E_pubc_BDC_BDC_28B_BCM_HoodStatus_Vt
{
    qword rawValue = 0ll;
    if(getValue(E_pubc_BDC_BDC_28B_BCM_HoodStatus_SetVt))
    {
        //update the signal value
        Msg_BDC_28B.BCM_HoodStatus=getValue(this);
    }
}
/*@@end*/

/*@@envVar:E_pubc_BDC_BDC_28B_BCM_HoodStatus_SetVt:*/
on envVar E_pubc_BDC_BDC_28B_BCM_HoodStatus_SetVt
{
    if(getValue(E_pubc_BDC_BDC_28B_BCM_HoodStatus_SetVt))
    {
        //update the signal value
        Msg_BDC_28B.BCM_HoodStatus=getvalue(E_pubc_BDC_BDC_28B_BCM_HoodStatus_Vt);
    }
    else
    {
        Msg_BDC_28B.BCM_HoodStatus=getValue(E_pubc_BDC_BDC_28B_BCM_HoodStatus_Rv);
    }
}
/*@@end*/
 












/*@@caplFunc:calc_SAE_J1850(int[],int):*/
int calc_SAE_J1850(int data[], int Crc_len)
	{
		int idx,crc,temp,temp1;
		crc = 0xFF;
        idx = 0;
        temp = 0;
        temp1 = 0;
	
        for(idx=0;idx < Crc_len;idx++)
        {
			temp1 = data[idx];
			temp = (crc^temp1);
			crc = CRC_J1850_Table[temp];
        }
		crc ^= 0xFF;
		return crc;
	}


/*	int calc_SAE_J1851(int data[], int Crc_len)
	{
		int crc;
		
        crc = (data[0]+data[1]+data[2]+data[3]+data[4]+data[5]+data[6]) ;
          
		crc ^= 255;
		return crc;
	}*/

	

/* 	int calc_SAE_J1850(int data[], int Crc_len)
	{
		int idx,crc,temp,temp1,temp2,idy;
		crc = 0xFF;
        idx = 0;
        idy = 0;
        temp = 0;
        temp1 = 0;
        temp2 = 0;
	
        for(idx=0;idx < Crc_len;idx++)
        {
         temp1 = data[idx];
         crc = (crc^temp1);
          for (idy=8; idy>0; idy--)
          {
              // Save the value before the top bit is shifted out.
              temp2 = crc;
              crc <<= 1;
              if (0 != (temp2 & 128))
              {
                  crc ^= 0x2f;
              }
          } 
          
         //crc = CRC_J1850_Table[temp];
        }
		crc ^= 0xFF;
		return crc;
	} */
/*@@end*/

/*@@Capl function to calculate CANFD Dlc*/
int Calc_Canfd_dlc(byte Dbc_dlc1)
	{
		if(Dbc_dlc > 8)
		    {
			 while (i<=7)
			  {
				if (CANFD_DLC[i]==Dbc_dlc)
				{
				return CAN_DLC[i];
				 break;
				}
				i++ ;
			}
		}
    else
	
	return Dbc_dlc1 ;
	
		
	}
	
	int calc_Checksum(int data[], int Crc_len)
 {
	int crc;
	crc=0x00;
	
    crc = (data[0]+data[1]+data[2]+data[3]+data[4]+data[5]+data[6]) ;
      
	crc ^= 255;
	return crc;
 }
	//For Messages with DLC = 8, CAN FD data length =8
	//For Messages with DLC = 9, CAN FD data length =12
	//For Messages with DLC = 10, CAN FD data length =16
	//For Messages with DLC = 11, CAN FD data length =20
	//For Messages with DLC = 12, CAN FD data length =24
	//For Messages with DLC = 13, CAN FD data length =32
	//For Messages with DLC = 14, CAN FD data length =48
	//For Messages with DLC = 15, CAN FD data length =64
/*@@end*/
	

