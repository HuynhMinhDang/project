
/*@@var:*/
variables
{
    //Used interact between raw and the physical environment variables
    byte chgEv_EPBi_15D_ESP_LongAccel = 0;
    byte chgEv_EPBi_15D_ESP_YawRateValid = 0;
    byte chgEv_EPBi_15D_ESP_YawRate = 0;
    byte chgEv_EPBi_15D_ESP_LatAccel = 0;
    
    message EPBi_15D        Msg_EPBi_15D;
    msTimer Tm_EPBi_15D;
    int Cycle_EPBi_15D = 10;
    
    int EPBi_15D_ESP_CRCCheck_278_counter =0;
    int EPBi_15D_ESP_CRCCheck_278_wrongvalctr =0;
    int EPBi_15D_ESP_RollingCounter_278_counter =0;
    int EPBi_15D_ESP_RollingCounter_278_wrongvalctr =0;
    
    //CRC Polynomial for MQB     
    byte cb_ChkSum_POLY_MQB =0x2F;
	// CANFD DLC
	byte Dbc_dlc;
	int i=0;
	char CAN_DLC[7]={9,10,11,12,13,14,15};
	char CANFD_DLC[7]={12,16,20,24,32,48,64};
    

    
        byte CRC_J1850_Table[256] = {
 /*0 - 7*/  0x00, 0x1D, 0x3A, 0x27, 0x74, 0x69, 0x4E, 0x53,
 /*8 - 15*/ 0xE8, 0xF5, 0xD2, 0xCF, 0x9C, 0x81, 0xA6, 0xBB,
 /*16 - 23*/ 0xCD, 0xD0, 0xF7, 0xEA, 0xB9, 0xA4, 0x83, 0x9E,
 /*24 - 31*/ 0x25, 0x38, 0x1F, 0x02, 0x51, 0x4C, 0x6B, 0x76,
 /*32 - 39*/ 0x87, 0x9A, 0xBD, 0xA0, 0xF3, 0xEE, 0xC9, 0xD4,
 /*40 - 47*/ 0x6F, 0x72, 0x55, 0x48, 0x1B, 0x06, 0x21, 0x3C,
 /*48 - 55*/ 0x4A, 0x57, 0x70, 0x6D, 0x3E, 0x23, 0x04, 0x19,
 /*56 - 63*/ 0xA2, 0xBF, 0x98, 0x85, 0xD6, 0xCB, 0xEC, 0xF1,
 /*64 - 71*/  0x13, 0x0E, 0x29, 0x34, 0x67, 0x7A, 0x5D, 0x40,
 /*72 - 79*/ 0xFB, 0xE6, 0xC1, 0xDC, 0x8F, 0x92, 0xB5, 0xA8,
 /*80 - 87*/ 0xDE, 0xC3, 0xE4, 0xF9, 0xAA, 0xB7, 0x90, 0x8D,
 /*88 - 95*/ 0x36, 0x2B, 0x0C, 0x11, 0x42, 0x5F, 0x78, 0x65,
 /*96 - 103*/ 0x94, 0x89, 0xAE, 0xB3, 0xE0, 0xFD, 0xDA, 0xC7,
 /*104 - 111*/ 0x7C, 0x61, 0x46, 0x5B, 0x08, 0x15, 0x32, 0x2F,
 /*112 - 119*/ 0x59, 0x44, 0x63, 0x7E, 0x2D, 0x30, 0x17, 0x0A,
 /*120 - 127*/ 0xB1, 0xAC, 0x8B, 0x96, 0xC5, 0xD8, 0xFF, 0xE2,
 /*128 - 135*/ 0x26, 0x3B, 0x1C, 0x01, 0x52, 0x4F, 0x68, 0x75,
 /*136 - 143*/ 0xCE, 0xD3, 0xF4, 0xE9, 0xBA, 0xA7, 0x80, 0x9D,
 /*144 - 151*/ 0xEB, 0xF6, 0xD1, 0xCC, 0x9F, 0x82, 0xA5, 0xB8,
 /*152 - 159*/ 0x03, 0x1E, 0x39, 0x24, 0x77, 0x6A, 0x4D, 0x50,
 /*160 - 167*/ 0xA1, 0xBC, 0x9B, 0x86, 0xD5, 0xC8, 0xEF, 0xF2,
 /*168 - 175*/ 0x49, 0x54, 0x73, 0x6E, 0x3D, 0x20, 0x07, 0x1A,
 /*176 - 183*/ 0x6C, 0x71, 0x56, 0x4B, 0x18, 0x05, 0x22, 0x3F,
 /*184 - 191*/ 0x84, 0x99, 0xBE, 0xA3, 0xF0, 0xED, 0xCA, 0xD7,
 /*192 - 199*/ 0x35, 0x28, 0x0F, 0x12, 0x41, 0x5C, 0x7B, 0x66,
 /*200 - 207*/ 0xDD, 0xC0, 0xE7, 0xFA, 0xA9, 0xB4, 0x93, 0x8E,
 /*208 - 215*/ 0xF8, 0xE5, 0xC2, 0xDF, 0x8C, 0x91, 0xB6, 0xAB,
 /*216 - 223*/ 0x10, 0x0D, 0x2A, 0x37, 0x64, 0x79, 0x5E, 0x43,
 /*224 - 231*/ 0xB2, 0xAF, 0x88, 0x95, 0xC6, 0xDB, 0xFC, 0xE1,
 /*232 - 239*/ 0x5A, 0x47, 0x60, 0x7D, 0x2E, 0x33, 0x14, 0x09,
 /*240 - 247*/ 0x7F, 0x62, 0x45, 0x58, 0x0B, 0x16, 0x31, 0x2C,
 /*248 - 255*/ 0x97, 0x8A, 0xAD, 0xB0, 0xE3, 0xFE, 0xD9, 0xC4
};

         
}
/*@@end*/


/*@@startStart:Start:*/
on start
{
    //Initialise cycle time and message timer 
    putValue(E_pubc_EPBi_EPBi_15D_cycleTm,Cycle_EPBi_15D);
    SetTimer( Tm_EPBi_15D,100);
    putValue(E_pubc_EPBi_EPBi_15D_Tm,1);
    
    //Initialise signals with init raw value
    Msg_EPBi_15D.ESP_LongAccel   =getvalue(E_pubc_EPBi_EPBi_15D_ESP_LongAccel_Rv);
    Msg_EPBi_15D.ESP_YawRateValid   =getvalue(E_pubc_EPBi_EPBi_15D_ESP_YawRateValid_Rv);
    Msg_EPBi_15D.ESP_YawRate   =getvalue(E_pubc_EPBi_EPBi_15D_ESP_YawRate_Rv);
    Msg_EPBi_15D.ESP_LatAccel   =getvalue(E_pubc_EPBi_EPBi_15D_ESP_LatAccel_Rv);
}
/*@@end*/

/*@@envVar:E_pubc_EPBi_CycMsgsON:*/
on envVar E_pubc_EPBi_CycMsgsON
{
    // enable all the cyclic messages 
    putValue(E_pubc_EPBi_EPBi_15D_Tm,1);
}
/*@@end*/

/*@@envVar:E_pubc_EPBi_CycMsgsOFF:*/
on envVar E_pubc_EPBi_CycMsgsOFF
{
    // disable all the cyclic messages
    putValue(E_pubc_EPBi_EPBi_15D_Tm,0);
    
}
/*@@end*/
/*@@timer:Tm_EPBi_15D:*/
on timer Tm_EPBi_15D
{
    //cyclic message timer 
    if(getValue(E_pubc_EPBi_EPBi_15D_Tm) == 1)
    {
        
		//update the BZ Signal
        if(EPBi_15D_ESP_RollingCounter_278_wrongvalctr == 0)
        {
            update_EPBi_15D_ESP_RollingCounter_278_counter();
            Msg_EPBi_15D.ESP_RollingCounter_278= EPBi_15D_ESP_RollingCounter_278_counter;
        }
        else if(EPBi_15D_ESP_RollingCounter_278_wrongvalctr > 0)
        {
			 EPBi_15D_ESP_RollingCounter_278_counter=EPBi_15D_ESP_RollingCounter_278_counter + EPBi_15D_ESP_RollingCounter_278_wrongvalctr;
			  Msg_EPBi_15D.ESP_RollingCounter_278= EPBi_15D_ESP_RollingCounter_278_counter;
             /*EPBi_15D_ESP_RollingCounter_278_wrongvalctr--;
             //if counter becomes zero, update panel controller to zero
             if(EPBi_15D_ESP_RollingCounter_278_wrongvalctr == 0)
             {
                putValue(E_pubc_EPBi_EPBi_15D_ESP_RollingCounter_278_wrongvalctr,0);
             }*/
        }
        else
        {
            // do nothing
        }
	
        update_EPBi_15D_CRC_CheckSum();
        output(Msg_EPBi_15D);
        
    }
    //Reset Timer
    SetTimer(Tm_EPBi_15D,Cycle_EPBi_15D);
}
/*@@end*/

/*@@envVar:E_pubc_EPBi_EPBi_15D_cycleTm:*/
on envVar E_pubc_EPBi_EPBi_15D_cycleTm
{
    // update the cycle time 
    Cycle_EPBi_15D=getvalue(this);
}
/*@@end*/

/*@@envVar:E_pubc_EPBi_EPBi_15D_tx:*/
on envVar E_pubc_EPBi_EPBi_15D_tx
{
    if(getValue(this))
    {       
        
        //update the BZ Signal
        if(EPBi_15D_ESP_RollingCounter_278_wrongvalctr == 0)
        {
            update_EPBi_15D_ESP_RollingCounter_278_counter();
            Msg_EPBi_15D.ESP_RollingCounter_278= EPBi_15D_ESP_RollingCounter_278_counter;
        }
        else if(EPBi_15D_ESP_RollingCounter_278_wrongvalctr > 0)
        {
			EPBi_15D_ESP_RollingCounter_278_counter=EPBi_15D_ESP_RollingCounter_278_counter + EPBi_15D_ESP_RollingCounter_278_wrongvalctr;
			 Msg_EPBi_15D.ESP_RollingCounter_278= EPBi_15D_ESP_RollingCounter_278_counter;
             /*EPBi_15D_ESP_RollingCounter_278_wrongvalctr--;
              // if counter becomes zero, update panel controller to zero
             if(EPBi_15D_ESP_RollingCounter_278_wrongvalctr == 0)
             {
                 putValue(E_pubc_EPBi_EPBi_15D_ESP_RollingCounter_278_wrongvalctr,0);
             } */
        }
        else
        { 
			// do nothing
        }    
        //calculate the CRC CheckSum
        update_EPBi_15D_CRC_CheckSum();

        output(Msg_EPBi_15D);        
    }
}
/*@@end*/

/*@@envVar:E_pubc_EPBi_EPBi_15D_Range:*/
on envVar E_pubc_EPBi_EPBi_15D_Range
{
    qword rawstatus = 0ll;
    qword rawValue = 0ll;    
    
    rawstatus = getvalue(this);    
    // set all the signals with min raw /max raw /init raw
    switch (rawstatus) 
    {
     case(0) :
        rawValue= 0;
        putValue(E_pubc_EPBi_EPBi_15D_ESP_LongAccel_Rv, rawValue);
        rawValue= 0;
        putValue(E_pubc_EPBi_EPBi_15D_ESP_YawRateValid_Rv, rawValue);
        rawValue= 0;
        putValue(E_pubc_EPBi_EPBi_15D_ESP_YawRate_Rv, rawValue);
        rawValue= 0;
        putValue(E_pubc_EPBi_EPBi_15D_ESP_LatAccel_Rv, rawValue);
        break;
     case(1) :
        rawValue= 1021;
        putValue(E_pubc_EPBi_EPBi_15D_ESP_LongAccel_Rv, rawValue);
        rawValue= 1;
        putValue(E_pubc_EPBi_EPBi_15D_ESP_YawRateValid_Rv, rawValue);
        rawValue= 16381;
        putValue(E_pubc_EPBi_EPBi_15D_ESP_YawRate_Rv, rawValue);
        rawValue= 253;
        putValue(E_pubc_EPBi_EPBi_15D_ESP_LatAccel_Rv, rawValue);
        break;
     default :
        rawValue= 0;
        putValue(E_pubc_EPBi_EPBi_15D_ESP_LongAccel_Rv, rawValue);
        rawValue= 0;
        putValue(E_pubc_EPBi_EPBi_15D_ESP_YawRateValid_Rv, rawValue);
        rawValue= 0;
        putValue(E_pubc_EPBi_EPBi_15D_ESP_YawRate_Rv, rawValue);
        rawValue= 0;
        putValue(E_pubc_EPBi_EPBi_15D_ESP_LatAccel_Rv, rawValue);
      break;
   }
}
/*@@end*/

/*@@envVar:E_pubc_EPBi_EPBi_15D_Dlc:*/
on envVar E_pubc_EPBi_EPBi_15D_Dlc
{
    if(getValue(E_pubc_EPBi_EPBi_15D_enDlc))
    {
        Msg_EPBi_15D.dlc =getValue(this);
    }
    else
    {   
	   Msg_EPBi_15D.dlc = 8;
	   	
  }
}
/*@@end*/

/*@@envVar:E_pubc_EPBi_EPBi_15D_enDlc:*/
on envVar E_pubc_EPBi_EPBi_15D_enDlc
{
    //For Messages with DLC = 8, set wrong DLC to smaller than defined DLC
    //For Messages with DLC < 8 set wrong DLC to smaller/longer than defined DLC
    if(getValue(this))
    {
        Msg_EPBi_15D.dlc =getValue(E_pubc_EPBi_EPBi_15D_Dlc);
    }
    else
    {
	   Msg_EPBi_15D.dlc = 8;
			
    }
}
/*@@end*/

/*@@envVar:E_pubc_EPBi_EPBi_15D_ESP_CRCCheck_278_wrongvalctr:*/
on envVar E_pubc_EPBi_EPBi_15D_ESP_CRCCheck_278_wrongvalctr
{
    //update disturb count
    //disturb value range:(-1 = always send wrong value),( X>0 ,x is the number of Messages with wrong CHK sent)
    EPBi_15D_ESP_CRCCheck_278_wrongvalctr =getValue(this);    
}
/*@@end*/
/*@@envVar:E_pubc_EPBi_EPBi_15D_ESP_RollingCounter_278_wrongvalctr:*/
on envVar E_pubc_EPBi_EPBi_15D_ESP_RollingCounter_278_wrongvalctr
{
    //update disturb count
    //disturb value range:(-1 = always send wrong value),( X>0 ,x is the number of Messages with wrong CHK sent)
    EPBi_15D_ESP_RollingCounter_278_wrongvalctr =getValue(this);    
}
/*@@end*/

/*@@envVar:E_pubc_EPBi_EPBi_15D_ESP_LongAccel_Rv:*/
on envVar E_pubc_EPBi_EPBi_15D_ESP_LongAccel_Rv
{
    int64 rawValue = 0ll;
    float rawValue_float = 0.0;
    float phyValue = 0.0;        

    //set the signal with updated raw value
    {
        rawValue = getvalue(this);
        if(chgEv_EPBi_15D_ESP_LongAccel == 0)
        {
            //type conversion to float
            rawValue_float = rawValue;        
            // raw to physical conversion
            phyValue = ((rawValue_float *0.03125)+(-16));
            putValue(E_pubc_EPBi_EPBi_15D_ESP_LongAccel_Pv, phyValue);
            chgEv_EPBi_15D_ESP_LongAccel = 1;
        }
        else
        {
            chgEv_EPBi_15D_ESP_LongAccel = 0;
        }    
        //update the signal value
        Msg_EPBi_15D.ESP_LongAccel=rawValue;        
    }                                                                           
}
/*@@end*/

/*@@envVar:E_pubc_EPBi_EPBi_15D_ESP_LongAccel_Pv:*/
on envVar E_pubc_EPBi_EPBi_15D_ESP_LongAccel_Pv
{
    int64 rawValue = 0ll;
    float phyValue = 0.0;
    
    //update the raw value with physical value 
    {
        if(chgEv_EPBi_15D_ESP_LongAccel == 0)
        {
            phyValue = getvalue(this);
            // physical to raw conversion
            rawValue = ((phyValue -(-16))/0.03125);
            putValue(E_pubc_EPBi_EPBi_15D_ESP_LongAccel_Rv, rawValue);
            chgEv_EPBi_15D_ESP_LongAccel = 1;  
        }
        else
        {
            chgEv_EPBi_15D_ESP_LongAccel = 0;
        }
    }
}
/*@@end*/


 
/*@@envVar:E_pubc_EPBi_EPBi_15D_ESP_YawRateValid_Rv:*/
on envVar E_pubc_EPBi_EPBi_15D_ESP_YawRateValid_Rv
{
    int64 rawValue = 0ll;
    float rawValue_float = 0.0;
    float phyValue = 0.0;        

    //set the signal with updated raw value
    if(getValue(E_pubc_EPBi_EPBi_15D_ESP_YawRateValid_SetVt)==0)
    {
        rawValue = getvalue(this);
        if(chgEv_EPBi_15D_ESP_YawRateValid == 0)
        {
            //type conversion to float
            rawValue_float = rawValue;        
            // raw to physical conversion
            phyValue = ((rawValue_float *1)+(0));
            putValue(E_pubc_EPBi_EPBi_15D_ESP_YawRateValid_Pv, phyValue);
            chgEv_EPBi_15D_ESP_YawRateValid = 1;
        }
        else
        {
            chgEv_EPBi_15D_ESP_YawRateValid = 0;
        }    
        //update the signal value
        Msg_EPBi_15D.ESP_YawRateValid=rawValue;        
    }                                                                           
}
/*@@end*/

/*@@envVar:E_pubc_EPBi_EPBi_15D_ESP_YawRateValid_Pv:*/
on envVar E_pubc_EPBi_EPBi_15D_ESP_YawRateValid_Pv
{
    int64 rawValue = 0ll;
    float phyValue = 0.0;
    
    //update the raw value with physical value 
    if(getValue(E_pubc_EPBi_EPBi_15D_ESP_YawRateValid_SetVt)==0)
    {
        if(chgEv_EPBi_15D_ESP_YawRateValid == 0)
        {
            phyValue = getvalue(this);
            // physical to raw conversion
            rawValue = ((phyValue -(0))/1);
            putValue(E_pubc_EPBi_EPBi_15D_ESP_YawRateValid_Rv, rawValue);
            chgEv_EPBi_15D_ESP_YawRateValid = 1;  
        }
        else
        {
            chgEv_EPBi_15D_ESP_YawRateValid = 0;
        }
    }
}
/*@@end*/

/*@@envVar:E_pubc_EPBi_EPBi_15D_ESP_YawRateValid_Vt:*/
on envVar E_pubc_EPBi_EPBi_15D_ESP_YawRateValid_Vt
{
    qword rawValue = 0ll;
    if(getValue(E_pubc_EPBi_EPBi_15D_ESP_YawRateValid_SetVt))
    {
        //update the signal value
        Msg_EPBi_15D.ESP_YawRateValid=getValue(this);
    }
}
/*@@end*/

/*@@envVar:E_pubc_EPBi_EPBi_15D_ESP_YawRateValid_SetVt:*/
on envVar E_pubc_EPBi_EPBi_15D_ESP_YawRateValid_SetVt
{
    if(getValue(E_pubc_EPBi_EPBi_15D_ESP_YawRateValid_SetVt))
    {
        //update the signal value
        Msg_EPBi_15D.ESP_YawRateValid=getvalue(E_pubc_EPBi_EPBi_15D_ESP_YawRateValid_Vt);
    }
    else
    {
        Msg_EPBi_15D.ESP_YawRateValid=getValue(E_pubc_EPBi_EPBi_15D_ESP_YawRateValid_Rv);
    }
}
/*@@end*/
 
/*@@envVar:E_pubc_EPBi_EPBi_15D_ESP_YawRate_Rv:*/
on envVar E_pubc_EPBi_EPBi_15D_ESP_YawRate_Rv
{
    int64 rawValue = 0ll;
    float rawValue_float = 0.0;
    float phyValue = 0.0;        

    //set the signal with updated raw value
    {
        rawValue = getvalue(this);
        if(chgEv_EPBi_15D_ESP_YawRate == 0)
        {
            //type conversion to float
            rawValue_float = rawValue;        
            // raw to physical conversion
            phyValue = ((rawValue_float *0.01)+(-81.91));
            putValue(E_pubc_EPBi_EPBi_15D_ESP_YawRate_Pv, phyValue);
            chgEv_EPBi_15D_ESP_YawRate = 1;
        }
        else
        {
            chgEv_EPBi_15D_ESP_YawRate = 0;
        }    
        //update the signal value
        Msg_EPBi_15D.ESP_YawRate=rawValue;        
    }                                                                           
}
/*@@end*/

/*@@envVar:E_pubc_EPBi_EPBi_15D_ESP_YawRate_Pv:*/
on envVar E_pubc_EPBi_EPBi_15D_ESP_YawRate_Pv
{
    int64 rawValue = 0ll;
    float phyValue = 0.0;
    
    //update the raw value with physical value 
    {
        if(chgEv_EPBi_15D_ESP_YawRate == 0)
        {
            phyValue = getvalue(this);
            // physical to raw conversion
            rawValue = ((phyValue -(-81.91))/0.01);
            putValue(E_pubc_EPBi_EPBi_15D_ESP_YawRate_Rv, rawValue);
            chgEv_EPBi_15D_ESP_YawRate = 1;  
        }
        else
        {
            chgEv_EPBi_15D_ESP_YawRate = 0;
        }
    }
}
/*@@end*/


 
/*@@envVar:E_pubc_EPBi_EPBi_15D_ESP_LatAccel_Rv:*/
on envVar E_pubc_EPBi_EPBi_15D_ESP_LatAccel_Rv
{
    int64 rawValue = 0ll;
    float rawValue_float = 0.0;
    float phyValue = 0.0;        

    //set the signal with updated raw value
    {
        rawValue = getvalue(this);
        if(chgEv_EPBi_15D_ESP_LatAccel == 0)
        {
            //type conversion to float
            rawValue_float = rawValue;        
            // raw to physical conversion
            phyValue = ((rawValue_float *0.1)+(-12.7));
            putValue(E_pubc_EPBi_EPBi_15D_ESP_LatAccel_Pv, phyValue);
            chgEv_EPBi_15D_ESP_LatAccel = 1;
        }
        else
        {
            chgEv_EPBi_15D_ESP_LatAccel = 0;
        }    
        //update the signal value
        Msg_EPBi_15D.ESP_LatAccel=rawValue;        
    }                                                                           
}
/*@@end*/

/*@@envVar:E_pubc_EPBi_EPBi_15D_ESP_LatAccel_Pv:*/
on envVar E_pubc_EPBi_EPBi_15D_ESP_LatAccel_Pv
{
    int64 rawValue = 0ll;
    float phyValue = 0.0;
    
    //update the raw value with physical value 
    {
        if(chgEv_EPBi_15D_ESP_LatAccel == 0)
        {
            phyValue = getvalue(this);
            // physical to raw conversion
            rawValue = ((phyValue -(-12.7))/0.1);
            putValue(E_pubc_EPBi_EPBi_15D_ESP_LatAccel_Rv, rawValue);
            chgEv_EPBi_15D_ESP_LatAccel = 1;  
        }
        else
        {
            chgEv_EPBi_15D_ESP_LatAccel = 0;
        }
    }
}
/*@@end*/


 

/*@@caplFunc:update_EPBi_15D_ESP_RollingCounter_278_counter():*///function
update_EPBi_15D_ESP_RollingCounter_278_counter()
{
    //update the signal value
    Msg_EPBi_15D.ESP_RollingCounter_278=EPBi_15D_ESP_RollingCounter_278_counter;
    
    if(EPBi_15D_ESP_RollingCounter_278_counter == 15)
    {
        EPBi_15D_ESP_RollingCounter_278_counter =0;
    }
    else
    {
        EPBi_15D_ESP_RollingCounter_278_counter =EPBi_15D_ESP_RollingCounter_278_counter+1;
    }    
    
}
/*@@end*/


/*@@caplFunc:update_EPBi_15D_CRC_CheckSum():*///function
update_EPBi_15D_CRC_CheckSum()
{
  int l_Crc_Len=0,l_count=0;
  int l_data[64];
 
  l_Crc_Len = 8-1;
  for (l_count=0;l_count<l_Crc_Len;l_count++)
    {
      l_data[l_count] = Msg_EPBi_15D.BYTE(l_count);    
    }
       
	Msg_EPBi_15D.BYTE(l_Crc_Len) = calc_SAE_J1850(l_data,l_Crc_Len); 

	
	if(EPBi_15D_ESP_CRCCheck_278_wrongvalctr != 0)
    {
		Msg_EPBi_15D.ESP_CRCCheck_278+=1; 
        //update signal with wrong CRC value
		if(EPBi_15D_ESP_CRCCheck_278_wrongvalctr > 0)
        {
             EPBi_15D_ESP_CRCCheck_278_wrongvalctr--;
              // if counter becomes zero, update panel controller to zero
             if(EPBi_15D_ESP_CRCCheck_278_wrongvalctr == 0)
             {
                 putValue(E_pubc_EPBi_EPBi_15D_ESP_CRCCheck_278_wrongvalctr,0);
             }
        }
	}
}
/*@@end*/









/*@@caplFunc:calc_SAE_J1850(int[],int):*/
int calc_SAE_J1850(int data[], int Crc_len)
	{
		int idx,crc,temp,temp1;
		crc = 0xFF;
        idx = 0;
        temp = 0;
        temp1 = 0;
	
        for(idx=0;idx < Crc_len;idx++)
        {
			temp1 = data[idx];
			temp = (crc^temp1);
			crc = CRC_J1850_Table[temp];
        }
		crc ^= 0xFF;
		return crc;
	}


/*	int calc_SAE_J1851(int data[], int Crc_len)
	{
		int crc;
		
        crc = (data[0]+data[1]+data[2]+data[3]+data[4]+data[5]+data[6]) ;
          
		crc ^= 255;
		return crc;
	}*/

	

/* 	int calc_SAE_J1850(int data[], int Crc_len)
	{
		int idx,crc,temp,temp1,temp2,idy;
		crc = 0xFF;
        idx = 0;
        idy = 0;
        temp = 0;
        temp1 = 0;
        temp2 = 0;
	
        for(idx=0;idx < Crc_len;idx++)
        {
         temp1 = data[idx];
         crc = (crc^temp1);
          for (idy=8; idy>0; idy--)
          {
              // Save the value before the top bit is shifted out.
              temp2 = crc;
              crc <<= 1;
              if (0 != (temp2 & 128))
              {
                  crc ^= 0x2f;
              }
          } 
          
         //crc = CRC_J1850_Table[temp];
        }
		crc ^= 0xFF;
		return crc;
	} */
/*@@end*/

/*@@Capl function to calculate CANFD Dlc*/
int Calc_Canfd_dlc(byte Dbc_dlc1)
	{
		if(Dbc_dlc > 8)
		    {
			 while (i<=7)
			  {
				if (CANFD_DLC[i]==Dbc_dlc)
				{
				return CAN_DLC[i];
				 break;
				}
				i++ ;
			}
		}
    else
	
	return Dbc_dlc1 ;
	
		
	}
	
	int calc_Checksum(int data[], int Crc_len)
 {
	int crc;
	crc=0x00;
	
    crc = (data[0]+data[1]+data[2]+data[3]+data[4]+data[5]+data[6]) ;
      
	crc ^= 255;
	return crc;
 }
	//For Messages with DLC = 8, CAN FD data length =8
	//For Messages with DLC = 9, CAN FD data length =12
	//For Messages with DLC = 10, CAN FD data length =16
	//For Messages with DLC = 11, CAN FD data length =20
	//For Messages with DLC = 12, CAN FD data length =24
	//For Messages with DLC = 13, CAN FD data length =32
	//For Messages with DLC = 14, CAN FD data length =48
	//For Messages with DLC = 15, CAN FD data length =64
/*@@end*/
	

