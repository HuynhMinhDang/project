/*@!Encoding:1252*/

variables
{
    //Used interact between raw and the physical environment variables
    byte chgEv_IBCU_20B_ESP_ABAactive = 0;
    byte chgEv_IBCU_20B_ESP_AWBavailable = 0;
    byte chgEv_IBCU_20B_ESP_PrefillActive = 0;
    byte chgEv_IBCU_20B_Wheel_Speed_RL_Data = 0;
    byte chgEv_IBCU_20B_Wheel_Speed_RL_Direction = 0;
    byte chgEv_IBCU_20B_Wheel_Speed_FR_Valid_Data = 0;
    byte chgEv_IBCU_20B_ESP_Vehicle_Speed_Reference = 0;
    byte chgEv_IBCU_20B_Wheel_Speed_FL_Pulse = 0;
    byte chgEv_IBCU_20B_ESP_PrefillAvailable = 0;
    byte chgEv_IBCU_20B_Wheel_Speed_FL_Valid_Data = 0;
    byte chgEv_IBCU_20B_Wheel_Speed_FR_Data = 0;
    byte chgEv_IBCU_20B_Wheel_Speed_FR_Pulse = 0;
    byte chgEv_IBCU_20B_ESP_ABAavailable = 0;
    byte chgEv_IBCU_20B_ESP_AEBdecActive = 0;
    byte chgEv_IBCU_20B_ESP_AWBactive = 0;
    byte chgEv_IBCU_20B_IBCU_BrakeDiscHighTempWarning = 0;
    byte chgEv_IBCU_20B_Wheel_Speed_RR_Direction = 0;
    byte chgEv_IBCU_20B_Wheel_Speed_RR_Data = 0;
    byte chgEv_IBCU_20B_ESP_TCSActive = 0;
    byte chgEv_IBCU_20B_ESP_HDC_STATUS = 0;
    byte chgEv_IBCU_20B_Wheel_Speed_FL_Data = 0;
    byte chgEv_IBCU_20B_Wheel_Speed_FL_Direction = 0;
    byte chgEv_IBCU_20B_ESP_AEBAvailable = 0;
    byte chgEv_IBCU_20B_Wheel_Speed_RR_Valid_Data = 0;
    byte chgEv_IBCU_20B_Wheel_Speed_FR_Direction = 0;
    byte chgEv_IBCU_20B_ESP_VDCActive = 0;
    byte chgEv_IBCU_20B_Wheel_Speed_RL_Valid_Data = 0;
    byte chgEv_IBCU_20B_Wheel_Speed_RR_Pulse = 0;
    byte chgEv_IBCU_20B_ESP_MasCylBrakePressureValid = 0;
    byte chgEv_IBCU_20B_ESP_BrakeForce = 0;
    byte chgEv_IBCU_20B_Wheel_Speed_RL_Pulse = 0;
    byte chgEv_IBCU_20B_ESP_OnlyABSActive = 0;
    byte chgEv_IBCU_20B_ESP_VehicleStandstill = 0;
    byte chgEv_IBCU_20B_ESP_MasCylBrakePressure = 0;
    byte chgEv_IBCU_1CB_IBCU_sOutputRodAct_Q = 0;
    byte chgEv_IBCU_1CB_IBCU_BrakePedalApplied = 0;
    byte chgEv_IBCU_1CB_IBCU_sOutputRodAct = 0;
    byte chgEv_IBCU_17A_ESP_ESPActiveStatus = 0;
    byte chgEv_IBCU_17A_ESP_ESPFunctionStatus = 0;
    byte chgEv_IBCU_17A_ESP_ABSFailStatus = 0;
    byte chgEv_IBCU_17A_ESP_VehicleSpeedValid = 0;
    byte chgEv_IBCU_17A_ESP_VehicleSpeed = 0;
    byte chgEv_IBCU_17A_ESP_TCSFailStatus = 0;
    
    message IBCU_20B        Msg_IBCU_20B;
    msTimer Tm_IBCU_20B;
    int Cycle_IBCU_20B = 20;
    message IBCU_1CB        Msg_IBCU_1CB;
    msTimer Tm_IBCU_1CB;
    int Cycle_IBCU_1CB = 10;
    message IBCU_17A        Msg_IBCU_17A;
    msTimer Tm_IBCU_17A;
    int Cycle_IBCU_17A = 10;
    
    int IBCU_20B_ESP_CRCCheck_206_counter =0;
    int IBCU_20B_ESP_CRCCheck_206_wrongvalctr =0;
    int IBCU_20B_ESP_CRCCheck_208_counter =0;
    int IBCU_20B_ESP_CRCCheck_208_wrongvalctr =0;
    int IBCU_20B_ESP_CRCCheck_258_counter =0;
    int IBCU_20B_ESP_CRCCheck_258_wrongvalctr =0;
    int IBCU_20B_ESP_CRCCheck_277_counter =0;
    int IBCU_20B_ESP_CRCCheck_277_wrongvalctr =0;
    int IBCU_20B_ESP_RollingCounter_206_counter =0;
    int IBCU_20B_ESP_RollingCounter_206_wrongvalctr =0;
    int IBCU_20B_ESP_RollingCounter_208_counter =0;
    int IBCU_20B_ESP_RollingCounter_208_wrongvalctr =0;
    int IBCU_20B_ESP_RollingCounter_258_counter =0;
    int IBCU_20B_ESP_RollingCounter_258_wrongvalctr =0;
    int IBCU_20B_ESP_RollingCounter_277_counter =0;
    int IBCU_20B_ESP_RollingCounter_277_wrongvalctr =0;
    int IBCU_1CB_IBCU_CRCCheck_237_counter =0;
    int IBCU_1CB_IBCU_CRCCheck_237_wrongvalctr =0;
    int IBCU_1CB_IBCU_RollingCounter_1CB_counter =0;
    int IBCU_1CB_IBCU_RollingCounter_1CB_wrongvalctr =0;
    int IBCU_1CB_IBCU_RollingCounter_237_counter =0;
    int IBCU_1CB_IBCU_RollingCounter_237_wrongvalctr =0;
    int IBCU_17A_ESP_CRCCheck_187_counter =0;
    int IBCU_17A_ESP_CRCCheck_187_wrongvalctr =0;
    int IBCU_17A_ESP_RollingCounter_187_counter =0;
    int IBCU_17A_ESP_RollingCounter_187_wrongvalctr =0;
    
    //CRC Polynomial for MQB     
    byte cb_ChkSum_POLY_MQB =0x2F;
	// CANFD DLC
	byte Dbc_dlc;
	int i=0;
	char CAN_DLC[7]={9,10,11,12,13,14,15};
	char CANFD_DLC[7]={12,16,20,24,32,48,64};
    

    
        byte CRC_J1850_Table[256] = {
 /*0 - 7*/  0x00, 0x1D, 0x3A, 0x27, 0x74, 0x69, 0x4E, 0x53,
 /*8 - 15*/ 0xE8, 0xF5, 0xD2, 0xCF, 0x9C, 0x81, 0xA6, 0xBB,
 /*16 - 23*/ 0xCD, 0xD0, 0xF7, 0xEA, 0xB9, 0xA4, 0x83, 0x9E,
 /*24 - 31*/ 0x25, 0x38, 0x1F, 0x02, 0x51, 0x4C, 0x6B, 0x76,
 /*32 - 39*/ 0x87, 0x9A, 0xBD, 0xA0, 0xF3, 0xEE, 0xC9, 0xD4,
 /*40 - 47*/ 0x6F, 0x72, 0x55, 0x48, 0x1B, 0x06, 0x21, 0x3C,
 /*48 - 55*/ 0x4A, 0x57, 0x70, 0x6D, 0x3E, 0x23, 0x04, 0x19,
 /*56 - 63*/ 0xA2, 0xBF, 0x98, 0x85, 0xD6, 0xCB, 0xEC, 0xF1,
 /*64 - 71*/  0x13, 0x0E, 0x29, 0x34, 0x67, 0x7A, 0x5D, 0x40,
 /*72 - 79*/ 0xFB, 0xE6, 0xC1, 0xDC, 0x8F, 0x92, 0xB5, 0xA8,
 /*80 - 87*/ 0xDE, 0xC3, 0xE4, 0xF9, 0xAA, 0xB7, 0x90, 0x8D,
 /*88 - 95*/ 0x36, 0x2B, 0x0C, 0x11, 0x42, 0x5F, 0x78, 0x65,
 /*96 - 103*/ 0x94, 0x89, 0xAE, 0xB3, 0xE0, 0xFD, 0xDA, 0xC7,
 /*104 - 111*/ 0x7C, 0x61, 0x46, 0x5B, 0x08, 0x15, 0x32, 0x2F,
 /*112 - 119*/ 0x59, 0x44, 0x63, 0x7E, 0x2D, 0x30, 0x17, 0x0A,
 /*120 - 127*/ 0xB1, 0xAC, 0x8B, 0x96, 0xC5, 0xD8, 0xFF, 0xE2,
 /*128 - 135*/ 0x26, 0x3B, 0x1C, 0x01, 0x52, 0x4F, 0x68, 0x75,
 /*136 - 143*/ 0xCE, 0xD3, 0xF4, 0xE9, 0xBA, 0xA7, 0x80, 0x9D,
 /*144 - 151*/ 0xEB, 0xF6, 0xD1, 0xCC, 0x9F, 0x82, 0xA5, 0xB8,
 /*152 - 159*/ 0x03, 0x1E, 0x39, 0x24, 0x77, 0x6A, 0x4D, 0x50,
 /*160 - 167*/ 0xA1, 0xBC, 0x9B, 0x86, 0xD5, 0xC8, 0xEF, 0xF2,
 /*168 - 175*/ 0x49, 0x54, 0x73, 0x6E, 0x3D, 0x20, 0x07, 0x1A,
 /*176 - 183*/ 0x6C, 0x71, 0x56, 0x4B, 0x18, 0x05, 0x22, 0x3F,
 /*184 - 191*/ 0x84, 0x99, 0xBE, 0xA3, 0xF0, 0xED, 0xCA, 0xD7,
 /*192 - 199*/ 0x35, 0x28, 0x0F, 0x12, 0x41, 0x5C, 0x7B, 0x66,
 /*200 - 207*/ 0xDD, 0xC0, 0xE7, 0xFA, 0xA9, 0xB4, 0x93, 0x8E,
 /*208 - 215*/ 0xF8, 0xE5, 0xC2, 0xDF, 0x8C, 0x91, 0xB6, 0xAB,
 /*216 - 223*/ 0x10, 0x0D, 0x2A, 0x37, 0x64, 0x79, 0x5E, 0x43,
 /*224 - 231*/ 0xB2, 0xAF, 0x88, 0x95, 0xC6, 0xDB, 0xFC, 0xE1,
 /*232 - 239*/ 0x5A, 0x47, 0x60, 0x7D, 0x2E, 0x33, 0x14, 0x09,
 /*240 - 247*/ 0x7F, 0x62, 0x45, 0x58, 0x0B, 0x16, 0x31, 0x2C,
 /*248 - 255*/ 0x97, 0x8A, 0xAD, 0xB0, 0xE3, 0xFE, 0xD9, 0xC4
};

         
}


on start
{
    //Initialise cycle time and message timer 
    putValue(E_pubc_IBCU_IBCU_20B_cycleTm,Cycle_IBCU_20B);
    SetTimer( Tm_IBCU_20B,100);
    putValue(E_pubc_IBCU_IBCU_20B_Tm,1);
    putValue(E_pubc_IBCU_IBCU_1CB_cycleTm,Cycle_IBCU_1CB);
    SetTimer( Tm_IBCU_1CB,101);
    putValue(E_pubc_IBCU_IBCU_1CB_Tm,1);
    putValue(E_pubc_IBCU_IBCU_17A_cycleTm,Cycle_IBCU_17A);
    SetTimer( Tm_IBCU_17A,102);
    putValue(E_pubc_IBCU_IBCU_17A_Tm,1);
    
    //Initialise signals with init raw value
    Msg_IBCU_20B.ESP_ABAactive   =getvalue(E_pubc_IBCU_IBCU_20B_ESP_ABAactive_Rv);
    Msg_IBCU_20B.ESP_AWBavailable   =getvalue(E_pubc_IBCU_IBCU_20B_ESP_AWBavailable_Rv);
    Msg_IBCU_20B.ESP_PrefillActive   =getvalue(E_pubc_IBCU_IBCU_20B_ESP_PrefillActive_Rv);
    Msg_IBCU_20B.Wheel_Speed_RL_Data   =getvalue(E_pubc_IBCU_IBCU_20B_Wheel_Speed_RL_Data_Rv);
    Msg_IBCU_20B.Wheel_Speed_RL_Direction   =getvalue(E_pubc_IBCU_IBCU_20B_Wheel_Speed_RL_Direction_Rv);
    Msg_IBCU_20B.Wheel_Speed_FR_Valid_Data   =getvalue(E_pubc_IBCU_IBCU_20B_Wheel_Speed_FR_Valid_Data_Rv);
    Msg_IBCU_20B.ESP_Vehicle_Speed_Reference   =getvalue(E_pubc_IBCU_IBCU_20B_ESP_Vehicle_Speed_Reference_Rv);
    Msg_IBCU_20B.Wheel_Speed_FL_Pulse   =getvalue(E_pubc_IBCU_IBCU_20B_Wheel_Speed_FL_Pulse_Rv);
    Msg_IBCU_20B.ESP_PrefillAvailable   =getvalue(E_pubc_IBCU_IBCU_20B_ESP_PrefillAvailable_Rv);
    Msg_IBCU_20B.Wheel_Speed_FL_Valid_Data   =getvalue(E_pubc_IBCU_IBCU_20B_Wheel_Speed_FL_Valid_Data_Rv);
    Msg_IBCU_20B.Wheel_Speed_FR_Data   =getvalue(E_pubc_IBCU_IBCU_20B_Wheel_Speed_FR_Data_Rv);
    Msg_IBCU_20B.Wheel_Speed_FR_Pulse   =getvalue(E_pubc_IBCU_IBCU_20B_Wheel_Speed_FR_Pulse_Rv);
    Msg_IBCU_20B.ESP_ABAavailable   =getvalue(E_pubc_IBCU_IBCU_20B_ESP_ABAavailable_Rv);
    Msg_IBCU_20B.ESP_AEBdecActive   =getvalue(E_pubc_IBCU_IBCU_20B_ESP_AEBdecActive_Rv);
    Msg_IBCU_20B.ESP_AWBactive   =getvalue(E_pubc_IBCU_IBCU_20B_ESP_AWBactive_Rv);
    Msg_IBCU_20B.IBCU_BrakeDiscHighTempWarning   =getvalue(E_pubc_IBCU_IBCU_20B_IBCU_BrakeDiscHighTempWarning_Rv);
    Msg_IBCU_20B.Wheel_Speed_RR_Direction   =getvalue(E_pubc_IBCU_IBCU_20B_Wheel_Speed_RR_Direction_Rv);
    Msg_IBCU_20B.Wheel_Speed_RR_Data   =getvalue(E_pubc_IBCU_IBCU_20B_Wheel_Speed_RR_Data_Rv);
    Msg_IBCU_20B.ESP_TCSActive   =getvalue(E_pubc_IBCU_IBCU_20B_ESP_TCSActive_Rv);
    Msg_IBCU_20B.ESP_HDC_STATUS   =getvalue(E_pubc_IBCU_IBCU_20B_ESP_HDC_STATUS_Rv);
    Msg_IBCU_20B.Wheel_Speed_FL_Data   =getvalue(E_pubc_IBCU_IBCU_20B_Wheel_Speed_FL_Data_Rv);
    Msg_IBCU_20B.Wheel_Speed_FL_Direction   =getvalue(E_pubc_IBCU_IBCU_20B_Wheel_Speed_FL_Direction_Rv);
    Msg_IBCU_20B.ESP_AEBAvailable   =getvalue(E_pubc_IBCU_IBCU_20B_ESP_AEBAvailable_Rv);
    Msg_IBCU_20B.Wheel_Speed_RR_Valid_Data   =getvalue(E_pubc_IBCU_IBCU_20B_Wheel_Speed_RR_Valid_Data_Rv);
    Msg_IBCU_20B.Wheel_Speed_FR_Direction   =getvalue(E_pubc_IBCU_IBCU_20B_Wheel_Speed_FR_Direction_Rv);
    Msg_IBCU_20B.ESP_VDCActive   =getvalue(E_pubc_IBCU_IBCU_20B_ESP_VDCActive_Rv);
    Msg_IBCU_20B.Wheel_Speed_RL_Valid_Data   =getvalue(E_pubc_IBCU_IBCU_20B_Wheel_Speed_RL_Valid_Data_Rv);
    Msg_IBCU_20B.Wheel_Speed_RR_Pulse   =getvalue(E_pubc_IBCU_IBCU_20B_Wheel_Speed_RR_Pulse_Rv);
    Msg_IBCU_20B.ESP_MasCylBrakePressureValid   =getvalue(E_pubc_IBCU_IBCU_20B_ESP_MasCylBrakePressureValid_Rv);
    Msg_IBCU_20B.ESP_BrakeForce   =getvalue(E_pubc_IBCU_IBCU_20B_ESP_BrakeForce_Rv);
    Msg_IBCU_20B.Wheel_Speed_RL_Pulse   =getvalue(E_pubc_IBCU_IBCU_20B_Wheel_Speed_RL_Pulse_Rv);
    Msg_IBCU_20B.ESP_OnlyABSActive   =getvalue(E_pubc_IBCU_IBCU_20B_ESP_OnlyABSActive_Rv);
    Msg_IBCU_20B.ESP_VehicleStandstill   =getvalue(E_pubc_IBCU_IBCU_20B_ESP_VehicleStandstill_Rv);
    Msg_IBCU_20B.ESP_MasCylBrakePressure   =getvalue(E_pubc_IBCU_IBCU_20B_ESP_MasCylBrakePressure_Rv);
    Msg_IBCU_1CB.IBCU_sOutputRodAct_Q   =getvalue(E_pubc_IBCU_IBCU_1CB_IBCU_sOutputRodAct_Q_Rv);
    Msg_IBCU_1CB.IBCU_BrakePedalApplied   =getvalue(E_pubc_IBCU_IBCU_1CB_IBCU_BrakePedalApplied_Rv);
    Msg_IBCU_1CB.IBCU_sOutputRodAct   =getvalue(E_pubc_IBCU_IBCU_1CB_IBCU_sOutputRodAct_Rv);
    Msg_IBCU_17A.ESP_ESPActiveStatus   =getvalue(E_pubc_IBCU_IBCU_17A_ESP_ESPActiveStatus_Rv);
    Msg_IBCU_17A.ESP_ESPFunctionStatus   =getvalue(E_pubc_IBCU_IBCU_17A_ESP_ESPFunctionStatus_Rv);
    Msg_IBCU_17A.ESP_ABSFailStatus   =getvalue(E_pubc_IBCU_IBCU_17A_ESP_ABSFailStatus_Rv);
    Msg_IBCU_17A.ESP_VehicleSpeedValid   =getvalue(E_pubc_IBCU_IBCU_17A_ESP_VehicleSpeedValid_Rv);
    Msg_IBCU_17A.ESP_VehicleSpeed   =getvalue(E_pubc_IBCU_IBCU_17A_ESP_VehicleSpeed_Rv);
    Msg_IBCU_17A.ESP_TCSFailStatus   =getvalue(E_pubc_IBCU_IBCU_17A_ESP_TCSFailStatus_Rv);
}

on envVar E_pubc_IBCU_CycMsgsON
{
    // enable all the cyclic messages 
    putValue(E_pubc_IBCU_IBCU_20B_Tm,1);
    putValue(E_pubc_IBCU_IBCU_1CB_Tm,1);
    putValue(E_pubc_IBCU_IBCU_17A_Tm,1);
}

on envVar E_pubc_IBCU_CycMsgsOFF
{
    // disable all the cyclic messages
    putValue(E_pubc_IBCU_IBCU_20B_Tm,0);
    putValue(E_pubc_IBCU_IBCU_1CB_Tm,0);
    putValue(E_pubc_IBCU_IBCU_17A_Tm,0);
    
}






on timer Tm_IBCU_20B
{
    //cyclic message timer 
    if(getValue(E_pubc_IBCU_IBCU_20B_Tm) == 1)
    {
        
		//update the BZ Signal
        if(IBCU_20B_ESP_RollingCounter_258_wrongvalctr == 0)
        {
            update_IBCU_20B_ESP_RollingCounter_258_counter();
            Msg_IBCU_20B.ESP_RollingCounter_258= IBCU_20B_ESP_RollingCounter_258_counter;
        }
        else if(IBCU_20B_ESP_RollingCounter_258_wrongvalctr > 0)
        {
			 IBCU_20B_ESP_RollingCounter_258_counter=IBCU_20B_ESP_RollingCounter_258_counter + IBCU_20B_ESP_RollingCounter_258_wrongvalctr;
			  Msg_IBCU_20B.ESP_RollingCounter_258= IBCU_20B_ESP_RollingCounter_258_counter;
             /*IBCU_20B_ESP_RollingCounter_258_wrongvalctr--;
             //if counter becomes zero, update panel controller to zero
             if(IBCU_20B_ESP_RollingCounter_258_wrongvalctr == 0)
             {
                putValue(E_pubc_IBCU_IBCU_20B_ESP_RollingCounter_258_wrongvalctr,0);
             }*/
        }
        else
        {
            // do nothing
        }
        if(IBCU_20B_ESP_RollingCounter_277_wrongvalctr == 0)
        {
            update_IBCU_20B_ESP_RollingCounter_277_counter();
            Msg_IBCU_20B.ESP_RollingCounter_277= IBCU_20B_ESP_RollingCounter_277_counter;
        }
        else if(IBCU_20B_ESP_RollingCounter_277_wrongvalctr > 0)
        {
			 IBCU_20B_ESP_RollingCounter_277_counter=IBCU_20B_ESP_RollingCounter_277_counter + IBCU_20B_ESP_RollingCounter_277_wrongvalctr;
			  Msg_IBCU_20B.ESP_RollingCounter_277= IBCU_20B_ESP_RollingCounter_277_counter;
             /*IBCU_20B_ESP_RollingCounter_277_wrongvalctr--;
             //if counter becomes zero, update panel controller to zero
             if(IBCU_20B_ESP_RollingCounter_277_wrongvalctr == 0)
             {
                putValue(E_pubc_IBCU_IBCU_20B_ESP_RollingCounter_277_wrongvalctr,0);
             }*/
        }
        else
        {
            // do nothing
        }
        if(IBCU_20B_ESP_RollingCounter_206_wrongvalctr == 0)
        {
            update_IBCU_20B_ESP_RollingCounter_206_counter();
            Msg_IBCU_20B.ESP_RollingCounter_206= IBCU_20B_ESP_RollingCounter_206_counter;
        }
        else if(IBCU_20B_ESP_RollingCounter_206_wrongvalctr > 0)
        {
			 IBCU_20B_ESP_RollingCounter_206_counter=IBCU_20B_ESP_RollingCounter_206_counter + IBCU_20B_ESP_RollingCounter_206_wrongvalctr;
			  Msg_IBCU_20B.ESP_RollingCounter_206= IBCU_20B_ESP_RollingCounter_206_counter;
             /*IBCU_20B_ESP_RollingCounter_206_wrongvalctr--;
             //if counter becomes zero, update panel controller to zero
             if(IBCU_20B_ESP_RollingCounter_206_wrongvalctr == 0)
             {
                putValue(E_pubc_IBCU_IBCU_20B_ESP_RollingCounter_206_wrongvalctr,0);
             }*/
        }
        else
        {
            // do nothing
        }
        if(IBCU_20B_ESP_RollingCounter_208_wrongvalctr == 0)
        {
            update_IBCU_20B_ESP_RollingCounter_208_counter();
            Msg_IBCU_20B.ESP_RollingCounter_208= IBCU_20B_ESP_RollingCounter_208_counter;
        }
        else if(IBCU_20B_ESP_RollingCounter_208_wrongvalctr > 0)
        {
			 IBCU_20B_ESP_RollingCounter_208_counter=IBCU_20B_ESP_RollingCounter_208_counter + IBCU_20B_ESP_RollingCounter_208_wrongvalctr;
			  Msg_IBCU_20B.ESP_RollingCounter_208= IBCU_20B_ESP_RollingCounter_208_counter;
             /*IBCU_20B_ESP_RollingCounter_208_wrongvalctr--;
             //if counter becomes zero, update panel controller to zero
             if(IBCU_20B_ESP_RollingCounter_208_wrongvalctr == 0)
             {
                putValue(E_pubc_IBCU_IBCU_20B_ESP_RollingCounter_208_wrongvalctr,0);
             }*/
        }
        else
        {
            // do nothing
        }
	
        update_IBCU_20B_CRC_CheckSum();
        output(Msg_IBCU_20B);
        
    }
    //Reset Timer
    SetTimer(Tm_IBCU_20B,Cycle_IBCU_20B);
}

on envVar E_pubc_IBCU_IBCU_20B_cycleTm
{
    // update the cycle time 
    Cycle_IBCU_20B=getvalue(this);
}
on timer Tm_IBCU_1CB
{
    //cyclic message timer 
    if(getValue(E_pubc_IBCU_IBCU_1CB_Tm) == 1)
    {
        
		//update the BZ Signal
        if(IBCU_1CB_IBCU_RollingCounter_1CB_wrongvalctr == 0)
        {
            update_IBCU_1CB_IBCU_RollingCounter_1CB_counter();
            Msg_IBCU_1CB.IBCU_RollingCounter_1CB= IBCU_1CB_IBCU_RollingCounter_1CB_counter;
        }
        else if(IBCU_1CB_IBCU_RollingCounter_1CB_wrongvalctr > 0)
        {
			 IBCU_1CB_IBCU_RollingCounter_1CB_counter=IBCU_1CB_IBCU_RollingCounter_1CB_counter + IBCU_1CB_IBCU_RollingCounter_1CB_wrongvalctr;
			  Msg_IBCU_1CB.IBCU_RollingCounter_1CB= IBCU_1CB_IBCU_RollingCounter_1CB_counter;
             /*IBCU_1CB_IBCU_RollingCounter_1CB_wrongvalctr--;
             //if counter becomes zero, update panel controller to zero
             if(IBCU_1CB_IBCU_RollingCounter_1CB_wrongvalctr == 0)
             {
                putValue(E_pubc_IBCU_IBCU_1CB_IBCU_RollingCounter_1CB_wrongvalctr,0);
             }*/
        }
        else
        {
            // do nothing
        }
        if(IBCU_1CB_IBCU_RollingCounter_237_wrongvalctr == 0)
        {
            update_IBCU_1CB_IBCU_RollingCounter_237_counter();
            Msg_IBCU_1CB.IBCU_RollingCounter_237= IBCU_1CB_IBCU_RollingCounter_237_counter;
        }
        else if(IBCU_1CB_IBCU_RollingCounter_237_wrongvalctr > 0)
        {
			 IBCU_1CB_IBCU_RollingCounter_237_counter=IBCU_1CB_IBCU_RollingCounter_237_counter + IBCU_1CB_IBCU_RollingCounter_237_wrongvalctr;
			  Msg_IBCU_1CB.IBCU_RollingCounter_237= IBCU_1CB_IBCU_RollingCounter_237_counter;
             /*IBCU_1CB_IBCU_RollingCounter_237_wrongvalctr--;
             //if counter becomes zero, update panel controller to zero
             if(IBCU_1CB_IBCU_RollingCounter_237_wrongvalctr == 0)
             {
                putValue(E_pubc_IBCU_IBCU_1CB_IBCU_RollingCounter_237_wrongvalctr,0);
             }*/
        }
        else
        {
            // do nothing
        }
	
        update_IBCU_1CB_CRC_CheckSum();
        output(Msg_IBCU_1CB);
        
    }
    //Reset Timer
    SetTimer(Tm_IBCU_1CB,Cycle_IBCU_1CB);
}

on envVar E_pubc_IBCU_IBCU_1CB_cycleTm
{
    // update the cycle time 
    Cycle_IBCU_1CB=getvalue(this);
}
on timer Tm_IBCU_17A
{
    //cyclic message timer 
    if(getValue(E_pubc_IBCU_IBCU_17A_Tm) == 1)
    {
        
		//update the BZ Signal
        if(IBCU_17A_ESP_RollingCounter_187_wrongvalctr == 0)
        {
            update_IBCU_17A_ESP_RollingCounter_187_counter();
            Msg_IBCU_17A.ESP_RollingCounter_187= IBCU_17A_ESP_RollingCounter_187_counter;
        }
        else if(IBCU_17A_ESP_RollingCounter_187_wrongvalctr > 0)
        {
			 IBCU_17A_ESP_RollingCounter_187_counter=IBCU_17A_ESP_RollingCounter_187_counter + IBCU_17A_ESP_RollingCounter_187_wrongvalctr;
			  Msg_IBCU_17A.ESP_RollingCounter_187= IBCU_17A_ESP_RollingCounter_187_counter;
             /*IBCU_17A_ESP_RollingCounter_187_wrongvalctr--;
             //if counter becomes zero, update panel controller to zero
             if(IBCU_17A_ESP_RollingCounter_187_wrongvalctr == 0)
             {
                putValue(E_pubc_IBCU_IBCU_17A_ESP_RollingCounter_187_wrongvalctr,0);
             }*/
        }
        else
        {
            // do nothing
        }
	
        update_IBCU_17A_CRC_CheckSum();
        output(Msg_IBCU_17A);
        
    }
    //Reset Timer
    SetTimer(Tm_IBCU_17A,Cycle_IBCU_17A);
}

on envVar E_pubc_IBCU_IBCU_17A_cycleTm
{
    // update the cycle time 
    Cycle_IBCU_17A=getvalue(this);
}

on envVar E_pubc_IBCU_IBCU_20B_tx
{
    if(getValue(this))
    {       
        
        //update the BZ Signal
        if(IBCU_20B_ESP_RollingCounter_258_wrongvalctr == 0)
        {
            update_IBCU_20B_ESP_RollingCounter_258_counter();
            Msg_IBCU_20B.ESP_RollingCounter_258= IBCU_20B_ESP_RollingCounter_258_counter;
        }
        else if(IBCU_20B_ESP_RollingCounter_258_wrongvalctr > 0)
        {
			IBCU_20B_ESP_RollingCounter_258_counter=IBCU_20B_ESP_RollingCounter_258_counter + IBCU_20B_ESP_RollingCounter_258_wrongvalctr;
			 Msg_IBCU_20B.ESP_RollingCounter_258= IBCU_20B_ESP_RollingCounter_258_counter;
             /*IBCU_20B_ESP_RollingCounter_258_wrongvalctr--;
              // if counter becomes zero, update panel controller to zero
             if(IBCU_20B_ESP_RollingCounter_258_wrongvalctr == 0)
             {
                 putValue(E_pubc_IBCU_IBCU_20B_ESP_RollingCounter_258_wrongvalctr,0);
             } */
        }
        else
        { 
			// do nothing
        }    
        //update the BZ Signal
        if(IBCU_20B_ESP_RollingCounter_277_wrongvalctr == 0)
        {
            update_IBCU_20B_ESP_RollingCounter_277_counter();
            Msg_IBCU_20B.ESP_RollingCounter_277= IBCU_20B_ESP_RollingCounter_277_counter;
        }
        else if(IBCU_20B_ESP_RollingCounter_277_wrongvalctr > 0)
        {
			IBCU_20B_ESP_RollingCounter_277_counter=IBCU_20B_ESP_RollingCounter_277_counter + IBCU_20B_ESP_RollingCounter_277_wrongvalctr;
			 Msg_IBCU_20B.ESP_RollingCounter_277= IBCU_20B_ESP_RollingCounter_277_counter;
             /*IBCU_20B_ESP_RollingCounter_277_wrongvalctr--;
              // if counter becomes zero, update panel controller to zero
             if(IBCU_20B_ESP_RollingCounter_277_wrongvalctr == 0)
             {
                 putValue(E_pubc_IBCU_IBCU_20B_ESP_RollingCounter_277_wrongvalctr,0);
             } */
        }
        else
        { 
			// do nothing
        }    
        //update the BZ Signal
        if(IBCU_20B_ESP_RollingCounter_206_wrongvalctr == 0)
        {
            update_IBCU_20B_ESP_RollingCounter_206_counter();
            Msg_IBCU_20B.ESP_RollingCounter_206= IBCU_20B_ESP_RollingCounter_206_counter;
        }
        else if(IBCU_20B_ESP_RollingCounter_206_wrongvalctr > 0)
        {
			IBCU_20B_ESP_RollingCounter_206_counter=IBCU_20B_ESP_RollingCounter_206_counter + IBCU_20B_ESP_RollingCounter_206_wrongvalctr;
			 Msg_IBCU_20B.ESP_RollingCounter_206= IBCU_20B_ESP_RollingCounter_206_counter;
             /*IBCU_20B_ESP_RollingCounter_206_wrongvalctr--;
              // if counter becomes zero, update panel controller to zero
             if(IBCU_20B_ESP_RollingCounter_206_wrongvalctr == 0)
             {
                 putValue(E_pubc_IBCU_IBCU_20B_ESP_RollingCounter_206_wrongvalctr,0);
             } */
        }
        else
        { 
			// do nothing
        }    
        //update the BZ Signal
        if(IBCU_20B_ESP_RollingCounter_208_wrongvalctr == 0)
        {
            update_IBCU_20B_ESP_RollingCounter_208_counter();
            Msg_IBCU_20B.ESP_RollingCounter_208= IBCU_20B_ESP_RollingCounter_208_counter;
        }
        else if(IBCU_20B_ESP_RollingCounter_208_wrongvalctr > 0)
        {
			IBCU_20B_ESP_RollingCounter_208_counter=IBCU_20B_ESP_RollingCounter_208_counter + IBCU_20B_ESP_RollingCounter_208_wrongvalctr;
			 Msg_IBCU_20B.ESP_RollingCounter_208= IBCU_20B_ESP_RollingCounter_208_counter;
             /*IBCU_20B_ESP_RollingCounter_208_wrongvalctr--;
              // if counter becomes zero, update panel controller to zero
             if(IBCU_20B_ESP_RollingCounter_208_wrongvalctr == 0)
             {
                 putValue(E_pubc_IBCU_IBCU_20B_ESP_RollingCounter_208_wrongvalctr,0);
             } */
        }
        else
        { 
			// do nothing
        }    
        //calculate the CRC CheckSum
        update_IBCU_20B_CRC_CheckSum();

        output(Msg_IBCU_20B);        
    }
}

on envVar E_pubc_IBCU_IBCU_20B_Range
{
    qword rawstatus = 0ll;
    qword rawValue = 0ll;    
    
    rawstatus = getvalue(this);    
    // set all the signals with min raw /max raw /init raw
    switch (rawstatus) 
    {
     case(0) :
        rawValue= 0;
        putValue(E_pubc_IBCU_IBCU_20B_ESP_ABAactive_Rv, rawValue);
        rawValue= 0;
        putValue(E_pubc_IBCU_IBCU_20B_ESP_AWBavailable_Rv, rawValue);
        rawValue= 0;
        putValue(E_pubc_IBCU_IBCU_20B_ESP_PrefillActive_Rv, rawValue);
        rawValue= 0;
        putValue(E_pubc_IBCU_IBCU_20B_Wheel_Speed_RL_Data_Rv, rawValue);
        rawValue= 0;
        putValue(E_pubc_IBCU_IBCU_20B_Wheel_Speed_RL_Direction_Rv, rawValue);
        rawValue= 0;
        putValue(E_pubc_IBCU_IBCU_20B_Wheel_Speed_FR_Valid_Data_Rv, rawValue);
        rawValue= 0;
        putValue(E_pubc_IBCU_IBCU_20B_ESP_Vehicle_Speed_Reference_Rv, rawValue);
        rawValue= 0;
        putValue(E_pubc_IBCU_IBCU_20B_Wheel_Speed_FL_Pulse_Rv, rawValue);
        rawValue= 0;
        putValue(E_pubc_IBCU_IBCU_20B_ESP_PrefillAvailable_Rv, rawValue);
        rawValue= 0;
        putValue(E_pubc_IBCU_IBCU_20B_Wheel_Speed_FL_Valid_Data_Rv, rawValue);
        rawValue= 0;
        putValue(E_pubc_IBCU_IBCU_20B_Wheel_Speed_FR_Data_Rv, rawValue);
        rawValue= 0;
        putValue(E_pubc_IBCU_IBCU_20B_Wheel_Speed_FR_Pulse_Rv, rawValue);
        rawValue= 0;
        putValue(E_pubc_IBCU_IBCU_20B_ESP_ABAavailable_Rv, rawValue);
        rawValue= 0;
        putValue(E_pubc_IBCU_IBCU_20B_ESP_AEBdecActive_Rv, rawValue);
        rawValue= 0;
        putValue(E_pubc_IBCU_IBCU_20B_ESP_AWBactive_Rv, rawValue);
        rawValue= 0;
        putValue(E_pubc_IBCU_IBCU_20B_IBCU_BrakeDiscHighTempWarning_Rv, rawValue);
        rawValue= 0;
        putValue(E_pubc_IBCU_IBCU_20B_Wheel_Speed_RR_Direction_Rv, rawValue);
        rawValue= 0;
        putValue(E_pubc_IBCU_IBCU_20B_Wheel_Speed_RR_Data_Rv, rawValue);
        rawValue= 0;
        putValue(E_pubc_IBCU_IBCU_20B_ESP_TCSActive_Rv, rawValue);
        rawValue= 0;
        putValue(E_pubc_IBCU_IBCU_20B_ESP_HDC_STATUS_Rv, rawValue);
        rawValue= 0;
        putValue(E_pubc_IBCU_IBCU_20B_Wheel_Speed_FL_Data_Rv, rawValue);
        rawValue= 0;
        putValue(E_pubc_IBCU_IBCU_20B_Wheel_Speed_FL_Direction_Rv, rawValue);
        rawValue= 0;
        putValue(E_pubc_IBCU_IBCU_20B_ESP_AEBAvailable_Rv, rawValue);
        rawValue= 0;
        putValue(E_pubc_IBCU_IBCU_20B_Wheel_Speed_RR_Valid_Data_Rv, rawValue);
        rawValue= 0;
        putValue(E_pubc_IBCU_IBCU_20B_Wheel_Speed_FR_Direction_Rv, rawValue);
        rawValue= 0;
        putValue(E_pubc_IBCU_IBCU_20B_ESP_VDCActive_Rv, rawValue);
        rawValue= 0;
        putValue(E_pubc_IBCU_IBCU_20B_Wheel_Speed_RL_Valid_Data_Rv, rawValue);
        rawValue= 0;
        putValue(E_pubc_IBCU_IBCU_20B_Wheel_Speed_RR_Pulse_Rv, rawValue);
        rawValue= 0;
        putValue(E_pubc_IBCU_IBCU_20B_ESP_MasCylBrakePressureValid_Rv, rawValue);
        rawValue= 0;
        putValue(E_pubc_IBCU_IBCU_20B_ESP_BrakeForce_Rv, rawValue);
        rawValue= 0;
        putValue(E_pubc_IBCU_IBCU_20B_Wheel_Speed_RL_Pulse_Rv, rawValue);
        rawValue= 0;
        putValue(E_pubc_IBCU_IBCU_20B_ESP_OnlyABSActive_Rv, rawValue);
        rawValue= 0;
        putValue(E_pubc_IBCU_IBCU_20B_ESP_VehicleStandstill_Rv, rawValue);
        rawValue= 0;
        putValue(E_pubc_IBCU_IBCU_20B_ESP_MasCylBrakePressure_Rv, rawValue);
        break;
     case(1) :
        rawValue= 1;
        putValue(E_pubc_IBCU_IBCU_20B_ESP_ABAactive_Rv, rawValue);
        rawValue= 1;
        putValue(E_pubc_IBCU_IBCU_20B_ESP_AWBavailable_Rv, rawValue);
        rawValue= 1;
        putValue(E_pubc_IBCU_IBCU_20B_ESP_PrefillActive_Rv, rawValue);
        rawValue= 6400;
        putValue(E_pubc_IBCU_IBCU_20B_Wheel_Speed_RL_Data_Rv, rawValue);
        rawValue= 3;
        putValue(E_pubc_IBCU_IBCU_20B_Wheel_Speed_RL_Direction_Rv, rawValue);
        rawValue= 1;
        putValue(E_pubc_IBCU_IBCU_20B_Wheel_Speed_FR_Valid_Data_Rv, rawValue);
        rawValue= 6400;
        putValue(E_pubc_IBCU_IBCU_20B_ESP_Vehicle_Speed_Reference_Rv, rawValue);
        rawValue= 254;
        putValue(E_pubc_IBCU_IBCU_20B_Wheel_Speed_FL_Pulse_Rv, rawValue);
        rawValue= 1;
        putValue(E_pubc_IBCU_IBCU_20B_ESP_PrefillAvailable_Rv, rawValue);
        rawValue= 1;
        putValue(E_pubc_IBCU_IBCU_20B_Wheel_Speed_FL_Valid_Data_Rv, rawValue);
        rawValue= 6400;
        putValue(E_pubc_IBCU_IBCU_20B_Wheel_Speed_FR_Data_Rv, rawValue);
        rawValue= 254;
        putValue(E_pubc_IBCU_IBCU_20B_Wheel_Speed_FR_Pulse_Rv, rawValue);
        rawValue= 1;
        putValue(E_pubc_IBCU_IBCU_20B_ESP_ABAavailable_Rv, rawValue);
        rawValue= 1;
        putValue(E_pubc_IBCU_IBCU_20B_ESP_AEBdecActive_Rv, rawValue);
        rawValue= 1;
        putValue(E_pubc_IBCU_IBCU_20B_ESP_AWBactive_Rv, rawValue);
        rawValue= 3;
        putValue(E_pubc_IBCU_IBCU_20B_IBCU_BrakeDiscHighTempWarning_Rv, rawValue);
        rawValue= 3;
        putValue(E_pubc_IBCU_IBCU_20B_Wheel_Speed_RR_Direction_Rv, rawValue);
        rawValue= 6400;
        putValue(E_pubc_IBCU_IBCU_20B_Wheel_Speed_RR_Data_Rv, rawValue);
        rawValue= 1;
        putValue(E_pubc_IBCU_IBCU_20B_ESP_TCSActive_Rv, rawValue);
        rawValue= 3;
        putValue(E_pubc_IBCU_IBCU_20B_ESP_HDC_STATUS_Rv, rawValue);
        rawValue= 6400;
        putValue(E_pubc_IBCU_IBCU_20B_Wheel_Speed_FL_Data_Rv, rawValue);
        rawValue= 3;
        putValue(E_pubc_IBCU_IBCU_20B_Wheel_Speed_FL_Direction_Rv, rawValue);
        rawValue= 1;
        putValue(E_pubc_IBCU_IBCU_20B_ESP_AEBAvailable_Rv, rawValue);
        rawValue= 1;
        putValue(E_pubc_IBCU_IBCU_20B_Wheel_Speed_RR_Valid_Data_Rv, rawValue);
        rawValue= 3;
        putValue(E_pubc_IBCU_IBCU_20B_Wheel_Speed_FR_Direction_Rv, rawValue);
        rawValue= 1;
        putValue(E_pubc_IBCU_IBCU_20B_ESP_VDCActive_Rv, rawValue);
        rawValue= 1;
        putValue(E_pubc_IBCU_IBCU_20B_Wheel_Speed_RL_Valid_Data_Rv, rawValue);
        rawValue= 254;
        putValue(E_pubc_IBCU_IBCU_20B_Wheel_Speed_RR_Pulse_Rv, rawValue);
        rawValue= 1;
        putValue(E_pubc_IBCU_IBCU_20B_ESP_MasCylBrakePressureValid_Rv, rawValue);
        rawValue= 1;
        putValue(E_pubc_IBCU_IBCU_20B_ESP_BrakeForce_Rv, rawValue);
        rawValue= 254;
        putValue(E_pubc_IBCU_IBCU_20B_Wheel_Speed_RL_Pulse_Rv, rawValue);
        rawValue= 1;
        putValue(E_pubc_IBCU_IBCU_20B_ESP_OnlyABSActive_Rv, rawValue);
        rawValue= 1;
        putValue(E_pubc_IBCU_IBCU_20B_ESP_VehicleStandstill_Rv, rawValue);
        rawValue= 2500;
        putValue(E_pubc_IBCU_IBCU_20B_ESP_MasCylBrakePressure_Rv, rawValue);
        break;
     default :
        rawValue= 0;
        putValue(E_pubc_IBCU_IBCU_20B_ESP_ABAactive_Rv, rawValue);
        rawValue= 0;
        putValue(E_pubc_IBCU_IBCU_20B_ESP_AWBavailable_Rv, rawValue);
        rawValue= 0;
        putValue(E_pubc_IBCU_IBCU_20B_ESP_PrefillActive_Rv, rawValue);
        rawValue= 0;
        putValue(E_pubc_IBCU_IBCU_20B_Wheel_Speed_RL_Data_Rv, rawValue);
        rawValue= 0;
        putValue(E_pubc_IBCU_IBCU_20B_Wheel_Speed_RL_Direction_Rv, rawValue);
        rawValue= 0;
        putValue(E_pubc_IBCU_IBCU_20B_Wheel_Speed_FR_Valid_Data_Rv, rawValue);
        rawValue= 0;
        putValue(E_pubc_IBCU_IBCU_20B_ESP_Vehicle_Speed_Reference_Rv, rawValue);
        rawValue= 0;
        putValue(E_pubc_IBCU_IBCU_20B_Wheel_Speed_FL_Pulse_Rv, rawValue);
        rawValue= 0;
        putValue(E_pubc_IBCU_IBCU_20B_ESP_PrefillAvailable_Rv, rawValue);
        rawValue= 0;
        putValue(E_pubc_IBCU_IBCU_20B_Wheel_Speed_FL_Valid_Data_Rv, rawValue);
        rawValue= 0;
        putValue(E_pubc_IBCU_IBCU_20B_Wheel_Speed_FR_Data_Rv, rawValue);
        rawValue= 0;
        putValue(E_pubc_IBCU_IBCU_20B_Wheel_Speed_FR_Pulse_Rv, rawValue);
        rawValue= 0;
        putValue(E_pubc_IBCU_IBCU_20B_ESP_ABAavailable_Rv, rawValue);
        rawValue= 0;
        putValue(E_pubc_IBCU_IBCU_20B_ESP_AEBdecActive_Rv, rawValue);
        rawValue= 0;
        putValue(E_pubc_IBCU_IBCU_20B_ESP_AWBactive_Rv, rawValue);
        rawValue= 0;
        putValue(E_pubc_IBCU_IBCU_20B_IBCU_BrakeDiscHighTempWarning_Rv, rawValue);
        rawValue= 0;
        putValue(E_pubc_IBCU_IBCU_20B_Wheel_Speed_RR_Direction_Rv, rawValue);
        rawValue= 0;
        putValue(E_pubc_IBCU_IBCU_20B_Wheel_Speed_RR_Data_Rv, rawValue);
        rawValue= 0;
        putValue(E_pubc_IBCU_IBCU_20B_ESP_TCSActive_Rv, rawValue);
        rawValue= 0;
        putValue(E_pubc_IBCU_IBCU_20B_ESP_HDC_STATUS_Rv, rawValue);
        rawValue= 0;
        putValue(E_pubc_IBCU_IBCU_20B_Wheel_Speed_FL_Data_Rv, rawValue);
        rawValue= 0;
        putValue(E_pubc_IBCU_IBCU_20B_Wheel_Speed_FL_Direction_Rv, rawValue);
        rawValue= 0;
        putValue(E_pubc_IBCU_IBCU_20B_ESP_AEBAvailable_Rv, rawValue);
        rawValue= 0;
        putValue(E_pubc_IBCU_IBCU_20B_Wheel_Speed_RR_Valid_Data_Rv, rawValue);
        rawValue= 0;
        putValue(E_pubc_IBCU_IBCU_20B_Wheel_Speed_FR_Direction_Rv, rawValue);
        rawValue= 0;
        putValue(E_pubc_IBCU_IBCU_20B_ESP_VDCActive_Rv, rawValue);
        rawValue= 0;
        putValue(E_pubc_IBCU_IBCU_20B_Wheel_Speed_RL_Valid_Data_Rv, rawValue);
        rawValue= 0;
        putValue(E_pubc_IBCU_IBCU_20B_Wheel_Speed_RR_Pulse_Rv, rawValue);
        rawValue= 0;
        putValue(E_pubc_IBCU_IBCU_20B_ESP_MasCylBrakePressureValid_Rv, rawValue);
        rawValue= 0;
        putValue(E_pubc_IBCU_IBCU_20B_ESP_BrakeForce_Rv, rawValue);
        rawValue= 0;
        putValue(E_pubc_IBCU_IBCU_20B_Wheel_Speed_RL_Pulse_Rv, rawValue);
        rawValue= 0;
        putValue(E_pubc_IBCU_IBCU_20B_ESP_OnlyABSActive_Rv, rawValue);
        rawValue= 0;
        putValue(E_pubc_IBCU_IBCU_20B_ESP_VehicleStandstill_Rv, rawValue);
        rawValue= 0;
        putValue(E_pubc_IBCU_IBCU_20B_ESP_MasCylBrakePressure_Rv, rawValue);
      break;
   }
}

on envVar E_pubc_IBCU_IBCU_20B_Dlc
{
    if(getValue(E_pubc_IBCU_IBCU_20B_enDlc))
    {
        Msg_IBCU_20B.dlc =getValue(this);
    }
    else
    {   
	   Msg_IBCU_20B.dlc = 48;
	   	
  }
}

on envVar E_pubc_IBCU_IBCU_20B_enDlc
{
    //For Messages with DLC = 8, set wrong DLC to smaller than defined DLC
    //For Messages with DLC < 8 set wrong DLC to smaller/longer than defined DLC
    if(getValue(this))
    {
        Msg_IBCU_20B.dlc =getValue(E_pubc_IBCU_IBCU_20B_Dlc);
    }
    else
    {
	   Msg_IBCU_20B.dlc = 48;
			
    }
}

on envVar E_pubc_IBCU_IBCU_20B_ESP_CRCCheck_206_wrongvalctr
{
    //update disturb count
    //disturb value range:(-1 = always send wrong value),( X>0 ,x is the number of Messages with wrong CHK sent)
    IBCU_20B_ESP_CRCCheck_206_wrongvalctr =getValue(this);    
}
on envVar E_pubc_IBCU_IBCU_20B_ESP_CRCCheck_208_wrongvalctr
{
    //update disturb count
    //disturb value range:(-1 = always send wrong value),( X>0 ,x is the number of Messages with wrong CHK sent)
    IBCU_20B_ESP_CRCCheck_208_wrongvalctr =getValue(this);    
}
on envVar E_pubc_IBCU_IBCU_20B_ESP_CRCCheck_258_wrongvalctr
{
    //update disturb count
    //disturb value range:(-1 = always send wrong value),( X>0 ,x is the number of Messages with wrong CHK sent)
    IBCU_20B_ESP_CRCCheck_258_wrongvalctr =getValue(this);    
}
on envVar E_pubc_IBCU_IBCU_20B_ESP_CRCCheck_277_wrongvalctr
{
    //update disturb count
    //disturb value range:(-1 = always send wrong value),( X>0 ,x is the number of Messages with wrong CHK sent)
    IBCU_20B_ESP_CRCCheck_277_wrongvalctr =getValue(this);    
}
on envVar E_pubc_IBCU_IBCU_20B_ESP_RollingCounter_206_wrongvalctr
{
    //update disturb count
    //disturb value range:(-1 = always send wrong value),( X>0 ,x is the number of Messages with wrong CHK sent)
    IBCU_20B_ESP_RollingCounter_206_wrongvalctr =getValue(this);    
}
on envVar E_pubc_IBCU_IBCU_20B_ESP_RollingCounter_208_wrongvalctr
{
    //update disturb count
    //disturb value range:(-1 = always send wrong value),( X>0 ,x is the number of Messages with wrong CHK sent)
    IBCU_20B_ESP_RollingCounter_208_wrongvalctr =getValue(this);    
}
on envVar E_pubc_IBCU_IBCU_20B_ESP_RollingCounter_258_wrongvalctr
{
    //update disturb count
    //disturb value range:(-1 = always send wrong value),( X>0 ,x is the number of Messages with wrong CHK sent)
    IBCU_20B_ESP_RollingCounter_258_wrongvalctr =getValue(this);    
}
on envVar E_pubc_IBCU_IBCU_20B_ESP_RollingCounter_277_wrongvalctr
{
    //update disturb count
    //disturb value range:(-1 = always send wrong value),( X>0 ,x is the number of Messages with wrong CHK sent)
    IBCU_20B_ESP_RollingCounter_277_wrongvalctr =getValue(this);    
}

on envVar E_pubc_IBCU_IBCU_20B_ESP_ABAactive_Rv
{
    int64 rawValue = 0ll;
    float rawValue_float = 0.0;
    float phyValue = 0.0;        

    //set the signal with updated raw value
    if(getValue(E_pubc_IBCU_IBCU_20B_ESP_ABAactive_SetVt)==0)
    {
        rawValue = getvalue(this);
        if(chgEv_IBCU_20B_ESP_ABAactive == 0)
        {
            //type conversion to float
            rawValue_float = rawValue;        
            // raw to physical conversion
            phyValue = ((rawValue_float *1)+(0));
            putValue(E_pubc_IBCU_IBCU_20B_ESP_ABAactive_Pv, phyValue);
            chgEv_IBCU_20B_ESP_ABAactive = 1;
        }
        else
        {
            chgEv_IBCU_20B_ESP_ABAactive = 0;
        }    
        //update the signal value
        Msg_IBCU_20B.ESP_ABAactive=rawValue;        
    }                                                                           
}

on envVar E_pubc_IBCU_IBCU_20B_ESP_ABAactive_Pv
{
    int64 rawValue = 0ll;
    float phyValue = 0.0;
    
    //update the raw value with physical value 
    if(getValue(E_pubc_IBCU_IBCU_20B_ESP_ABAactive_SetVt)==0)
    {
        if(chgEv_IBCU_20B_ESP_ABAactive == 0)
        {
            phyValue = getvalue(this);
            // physical to raw conversion
            rawValue = ((phyValue -(0))/1);
            putValue(E_pubc_IBCU_IBCU_20B_ESP_ABAactive_Rv, rawValue);
            chgEv_IBCU_20B_ESP_ABAactive = 1;  
        }
        else
        {
            chgEv_IBCU_20B_ESP_ABAactive = 0;
        }
    }
}

on envVar E_pubc_IBCU_IBCU_20B_ESP_ABAactive_Vt
{
    qword rawValue = 0ll;
    if(getValue(E_pubc_IBCU_IBCU_20B_ESP_ABAactive_SetVt))
    {
        //update the signal value
        Msg_IBCU_20B.ESP_ABAactive=getValue(this);
    }
}

on envVar E_pubc_IBCU_IBCU_20B_ESP_ABAactive_SetVt
{
    if(getValue(E_pubc_IBCU_IBCU_20B_ESP_ABAactive_SetVt))
    {
        //update the signal value
        Msg_IBCU_20B.ESP_ABAactive=getvalue(E_pubc_IBCU_IBCU_20B_ESP_ABAactive_Vt);
    }
    else
    {
        Msg_IBCU_20B.ESP_ABAactive=getValue(E_pubc_IBCU_IBCU_20B_ESP_ABAactive_Rv);
    }
}
 
on envVar E_pubc_IBCU_IBCU_20B_ESP_AWBavailable_Rv
{
    int64 rawValue = 0ll;
    float rawValue_float = 0.0;
    float phyValue = 0.0;        

    //set the signal with updated raw value
    if(getValue(E_pubc_IBCU_IBCU_20B_ESP_AWBavailable_SetVt)==0)
    {
        rawValue = getvalue(this);
        if(chgEv_IBCU_20B_ESP_AWBavailable == 0)
        {
            //type conversion to float
            rawValue_float = rawValue;        
            // raw to physical conversion
            phyValue = ((rawValue_float *1)+(0));
            putValue(E_pubc_IBCU_IBCU_20B_ESP_AWBavailable_Pv, phyValue);
            chgEv_IBCU_20B_ESP_AWBavailable = 1;
        }
        else
        {
            chgEv_IBCU_20B_ESP_AWBavailable = 0;
        }    
        //update the signal value
        Msg_IBCU_20B.ESP_AWBavailable=rawValue;        
    }                                                                           
}

on envVar E_pubc_IBCU_IBCU_20B_ESP_AWBavailable_Pv
{
    int64 rawValue = 0ll;
    float phyValue = 0.0;
    
    //update the raw value with physical value 
    if(getValue(E_pubc_IBCU_IBCU_20B_ESP_AWBavailable_SetVt)==0)
    {
        if(chgEv_IBCU_20B_ESP_AWBavailable == 0)
        {
            phyValue = getvalue(this);
            // physical to raw conversion
            rawValue = ((phyValue -(0))/1);
            putValue(E_pubc_IBCU_IBCU_20B_ESP_AWBavailable_Rv, rawValue);
            chgEv_IBCU_20B_ESP_AWBavailable = 1;  
        }
        else
        {
            chgEv_IBCU_20B_ESP_AWBavailable = 0;
        }
    }
}

on envVar E_pubc_IBCU_IBCU_20B_ESP_AWBavailable_Vt
{
    qword rawValue = 0ll;
    if(getValue(E_pubc_IBCU_IBCU_20B_ESP_AWBavailable_SetVt))
    {
        //update the signal value
        Msg_IBCU_20B.ESP_AWBavailable=getValue(this);
    }
}

on envVar E_pubc_IBCU_IBCU_20B_ESP_AWBavailable_SetVt
{
    if(getValue(E_pubc_IBCU_IBCU_20B_ESP_AWBavailable_SetVt))
    {
        //update the signal value
        Msg_IBCU_20B.ESP_AWBavailable=getvalue(E_pubc_IBCU_IBCU_20B_ESP_AWBavailable_Vt);
    }
    else
    {
        Msg_IBCU_20B.ESP_AWBavailable=getValue(E_pubc_IBCU_IBCU_20B_ESP_AWBavailable_Rv);
    }
}
 
on envVar E_pubc_IBCU_IBCU_20B_ESP_PrefillActive_Rv
{
    int64 rawValue = 0ll;
    float rawValue_float = 0.0;
    float phyValue = 0.0;        

    //set the signal with updated raw value
    if(getValue(E_pubc_IBCU_IBCU_20B_ESP_PrefillActive_SetVt)==0)
    {
        rawValue = getvalue(this);
        if(chgEv_IBCU_20B_ESP_PrefillActive == 0)
        {
            //type conversion to float
            rawValue_float = rawValue;        
            // raw to physical conversion
            phyValue = ((rawValue_float *1)+(0));
            putValue(E_pubc_IBCU_IBCU_20B_ESP_PrefillActive_Pv, phyValue);
            chgEv_IBCU_20B_ESP_PrefillActive = 1;
        }
        else
        {
            chgEv_IBCU_20B_ESP_PrefillActive = 0;
        }    
        //update the signal value
        Msg_IBCU_20B.ESP_PrefillActive=rawValue;        
    }                                                                           
}

on envVar E_pubc_IBCU_IBCU_20B_ESP_PrefillActive_Pv
{
    int64 rawValue = 0ll;
    float phyValue = 0.0;
    
    //update the raw value with physical value 
    if(getValue(E_pubc_IBCU_IBCU_20B_ESP_PrefillActive_SetVt)==0)
    {
        if(chgEv_IBCU_20B_ESP_PrefillActive == 0)
        {
            phyValue = getvalue(this);
            // physical to raw conversion
            rawValue = ((phyValue -(0))/1);
            putValue(E_pubc_IBCU_IBCU_20B_ESP_PrefillActive_Rv, rawValue);
            chgEv_IBCU_20B_ESP_PrefillActive = 1;  
        }
        else
        {
            chgEv_IBCU_20B_ESP_PrefillActive = 0;
        }
    }
}

on envVar E_pubc_IBCU_IBCU_20B_ESP_PrefillActive_Vt
{
    qword rawValue = 0ll;
    if(getValue(E_pubc_IBCU_IBCU_20B_ESP_PrefillActive_SetVt))
    {
        //update the signal value
        Msg_IBCU_20B.ESP_PrefillActive=getValue(this);
    }
}

on envVar E_pubc_IBCU_IBCU_20B_ESP_PrefillActive_SetVt
{
    if(getValue(E_pubc_IBCU_IBCU_20B_ESP_PrefillActive_SetVt))
    {
        //update the signal value
        Msg_IBCU_20B.ESP_PrefillActive=getvalue(E_pubc_IBCU_IBCU_20B_ESP_PrefillActive_Vt);
    }
    else
    {
        Msg_IBCU_20B.ESP_PrefillActive=getValue(E_pubc_IBCU_IBCU_20B_ESP_PrefillActive_Rv);
    }
}
 
on envVar E_pubc_IBCU_IBCU_20B_Wheel_Speed_RL_Data_Rv
{
    int64 rawValue = 0ll;
    float rawValue_float = 0.0;
    float phyValue = 0.0;        

    //set the signal with updated raw value
    {
        rawValue = getvalue(this);
        if(chgEv_IBCU_20B_Wheel_Speed_RL_Data == 0)
        {
            //type conversion to float
            rawValue_float = rawValue;        
            // raw to physical conversion
            phyValue = ((rawValue_float *0.05625)+(0));
            putValue(E_pubc_IBCU_IBCU_20B_Wheel_Speed_RL_Data_Pv, phyValue);
            chgEv_IBCU_20B_Wheel_Speed_RL_Data = 1;
        }
        else
        {
            chgEv_IBCU_20B_Wheel_Speed_RL_Data = 0;
        }    
        //update the signal value
        Msg_IBCU_20B.Wheel_Speed_RL_Data=rawValue;        
    }                                                                           
}

on envVar E_pubc_IBCU_IBCU_20B_Wheel_Speed_RL_Data_Pv
{
    int64 rawValue = 0ll;
    float phyValue = 0.0;
    
    //update the raw value with physical value 
    {
        if(chgEv_IBCU_20B_Wheel_Speed_RL_Data == 0)
        {
            phyValue = getvalue(this);
            // physical to raw conversion
            rawValue = ((phyValue -(0))/0.05625);
            putValue(E_pubc_IBCU_IBCU_20B_Wheel_Speed_RL_Data_Rv, rawValue);
            chgEv_IBCU_20B_Wheel_Speed_RL_Data = 1;  
        }
        else
        {
            chgEv_IBCU_20B_Wheel_Speed_RL_Data = 0;
        }
    }
}


 
on envVar E_pubc_IBCU_IBCU_20B_Wheel_Speed_RL_Direction_Rv
{
    int64 rawValue = 0ll;
    float rawValue_float = 0.0;
    float phyValue = 0.0;        

    //set the signal with updated raw value
    if(getValue(E_pubc_IBCU_IBCU_20B_Wheel_Speed_RL_Direction_SetVt)==0)
    {
        rawValue = getvalue(this);
        if(chgEv_IBCU_20B_Wheel_Speed_RL_Direction == 0)
        {
            //type conversion to float
            rawValue_float = rawValue;        
            // raw to physical conversion
            phyValue = ((rawValue_float *1)+(0));
            putValue(E_pubc_IBCU_IBCU_20B_Wheel_Speed_RL_Direction_Pv, phyValue);
            chgEv_IBCU_20B_Wheel_Speed_RL_Direction = 1;
        }
        else
        {
            chgEv_IBCU_20B_Wheel_Speed_RL_Direction = 0;
        }    
        //update the signal value
        Msg_IBCU_20B.Wheel_Speed_RL_Direction=rawValue;        
    }                                                                           
}

on envVar E_pubc_IBCU_IBCU_20B_Wheel_Speed_RL_Direction_Pv
{
    int64 rawValue = 0ll;
    float phyValue = 0.0;
    
    //update the raw value with physical value 
    if(getValue(E_pubc_IBCU_IBCU_20B_Wheel_Speed_RL_Direction_SetVt)==0)
    {
        if(chgEv_IBCU_20B_Wheel_Speed_RL_Direction == 0)
        {
            phyValue = getvalue(this);
            // physical to raw conversion
            rawValue = ((phyValue -(0))/1);
            putValue(E_pubc_IBCU_IBCU_20B_Wheel_Speed_RL_Direction_Rv, rawValue);
            chgEv_IBCU_20B_Wheel_Speed_RL_Direction = 1;  
        }
        else
        {
            chgEv_IBCU_20B_Wheel_Speed_RL_Direction = 0;
        }
    }
}

on envVar E_pubc_IBCU_IBCU_20B_Wheel_Speed_RL_Direction_Vt
{
    qword rawValue = 0ll;
    if(getValue(E_pubc_IBCU_IBCU_20B_Wheel_Speed_RL_Direction_SetVt))
    {
        //update the signal value
        Msg_IBCU_20B.Wheel_Speed_RL_Direction=getValue(this);
    }
}

on envVar E_pubc_IBCU_IBCU_20B_Wheel_Speed_RL_Direction_SetVt
{
    if(getValue(E_pubc_IBCU_IBCU_20B_Wheel_Speed_RL_Direction_SetVt))
    {
        //update the signal value
        Msg_IBCU_20B.Wheel_Speed_RL_Direction=getvalue(E_pubc_IBCU_IBCU_20B_Wheel_Speed_RL_Direction_Vt);
    }
    else
    {
        Msg_IBCU_20B.Wheel_Speed_RL_Direction=getValue(E_pubc_IBCU_IBCU_20B_Wheel_Speed_RL_Direction_Rv);
    }
}
 
on envVar E_pubc_IBCU_IBCU_20B_Wheel_Speed_FR_Valid_Data_Rv
{
    int64 rawValue = 0ll;
    float rawValue_float = 0.0;
    float phyValue = 0.0;        

    //set the signal with updated raw value
    if(getValue(E_pubc_IBCU_IBCU_20B_Wheel_Speed_FR_Valid_Data_SetVt)==0)
    {
        rawValue = getvalue(this);
        if(chgEv_IBCU_20B_Wheel_Speed_FR_Valid_Data == 0)
        {
            //type conversion to float
            rawValue_float = rawValue;        
            // raw to physical conversion
            phyValue = ((rawValue_float *1)+(0));
            putValue(E_pubc_IBCU_IBCU_20B_Wheel_Speed_FR_Valid_Data_Pv, phyValue);
            chgEv_IBCU_20B_Wheel_Speed_FR_Valid_Data = 1;
        }
        else
        {
            chgEv_IBCU_20B_Wheel_Speed_FR_Valid_Data = 0;
        }    
        //update the signal value
        Msg_IBCU_20B.Wheel_Speed_FR_Valid_Data=rawValue;        
    }                                                                           
}

on envVar E_pubc_IBCU_IBCU_20B_Wheel_Speed_FR_Valid_Data_Pv
{
    int64 rawValue = 0ll;
    float phyValue = 0.0;
    
    //update the raw value with physical value 
    if(getValue(E_pubc_IBCU_IBCU_20B_Wheel_Speed_FR_Valid_Data_SetVt)==0)
    {
        if(chgEv_IBCU_20B_Wheel_Speed_FR_Valid_Data == 0)
        {
            phyValue = getvalue(this);
            // physical to raw conversion
            rawValue = ((phyValue -(0))/1);
            putValue(E_pubc_IBCU_IBCU_20B_Wheel_Speed_FR_Valid_Data_Rv, rawValue);
            chgEv_IBCU_20B_Wheel_Speed_FR_Valid_Data = 1;  
        }
        else
        {
            chgEv_IBCU_20B_Wheel_Speed_FR_Valid_Data = 0;
        }
    }
}

on envVar E_pubc_IBCU_IBCU_20B_Wheel_Speed_FR_Valid_Data_Vt
{
    qword rawValue = 0ll;
    if(getValue(E_pubc_IBCU_IBCU_20B_Wheel_Speed_FR_Valid_Data_SetVt))
    {
        //update the signal value
        Msg_IBCU_20B.Wheel_Speed_FR_Valid_Data=getValue(this);
    }
}

on envVar E_pubc_IBCU_IBCU_20B_Wheel_Speed_FR_Valid_Data_SetVt
{
    if(getValue(E_pubc_IBCU_IBCU_20B_Wheel_Speed_FR_Valid_Data_SetVt))
    {
        //update the signal value
        Msg_IBCU_20B.Wheel_Speed_FR_Valid_Data=getvalue(E_pubc_IBCU_IBCU_20B_Wheel_Speed_FR_Valid_Data_Vt);
    }
    else
    {
        Msg_IBCU_20B.Wheel_Speed_FR_Valid_Data=getValue(E_pubc_IBCU_IBCU_20B_Wheel_Speed_FR_Valid_Data_Rv);
    }
}
 
on envVar E_pubc_IBCU_IBCU_20B_ESP_Vehicle_Speed_Reference_Rv
{
    int64 rawValue = 0ll;
    float rawValue_float = 0.0;
    float phyValue = 0.0;        

    //set the signal with updated raw value
    if(getValue(E_pubc_IBCU_IBCU_20B_ESP_Vehicle_Speed_Reference_SetVt)==0)
    {
        rawValue = getvalue(this);
        if(chgEv_IBCU_20B_ESP_Vehicle_Speed_Reference == 0)
        {
            //type conversion to float
            rawValue_float = rawValue;        
            // raw to physical conversion
            phyValue = ((rawValue_float *0.05625)+(0));
            putValue(E_pubc_IBCU_IBCU_20B_ESP_Vehicle_Speed_Reference_Pv, phyValue);
            chgEv_IBCU_20B_ESP_Vehicle_Speed_Reference = 1;
        }
        else
        {
            chgEv_IBCU_20B_ESP_Vehicle_Speed_Reference = 0;
        }    
        //update the signal value
        Msg_IBCU_20B.ESP_Vehicle_Speed_Reference=rawValue;        
    }                                                                           
}

on envVar E_pubc_IBCU_IBCU_20B_ESP_Vehicle_Speed_Reference_Pv
{
    int64 rawValue = 0ll;
    float phyValue = 0.0;
    
    //update the raw value with physical value 
    if(getValue(E_pubc_IBCU_IBCU_20B_ESP_Vehicle_Speed_Reference_SetVt)==0)
    {
        if(chgEv_IBCU_20B_ESP_Vehicle_Speed_Reference == 0)
        {
            phyValue = getvalue(this);
            // physical to raw conversion
            rawValue = ((phyValue -(0))/0.05625);
            putValue(E_pubc_IBCU_IBCU_20B_ESP_Vehicle_Speed_Reference_Rv, rawValue);
            chgEv_IBCU_20B_ESP_Vehicle_Speed_Reference = 1;  
        }
        else
        {
            chgEv_IBCU_20B_ESP_Vehicle_Speed_Reference = 0;
        }
    }
}

on envVar E_pubc_IBCU_IBCU_20B_ESP_Vehicle_Speed_Reference_Vt
{
    qword rawValue = 0ll;
    if(getValue(E_pubc_IBCU_IBCU_20B_ESP_Vehicle_Speed_Reference_SetVt))
    {
        //update the signal value
        Msg_IBCU_20B.ESP_Vehicle_Speed_Reference=getValue(this);
    }
}

on envVar E_pubc_IBCU_IBCU_20B_ESP_Vehicle_Speed_Reference_SetVt
{
    if(getValue(E_pubc_IBCU_IBCU_20B_ESP_Vehicle_Speed_Reference_SetVt))
    {
        //update the signal value
        Msg_IBCU_20B.ESP_Vehicle_Speed_Reference=getvalue(E_pubc_IBCU_IBCU_20B_ESP_Vehicle_Speed_Reference_Vt);
    }
    else
    {
        Msg_IBCU_20B.ESP_Vehicle_Speed_Reference=getValue(E_pubc_IBCU_IBCU_20B_ESP_Vehicle_Speed_Reference_Rv);
    }
}
 
on envVar E_pubc_IBCU_IBCU_20B_Wheel_Speed_FL_Pulse_Rv
{
    int64 rawValue = 0ll;
    float rawValue_float = 0.0;
    float phyValue = 0.0;        

    //set the signal with updated raw value
    {
        rawValue = getvalue(this);
        if(chgEv_IBCU_20B_Wheel_Speed_FL_Pulse == 0)
        {
            //type conversion to float
            rawValue_float = rawValue;        
            // raw to physical conversion
            phyValue = ((rawValue_float *1)+(0));
            putValue(E_pubc_IBCU_IBCU_20B_Wheel_Speed_FL_Pulse_Pv, phyValue);
            chgEv_IBCU_20B_Wheel_Speed_FL_Pulse = 1;
        }
        else
        {
            chgEv_IBCU_20B_Wheel_Speed_FL_Pulse = 0;
        }    
        //update the signal value
        Msg_IBCU_20B.Wheel_Speed_FL_Pulse=rawValue;        
    }                                                                           
}

on envVar E_pubc_IBCU_IBCU_20B_Wheel_Speed_FL_Pulse_Pv
{
    int64 rawValue = 0ll;
    float phyValue = 0.0;
    
    //update the raw value with physical value 
    {
        if(chgEv_IBCU_20B_Wheel_Speed_FL_Pulse == 0)
        {
            phyValue = getvalue(this);
            // physical to raw conversion
            rawValue = ((phyValue -(0))/1);
            putValue(E_pubc_IBCU_IBCU_20B_Wheel_Speed_FL_Pulse_Rv, rawValue);
            chgEv_IBCU_20B_Wheel_Speed_FL_Pulse = 1;  
        }
        else
        {
            chgEv_IBCU_20B_Wheel_Speed_FL_Pulse = 0;
        }
    }
}


 
on envVar E_pubc_IBCU_IBCU_20B_ESP_PrefillAvailable_Rv
{
    int64 rawValue = 0ll;
    float rawValue_float = 0.0;
    float phyValue = 0.0;        

    //set the signal with updated raw value
    if(getValue(E_pubc_IBCU_IBCU_20B_ESP_PrefillAvailable_SetVt)==0)
    {
        rawValue = getvalue(this);
        if(chgEv_IBCU_20B_ESP_PrefillAvailable == 0)
        {
            //type conversion to float
            rawValue_float = rawValue;        
            // raw to physical conversion
            phyValue = ((rawValue_float *1)+(0));
            putValue(E_pubc_IBCU_IBCU_20B_ESP_PrefillAvailable_Pv, phyValue);
            chgEv_IBCU_20B_ESP_PrefillAvailable = 1;
        }
        else
        {
            chgEv_IBCU_20B_ESP_PrefillAvailable = 0;
        }    
        //update the signal value
        Msg_IBCU_20B.ESP_PrefillAvailable=rawValue;        
    }                                                                           
}

on envVar E_pubc_IBCU_IBCU_20B_ESP_PrefillAvailable_Pv
{
    int64 rawValue = 0ll;
    float phyValue = 0.0;
    
    //update the raw value with physical value 
    if(getValue(E_pubc_IBCU_IBCU_20B_ESP_PrefillAvailable_SetVt)==0)
    {
        if(chgEv_IBCU_20B_ESP_PrefillAvailable == 0)
        {
            phyValue = getvalue(this);
            // physical to raw conversion
            rawValue = ((phyValue -(0))/1);
            putValue(E_pubc_IBCU_IBCU_20B_ESP_PrefillAvailable_Rv, rawValue);
            chgEv_IBCU_20B_ESP_PrefillAvailable = 1;  
        }
        else
        {
            chgEv_IBCU_20B_ESP_PrefillAvailable = 0;
        }
    }
}

on envVar E_pubc_IBCU_IBCU_20B_ESP_PrefillAvailable_Vt
{
    qword rawValue = 0ll;
    if(getValue(E_pubc_IBCU_IBCU_20B_ESP_PrefillAvailable_SetVt))
    {
        //update the signal value
        Msg_IBCU_20B.ESP_PrefillAvailable=getValue(this);
    }
}

on envVar E_pubc_IBCU_IBCU_20B_ESP_PrefillAvailable_SetVt
{
    if(getValue(E_pubc_IBCU_IBCU_20B_ESP_PrefillAvailable_SetVt))
    {
        //update the signal value
        Msg_IBCU_20B.ESP_PrefillAvailable=getvalue(E_pubc_IBCU_IBCU_20B_ESP_PrefillAvailable_Vt);
    }
    else
    {
        Msg_IBCU_20B.ESP_PrefillAvailable=getValue(E_pubc_IBCU_IBCU_20B_ESP_PrefillAvailable_Rv);
    }
}
 
on envVar E_pubc_IBCU_IBCU_20B_Wheel_Speed_FL_Valid_Data_Rv
{
    int64 rawValue = 0ll;
    float rawValue_float = 0.0;
    float phyValue = 0.0;        

    //set the signal with updated raw value
    if(getValue(E_pubc_IBCU_IBCU_20B_Wheel_Speed_FL_Valid_Data_SetVt)==0)
    {
        rawValue = getvalue(this);
        if(chgEv_IBCU_20B_Wheel_Speed_FL_Valid_Data == 0)
        {
            //type conversion to float
            rawValue_float = rawValue;        
            // raw to physical conversion
            phyValue = ((rawValue_float *1)+(0));
            putValue(E_pubc_IBCU_IBCU_20B_Wheel_Speed_FL_Valid_Data_Pv, phyValue);
            chgEv_IBCU_20B_Wheel_Speed_FL_Valid_Data = 1;
        }
        else
        {
            chgEv_IBCU_20B_Wheel_Speed_FL_Valid_Data = 0;
        }    
        //update the signal value
        Msg_IBCU_20B.Wheel_Speed_FL_Valid_Data=rawValue;        
    }                                                                           
}

on envVar E_pubc_IBCU_IBCU_20B_Wheel_Speed_FL_Valid_Data_Pv
{
    int64 rawValue = 0ll;
    float phyValue = 0.0;
    
    //update the raw value with physical value 
    if(getValue(E_pubc_IBCU_IBCU_20B_Wheel_Speed_FL_Valid_Data_SetVt)==0)
    {
        if(chgEv_IBCU_20B_Wheel_Speed_FL_Valid_Data == 0)
        {
            phyValue = getvalue(this);
            // physical to raw conversion
            rawValue = ((phyValue -(0))/1);
            putValue(E_pubc_IBCU_IBCU_20B_Wheel_Speed_FL_Valid_Data_Rv, rawValue);
            chgEv_IBCU_20B_Wheel_Speed_FL_Valid_Data = 1;  
        }
        else
        {
            chgEv_IBCU_20B_Wheel_Speed_FL_Valid_Data = 0;
        }
    }
}

on envVar E_pubc_IBCU_IBCU_20B_Wheel_Speed_FL_Valid_Data_Vt
{
    qword rawValue = 0ll;
    if(getValue(E_pubc_IBCU_IBCU_20B_Wheel_Speed_FL_Valid_Data_SetVt))
    {
        //update the signal value
        Msg_IBCU_20B.Wheel_Speed_FL_Valid_Data=getValue(this);
    }
}

on envVar E_pubc_IBCU_IBCU_20B_Wheel_Speed_FL_Valid_Data_SetVt
{
    if(getValue(E_pubc_IBCU_IBCU_20B_Wheel_Speed_FL_Valid_Data_SetVt))
    {
        //update the signal value
        Msg_IBCU_20B.Wheel_Speed_FL_Valid_Data=getvalue(E_pubc_IBCU_IBCU_20B_Wheel_Speed_FL_Valid_Data_Vt);
    }
    else
    {
        Msg_IBCU_20B.Wheel_Speed_FL_Valid_Data=getValue(E_pubc_IBCU_IBCU_20B_Wheel_Speed_FL_Valid_Data_Rv);
    }
}
 
on envVar E_pubc_IBCU_IBCU_20B_Wheel_Speed_FR_Data_Rv
{
    int64 rawValue = 0ll;
    float rawValue_float = 0.0;
    float phyValue = 0.0;        

    //set the signal with updated raw value
    {
        rawValue = getvalue(this);
        if(chgEv_IBCU_20B_Wheel_Speed_FR_Data == 0)
        {
            //type conversion to float
            rawValue_float = rawValue;        
            // raw to physical conversion
            phyValue = ((rawValue_float *0.05625)+(0));
            putValue(E_pubc_IBCU_IBCU_20B_Wheel_Speed_FR_Data_Pv, phyValue);
            chgEv_IBCU_20B_Wheel_Speed_FR_Data = 1;
        }
        else
        {
            chgEv_IBCU_20B_Wheel_Speed_FR_Data = 0;
        }    
        //update the signal value
        Msg_IBCU_20B.Wheel_Speed_FR_Data=rawValue;        
    }                                                                           
}

on envVar E_pubc_IBCU_IBCU_20B_Wheel_Speed_FR_Data_Pv
{
    int64 rawValue = 0ll;
    float phyValue = 0.0;
    
    //update the raw value with physical value 
    {
        if(chgEv_IBCU_20B_Wheel_Speed_FR_Data == 0)
        {
            phyValue = getvalue(this);
            // physical to raw conversion
            rawValue = ((phyValue -(0))/0.05625);
            putValue(E_pubc_IBCU_IBCU_20B_Wheel_Speed_FR_Data_Rv, rawValue);
            chgEv_IBCU_20B_Wheel_Speed_FR_Data = 1;  
        }
        else
        {
            chgEv_IBCU_20B_Wheel_Speed_FR_Data = 0;
        }
    }
}


 
on envVar E_pubc_IBCU_IBCU_20B_Wheel_Speed_FR_Pulse_Rv
{
    int64 rawValue = 0ll;
    float rawValue_float = 0.0;
    float phyValue = 0.0;        

    //set the signal with updated raw value
    {
        rawValue = getvalue(this);
        if(chgEv_IBCU_20B_Wheel_Speed_FR_Pulse == 0)
        {
            //type conversion to float
            rawValue_float = rawValue;        
            // raw to physical conversion
            phyValue = ((rawValue_float *1)+(0));
            putValue(E_pubc_IBCU_IBCU_20B_Wheel_Speed_FR_Pulse_Pv, phyValue);
            chgEv_IBCU_20B_Wheel_Speed_FR_Pulse = 1;
        }
        else
        {
            chgEv_IBCU_20B_Wheel_Speed_FR_Pulse = 0;
        }    
        //update the signal value
        Msg_IBCU_20B.Wheel_Speed_FR_Pulse=rawValue;        
    }                                                                           
}

on envVar E_pubc_IBCU_IBCU_20B_Wheel_Speed_FR_Pulse_Pv
{
    int64 rawValue = 0ll;
    float phyValue = 0.0;
    
    //update the raw value with physical value 
    {
        if(chgEv_IBCU_20B_Wheel_Speed_FR_Pulse == 0)
        {
            phyValue = getvalue(this);
            // physical to raw conversion
            rawValue = ((phyValue -(0))/1);
            putValue(E_pubc_IBCU_IBCU_20B_Wheel_Speed_FR_Pulse_Rv, rawValue);
            chgEv_IBCU_20B_Wheel_Speed_FR_Pulse = 1;  
        }
        else
        {
            chgEv_IBCU_20B_Wheel_Speed_FR_Pulse = 0;
        }
    }
}


 
on envVar E_pubc_IBCU_IBCU_20B_ESP_ABAavailable_Rv
{
    int64 rawValue = 0ll;
    float rawValue_float = 0.0;
    float phyValue = 0.0;        

    //set the signal with updated raw value
    if(getValue(E_pubc_IBCU_IBCU_20B_ESP_ABAavailable_SetVt)==0)
    {
        rawValue = getvalue(this);
        if(chgEv_IBCU_20B_ESP_ABAavailable == 0)
        {
            //type conversion to float
            rawValue_float = rawValue;        
            // raw to physical conversion
            phyValue = ((rawValue_float *1)+(0));
            putValue(E_pubc_IBCU_IBCU_20B_ESP_ABAavailable_Pv, phyValue);
            chgEv_IBCU_20B_ESP_ABAavailable = 1;
        }
        else
        {
            chgEv_IBCU_20B_ESP_ABAavailable = 0;
        }    
        //update the signal value
        Msg_IBCU_20B.ESP_ABAavailable=rawValue;        
    }                                                                           
}

on envVar E_pubc_IBCU_IBCU_20B_ESP_ABAavailable_Pv
{
    int64 rawValue = 0ll;
    float phyValue = 0.0;
    
    //update the raw value with physical value 
    if(getValue(E_pubc_IBCU_IBCU_20B_ESP_ABAavailable_SetVt)==0)
    {
        if(chgEv_IBCU_20B_ESP_ABAavailable == 0)
        {
            phyValue = getvalue(this);
            // physical to raw conversion
            rawValue = ((phyValue -(0))/1);
            putValue(E_pubc_IBCU_IBCU_20B_ESP_ABAavailable_Rv, rawValue);
            chgEv_IBCU_20B_ESP_ABAavailable = 1;  
        }
        else
        {
            chgEv_IBCU_20B_ESP_ABAavailable = 0;
        }
    }
}

on envVar E_pubc_IBCU_IBCU_20B_ESP_ABAavailable_Vt
{
    qword rawValue = 0ll;
    if(getValue(E_pubc_IBCU_IBCU_20B_ESP_ABAavailable_SetVt))
    {
        //update the signal value
        Msg_IBCU_20B.ESP_ABAavailable=getValue(this);
    }
}

on envVar E_pubc_IBCU_IBCU_20B_ESP_ABAavailable_SetVt
{
    if(getValue(E_pubc_IBCU_IBCU_20B_ESP_ABAavailable_SetVt))
    {
        //update the signal value
        Msg_IBCU_20B.ESP_ABAavailable=getvalue(E_pubc_IBCU_IBCU_20B_ESP_ABAavailable_Vt);
    }
    else
    {
        Msg_IBCU_20B.ESP_ABAavailable=getValue(E_pubc_IBCU_IBCU_20B_ESP_ABAavailable_Rv);
    }
}
 
on envVar E_pubc_IBCU_IBCU_20B_ESP_AEBdecActive_Rv
{
    int64 rawValue = 0ll;
    float rawValue_float = 0.0;
    float phyValue = 0.0;        

    //set the signal with updated raw value
    if(getValue(E_pubc_IBCU_IBCU_20B_ESP_AEBdecActive_SetVt)==0)
    {
        rawValue = getvalue(this);
        if(chgEv_IBCU_20B_ESP_AEBdecActive == 0)
        {
            //type conversion to float
            rawValue_float = rawValue;        
            // raw to physical conversion
            phyValue = ((rawValue_float *1)+(0));
            putValue(E_pubc_IBCU_IBCU_20B_ESP_AEBdecActive_Pv, phyValue);
            chgEv_IBCU_20B_ESP_AEBdecActive = 1;
        }
        else
        {
            chgEv_IBCU_20B_ESP_AEBdecActive = 0;
        }    
        //update the signal value
        Msg_IBCU_20B.ESP_AEBdecActive=rawValue;        
    }                                                                           
}

on envVar E_pubc_IBCU_IBCU_20B_ESP_AEBdecActive_Pv
{
    int64 rawValue = 0ll;
    float phyValue = 0.0;
    
    //update the raw value with physical value 
    if(getValue(E_pubc_IBCU_IBCU_20B_ESP_AEBdecActive_SetVt)==0)
    {
        if(chgEv_IBCU_20B_ESP_AEBdecActive == 0)
        {
            phyValue = getvalue(this);
            // physical to raw conversion
            rawValue = ((phyValue -(0))/1);
            putValue(E_pubc_IBCU_IBCU_20B_ESP_AEBdecActive_Rv, rawValue);
            chgEv_IBCU_20B_ESP_AEBdecActive = 1;  
        }
        else
        {
            chgEv_IBCU_20B_ESP_AEBdecActive = 0;
        }
    }
}

on envVar E_pubc_IBCU_IBCU_20B_ESP_AEBdecActive_Vt
{
    qword rawValue = 0ll;
    if(getValue(E_pubc_IBCU_IBCU_20B_ESP_AEBdecActive_SetVt))
    {
        //update the signal value
        Msg_IBCU_20B.ESP_AEBdecActive=getValue(this);
    }
}

on envVar E_pubc_IBCU_IBCU_20B_ESP_AEBdecActive_SetVt
{
    if(getValue(E_pubc_IBCU_IBCU_20B_ESP_AEBdecActive_SetVt))
    {
        //update the signal value
        Msg_IBCU_20B.ESP_AEBdecActive=getvalue(E_pubc_IBCU_IBCU_20B_ESP_AEBdecActive_Vt);
    }
    else
    {
        Msg_IBCU_20B.ESP_AEBdecActive=getValue(E_pubc_IBCU_IBCU_20B_ESP_AEBdecActive_Rv);
    }
}
 
on envVar E_pubc_IBCU_IBCU_20B_ESP_AWBactive_Rv
{
    int64 rawValue = 0ll;
    float rawValue_float = 0.0;
    float phyValue = 0.0;        

    //set the signal with updated raw value
    if(getValue(E_pubc_IBCU_IBCU_20B_ESP_AWBactive_SetVt)==0)
    {
        rawValue = getvalue(this);
        if(chgEv_IBCU_20B_ESP_AWBactive == 0)
        {
            //type conversion to float
            rawValue_float = rawValue;        
            // raw to physical conversion
            phyValue = ((rawValue_float *1)+(0));
            putValue(E_pubc_IBCU_IBCU_20B_ESP_AWBactive_Pv, phyValue);
            chgEv_IBCU_20B_ESP_AWBactive = 1;
        }
        else
        {
            chgEv_IBCU_20B_ESP_AWBactive = 0;
        }    
        //update the signal value
        Msg_IBCU_20B.ESP_AWBactive=rawValue;        
    }                                                                           
}

on envVar E_pubc_IBCU_IBCU_20B_ESP_AWBactive_Pv
{
    int64 rawValue = 0ll;
    float phyValue = 0.0;
    
    //update the raw value with physical value 
    if(getValue(E_pubc_IBCU_IBCU_20B_ESP_AWBactive_SetVt)==0)
    {
        if(chgEv_IBCU_20B_ESP_AWBactive == 0)
        {
            phyValue = getvalue(this);
            // physical to raw conversion
            rawValue = ((phyValue -(0))/1);
            putValue(E_pubc_IBCU_IBCU_20B_ESP_AWBactive_Rv, rawValue);
            chgEv_IBCU_20B_ESP_AWBactive = 1;  
        }
        else
        {
            chgEv_IBCU_20B_ESP_AWBactive = 0;
        }
    }
}

on envVar E_pubc_IBCU_IBCU_20B_ESP_AWBactive_Vt
{
    qword rawValue = 0ll;
    if(getValue(E_pubc_IBCU_IBCU_20B_ESP_AWBactive_SetVt))
    {
        //update the signal value
        Msg_IBCU_20B.ESP_AWBactive=getValue(this);
    }
}

on envVar E_pubc_IBCU_IBCU_20B_ESP_AWBactive_SetVt
{
    if(getValue(E_pubc_IBCU_IBCU_20B_ESP_AWBactive_SetVt))
    {
        //update the signal value
        Msg_IBCU_20B.ESP_AWBactive=getvalue(E_pubc_IBCU_IBCU_20B_ESP_AWBactive_Vt);
    }
    else
    {
        Msg_IBCU_20B.ESP_AWBactive=getValue(E_pubc_IBCU_IBCU_20B_ESP_AWBactive_Rv);
    }
}
 
on envVar E_pubc_IBCU_IBCU_20B_IBCU_BrakeDiscHighTempWarning_Rv
{
    int64 rawValue = 0ll;
    float rawValue_float = 0.0;
    float phyValue = 0.0;        

    //set the signal with updated raw value
    if(getValue(E_pubc_IBCU_IBCU_20B_IBCU_BrakeDiscHighTempWarning_SetVt)==0)
    {
        rawValue = getvalue(this);
        if(chgEv_IBCU_20B_IBCU_BrakeDiscHighTempWarning == 0)
        {
            //type conversion to float
            rawValue_float = rawValue;        
            // raw to physical conversion
            phyValue = ((rawValue_float *1)+(0));
            putValue(E_pubc_IBCU_IBCU_20B_IBCU_BrakeDiscHighTempWarning_Pv, phyValue);
            chgEv_IBCU_20B_IBCU_BrakeDiscHighTempWarning = 1;
        }
        else
        {
            chgEv_IBCU_20B_IBCU_BrakeDiscHighTempWarning = 0;
        }    
        //update the signal value
        Msg_IBCU_20B.IBCU_BrakeDiscHighTempWarning=rawValue;        
    }                                                                           
}

on envVar E_pubc_IBCU_IBCU_20B_IBCU_BrakeDiscHighTempWarning_Pv
{
    int64 rawValue = 0ll;
    float phyValue = 0.0;
    
    //update the raw value with physical value 
    if(getValue(E_pubc_IBCU_IBCU_20B_IBCU_BrakeDiscHighTempWarning_SetVt)==0)
    {
        if(chgEv_IBCU_20B_IBCU_BrakeDiscHighTempWarning == 0)
        {
            phyValue = getvalue(this);
            // physical to raw conversion
            rawValue = ((phyValue -(0))/1);
            putValue(E_pubc_IBCU_IBCU_20B_IBCU_BrakeDiscHighTempWarning_Rv, rawValue);
            chgEv_IBCU_20B_IBCU_BrakeDiscHighTempWarning = 1;  
        }
        else
        {
            chgEv_IBCU_20B_IBCU_BrakeDiscHighTempWarning = 0;
        }
    }
}

on envVar E_pubc_IBCU_IBCU_20B_IBCU_BrakeDiscHighTempWarning_Vt
{
    qword rawValue = 0ll;
    if(getValue(E_pubc_IBCU_IBCU_20B_IBCU_BrakeDiscHighTempWarning_SetVt))
    {
        //update the signal value
        Msg_IBCU_20B.IBCU_BrakeDiscHighTempWarning=getValue(this);
    }
}

on envVar E_pubc_IBCU_IBCU_20B_IBCU_BrakeDiscHighTempWarning_SetVt
{
    if(getValue(E_pubc_IBCU_IBCU_20B_IBCU_BrakeDiscHighTempWarning_SetVt))
    {
        //update the signal value
        Msg_IBCU_20B.IBCU_BrakeDiscHighTempWarning=getvalue(E_pubc_IBCU_IBCU_20B_IBCU_BrakeDiscHighTempWarning_Vt);
    }
    else
    {
        Msg_IBCU_20B.IBCU_BrakeDiscHighTempWarning=getValue(E_pubc_IBCU_IBCU_20B_IBCU_BrakeDiscHighTempWarning_Rv);
    }
}
 
on envVar E_pubc_IBCU_IBCU_20B_Wheel_Speed_RR_Direction_Rv
{
    int64 rawValue = 0ll;
    float rawValue_float = 0.0;
    float phyValue = 0.0;        

    //set the signal with updated raw value
    if(getValue(E_pubc_IBCU_IBCU_20B_Wheel_Speed_RR_Direction_SetVt)==0)
    {
        rawValue = getvalue(this);
        if(chgEv_IBCU_20B_Wheel_Speed_RR_Direction == 0)
        {
            //type conversion to float
            rawValue_float = rawValue;        
            // raw to physical conversion
            phyValue = ((rawValue_float *1)+(0));
            putValue(E_pubc_IBCU_IBCU_20B_Wheel_Speed_RR_Direction_Pv, phyValue);
            chgEv_IBCU_20B_Wheel_Speed_RR_Direction = 1;
        }
        else
        {
            chgEv_IBCU_20B_Wheel_Speed_RR_Direction = 0;
        }    
        //update the signal value
        Msg_IBCU_20B.Wheel_Speed_RR_Direction=rawValue;        
    }                                                                           
}

on envVar E_pubc_IBCU_IBCU_20B_Wheel_Speed_RR_Direction_Pv
{
    int64 rawValue = 0ll;
    float phyValue = 0.0;
    
    //update the raw value with physical value 
    if(getValue(E_pubc_IBCU_IBCU_20B_Wheel_Speed_RR_Direction_SetVt)==0)
    {
        if(chgEv_IBCU_20B_Wheel_Speed_RR_Direction == 0)
        {
            phyValue = getvalue(this);
            // physical to raw conversion
            rawValue = ((phyValue -(0))/1);
            putValue(E_pubc_IBCU_IBCU_20B_Wheel_Speed_RR_Direction_Rv, rawValue);
            chgEv_IBCU_20B_Wheel_Speed_RR_Direction = 1;  
        }
        else
        {
            chgEv_IBCU_20B_Wheel_Speed_RR_Direction = 0;
        }
    }
}

on envVar E_pubc_IBCU_IBCU_20B_Wheel_Speed_RR_Direction_Vt
{
    qword rawValue = 0ll;
    if(getValue(E_pubc_IBCU_IBCU_20B_Wheel_Speed_RR_Direction_SetVt))
    {
        //update the signal value
        Msg_IBCU_20B.Wheel_Speed_RR_Direction=getValue(this);
    }
}

on envVar E_pubc_IBCU_IBCU_20B_Wheel_Speed_RR_Direction_SetVt
{
    if(getValue(E_pubc_IBCU_IBCU_20B_Wheel_Speed_RR_Direction_SetVt))
    {
        //update the signal value
        Msg_IBCU_20B.Wheel_Speed_RR_Direction=getvalue(E_pubc_IBCU_IBCU_20B_Wheel_Speed_RR_Direction_Vt);
    }
    else
    {
        Msg_IBCU_20B.Wheel_Speed_RR_Direction=getValue(E_pubc_IBCU_IBCU_20B_Wheel_Speed_RR_Direction_Rv);
    }
}
 
on envVar E_pubc_IBCU_IBCU_20B_Wheel_Speed_RR_Data_Rv
{
    int64 rawValue = 0ll;
    float rawValue_float = 0.0;
    float phyValue = 0.0;        

    //set the signal with updated raw value
    {
        rawValue = getvalue(this);
        if(chgEv_IBCU_20B_Wheel_Speed_RR_Data == 0)
        {
            //type conversion to float
            rawValue_float = rawValue;        
            // raw to physical conversion
            phyValue = ((rawValue_float *0.05625)+(0));
            putValue(E_pubc_IBCU_IBCU_20B_Wheel_Speed_RR_Data_Pv, phyValue);
            chgEv_IBCU_20B_Wheel_Speed_RR_Data = 1;
        }
        else
        {
            chgEv_IBCU_20B_Wheel_Speed_RR_Data = 0;
        }    
        //update the signal value
        Msg_IBCU_20B.Wheel_Speed_RR_Data=rawValue;        
    }                                                                           
}

on envVar E_pubc_IBCU_IBCU_20B_Wheel_Speed_RR_Data_Pv
{
    int64 rawValue = 0ll;
    float phyValue = 0.0;
    
    //update the raw value with physical value 
    {
        if(chgEv_IBCU_20B_Wheel_Speed_RR_Data == 0)
        {
            phyValue = getvalue(this);
            // physical to raw conversion
            rawValue = ((phyValue -(0))/0.05625);
            putValue(E_pubc_IBCU_IBCU_20B_Wheel_Speed_RR_Data_Rv, rawValue);
            chgEv_IBCU_20B_Wheel_Speed_RR_Data = 1;  
        }
        else
        {
            chgEv_IBCU_20B_Wheel_Speed_RR_Data = 0;
        }
    }
}


 
on envVar E_pubc_IBCU_IBCU_20B_ESP_TCSActive_Rv
{
    int64 rawValue = 0ll;
    float rawValue_float = 0.0;
    float phyValue = 0.0;        

    //set the signal with updated raw value
    if(getValue(E_pubc_IBCU_IBCU_20B_ESP_TCSActive_SetVt)==0)
    {
        rawValue = getvalue(this);
        if(chgEv_IBCU_20B_ESP_TCSActive == 0)
        {
            //type conversion to float
            rawValue_float = rawValue;        
            // raw to physical conversion
            phyValue = ((rawValue_float *1)+(0));
            putValue(E_pubc_IBCU_IBCU_20B_ESP_TCSActive_Pv, phyValue);
            chgEv_IBCU_20B_ESP_TCSActive = 1;
        }
        else
        {
            chgEv_IBCU_20B_ESP_TCSActive = 0;
        }    
        //update the signal value
        Msg_IBCU_20B.ESP_TCSActive=rawValue;        
    }                                                                           
}

on envVar E_pubc_IBCU_IBCU_20B_ESP_TCSActive_Pv
{
    int64 rawValue = 0ll;
    float phyValue = 0.0;
    
    //update the raw value with physical value 
    if(getValue(E_pubc_IBCU_IBCU_20B_ESP_TCSActive_SetVt)==0)
    {
        if(chgEv_IBCU_20B_ESP_TCSActive == 0)
        {
            phyValue = getvalue(this);
            // physical to raw conversion
            rawValue = ((phyValue -(0))/1);
            putValue(E_pubc_IBCU_IBCU_20B_ESP_TCSActive_Rv, rawValue);
            chgEv_IBCU_20B_ESP_TCSActive = 1;  
        }
        else
        {
            chgEv_IBCU_20B_ESP_TCSActive = 0;
        }
    }
}

on envVar E_pubc_IBCU_IBCU_20B_ESP_TCSActive_Vt
{
    qword rawValue = 0ll;
    if(getValue(E_pubc_IBCU_IBCU_20B_ESP_TCSActive_SetVt))
    {
        //update the signal value
        Msg_IBCU_20B.ESP_TCSActive=getValue(this);
    }
}

on envVar E_pubc_IBCU_IBCU_20B_ESP_TCSActive_SetVt
{
    if(getValue(E_pubc_IBCU_IBCU_20B_ESP_TCSActive_SetVt))
    {
        //update the signal value
        Msg_IBCU_20B.ESP_TCSActive=getvalue(E_pubc_IBCU_IBCU_20B_ESP_TCSActive_Vt);
    }
    else
    {
        Msg_IBCU_20B.ESP_TCSActive=getValue(E_pubc_IBCU_IBCU_20B_ESP_TCSActive_Rv);
    }
}
 
on envVar E_pubc_IBCU_IBCU_20B_ESP_HDC_STATUS_Rv
{
    int64 rawValue = 0ll;
    float rawValue_float = 0.0;
    float phyValue = 0.0;        

    //set the signal with updated raw value
    if(getValue(E_pubc_IBCU_IBCU_20B_ESP_HDC_STATUS_SetVt)==0)
    {
        rawValue = getvalue(this);
        if(chgEv_IBCU_20B_ESP_HDC_STATUS == 0)
        {
            //type conversion to float
            rawValue_float = rawValue;        
            // raw to physical conversion
            phyValue = ((rawValue_float *1)+(0));
            putValue(E_pubc_IBCU_IBCU_20B_ESP_HDC_STATUS_Pv, phyValue);
            chgEv_IBCU_20B_ESP_HDC_STATUS = 1;
        }
        else
        {
            chgEv_IBCU_20B_ESP_HDC_STATUS = 0;
        }    
        //update the signal value
        Msg_IBCU_20B.ESP_HDC_STATUS=rawValue;        
    }                                                                           
}

on envVar E_pubc_IBCU_IBCU_20B_ESP_HDC_STATUS_Pv
{
    int64 rawValue = 0ll;
    float phyValue = 0.0;
    
    //update the raw value with physical value 
    if(getValue(E_pubc_IBCU_IBCU_20B_ESP_HDC_STATUS_SetVt)==0)
    {
        if(chgEv_IBCU_20B_ESP_HDC_STATUS == 0)
        {
            phyValue = getvalue(this);
            // physical to raw conversion
            rawValue = ((phyValue -(0))/1);
            putValue(E_pubc_IBCU_IBCU_20B_ESP_HDC_STATUS_Rv, rawValue);
            chgEv_IBCU_20B_ESP_HDC_STATUS = 1;  
        }
        else
        {
            chgEv_IBCU_20B_ESP_HDC_STATUS = 0;
        }
    }
}

on envVar E_pubc_IBCU_IBCU_20B_ESP_HDC_STATUS_Vt
{
    qword rawValue = 0ll;
    if(getValue(E_pubc_IBCU_IBCU_20B_ESP_HDC_STATUS_SetVt))
    {
        //update the signal value
        Msg_IBCU_20B.ESP_HDC_STATUS=getValue(this);
    }
}

on envVar E_pubc_IBCU_IBCU_20B_ESP_HDC_STATUS_SetVt
{
    if(getValue(E_pubc_IBCU_IBCU_20B_ESP_HDC_STATUS_SetVt))
    {
        //update the signal value
        Msg_IBCU_20B.ESP_HDC_STATUS=getvalue(E_pubc_IBCU_IBCU_20B_ESP_HDC_STATUS_Vt);
    }
    else
    {
        Msg_IBCU_20B.ESP_HDC_STATUS=getValue(E_pubc_IBCU_IBCU_20B_ESP_HDC_STATUS_Rv);
    }
}
 
on envVar E_pubc_IBCU_IBCU_20B_Wheel_Speed_FL_Data_Rv
{
    int64 rawValue = 0ll;
    float rawValue_float = 0.0;
    float phyValue = 0.0;        

    //set the signal with updated raw value
    {
        rawValue = getvalue(this);
        if(chgEv_IBCU_20B_Wheel_Speed_FL_Data == 0)
        {
            //type conversion to float
            rawValue_float = rawValue;        
            // raw to physical conversion
            phyValue = ((rawValue_float *0.05625)+(0));
            putValue(E_pubc_IBCU_IBCU_20B_Wheel_Speed_FL_Data_Pv, phyValue);
            chgEv_IBCU_20B_Wheel_Speed_FL_Data = 1;
        }
        else
        {
            chgEv_IBCU_20B_Wheel_Speed_FL_Data = 0;
        }    
        //update the signal value
        Msg_IBCU_20B.Wheel_Speed_FL_Data=rawValue;        
    }                                                                           
}

on envVar E_pubc_IBCU_IBCU_20B_Wheel_Speed_FL_Data_Pv
{
    int64 rawValue = 0ll;
    float phyValue = 0.0;
    
    //update the raw value with physical value 
    {
        if(chgEv_IBCU_20B_Wheel_Speed_FL_Data == 0)
        {
            phyValue = getvalue(this);
            // physical to raw conversion
            rawValue = ((phyValue -(0))/0.05625);
            putValue(E_pubc_IBCU_IBCU_20B_Wheel_Speed_FL_Data_Rv, rawValue);
            chgEv_IBCU_20B_Wheel_Speed_FL_Data = 1;  
        }
        else
        {
            chgEv_IBCU_20B_Wheel_Speed_FL_Data = 0;
        }
    }
}


 
on envVar E_pubc_IBCU_IBCU_20B_Wheel_Speed_FL_Direction_Rv
{
    int64 rawValue = 0ll;
    float rawValue_float = 0.0;
    float phyValue = 0.0;        

    //set the signal with updated raw value
    if(getValue(E_pubc_IBCU_IBCU_20B_Wheel_Speed_FL_Direction_SetVt)==0)
    {
        rawValue = getvalue(this);
        if(chgEv_IBCU_20B_Wheel_Speed_FL_Direction == 0)
        {
            //type conversion to float
            rawValue_float = rawValue;        
            // raw to physical conversion
            phyValue = ((rawValue_float *1)+(0));
            putValue(E_pubc_IBCU_IBCU_20B_Wheel_Speed_FL_Direction_Pv, phyValue);
            chgEv_IBCU_20B_Wheel_Speed_FL_Direction = 1;
        }
        else
        {
            chgEv_IBCU_20B_Wheel_Speed_FL_Direction = 0;
        }    
        //update the signal value
        Msg_IBCU_20B.Wheel_Speed_FL_Direction=rawValue;        
    }                                                                           
}

on envVar E_pubc_IBCU_IBCU_20B_Wheel_Speed_FL_Direction_Pv
{
    int64 rawValue = 0ll;
    float phyValue = 0.0;
    
    //update the raw value with physical value 
    if(getValue(E_pubc_IBCU_IBCU_20B_Wheel_Speed_FL_Direction_SetVt)==0)
    {
        if(chgEv_IBCU_20B_Wheel_Speed_FL_Direction == 0)
        {
            phyValue = getvalue(this);
            // physical to raw conversion
            rawValue = ((phyValue -(0))/1);
            putValue(E_pubc_IBCU_IBCU_20B_Wheel_Speed_FL_Direction_Rv, rawValue);
            chgEv_IBCU_20B_Wheel_Speed_FL_Direction = 1;  
        }
        else
        {
            chgEv_IBCU_20B_Wheel_Speed_FL_Direction = 0;
        }
    }
}

on envVar E_pubc_IBCU_IBCU_20B_Wheel_Speed_FL_Direction_Vt
{
    qword rawValue = 0ll;
    if(getValue(E_pubc_IBCU_IBCU_20B_Wheel_Speed_FL_Direction_SetVt))
    {
        //update the signal value
        Msg_IBCU_20B.Wheel_Speed_FL_Direction=getValue(this);
    }
}

on envVar E_pubc_IBCU_IBCU_20B_Wheel_Speed_FL_Direction_SetVt
{
    if(getValue(E_pubc_IBCU_IBCU_20B_Wheel_Speed_FL_Direction_SetVt))
    {
        //update the signal value
        Msg_IBCU_20B.Wheel_Speed_FL_Direction=getvalue(E_pubc_IBCU_IBCU_20B_Wheel_Speed_FL_Direction_Vt);
    }
    else
    {
        Msg_IBCU_20B.Wheel_Speed_FL_Direction=getValue(E_pubc_IBCU_IBCU_20B_Wheel_Speed_FL_Direction_Rv);
    }
}
 
on envVar E_pubc_IBCU_IBCU_20B_ESP_AEBAvailable_Rv
{
    int64 rawValue = 0ll;
    float rawValue_float = 0.0;
    float phyValue = 0.0;        

    //set the signal with updated raw value
    if(getValue(E_pubc_IBCU_IBCU_20B_ESP_AEBAvailable_SetVt)==0)
    {
        rawValue = getvalue(this);
        if(chgEv_IBCU_20B_ESP_AEBAvailable == 0)
        {
            //type conversion to float
            rawValue_float = rawValue;        
            // raw to physical conversion
            phyValue = ((rawValue_float *1)+(0));
            putValue(E_pubc_IBCU_IBCU_20B_ESP_AEBAvailable_Pv, phyValue);
            chgEv_IBCU_20B_ESP_AEBAvailable = 1;
        }
        else
        {
            chgEv_IBCU_20B_ESP_AEBAvailable = 0;
        }    
        //update the signal value
        Msg_IBCU_20B.ESP_AEBAvailable=rawValue;        
    }                                                                           
}

on envVar E_pubc_IBCU_IBCU_20B_ESP_AEBAvailable_Pv
{
    int64 rawValue = 0ll;
    float phyValue = 0.0;
    
    //update the raw value with physical value 
    if(getValue(E_pubc_IBCU_IBCU_20B_ESP_AEBAvailable_SetVt)==0)
    {
        if(chgEv_IBCU_20B_ESP_AEBAvailable == 0)
        {
            phyValue = getvalue(this);
            // physical to raw conversion
            rawValue = ((phyValue -(0))/1);
            putValue(E_pubc_IBCU_IBCU_20B_ESP_AEBAvailable_Rv, rawValue);
            chgEv_IBCU_20B_ESP_AEBAvailable = 1;  
        }
        else
        {
            chgEv_IBCU_20B_ESP_AEBAvailable = 0;
        }
    }
}

on envVar E_pubc_IBCU_IBCU_20B_ESP_AEBAvailable_Vt
{
    qword rawValue = 0ll;
    if(getValue(E_pubc_IBCU_IBCU_20B_ESP_AEBAvailable_SetVt))
    {
        //update the signal value
        Msg_IBCU_20B.ESP_AEBAvailable=getValue(this);
    }
}

on envVar E_pubc_IBCU_IBCU_20B_ESP_AEBAvailable_SetVt
{
    if(getValue(E_pubc_IBCU_IBCU_20B_ESP_AEBAvailable_SetVt))
    {
        //update the signal value
        Msg_IBCU_20B.ESP_AEBAvailable=getvalue(E_pubc_IBCU_IBCU_20B_ESP_AEBAvailable_Vt);
    }
    else
    {
        Msg_IBCU_20B.ESP_AEBAvailable=getValue(E_pubc_IBCU_IBCU_20B_ESP_AEBAvailable_Rv);
    }
}
 
on envVar E_pubc_IBCU_IBCU_20B_Wheel_Speed_RR_Valid_Data_Rv
{
    int64 rawValue = 0ll;
    float rawValue_float = 0.0;
    float phyValue = 0.0;        

    //set the signal with updated raw value
    if(getValue(E_pubc_IBCU_IBCU_20B_Wheel_Speed_RR_Valid_Data_SetVt)==0)
    {
        rawValue = getvalue(this);
        if(chgEv_IBCU_20B_Wheel_Speed_RR_Valid_Data == 0)
        {
            //type conversion to float
            rawValue_float = rawValue;        
            // raw to physical conversion
            phyValue = ((rawValue_float *1)+(0));
            putValue(E_pubc_IBCU_IBCU_20B_Wheel_Speed_RR_Valid_Data_Pv, phyValue);
            chgEv_IBCU_20B_Wheel_Speed_RR_Valid_Data = 1;
        }
        else
        {
            chgEv_IBCU_20B_Wheel_Speed_RR_Valid_Data = 0;
        }    
        //update the signal value
        Msg_IBCU_20B.Wheel_Speed_RR_Valid_Data=rawValue;        
    }                                                                           
}

on envVar E_pubc_IBCU_IBCU_20B_Wheel_Speed_RR_Valid_Data_Pv
{
    int64 rawValue = 0ll;
    float phyValue = 0.0;
    
    //update the raw value with physical value 
    if(getValue(E_pubc_IBCU_IBCU_20B_Wheel_Speed_RR_Valid_Data_SetVt)==0)
    {
        if(chgEv_IBCU_20B_Wheel_Speed_RR_Valid_Data == 0)
        {
            phyValue = getvalue(this);
            // physical to raw conversion
            rawValue = ((phyValue -(0))/1);
            putValue(E_pubc_IBCU_IBCU_20B_Wheel_Speed_RR_Valid_Data_Rv, rawValue);
            chgEv_IBCU_20B_Wheel_Speed_RR_Valid_Data = 1;  
        }
        else
        {
            chgEv_IBCU_20B_Wheel_Speed_RR_Valid_Data = 0;
        }
    }
}

on envVar E_pubc_IBCU_IBCU_20B_Wheel_Speed_RR_Valid_Data_Vt
{
    qword rawValue = 0ll;
    if(getValue(E_pubc_IBCU_IBCU_20B_Wheel_Speed_RR_Valid_Data_SetVt))
    {
        //update the signal value
        Msg_IBCU_20B.Wheel_Speed_RR_Valid_Data=getValue(this);
    }
}

on envVar E_pubc_IBCU_IBCU_20B_Wheel_Speed_RR_Valid_Data_SetVt
{
    if(getValue(E_pubc_IBCU_IBCU_20B_Wheel_Speed_RR_Valid_Data_SetVt))
    {
        //update the signal value
        Msg_IBCU_20B.Wheel_Speed_RR_Valid_Data=getvalue(E_pubc_IBCU_IBCU_20B_Wheel_Speed_RR_Valid_Data_Vt);
    }
    else
    {
        Msg_IBCU_20B.Wheel_Speed_RR_Valid_Data=getValue(E_pubc_IBCU_IBCU_20B_Wheel_Speed_RR_Valid_Data_Rv);
    }
}
 
on envVar E_pubc_IBCU_IBCU_20B_Wheel_Speed_FR_Direction_Rv
{
    int64 rawValue = 0ll;
    float rawValue_float = 0.0;
    float phyValue = 0.0;        

    //set the signal with updated raw value
    if(getValue(E_pubc_IBCU_IBCU_20B_Wheel_Speed_FR_Direction_SetVt)==0)
    {
        rawValue = getvalue(this);
        if(chgEv_IBCU_20B_Wheel_Speed_FR_Direction == 0)
        {
            //type conversion to float
            rawValue_float = rawValue;        
            // raw to physical conversion
            phyValue = ((rawValue_float *1)+(0));
            putValue(E_pubc_IBCU_IBCU_20B_Wheel_Speed_FR_Direction_Pv, phyValue);
            chgEv_IBCU_20B_Wheel_Speed_FR_Direction = 1;
        }
        else
        {
            chgEv_IBCU_20B_Wheel_Speed_FR_Direction = 0;
        }    
        //update the signal value
        Msg_IBCU_20B.Wheel_Speed_FR_Direction=rawValue;        
    }                                                                           
}

on envVar E_pubc_IBCU_IBCU_20B_Wheel_Speed_FR_Direction_Pv
{
    int64 rawValue = 0ll;
    float phyValue = 0.0;
    
    //update the raw value with physical value 
    if(getValue(E_pubc_IBCU_IBCU_20B_Wheel_Speed_FR_Direction_SetVt)==0)
    {
        if(chgEv_IBCU_20B_Wheel_Speed_FR_Direction == 0)
        {
            phyValue = getvalue(this);
            // physical to raw conversion
            rawValue = ((phyValue -(0))/1);
            putValue(E_pubc_IBCU_IBCU_20B_Wheel_Speed_FR_Direction_Rv, rawValue);
            chgEv_IBCU_20B_Wheel_Speed_FR_Direction = 1;  
        }
        else
        {
            chgEv_IBCU_20B_Wheel_Speed_FR_Direction = 0;
        }
    }
}

on envVar E_pubc_IBCU_IBCU_20B_Wheel_Speed_FR_Direction_Vt
{
    qword rawValue = 0ll;
    if(getValue(E_pubc_IBCU_IBCU_20B_Wheel_Speed_FR_Direction_SetVt))
    {
        //update the signal value
        Msg_IBCU_20B.Wheel_Speed_FR_Direction=getValue(this);
    }
}

on envVar E_pubc_IBCU_IBCU_20B_Wheel_Speed_FR_Direction_SetVt
{
    if(getValue(E_pubc_IBCU_IBCU_20B_Wheel_Speed_FR_Direction_SetVt))
    {
        //update the signal value
        Msg_IBCU_20B.Wheel_Speed_FR_Direction=getvalue(E_pubc_IBCU_IBCU_20B_Wheel_Speed_FR_Direction_Vt);
    }
    else
    {
        Msg_IBCU_20B.Wheel_Speed_FR_Direction=getValue(E_pubc_IBCU_IBCU_20B_Wheel_Speed_FR_Direction_Rv);
    }
}
 
on envVar E_pubc_IBCU_IBCU_20B_ESP_VDCActive_Rv
{
    int64 rawValue = 0ll;
    float rawValue_float = 0.0;
    float phyValue = 0.0;        

    //set the signal with updated raw value
    if(getValue(E_pubc_IBCU_IBCU_20B_ESP_VDCActive_SetVt)==0)
    {
        rawValue = getvalue(this);
        if(chgEv_IBCU_20B_ESP_VDCActive == 0)
        {
            //type conversion to float
            rawValue_float = rawValue;        
            // raw to physical conversion
            phyValue = ((rawValue_float *1)+(0));
            putValue(E_pubc_IBCU_IBCU_20B_ESP_VDCActive_Pv, phyValue);
            chgEv_IBCU_20B_ESP_VDCActive = 1;
        }
        else
        {
            chgEv_IBCU_20B_ESP_VDCActive = 0;
        }    
        //update the signal value
        Msg_IBCU_20B.ESP_VDCActive=rawValue;        
    }                                                                           
}

on envVar E_pubc_IBCU_IBCU_20B_ESP_VDCActive_Pv
{
    int64 rawValue = 0ll;
    float phyValue = 0.0;
    
    //update the raw value with physical value 
    if(getValue(E_pubc_IBCU_IBCU_20B_ESP_VDCActive_SetVt)==0)
    {
        if(chgEv_IBCU_20B_ESP_VDCActive == 0)
        {
            phyValue = getvalue(this);
            // physical to raw conversion
            rawValue = ((phyValue -(0))/1);
            putValue(E_pubc_IBCU_IBCU_20B_ESP_VDCActive_Rv, rawValue);
            chgEv_IBCU_20B_ESP_VDCActive = 1;  
        }
        else
        {
            chgEv_IBCU_20B_ESP_VDCActive = 0;
        }
    }
}

on envVar E_pubc_IBCU_IBCU_20B_ESP_VDCActive_Vt
{
    qword rawValue = 0ll;
    if(getValue(E_pubc_IBCU_IBCU_20B_ESP_VDCActive_SetVt))
    {
        //update the signal value
        Msg_IBCU_20B.ESP_VDCActive=getValue(this);
    }
}

on envVar E_pubc_IBCU_IBCU_20B_ESP_VDCActive_SetVt
{
    if(getValue(E_pubc_IBCU_IBCU_20B_ESP_VDCActive_SetVt))
    {
        //update the signal value
        Msg_IBCU_20B.ESP_VDCActive=getvalue(E_pubc_IBCU_IBCU_20B_ESP_VDCActive_Vt);
    }
    else
    {
        Msg_IBCU_20B.ESP_VDCActive=getValue(E_pubc_IBCU_IBCU_20B_ESP_VDCActive_Rv);
    }
}
 
on envVar E_pubc_IBCU_IBCU_20B_Wheel_Speed_RL_Valid_Data_Rv
{
    int64 rawValue = 0ll;
    float rawValue_float = 0.0;
    float phyValue = 0.0;        

    //set the signal with updated raw value
    if(getValue(E_pubc_IBCU_IBCU_20B_Wheel_Speed_RL_Valid_Data_SetVt)==0)
    {
        rawValue = getvalue(this);
        if(chgEv_IBCU_20B_Wheel_Speed_RL_Valid_Data == 0)
        {
            //type conversion to float
            rawValue_float = rawValue;        
            // raw to physical conversion
            phyValue = ((rawValue_float *1)+(0));
            putValue(E_pubc_IBCU_IBCU_20B_Wheel_Speed_RL_Valid_Data_Pv, phyValue);
            chgEv_IBCU_20B_Wheel_Speed_RL_Valid_Data = 1;
        }
        else
        {
            chgEv_IBCU_20B_Wheel_Speed_RL_Valid_Data = 0;
        }    
        //update the signal value
        Msg_IBCU_20B.Wheel_Speed_RL_Valid_Data=rawValue;        
    }                                                                           
}

on envVar E_pubc_IBCU_IBCU_20B_Wheel_Speed_RL_Valid_Data_Pv
{
    int64 rawValue = 0ll;
    float phyValue = 0.0;
    
    //update the raw value with physical value 
    if(getValue(E_pubc_IBCU_IBCU_20B_Wheel_Speed_RL_Valid_Data_SetVt)==0)
    {
        if(chgEv_IBCU_20B_Wheel_Speed_RL_Valid_Data == 0)
        {
            phyValue = getvalue(this);
            // physical to raw conversion
            rawValue = ((phyValue -(0))/1);
            putValue(E_pubc_IBCU_IBCU_20B_Wheel_Speed_RL_Valid_Data_Rv, rawValue);
            chgEv_IBCU_20B_Wheel_Speed_RL_Valid_Data = 1;  
        }
        else
        {
            chgEv_IBCU_20B_Wheel_Speed_RL_Valid_Data = 0;
        }
    }
}

on envVar E_pubc_IBCU_IBCU_20B_Wheel_Speed_RL_Valid_Data_Vt
{
    qword rawValue = 0ll;
    if(getValue(E_pubc_IBCU_IBCU_20B_Wheel_Speed_RL_Valid_Data_SetVt))
    {
        //update the signal value
        Msg_IBCU_20B.Wheel_Speed_RL_Valid_Data=getValue(this);
    }
}

on envVar E_pubc_IBCU_IBCU_20B_Wheel_Speed_RL_Valid_Data_SetVt
{
    if(getValue(E_pubc_IBCU_IBCU_20B_Wheel_Speed_RL_Valid_Data_SetVt))
    {
        //update the signal value
        Msg_IBCU_20B.Wheel_Speed_RL_Valid_Data=getvalue(E_pubc_IBCU_IBCU_20B_Wheel_Speed_RL_Valid_Data_Vt);
    }
    else
    {
        Msg_IBCU_20B.Wheel_Speed_RL_Valid_Data=getValue(E_pubc_IBCU_IBCU_20B_Wheel_Speed_RL_Valid_Data_Rv);
    }
}
 
on envVar E_pubc_IBCU_IBCU_20B_Wheel_Speed_RR_Pulse_Rv
{
    int64 rawValue = 0ll;
    float rawValue_float = 0.0;
    float phyValue = 0.0;        

    //set the signal with updated raw value
    {
        rawValue = getvalue(this);
        if(chgEv_IBCU_20B_Wheel_Speed_RR_Pulse == 0)
        {
            //type conversion to float
            rawValue_float = rawValue;        
            // raw to physical conversion
            phyValue = ((rawValue_float *1)+(0));
            putValue(E_pubc_IBCU_IBCU_20B_Wheel_Speed_RR_Pulse_Pv, phyValue);
            chgEv_IBCU_20B_Wheel_Speed_RR_Pulse = 1;
        }
        else
        {
            chgEv_IBCU_20B_Wheel_Speed_RR_Pulse = 0;
        }    
        //update the signal value
        Msg_IBCU_20B.Wheel_Speed_RR_Pulse=rawValue;        
    }                                                                           
}

on envVar E_pubc_IBCU_IBCU_20B_Wheel_Speed_RR_Pulse_Pv
{
    int64 rawValue = 0ll;
    float phyValue = 0.0;
    
    //update the raw value with physical value 
    {
        if(chgEv_IBCU_20B_Wheel_Speed_RR_Pulse == 0)
        {
            phyValue = getvalue(this);
            // physical to raw conversion
            rawValue = ((phyValue -(0))/1);
            putValue(E_pubc_IBCU_IBCU_20B_Wheel_Speed_RR_Pulse_Rv, rawValue);
            chgEv_IBCU_20B_Wheel_Speed_RR_Pulse = 1;  
        }
        else
        {
            chgEv_IBCU_20B_Wheel_Speed_RR_Pulse = 0;
        }
    }
}


 
on envVar E_pubc_IBCU_IBCU_20B_ESP_MasCylBrakePressureValid_Rv
{
    int64 rawValue = 0ll;
    float rawValue_float = 0.0;
    float phyValue = 0.0;        

    //set the signal with updated raw value
    if(getValue(E_pubc_IBCU_IBCU_20B_ESP_MasCylBrakePressureValid_SetVt)==0)
    {
        rawValue = getvalue(this);
        if(chgEv_IBCU_20B_ESP_MasCylBrakePressureValid == 0)
        {
            //type conversion to float
            rawValue_float = rawValue;        
            // raw to physical conversion
            phyValue = ((rawValue_float *1)+(0));
            putValue(E_pubc_IBCU_IBCU_20B_ESP_MasCylBrakePressureValid_Pv, phyValue);
            chgEv_IBCU_20B_ESP_MasCylBrakePressureValid = 1;
        }
        else
        {
            chgEv_IBCU_20B_ESP_MasCylBrakePressureValid = 0;
        }    
        //update the signal value
        Msg_IBCU_20B.ESP_MasCylBrakePressureValid=rawValue;        
    }                                                                           
}

on envVar E_pubc_IBCU_IBCU_20B_ESP_MasCylBrakePressureValid_Pv
{
    int64 rawValue = 0ll;
    float phyValue = 0.0;
    
    //update the raw value with physical value 
    if(getValue(E_pubc_IBCU_IBCU_20B_ESP_MasCylBrakePressureValid_SetVt)==0)
    {
        if(chgEv_IBCU_20B_ESP_MasCylBrakePressureValid == 0)
        {
            phyValue = getvalue(this);
            // physical to raw conversion
            rawValue = ((phyValue -(0))/1);
            putValue(E_pubc_IBCU_IBCU_20B_ESP_MasCylBrakePressureValid_Rv, rawValue);
            chgEv_IBCU_20B_ESP_MasCylBrakePressureValid = 1;  
        }
        else
        {
            chgEv_IBCU_20B_ESP_MasCylBrakePressureValid = 0;
        }
    }
}

on envVar E_pubc_IBCU_IBCU_20B_ESP_MasCylBrakePressureValid_Vt
{
    qword rawValue = 0ll;
    if(getValue(E_pubc_IBCU_IBCU_20B_ESP_MasCylBrakePressureValid_SetVt))
    {
        //update the signal value
        Msg_IBCU_20B.ESP_MasCylBrakePressureValid=getValue(this);
    }
}

on envVar E_pubc_IBCU_IBCU_20B_ESP_MasCylBrakePressureValid_SetVt
{
    if(getValue(E_pubc_IBCU_IBCU_20B_ESP_MasCylBrakePressureValid_SetVt))
    {
        //update the signal value
        Msg_IBCU_20B.ESP_MasCylBrakePressureValid=getvalue(E_pubc_IBCU_IBCU_20B_ESP_MasCylBrakePressureValid_Vt);
    }
    else
    {
        Msg_IBCU_20B.ESP_MasCylBrakePressureValid=getValue(E_pubc_IBCU_IBCU_20B_ESP_MasCylBrakePressureValid_Rv);
    }
}
 
on envVar E_pubc_IBCU_IBCU_20B_ESP_BrakeForce_Rv
{
    int64 rawValue = 0ll;
    float rawValue_float = 0.0;
    float phyValue = 0.0;        

    //set the signal with updated raw value
    if(getValue(E_pubc_IBCU_IBCU_20B_ESP_BrakeForce_SetVt)==0)
    {
        rawValue = getvalue(this);
        if(chgEv_IBCU_20B_ESP_BrakeForce == 0)
        {
            //type conversion to float
            rawValue_float = rawValue;        
            // raw to physical conversion
            phyValue = ((rawValue_float *1)+(0));
            putValue(E_pubc_IBCU_IBCU_20B_ESP_BrakeForce_Pv, phyValue);
            chgEv_IBCU_20B_ESP_BrakeForce = 1;
        }
        else
        {
            chgEv_IBCU_20B_ESP_BrakeForce = 0;
        }    
        //update the signal value
        Msg_IBCU_20B.ESP_BrakeForce=rawValue;        
    }                                                                           
}

on envVar E_pubc_IBCU_IBCU_20B_ESP_BrakeForce_Pv
{
    int64 rawValue = 0ll;
    float phyValue = 0.0;
    
    //update the raw value with physical value 
    if(getValue(E_pubc_IBCU_IBCU_20B_ESP_BrakeForce_SetVt)==0)
    {
        if(chgEv_IBCU_20B_ESP_BrakeForce == 0)
        {
            phyValue = getvalue(this);
            // physical to raw conversion
            rawValue = ((phyValue -(0))/1);
            putValue(E_pubc_IBCU_IBCU_20B_ESP_BrakeForce_Rv, rawValue);
            chgEv_IBCU_20B_ESP_BrakeForce = 1;  
        }
        else
        {
            chgEv_IBCU_20B_ESP_BrakeForce = 0;
        }
    }
}

on envVar E_pubc_IBCU_IBCU_20B_ESP_BrakeForce_Vt
{
    qword rawValue = 0ll;
    if(getValue(E_pubc_IBCU_IBCU_20B_ESP_BrakeForce_SetVt))
    {
        //update the signal value
        Msg_IBCU_20B.ESP_BrakeForce=getValue(this);
    }
}

on envVar E_pubc_IBCU_IBCU_20B_ESP_BrakeForce_SetVt
{
    if(getValue(E_pubc_IBCU_IBCU_20B_ESP_BrakeForce_SetVt))
    {
        //update the signal value
        Msg_IBCU_20B.ESP_BrakeForce=getvalue(E_pubc_IBCU_IBCU_20B_ESP_BrakeForce_Vt);
    }
    else
    {
        Msg_IBCU_20B.ESP_BrakeForce=getValue(E_pubc_IBCU_IBCU_20B_ESP_BrakeForce_Rv);
    }
}
 
on envVar E_pubc_IBCU_IBCU_20B_Wheel_Speed_RL_Pulse_Rv
{
    int64 rawValue = 0ll;
    float rawValue_float = 0.0;
    float phyValue = 0.0;        

    //set the signal with updated raw value
    {
        rawValue = getvalue(this);
        if(chgEv_IBCU_20B_Wheel_Speed_RL_Pulse == 0)
        {
            //type conversion to float
            rawValue_float = rawValue;        
            // raw to physical conversion
            phyValue = ((rawValue_float *1)+(0));
            putValue(E_pubc_IBCU_IBCU_20B_Wheel_Speed_RL_Pulse_Pv, phyValue);
            chgEv_IBCU_20B_Wheel_Speed_RL_Pulse = 1;
        }
        else
        {
            chgEv_IBCU_20B_Wheel_Speed_RL_Pulse = 0;
        }    
        //update the signal value
        Msg_IBCU_20B.Wheel_Speed_RL_Pulse=rawValue;        
    }                                                                           
}

on envVar E_pubc_IBCU_IBCU_20B_Wheel_Speed_RL_Pulse_Pv
{
    int64 rawValue = 0ll;
    float phyValue = 0.0;
    
    //update the raw value with physical value 
    {
        if(chgEv_IBCU_20B_Wheel_Speed_RL_Pulse == 0)
        {
            phyValue = getvalue(this);
            // physical to raw conversion
            rawValue = ((phyValue -(0))/1);
            putValue(E_pubc_IBCU_IBCU_20B_Wheel_Speed_RL_Pulse_Rv, rawValue);
            chgEv_IBCU_20B_Wheel_Speed_RL_Pulse = 1;  
        }
        else
        {
            chgEv_IBCU_20B_Wheel_Speed_RL_Pulse = 0;
        }
    }
}


 
on envVar E_pubc_IBCU_IBCU_20B_ESP_OnlyABSActive_Rv
{
    int64 rawValue = 0ll;
    float rawValue_float = 0.0;
    float phyValue = 0.0;        

    //set the signal with updated raw value
    if(getValue(E_pubc_IBCU_IBCU_20B_ESP_OnlyABSActive_SetVt)==0)
    {
        rawValue = getvalue(this);
        if(chgEv_IBCU_20B_ESP_OnlyABSActive == 0)
        {
            //type conversion to float
            rawValue_float = rawValue;        
            // raw to physical conversion
            phyValue = ((rawValue_float *1)+(0));
            putValue(E_pubc_IBCU_IBCU_20B_ESP_OnlyABSActive_Pv, phyValue);
            chgEv_IBCU_20B_ESP_OnlyABSActive = 1;
        }
        else
        {
            chgEv_IBCU_20B_ESP_OnlyABSActive = 0;
        }    
        //update the signal value
        Msg_IBCU_20B.ESP_OnlyABSActive=rawValue;        
    }                                                                           
}

on envVar E_pubc_IBCU_IBCU_20B_ESP_OnlyABSActive_Pv
{
    int64 rawValue = 0ll;
    float phyValue = 0.0;
    
    //update the raw value with physical value 
    if(getValue(E_pubc_IBCU_IBCU_20B_ESP_OnlyABSActive_SetVt)==0)
    {
        if(chgEv_IBCU_20B_ESP_OnlyABSActive == 0)
        {
            phyValue = getvalue(this);
            // physical to raw conversion
            rawValue = ((phyValue -(0))/1);
            putValue(E_pubc_IBCU_IBCU_20B_ESP_OnlyABSActive_Rv, rawValue);
            chgEv_IBCU_20B_ESP_OnlyABSActive = 1;  
        }
        else
        {
            chgEv_IBCU_20B_ESP_OnlyABSActive = 0;
        }
    }
}

on envVar E_pubc_IBCU_IBCU_20B_ESP_OnlyABSActive_Vt
{
    qword rawValue = 0ll;
    if(getValue(E_pubc_IBCU_IBCU_20B_ESP_OnlyABSActive_SetVt))
    {
        //update the signal value
        Msg_IBCU_20B.ESP_OnlyABSActive=getValue(this);
    }
}

on envVar E_pubc_IBCU_IBCU_20B_ESP_OnlyABSActive_SetVt
{
    if(getValue(E_pubc_IBCU_IBCU_20B_ESP_OnlyABSActive_SetVt))
    {
        //update the signal value
        Msg_IBCU_20B.ESP_OnlyABSActive=getvalue(E_pubc_IBCU_IBCU_20B_ESP_OnlyABSActive_Vt);
    }
    else
    {
        Msg_IBCU_20B.ESP_OnlyABSActive=getValue(E_pubc_IBCU_IBCU_20B_ESP_OnlyABSActive_Rv);
    }
}
 
on envVar E_pubc_IBCU_IBCU_20B_ESP_VehicleStandstill_Rv
{
    int64 rawValue = 0ll;
    float rawValue_float = 0.0;
    float phyValue = 0.0;        

    //set the signal with updated raw value
    if(getValue(E_pubc_IBCU_IBCU_20B_ESP_VehicleStandstill_SetVt)==0)
    {
        rawValue = getvalue(this);
        if(chgEv_IBCU_20B_ESP_VehicleStandstill == 0)
        {
            //type conversion to float
            rawValue_float = rawValue;        
            // raw to physical conversion
            phyValue = ((rawValue_float *1)+(0));
            putValue(E_pubc_IBCU_IBCU_20B_ESP_VehicleStandstill_Pv, phyValue);
            chgEv_IBCU_20B_ESP_VehicleStandstill = 1;
        }
        else
        {
            chgEv_IBCU_20B_ESP_VehicleStandstill = 0;
        }    
        //update the signal value
        Msg_IBCU_20B.ESP_VehicleStandstill=rawValue;        
    }                                                                           
}

on envVar E_pubc_IBCU_IBCU_20B_ESP_VehicleStandstill_Pv
{
    int64 rawValue = 0ll;
    float phyValue = 0.0;
    
    //update the raw value with physical value 
    if(getValue(E_pubc_IBCU_IBCU_20B_ESP_VehicleStandstill_SetVt)==0)
    {
        if(chgEv_IBCU_20B_ESP_VehicleStandstill == 0)
        {
            phyValue = getvalue(this);
            // physical to raw conversion
            rawValue = ((phyValue -(0))/1);
            putValue(E_pubc_IBCU_IBCU_20B_ESP_VehicleStandstill_Rv, rawValue);
            chgEv_IBCU_20B_ESP_VehicleStandstill = 1;  
        }
        else
        {
            chgEv_IBCU_20B_ESP_VehicleStandstill = 0;
        }
    }
}

on envVar E_pubc_IBCU_IBCU_20B_ESP_VehicleStandstill_Vt
{
    qword rawValue = 0ll;
    if(getValue(E_pubc_IBCU_IBCU_20B_ESP_VehicleStandstill_SetVt))
    {
        //update the signal value
        Msg_IBCU_20B.ESP_VehicleStandstill=getValue(this);
    }
}

on envVar E_pubc_IBCU_IBCU_20B_ESP_VehicleStandstill_SetVt
{
    if(getValue(E_pubc_IBCU_IBCU_20B_ESP_VehicleStandstill_SetVt))
    {
        //update the signal value
        Msg_IBCU_20B.ESP_VehicleStandstill=getvalue(E_pubc_IBCU_IBCU_20B_ESP_VehicleStandstill_Vt);
    }
    else
    {
        Msg_IBCU_20B.ESP_VehicleStandstill=getValue(E_pubc_IBCU_IBCU_20B_ESP_VehicleStandstill_Rv);
    }
}
 
on envVar E_pubc_IBCU_IBCU_20B_ESP_MasCylBrakePressure_Rv
{
    int64 rawValue = 0ll;
    float rawValue_float = 0.0;
    float phyValue = 0.0;        

    //set the signal with updated raw value
    {
        rawValue = getvalue(this);
        if(chgEv_IBCU_20B_ESP_MasCylBrakePressure == 0)
        {
            //type conversion to float
            rawValue_float = rawValue;        
            // raw to physical conversion
            phyValue = ((rawValue_float *0.1)+(0));
            putValue(E_pubc_IBCU_IBCU_20B_ESP_MasCylBrakePressure_Pv, phyValue);
            chgEv_IBCU_20B_ESP_MasCylBrakePressure = 1;
        }
        else
        {
            chgEv_IBCU_20B_ESP_MasCylBrakePressure = 0;
        }    
        //update the signal value
        Msg_IBCU_20B.ESP_MasCylBrakePressure=rawValue;        
    }                                                                           
}

on envVar E_pubc_IBCU_IBCU_20B_ESP_MasCylBrakePressure_Pv
{
    int64 rawValue = 0ll;
    float phyValue = 0.0;
    
    //update the raw value with physical value 
    {
        if(chgEv_IBCU_20B_ESP_MasCylBrakePressure == 0)
        {
            phyValue = getvalue(this);
            // physical to raw conversion
            rawValue = ((phyValue -(0))/0.1);
            putValue(E_pubc_IBCU_IBCU_20B_ESP_MasCylBrakePressure_Rv, rawValue);
            chgEv_IBCU_20B_ESP_MasCylBrakePressure = 1;  
        }
        else
        {
            chgEv_IBCU_20B_ESP_MasCylBrakePressure = 0;
        }
    }
}


 
on envVar E_pubc_IBCU_IBCU_1CB_tx
{
    if(getValue(this))
    {       
        
        //update the BZ Signal
        if(IBCU_1CB_IBCU_RollingCounter_1CB_wrongvalctr == 0)
        {
            update_IBCU_1CB_IBCU_RollingCounter_1CB_counter();
            Msg_IBCU_1CB.IBCU_RollingCounter_1CB= IBCU_1CB_IBCU_RollingCounter_1CB_counter;
        }
        else if(IBCU_1CB_IBCU_RollingCounter_1CB_wrongvalctr > 0)
        {
			IBCU_1CB_IBCU_RollingCounter_1CB_counter=IBCU_1CB_IBCU_RollingCounter_1CB_counter + IBCU_1CB_IBCU_RollingCounter_1CB_wrongvalctr;
			 Msg_IBCU_1CB.IBCU_RollingCounter_1CB= IBCU_1CB_IBCU_RollingCounter_1CB_counter;
             /*IBCU_1CB_IBCU_RollingCounter_1CB_wrongvalctr--;
              // if counter becomes zero, update panel controller to zero
             if(IBCU_1CB_IBCU_RollingCounter_1CB_wrongvalctr == 0)
             {
                 putValue(E_pubc_IBCU_IBCU_1CB_IBCU_RollingCounter_1CB_wrongvalctr,0);
             } */
        }
        else
        { 
			// do nothing
        }    
        //update the BZ Signal
        if(IBCU_1CB_IBCU_RollingCounter_237_wrongvalctr == 0)
        {
            update_IBCU_1CB_IBCU_RollingCounter_237_counter();
            Msg_IBCU_1CB.IBCU_RollingCounter_237= IBCU_1CB_IBCU_RollingCounter_237_counter;
        }
        else if(IBCU_1CB_IBCU_RollingCounter_237_wrongvalctr > 0)
        {
			IBCU_1CB_IBCU_RollingCounter_237_counter=IBCU_1CB_IBCU_RollingCounter_237_counter + IBCU_1CB_IBCU_RollingCounter_237_wrongvalctr;
			 Msg_IBCU_1CB.IBCU_RollingCounter_237= IBCU_1CB_IBCU_RollingCounter_237_counter;
             /*IBCU_1CB_IBCU_RollingCounter_237_wrongvalctr--;
              // if counter becomes zero, update panel controller to zero
             if(IBCU_1CB_IBCU_RollingCounter_237_wrongvalctr == 0)
             {
                 putValue(E_pubc_IBCU_IBCU_1CB_IBCU_RollingCounter_237_wrongvalctr,0);
             } */
        }
        else
        { 
			// do nothing
        }    
        //calculate the CRC CheckSum
        update_IBCU_1CB_CRC_CheckSum();

        output(Msg_IBCU_1CB);        
    }
}

on envVar E_pubc_IBCU_IBCU_1CB_Range
{
    qword rawstatus = 0ll;
    qword rawValue = 0ll;    
    
    rawstatus = getvalue(this);    
    // set all the signals with min raw /max raw /init raw
    switch (rawstatus) 
    {
     case(0) :
        rawValue= 0;
        putValue(E_pubc_IBCU_IBCU_1CB_IBCU_sOutputRodAct_Q_Rv, rawValue);
        rawValue= 0;
        putValue(E_pubc_IBCU_IBCU_1CB_IBCU_BrakePedalApplied_Rv, rawValue);
        rawValue= 0;
        putValue(E_pubc_IBCU_IBCU_1CB_IBCU_sOutputRodAct_Rv, rawValue);
        break;
     case(1) :
        rawValue= 3;
        putValue(E_pubc_IBCU_IBCU_1CB_IBCU_sOutputRodAct_Q_Rv, rawValue);
        rawValue= 1;
        putValue(E_pubc_IBCU_IBCU_1CB_IBCU_BrakePedalApplied_Rv, rawValue);
        rawValue= 3328;
        putValue(E_pubc_IBCU_IBCU_1CB_IBCU_sOutputRodAct_Rv, rawValue);
        break;
     default :
        rawValue= 0;
        putValue(E_pubc_IBCU_IBCU_1CB_IBCU_sOutputRodAct_Q_Rv, rawValue);
        rawValue= 0;
        putValue(E_pubc_IBCU_IBCU_1CB_IBCU_BrakePedalApplied_Rv, rawValue);
        rawValue= 0;
        putValue(E_pubc_IBCU_IBCU_1CB_IBCU_sOutputRodAct_Rv, rawValue);
      break;
   }
}

on envVar E_pubc_IBCU_IBCU_1CB_Dlc
{
    if(getValue(E_pubc_IBCU_IBCU_1CB_enDlc))
    {
        Msg_IBCU_1CB.dlc =getValue(this);
    }
    else
    {   
	   Msg_IBCU_1CB.dlc = 16;
	   	
  }
}

on envVar E_pubc_IBCU_IBCU_1CB_enDlc
{
    //For Messages with DLC = 8, set wrong DLC to smaller than defined DLC
    //For Messages with DLC < 8 set wrong DLC to smaller/longer than defined DLC
    if(getValue(this))
    {
        Msg_IBCU_1CB.dlc =getValue(E_pubc_IBCU_IBCU_1CB_Dlc);
    }
    else
    {
	   Msg_IBCU_1CB.dlc = 16;
			
    }
}


on envVar E_pubc_IBCU_IBCU_1CB_IBCU_CRCCheck_237_wrongvalctr
{
    //update disturb count
    //disturb value range:(-1 = always send wrong value),( X>0 ,x is the number of Messages with wrong CHK sent)
    IBCU_1CB_IBCU_CRCCheck_237_wrongvalctr =getValue(this);    
}
on envVar E_pubc_IBCU_IBCU_1CB_IBCU_RollingCounter_1CB_wrongvalctr
{
    //update disturb count
    //disturb value range:(-1 = always send wrong value),( X>0 ,x is the number of Messages with wrong CHK sent)
    IBCU_1CB_IBCU_RollingCounter_1CB_wrongvalctr =getValue(this);    
}
on envVar E_pubc_IBCU_IBCU_1CB_IBCU_RollingCounter_237_wrongvalctr
{
    //update disturb count
    //disturb value range:(-1 = always send wrong value),( X>0 ,x is the number of Messages with wrong CHK sent)
    IBCU_1CB_IBCU_RollingCounter_237_wrongvalctr =getValue(this);    
}

/*@@envVar:E_pubc_IBCU_IBCU_1CB_IBCU_sOutputRodAct_Q_Rv:*/
on envVar E_pubc_IBCU_IBCU_1CB_IBCU_sOutputRodAct_Q_Rv
{
    int64 rawValue = 0ll;
    float rawValue_float = 0.0;
    float phyValue = 0.0;        

    //set the signal with updated raw value
    if(getValue(E_pubc_IBCU_IBCU_1CB_IBCU_sOutputRodAct_Q_SetVt)==0)
    {
        rawValue = getvalue(this);
        if(chgEv_IBCU_1CB_IBCU_sOutputRodAct_Q == 0)
        {
            //type conversion to float
            rawValue_float = rawValue;        
            // raw to physical conversion
            phyValue = ((rawValue_float *1)+(0));
            putValue(E_pubc_IBCU_IBCU_1CB_IBCU_sOutputRodAct_Q_Pv, phyValue);
            chgEv_IBCU_1CB_IBCU_sOutputRodAct_Q = 1;
        }
        else
        {
            chgEv_IBCU_1CB_IBCU_sOutputRodAct_Q = 0;
        }    
        //update the signal value
        Msg_IBCU_1CB.IBCU_sOutputRodAct_Q=rawValue;        
    }                                                                           
}
/*@@end*/

/*@@envVar:E_pubc_IBCU_IBCU_1CB_IBCU_sOutputRodAct_Q_Pv:*/
on envVar E_pubc_IBCU_IBCU_1CB_IBCU_sOutputRodAct_Q_Pv
{
    int64 rawValue = 0ll;
    float phyValue = 0.0;
    
    //update the raw value with physical value 
    if(getValue(E_pubc_IBCU_IBCU_1CB_IBCU_sOutputRodAct_Q_SetVt)==0)
    {
        if(chgEv_IBCU_1CB_IBCU_sOutputRodAct_Q == 0)
        {
            phyValue = getvalue(this);
            // physical to raw conversion
            rawValue = ((phyValue -(0))/1);
            putValue(E_pubc_IBCU_IBCU_1CB_IBCU_sOutputRodAct_Q_Rv, rawValue);
            chgEv_IBCU_1CB_IBCU_sOutputRodAct_Q = 1;  
        }
        else
        {
            chgEv_IBCU_1CB_IBCU_sOutputRodAct_Q = 0;
        }
    }
}
/*@@end*/

/*@@envVar:E_pubc_IBCU_IBCU_1CB_IBCU_sOutputRodAct_Q_Vt:*/
on envVar E_pubc_IBCU_IBCU_1CB_IBCU_sOutputRodAct_Q_Vt
{
    qword rawValue = 0ll;
    if(getValue(E_pubc_IBCU_IBCU_1CB_IBCU_sOutputRodAct_Q_SetVt))
    {
        //update the signal value
        Msg_IBCU_1CB.IBCU_sOutputRodAct_Q=getValue(this);
    }
}
/*@@end*/

/*@@envVar:E_pubc_IBCU_IBCU_1CB_IBCU_sOutputRodAct_Q_SetVt:*/
on envVar E_pubc_IBCU_IBCU_1CB_IBCU_sOutputRodAct_Q_SetVt
{
    if(getValue(E_pubc_IBCU_IBCU_1CB_IBCU_sOutputRodAct_Q_SetVt))
    {
        //update the signal value
        Msg_IBCU_1CB.IBCU_sOutputRodAct_Q=getvalue(E_pubc_IBCU_IBCU_1CB_IBCU_sOutputRodAct_Q_Vt);
    }
    else
    {
        Msg_IBCU_1CB.IBCU_sOutputRodAct_Q=getValue(E_pubc_IBCU_IBCU_1CB_IBCU_sOutputRodAct_Q_Rv);
    }
}
/*@@end*/
on envVar E_pubc_IBCU_IBCU_1CB_IBCU_BrakePedalApplied_Rv
{
    int64 rawValue = 0ll;
    float rawValue_float = 0.0;
    float phyValue = 0.0;        

    //set the signal with updated raw value
    if(getValue(E_pubc_IBCU_IBCU_1CB_IBCU_BrakePedalApplied_SetVt)==0)
    {
        rawValue = getvalue(this);
        if(chgEv_IBCU_1CB_IBCU_BrakePedalApplied == 0)
        {
            //type conversion to float
            rawValue_float = rawValue;        
            // raw to physical conversion
            phyValue = ((rawValue_float *1)+(0));
            putValue(E_pubc_IBCU_IBCU_1CB_IBCU_BrakePedalApplied_Pv, phyValue);
            chgEv_IBCU_1CB_IBCU_BrakePedalApplied = 1;
        }
        else
        {
            chgEv_IBCU_1CB_IBCU_BrakePedalApplied = 0;
        }    
        //update the signal value
        Msg_IBCU_1CB.IBCU_BrakePedalApplied=rawValue;        
    }                                                                           
}

on envVar E_pubc_IBCU_IBCU_1CB_IBCU_BrakePedalApplied_Pv
{
    int64 rawValue = 0ll;
    float phyValue = 0.0;
    
    //update the raw value with physical value 
    if(getValue(E_pubc_IBCU_IBCU_1CB_IBCU_BrakePedalApplied_SetVt)==0)
    {
        if(chgEv_IBCU_1CB_IBCU_BrakePedalApplied == 0)
        {
            phyValue = getvalue(this);
            // physical to raw conversion
            rawValue = ((phyValue -(0))/1);
            putValue(E_pubc_IBCU_IBCU_1CB_IBCU_BrakePedalApplied_Rv, rawValue);
            chgEv_IBCU_1CB_IBCU_BrakePedalApplied = 1;  
        }
        else
        {
            chgEv_IBCU_1CB_IBCU_BrakePedalApplied = 0;
        }
    }
}

on envVar E_pubc_IBCU_IBCU_1CB_IBCU_BrakePedalApplied_Vt
{
    qword rawValue = 0ll;
    if(getValue(E_pubc_IBCU_IBCU_1CB_IBCU_BrakePedalApplied_SetVt))
    {
        //update the signal value
        Msg_IBCU_1CB.IBCU_BrakePedalApplied=getValue(this);
    }
}

on envVar E_pubc_IBCU_IBCU_1CB_IBCU_BrakePedalApplied_SetVt
{
    if(getValue(E_pubc_IBCU_IBCU_1CB_IBCU_BrakePedalApplied_SetVt))
    {
        //update the signal value
        Msg_IBCU_1CB.IBCU_BrakePedalApplied=getvalue(E_pubc_IBCU_IBCU_1CB_IBCU_BrakePedalApplied_Vt);
    }
    else
    {
        Msg_IBCU_1CB.IBCU_BrakePedalApplied=getValue(E_pubc_IBCU_IBCU_1CB_IBCU_BrakePedalApplied_Rv);
    }
}
 
/*@@envVar:E_pubc_IBCU_IBCU_1CB_IBCU_sOutputRodAct_Rv:*/
on envVar E_pubc_IBCU_IBCU_1CB_IBCU_sOutputRodAct_Rv
{
    int64 rawValue = 0ll;
    float rawValue_float = 0.0;
    float phyValue = 0.0;        

    //set the signal with updated raw value
    {
        rawValue = getvalue(this);
        if(chgEv_IBCU_1CB_IBCU_sOutputRodAct == 0)
        {
            //type conversion to float
            rawValue_float = rawValue;        
            // raw to physical conversion
            phyValue = ((rawValue_float *0.015625)+(-5));
            putValue(E_pubc_IBCU_IBCU_1CB_IBCU_sOutputRodAct_Pv, phyValue);
            chgEv_IBCU_1CB_IBCU_sOutputRodAct = 1;
        }
        else
        {
            chgEv_IBCU_1CB_IBCU_sOutputRodAct = 0;
        }    
        //update the signal value
        Msg_IBCU_1CB.IBCU_sOutputRodAct=rawValue;        
    }                                                                           
}
/*@@end*/

/*@@envVar:E_pubc_IBCU_IBCU_1CB_IBCU_sOutputRodAct_Pv:*/
on envVar E_pubc_IBCU_IBCU_1CB_IBCU_sOutputRodAct_Pv
{
    int64 rawValue = 0ll;
    float phyValue = 0.0;
    
    //update the raw value with physical value 
    {
        if(chgEv_IBCU_1CB_IBCU_sOutputRodAct == 0)
        {
            phyValue = getvalue(this);
            // physical to raw conversion
            rawValue = ((phyValue -(-5))/0.015625);
            putValue(E_pubc_IBCU_IBCU_1CB_IBCU_sOutputRodAct_Rv, rawValue);
            chgEv_IBCU_1CB_IBCU_sOutputRodAct = 1;  
        }
        else
        {
            chgEv_IBCU_1CB_IBCU_sOutputRodAct = 0;
        }
    }
}
/*@@end*/
on envVar E_pubc_IBCU_IBCU_17A_tx
{
    if(getValue(this))
    {       
        
        //update the BZ Signal
        if(IBCU_17A_ESP_RollingCounter_187_wrongvalctr == 0)
        {
            update_IBCU_17A_ESP_RollingCounter_187_counter();
            Msg_IBCU_17A.ESP_RollingCounter_187= IBCU_17A_ESP_RollingCounter_187_counter;
        }
        else if(IBCU_17A_ESP_RollingCounter_187_wrongvalctr > 0)
        {
			IBCU_17A_ESP_RollingCounter_187_counter=IBCU_17A_ESP_RollingCounter_187_counter + IBCU_17A_ESP_RollingCounter_187_wrongvalctr;
			 Msg_IBCU_17A.ESP_RollingCounter_187= IBCU_17A_ESP_RollingCounter_187_counter;
             /*IBCU_17A_ESP_RollingCounter_187_wrongvalctr--;
              // if counter becomes zero, update panel controller to zero
             if(IBCU_17A_ESP_RollingCounter_187_wrongvalctr == 0)
             {
                 putValue(E_pubc_IBCU_IBCU_17A_ESP_RollingCounter_187_wrongvalctr,0);
             } */
        }
        else
        { 
			// do nothing
        }    
        //calculate the CRC CheckSum
        update_IBCU_17A_CRC_CheckSum();

        output(Msg_IBCU_17A);        
    }
}

on envVar E_pubc_IBCU_IBCU_17A_Range
{
    qword rawstatus = 0ll;
    qword rawValue = 0ll;    
    
    rawstatus = getvalue(this);    
    // set all the signals with min raw /max raw /init raw
    switch (rawstatus) 
    {
     case(0) :
        rawValue= 0;
        putValue(E_pubc_IBCU_IBCU_17A_ESP_ESPActiveStatus_Rv, rawValue);
        rawValue= 0;
        putValue(E_pubc_IBCU_IBCU_17A_ESP_ESPFunctionStatus_Rv, rawValue);
        rawValue= 0;
        putValue(E_pubc_IBCU_IBCU_17A_ESP_ABSFailStatus_Rv, rawValue);
        rawValue= 0;
        putValue(E_pubc_IBCU_IBCU_17A_ESP_VehicleSpeedValid_Rv, rawValue);
        rawValue= 0;
        putValue(E_pubc_IBCU_IBCU_17A_ESP_VehicleSpeed_Rv, rawValue);
        rawValue= 0;
        putValue(E_pubc_IBCU_IBCU_17A_ESP_TCSFailStatus_Rv, rawValue);
        break;
     case(1) :
        rawValue= 1;
        putValue(E_pubc_IBCU_IBCU_17A_ESP_ESPActiveStatus_Rv, rawValue);
        rawValue= 1;
        putValue(E_pubc_IBCU_IBCU_17A_ESP_ESPFunctionStatus_Rv, rawValue);
        rawValue= 1;
        putValue(E_pubc_IBCU_IBCU_17A_ESP_ABSFailStatus_Rv, rawValue);
        rawValue= 1;
        putValue(E_pubc_IBCU_IBCU_17A_ESP_VehicleSpeedValid_Rv, rawValue);
        rawValue= 6400;
        putValue(E_pubc_IBCU_IBCU_17A_ESP_VehicleSpeed_Rv, rawValue);
        rawValue= 1;
        putValue(E_pubc_IBCU_IBCU_17A_ESP_TCSFailStatus_Rv, rawValue);
        break;
     default :
        rawValue= 0;
        putValue(E_pubc_IBCU_IBCU_17A_ESP_ESPActiveStatus_Rv, rawValue);
        rawValue= 0;
        putValue(E_pubc_IBCU_IBCU_17A_ESP_ESPFunctionStatus_Rv, rawValue);
        rawValue= 0;
        putValue(E_pubc_IBCU_IBCU_17A_ESP_ABSFailStatus_Rv, rawValue);
        rawValue= 0;
        putValue(E_pubc_IBCU_IBCU_17A_ESP_VehicleSpeedValid_Rv, rawValue);
        rawValue= 0;
        putValue(E_pubc_IBCU_IBCU_17A_ESP_VehicleSpeed_Rv, rawValue);
        rawValue= 0;
        putValue(E_pubc_IBCU_IBCU_17A_ESP_TCSFailStatus_Rv, rawValue);
      break;
   }
}

on envVar E_pubc_IBCU_IBCU_17A_Dlc
{
    if(getValue(E_pubc_IBCU_IBCU_17A_enDlc))
    {
        Msg_IBCU_17A.dlc =getValue(this);
    }
    else
    {   
	   Msg_IBCU_17A.dlc = 48;
	   	
  }
}

on envVar E_pubc_IBCU_IBCU_17A_enDlc
{
    //For Messages with DLC = 8, set wrong DLC to smaller than defined DLC
    //For Messages with DLC < 8 set wrong DLC to smaller/longer than defined DLC
    if(getValue(this))
    {
        Msg_IBCU_17A.dlc =getValue(E_pubc_IBCU_IBCU_17A_Dlc);
    }
    else
    {
	   Msg_IBCU_17A.dlc = 48;
			
    }
}

on envVar E_pubc_IBCU_IBCU_17A_ESP_CRCCheck_187_wrongvalctr
{
    //update disturb count
    //disturb value range:(-1 = always send wrong value),( X>0 ,x is the number of Messages with wrong CHK sent)
    IBCU_17A_ESP_CRCCheck_187_wrongvalctr =getValue(this);    
}
on envVar E_pubc_IBCU_IBCU_17A_ESP_RollingCounter_187_wrongvalctr
{
    //update disturb count
    //disturb value range:(-1 = always send wrong value),( X>0 ,x is the number of Messages with wrong CHK sent)
    IBCU_17A_ESP_RollingCounter_187_wrongvalctr =getValue(this);    
}

on envVar E_pubc_IBCU_IBCU_17A_ESP_ESPActiveStatus_Rv
{
    int64 rawValue = 0ll;
    float rawValue_float = 0.0;
    float phyValue = 0.0;        

    //set the signal with updated raw value
    if(getValue(E_pubc_IBCU_IBCU_17A_ESP_ESPActiveStatus_SetVt)==0)
    {
        rawValue = getvalue(this);
        if(chgEv_IBCU_17A_ESP_ESPActiveStatus == 0)
        {
            //type conversion to float
            rawValue_float = rawValue;        
            // raw to physical conversion
            phyValue = ((rawValue_float *1)+(0));
            putValue(E_pubc_IBCU_IBCU_17A_ESP_ESPActiveStatus_Pv, phyValue);
            chgEv_IBCU_17A_ESP_ESPActiveStatus = 1;
        }
        else
        {
            chgEv_IBCU_17A_ESP_ESPActiveStatus = 0;
        }    
        //update the signal value
        Msg_IBCU_17A.ESP_ESPActiveStatus=rawValue;        
    }                                                                           
}

on envVar E_pubc_IBCU_IBCU_17A_ESP_ESPActiveStatus_Pv
{
    int64 rawValue = 0ll;
    float phyValue = 0.0;
    
    //update the raw value with physical value 
    if(getValue(E_pubc_IBCU_IBCU_17A_ESP_ESPActiveStatus_SetVt)==0)
    {
        if(chgEv_IBCU_17A_ESP_ESPActiveStatus == 0)
        {
            phyValue = getvalue(this);
            // physical to raw conversion
            rawValue = ((phyValue -(0))/1);
            putValue(E_pubc_IBCU_IBCU_17A_ESP_ESPActiveStatus_Rv, rawValue);
            chgEv_IBCU_17A_ESP_ESPActiveStatus = 1;  
        }
        else
        {
            chgEv_IBCU_17A_ESP_ESPActiveStatus = 0;
        }
    }
}

on envVar E_pubc_IBCU_IBCU_17A_ESP_ESPActiveStatus_Vt
{
    qword rawValue = 0ll;
    if(getValue(E_pubc_IBCU_IBCU_17A_ESP_ESPActiveStatus_SetVt))
    {
        //update the signal value
        Msg_IBCU_17A.ESP_ESPActiveStatus=getValue(this);
    }
}

on envVar E_pubc_IBCU_IBCU_17A_ESP_ESPActiveStatus_SetVt
{
    if(getValue(E_pubc_IBCU_IBCU_17A_ESP_ESPActiveStatus_SetVt))
    {
        //update the signal value
        Msg_IBCU_17A.ESP_ESPActiveStatus=getvalue(E_pubc_IBCU_IBCU_17A_ESP_ESPActiveStatus_Vt);
    }
    else
    {
        Msg_IBCU_17A.ESP_ESPActiveStatus=getValue(E_pubc_IBCU_IBCU_17A_ESP_ESPActiveStatus_Rv);
    }
}
 
on envVar E_pubc_IBCU_IBCU_17A_ESP_ESPFunctionStatus_Rv
{
    int64 rawValue = 0ll;
    float rawValue_float = 0.0;
    float phyValue = 0.0;        

    //set the signal with updated raw value
    if(getValue(E_pubc_IBCU_IBCU_17A_ESP_ESPFunctionStatus_SetVt)==0)
    {
        rawValue = getvalue(this);
        if(chgEv_IBCU_17A_ESP_ESPFunctionStatus == 0)
        {
            //type conversion to float
            rawValue_float = rawValue;        
            // raw to physical conversion
            phyValue = ((rawValue_float *1)+(0));
            putValue(E_pubc_IBCU_IBCU_17A_ESP_ESPFunctionStatus_Pv, phyValue);
            chgEv_IBCU_17A_ESP_ESPFunctionStatus = 1;
        }
        else
        {
            chgEv_IBCU_17A_ESP_ESPFunctionStatus = 0;
        }    
        //update the signal value
        Msg_IBCU_17A.ESP_ESPFunctionStatus=rawValue;        
    }                                                                           
}

on envVar E_pubc_IBCU_IBCU_17A_ESP_ESPFunctionStatus_Pv
{
    int64 rawValue = 0ll;
    float phyValue = 0.0;
    
    //update the raw value with physical value 
    if(getValue(E_pubc_IBCU_IBCU_17A_ESP_ESPFunctionStatus_SetVt)==0)
    {
        if(chgEv_IBCU_17A_ESP_ESPFunctionStatus == 0)
        {
            phyValue = getvalue(this);
            // physical to raw conversion
            rawValue = ((phyValue -(0))/1);
            putValue(E_pubc_IBCU_IBCU_17A_ESP_ESPFunctionStatus_Rv, rawValue);
            chgEv_IBCU_17A_ESP_ESPFunctionStatus = 1;  
        }
        else
        {
            chgEv_IBCU_17A_ESP_ESPFunctionStatus = 0;
        }
    }
}

on envVar E_pubc_IBCU_IBCU_17A_ESP_ESPFunctionStatus_Vt
{
    qword rawValue = 0ll;
    if(getValue(E_pubc_IBCU_IBCU_17A_ESP_ESPFunctionStatus_SetVt))
    {
        //update the signal value
        Msg_IBCU_17A.ESP_ESPFunctionStatus=getValue(this);
    }
}

on envVar E_pubc_IBCU_IBCU_17A_ESP_ESPFunctionStatus_SetVt
{
    if(getValue(E_pubc_IBCU_IBCU_17A_ESP_ESPFunctionStatus_SetVt))
    {
        //update the signal value
        Msg_IBCU_17A.ESP_ESPFunctionStatus=getvalue(E_pubc_IBCU_IBCU_17A_ESP_ESPFunctionStatus_Vt);
    }
    else
    {
        Msg_IBCU_17A.ESP_ESPFunctionStatus=getValue(E_pubc_IBCU_IBCU_17A_ESP_ESPFunctionStatus_Rv);
    }
}
 
on envVar E_pubc_IBCU_IBCU_17A_ESP_ABSFailStatus_Rv
{
    int64 rawValue = 0ll;
    float rawValue_float = 0.0;
    float phyValue = 0.0;        

    //set the signal with updated raw value
    if(getValue(E_pubc_IBCU_IBCU_17A_ESP_ABSFailStatus_SetVt)==0)
    {
        rawValue = getvalue(this);
        if(chgEv_IBCU_17A_ESP_ABSFailStatus == 0)
        {
            //type conversion to float
            rawValue_float = rawValue;        
            // raw to physical conversion
            phyValue = ((rawValue_float *1)+(0));
            putValue(E_pubc_IBCU_IBCU_17A_ESP_ABSFailStatus_Pv, phyValue);
            chgEv_IBCU_17A_ESP_ABSFailStatus = 1;
        }
        else
        {
            chgEv_IBCU_17A_ESP_ABSFailStatus = 0;
        }    
        //update the signal value
        Msg_IBCU_17A.ESP_ABSFailStatus=rawValue;        
    }                                                                           
}

on envVar E_pubc_IBCU_IBCU_17A_ESP_ABSFailStatus_Pv
{
    int64 rawValue = 0ll;
    float phyValue = 0.0;
    
    //update the raw value with physical value 
    if(getValue(E_pubc_IBCU_IBCU_17A_ESP_ABSFailStatus_SetVt)==0)
    {
        if(chgEv_IBCU_17A_ESP_ABSFailStatus == 0)
        {
            phyValue = getvalue(this);
            // physical to raw conversion
            rawValue = ((phyValue -(0))/1);
            putValue(E_pubc_IBCU_IBCU_17A_ESP_ABSFailStatus_Rv, rawValue);
            chgEv_IBCU_17A_ESP_ABSFailStatus = 1;  
        }
        else
        {
            chgEv_IBCU_17A_ESP_ABSFailStatus = 0;
        }
    }
}

on envVar E_pubc_IBCU_IBCU_17A_ESP_ABSFailStatus_Vt
{
    qword rawValue = 0ll;
    if(getValue(E_pubc_IBCU_IBCU_17A_ESP_ABSFailStatus_SetVt))
    {
        //update the signal value
        Msg_IBCU_17A.ESP_ABSFailStatus=getValue(this);
    }
}

on envVar E_pubc_IBCU_IBCU_17A_ESP_ABSFailStatus_SetVt
{
    if(getValue(E_pubc_IBCU_IBCU_17A_ESP_ABSFailStatus_SetVt))
    {
        //update the signal value
        Msg_IBCU_17A.ESP_ABSFailStatus=getvalue(E_pubc_IBCU_IBCU_17A_ESP_ABSFailStatus_Vt);
    }
    else
    {
        Msg_IBCU_17A.ESP_ABSFailStatus=getValue(E_pubc_IBCU_IBCU_17A_ESP_ABSFailStatus_Rv);
    }
}
 
on envVar E_pubc_IBCU_IBCU_17A_ESP_VehicleSpeedValid_Rv
{
    int64 rawValue = 0ll;
    float rawValue_float = 0.0;
    float phyValue = 0.0;        

    //set the signal with updated raw value
    if(getValue(E_pubc_IBCU_IBCU_17A_ESP_VehicleSpeedValid_SetVt)==0)
    {
        rawValue = getvalue(this);
        if(chgEv_IBCU_17A_ESP_VehicleSpeedValid == 0)
        {
            //type conversion to float
            rawValue_float = rawValue;        
            // raw to physical conversion
            phyValue = ((rawValue_float *1)+(0));
            putValue(E_pubc_IBCU_IBCU_17A_ESP_VehicleSpeedValid_Pv, phyValue);
            chgEv_IBCU_17A_ESP_VehicleSpeedValid = 1;
        }
        else
        {
            chgEv_IBCU_17A_ESP_VehicleSpeedValid = 0;
        }    
        //update the signal value
        Msg_IBCU_17A.ESP_VehicleSpeedValid=rawValue;        
    }                                                                           
}

on envVar E_pubc_IBCU_IBCU_17A_ESP_VehicleSpeedValid_Pv
{
    int64 rawValue = 0ll;
    float phyValue = 0.0;
    
    //update the raw value with physical value 
    if(getValue(E_pubc_IBCU_IBCU_17A_ESP_VehicleSpeedValid_SetVt)==0)
    {
        if(chgEv_IBCU_17A_ESP_VehicleSpeedValid == 0)
        {
            phyValue = getvalue(this);
            // physical to raw conversion
            rawValue = ((phyValue -(0))/1);
            putValue(E_pubc_IBCU_IBCU_17A_ESP_VehicleSpeedValid_Rv, rawValue);
            chgEv_IBCU_17A_ESP_VehicleSpeedValid = 1;  
        }
        else
        {
            chgEv_IBCU_17A_ESP_VehicleSpeedValid = 0;
        }
    }
}

on envVar E_pubc_IBCU_IBCU_17A_ESP_VehicleSpeedValid_Vt
{
    qword rawValue = 0ll;
    if(getValue(E_pubc_IBCU_IBCU_17A_ESP_VehicleSpeedValid_SetVt))
    {
        //update the signal value
        Msg_IBCU_17A.ESP_VehicleSpeedValid=getValue(this);
    }
}

on envVar E_pubc_IBCU_IBCU_17A_ESP_VehicleSpeedValid_SetVt
{
    if(getValue(E_pubc_IBCU_IBCU_17A_ESP_VehicleSpeedValid_SetVt))
    {
        //update the signal value
        Msg_IBCU_17A.ESP_VehicleSpeedValid=getvalue(E_pubc_IBCU_IBCU_17A_ESP_VehicleSpeedValid_Vt);
    }
    else
    {
        Msg_IBCU_17A.ESP_VehicleSpeedValid=getValue(E_pubc_IBCU_IBCU_17A_ESP_VehicleSpeedValid_Rv);
    }
}
 
on envVar E_pubc_IBCU_IBCU_17A_ESP_VehicleSpeed_Rv
{
    int64 rawValue = 0ll;
    float rawValue_float = 0.0;
    float phyValue = 0.0;        

    //set the signal with updated raw value
    if(getValue(E_pubc_IBCU_IBCU_17A_ESP_VehicleSpeed_SetVt)==0)
    {
        rawValue = getvalue(this);
        if(chgEv_IBCU_17A_ESP_VehicleSpeed == 0)
        {
            //type conversion to float
            rawValue_float = rawValue;        
            // raw to physical conversion
            phyValue = ((rawValue_float *0.05625)+(0));
            putValue(E_pubc_IBCU_IBCU_17A_ESP_VehicleSpeed_Pv, phyValue);
            chgEv_IBCU_17A_ESP_VehicleSpeed = 1;
        }
        else
        {
            chgEv_IBCU_17A_ESP_VehicleSpeed = 0;
        }    
        //update the signal value
        Msg_IBCU_17A.ESP_VehicleSpeed=rawValue;        
    }                                                                           
}

on envVar E_pubc_IBCU_IBCU_17A_ESP_VehicleSpeed_Pv
{
    int64 rawValue = 0ll;
    float phyValue = 0.0;
    
    //update the raw value with physical value 
    if(getValue(E_pubc_IBCU_IBCU_17A_ESP_VehicleSpeed_SetVt)==0)
    {
        if(chgEv_IBCU_17A_ESP_VehicleSpeed == 0)
        {
            phyValue = getvalue(this);
            // physical to raw conversion
            rawValue = ((phyValue -(0))/0.05625);
            putValue(E_pubc_IBCU_IBCU_17A_ESP_VehicleSpeed_Rv, rawValue);
            chgEv_IBCU_17A_ESP_VehicleSpeed = 1;  
        }
        else
        {
            chgEv_IBCU_17A_ESP_VehicleSpeed = 0;
        }
    }
}

on envVar E_pubc_IBCU_IBCU_17A_ESP_VehicleSpeed_Vt
{
    qword rawValue = 0ll;
    if(getValue(E_pubc_IBCU_IBCU_17A_ESP_VehicleSpeed_SetVt))
    {
        //update the signal value
        Msg_IBCU_17A.ESP_VehicleSpeed=getValue(this);
    }
}

on envVar E_pubc_IBCU_IBCU_17A_ESP_VehicleSpeed_SetVt
{
    if(getValue(E_pubc_IBCU_IBCU_17A_ESP_VehicleSpeed_SetVt))
    {
        //update the signal value
        Msg_IBCU_17A.ESP_VehicleSpeed=getvalue(E_pubc_IBCU_IBCU_17A_ESP_VehicleSpeed_Vt);
    }
    else
    {
        Msg_IBCU_17A.ESP_VehicleSpeed=getValue(E_pubc_IBCU_IBCU_17A_ESP_VehicleSpeed_Rv);
    }
}
 
on envVar E_pubc_IBCU_IBCU_17A_ESP_TCSFailStatus_Rv
{
    int64 rawValue = 0ll;
    float rawValue_float = 0.0;
    float phyValue = 0.0;        

    //set the signal with updated raw value
    if(getValue(E_pubc_IBCU_IBCU_17A_ESP_TCSFailStatus_SetVt)==0)
    {
        rawValue = getvalue(this);
        if(chgEv_IBCU_17A_ESP_TCSFailStatus == 0)
        {
            //type conversion to float
            rawValue_float = rawValue;        
            // raw to physical conversion
            phyValue = ((rawValue_float *1)+(0));
            putValue(E_pubc_IBCU_IBCU_17A_ESP_TCSFailStatus_Pv, phyValue);
            chgEv_IBCU_17A_ESP_TCSFailStatus = 1;
        }
        else
        {
            chgEv_IBCU_17A_ESP_TCSFailStatus = 0;
        }    
        //update the signal value
        Msg_IBCU_17A.ESP_TCSFailStatus=rawValue;        
    }                                                                           
}

on envVar E_pubc_IBCU_IBCU_17A_ESP_TCSFailStatus_Pv
{
    int64 rawValue = 0ll;
    float phyValue = 0.0;
    
    //update the raw value with physical value 
    if(getValue(E_pubc_IBCU_IBCU_17A_ESP_TCSFailStatus_SetVt)==0)
    {
        if(chgEv_IBCU_17A_ESP_TCSFailStatus == 0)
        {
            phyValue = getvalue(this);
            // physical to raw conversion
            rawValue = ((phyValue -(0))/1);
            putValue(E_pubc_IBCU_IBCU_17A_ESP_TCSFailStatus_Rv, rawValue);
            chgEv_IBCU_17A_ESP_TCSFailStatus = 1;  
        }
        else
        {
            chgEv_IBCU_17A_ESP_TCSFailStatus = 0;
        }
    }
}

on envVar E_pubc_IBCU_IBCU_17A_ESP_TCSFailStatus_Vt
{
    qword rawValue = 0ll;
    if(getValue(E_pubc_IBCU_IBCU_17A_ESP_TCSFailStatus_SetVt))
    {
        //update the signal value
        Msg_IBCU_17A.ESP_TCSFailStatus=getValue(this);
    }
}

on envVar E_pubc_IBCU_IBCU_17A_ESP_TCSFailStatus_SetVt
{
    if(getValue(E_pubc_IBCU_IBCU_17A_ESP_TCSFailStatus_SetVt))
    {
        //update the signal value
        Msg_IBCU_17A.ESP_TCSFailStatus=getvalue(E_pubc_IBCU_IBCU_17A_ESP_TCSFailStatus_Vt);
    }
    else
    {
        Msg_IBCU_17A.ESP_TCSFailStatus=getValue(E_pubc_IBCU_IBCU_17A_ESP_TCSFailStatus_Rv);
    }
}
 

update_IBCU_20B_ESP_RollingCounter_258_counter()
{
    //update the signal value
    Msg_IBCU_20B.ESP_RollingCounter_258=IBCU_20B_ESP_RollingCounter_258_counter;
    
    if(IBCU_20B_ESP_RollingCounter_258_counter == 15)
    {
        IBCU_20B_ESP_RollingCounter_258_counter =0;
    }
    else
    {
        IBCU_20B_ESP_RollingCounter_258_counter =IBCU_20B_ESP_RollingCounter_258_counter+1;
    }    
    
}
update_IBCU_20B_ESP_RollingCounter_277_counter()
{
    //update the signal value
    Msg_IBCU_20B.ESP_RollingCounter_277=IBCU_20B_ESP_RollingCounter_277_counter;
    
    if(IBCU_20B_ESP_RollingCounter_277_counter == 15)
    {
        IBCU_20B_ESP_RollingCounter_277_counter =0;
    }
    else
    {
        IBCU_20B_ESP_RollingCounter_277_counter =IBCU_20B_ESP_RollingCounter_277_counter+1;
    }    
    
}
update_IBCU_20B_ESP_RollingCounter_206_counter()
{
    //update the signal value
    Msg_IBCU_20B.ESP_RollingCounter_206=IBCU_20B_ESP_RollingCounter_206_counter;
    
    if(IBCU_20B_ESP_RollingCounter_206_counter == 15)
    {
        IBCU_20B_ESP_RollingCounter_206_counter =0;
    }
    else
    {
        IBCU_20B_ESP_RollingCounter_206_counter =IBCU_20B_ESP_RollingCounter_206_counter+1;
    }    
    
}
update_IBCU_20B_ESP_RollingCounter_208_counter()
{
    //update the signal value
    Msg_IBCU_20B.ESP_RollingCounter_208=IBCU_20B_ESP_RollingCounter_208_counter;
    
    if(IBCU_20B_ESP_RollingCounter_208_counter == 15)
    {
        IBCU_20B_ESP_RollingCounter_208_counter =0;
    }
    else
    {
        IBCU_20B_ESP_RollingCounter_208_counter =IBCU_20B_ESP_RollingCounter_208_counter+1;
    }    
    
}
update_IBCU_1CB_IBCU_RollingCounter_1CB_counter()
{
    //update the signal value
    Msg_IBCU_1CB.IBCU_RollingCounter_1CB=IBCU_1CB_IBCU_RollingCounter_1CB_counter;
    
    if(IBCU_1CB_IBCU_RollingCounter_1CB_counter == 15)
    {
        IBCU_1CB_IBCU_RollingCounter_1CB_counter =0;
    }
    else
    {
        IBCU_1CB_IBCU_RollingCounter_1CB_counter =IBCU_1CB_IBCU_RollingCounter_1CB_counter+1;
    }    
    
}
update_IBCU_1CB_IBCU_RollingCounter_237_counter()
{
    //update the signal value
    Msg_IBCU_1CB.IBCU_RollingCounter_237=IBCU_1CB_IBCU_RollingCounter_237_counter;
    
    if(IBCU_1CB_IBCU_RollingCounter_237_counter == 15)
    {
        IBCU_1CB_IBCU_RollingCounter_237_counter =0;
    }
    else
    {
        IBCU_1CB_IBCU_RollingCounter_237_counter =IBCU_1CB_IBCU_RollingCounter_237_counter+1;
    }    
    
}
update_IBCU_17A_ESP_RollingCounter_187_counter()
{
    //update the signal value
    Msg_IBCU_17A.ESP_RollingCounter_187=IBCU_17A_ESP_RollingCounter_187_counter;
    
    if(IBCU_17A_ESP_RollingCounter_187_counter == 15)
    {
        IBCU_17A_ESP_RollingCounter_187_counter =0;
    }
    else
    {
        IBCU_17A_ESP_RollingCounter_187_counter =IBCU_17A_ESP_RollingCounter_187_counter+1;
    }    
    
}


update_IBCU_20B_CRC_CheckSum()
{
  int l_Crc_Len1=0,l_Crc_Len2=0,l_Crc_Len3=0,l_Crc_Len4=0,l_count=0;
  int l_count_206=0,l_count_208 =0,l_count_258=0,l_count_277 =0;
  
  int l_data_206[8];
  int l_data_208[8];
  int l_data_258[8];
  int l_data_277[8];
  
 
  l_Crc_Len1 = 7;
  l_Crc_Len2 = 15;
  l_Crc_Len3 = 31;
  l_Crc_Len4 = 39;
  
  // ESP_CRCCheck_206
	for (l_count=0;l_count<l_Crc_Len1;l_count++)
    {
      l_data_206[l_count_206] = Msg_IBCU_20B.BYTE(l_count);
      l_count_206++;  
    }
       l_count_206 = 0;
	Msg_IBCU_20B.BYTE(l_Crc_Len1) = calc_SAE_J1850(l_data_206,7); 

	
	if(IBCU_20B_ESP_CRCCheck_206_wrongvalctr != 0)
    {
		Msg_IBCU_20B.ESP_CRCCheck_206+=1; 
        //update signal with wrong CRC value
		if(IBCU_20B_ESP_CRCCheck_206_wrongvalctr > 0)
        {
             IBCU_20B_ESP_CRCCheck_206_wrongvalctr--;
              // if counter becomes zero, update panel controller to zero
             if(IBCU_20B_ESP_CRCCheck_206_wrongvalctr == 0)
             {
                 putValue(E_pubc_IBCU_IBCU_20B_ESP_CRCCheck_206_wrongvalctr,0);
             }
        }
	}
	
	// ESP_CRCCheck_208
	for (l_count=8;l_count<l_Crc_Len2;l_count++)
    {
      l_data_208[l_count_208] = Msg_IBCU_20B.BYTE(l_count);
      l_count_208++;  
    }
     l_count_208 = 0;
	Msg_IBCU_20B.BYTE(l_Crc_Len2) = calc_SAE_J1850(l_data_208,7); 

	
	if(IBCU_20B_ESP_CRCCheck_208_wrongvalctr != 0)
    {
		Msg_IBCU_20B.ESP_CRCCheck_208+=1; 
        //update signal with wrong CRC value
		if(IBCU_20B_ESP_CRCCheck_208_wrongvalctr > 0)
        {
             IBCU_20B_ESP_CRCCheck_208_wrongvalctr--;
              // if counter becomes zero, update panel controller to zero
             if(IBCU_20B_ESP_CRCCheck_208_wrongvalctr == 0)
             {
                 putValue(E_pubc_IBCU_IBCU_20B_ESP_CRCCheck_208_wrongvalctr,0);
             }
        }
	}
	
	// ESP_CRCCheck_258
	for (l_count=24;l_count<l_Crc_Len3;l_count++)
    {
      l_data_258[l_count_258] = Msg_IBCU_20B.BYTE(l_count); 
    l_count_258++;  
    }
       l_count_258 =0;
	Msg_IBCU_20B.BYTE(l_Crc_Len3) = calc_SAE_J1850(l_data_258,7); 

	
	if(IBCU_20B_ESP_CRCCheck_258_wrongvalctr != 0)
    {
		Msg_IBCU_20B.ESP_CRCCheck_258+=1; 
        //update signal with wrong CRC value
		if(IBCU_20B_ESP_CRCCheck_258_wrongvalctr > 0)
        {
             IBCU_20B_ESP_CRCCheck_258_wrongvalctr--;
              // if counter becomes zero, update panel controller to zero
             if(IBCU_20B_ESP_CRCCheck_258_wrongvalctr == 0)
             {
                 putValue(E_pubc_IBCU_IBCU_20B_ESP_CRCCheck_258_wrongvalctr,0);
             }
        }
	}
	
	// ESP_CRCCheck_277
	for (l_count=32;l_count<l_Crc_Len4;l_count++)
    {
      l_data_277[l_count_277] = Msg_IBCU_20B.BYTE(l_count);
      l_count_277++;  
    }
       l_count_277 = 0;
	Msg_IBCU_20B.BYTE(l_Crc_Len4) = calc_SAE_J1850(l_data_277,7); 

	
	if(IBCU_20B_ESP_CRCCheck_277_wrongvalctr != 0)
    {
		Msg_IBCU_20B.ESP_CRCCheck_277+=1; 
        //update signal with wrong CRC value
		if(IBCU_20B_ESP_CRCCheck_277_wrongvalctr > 0)
        {
             IBCU_20B_ESP_CRCCheck_277_wrongvalctr--;
              // if counter becomes zero, update panel controller to zero
             if(IBCU_20B_ESP_CRCCheck_277_wrongvalctr == 0)
             {
                 putValue(E_pubc_IBCU_IBCU_20B_ESP_CRCCheck_277_wrongvalctr,0);
             }
        }
	}
	
	
  
}
update_IBCU_1CB_CRC_CheckSum()
{
  int l_Crc_Len2=0,l_count=0;
  int l_count_237 =0;
  
  int l_data_237[8];
  
 
  l_Crc_Len2 = 15;
  
  
	// IBCU_CRCCheck_237
	for (l_count=8;l_count<l_Crc_Len2;l_count++)
    {
      l_data_237[l_count_237] = Msg_IBCU_1CB.BYTE(l_count);
      l_count_237++;  
    }
     l_count_237 = 0;
	Msg_IBCU_1CB.BYTE(l_Crc_Len2) = calc_SAE_J1850(l_data_237,7); 

	
	if(IBCU_1CB_IBCU_CRCCheck_237_wrongvalctr != 0)
    {
		Msg_IBCU_1CB.IBCU_CRCCheck_237+=1; 
        //update signal with wrong CRC value
		if(IBCU_1CB_IBCU_CRCCheck_237_wrongvalctr > 0)
        {
             IBCU_1CB_IBCU_CRCCheck_237_wrongvalctr--;
              // if counter becomes zero, update panel controller to zero
             if(IBCU_1CB_IBCU_CRCCheck_237_wrongvalctr == 0)
             {
                 putValue(E_pubc_IBCU_IBCU_1CB_IBCU_CRCCheck_237_wrongvalctr,0);
             }
        }
	}
	
}
update_IBCU_17A_CRC_CheckSum()
{
  int l_Crc_Len1=0,l_count=0;
  int l_count_187 =0;
  
  int l_data_187[8];
  
 
  l_Crc_Len1 = 7;
  
  
	// ESP_CRCCheck_187
	for (l_count=0;l_count<l_Crc_Len1;l_count++)
    {
      l_data_187[l_count_187] = Msg_IBCU_17A.BYTE(l_count);
      l_count_187++;  
    }
     l_count_187 = 0;
	Msg_IBCU_17A.BYTE(l_Crc_Len1) = calc_SAE_J1850(l_data_187,7); 

	
	if(IBCU_17A_ESP_CRCCheck_187_wrongvalctr != 0)
    {
		Msg_IBCU_17A.ESP_CRCCheck_187+=1; 
        //update signal with wrong CRC value
		if(IBCU_17A_ESP_CRCCheck_187_wrongvalctr > 0)
        {
             IBCU_17A_ESP_CRCCheck_187_wrongvalctr--;
              // if counter becomes zero, update panel controller to zero
             if(IBCU_17A_ESP_CRCCheck_187_wrongvalctr == 0)
             {
                 putValue(E_pubc_IBCU_IBCU_17A_ESP_CRCCheck_187_wrongvalctr,0);
             }
        }
	}
	
}



int calc_SAE_J1850(int data[], int Crc_len)
	{
		int idx,crc,temp,temp1;
		crc = 0xFF;
        idx = 0;
        temp = 0;
        temp1 = 0;
	
        for(idx=0;idx < Crc_len;idx++)
        {
			temp1 = data[idx];
			temp = (crc^temp1);
			crc = CRC_J1850_Table[temp];
        }
		crc ^= 0xFF;
		return crc;
	}


/*	int calc_SAE_J1851(int data[], int Crc_len)
	{
		int crc;
		
        crc = (data[0]+data[1]+data[2]+data[3]+data[4]+data[5]+data[6]) ;
          
		crc ^= 255;
		return crc;
	}*/

	

/* 	int calc_SAE_J1850(int data[], int Crc_len)
	{
		int idx,crc,temp,temp1,temp2,idy;
		crc = 0xFF;
        idx = 0;
        idy = 0;
        temp = 0;
        temp1 = 0;
        temp2 = 0;
	
        for(idx=0;idx < Crc_len;idx++)
        {
         temp1 = data[idx];
         crc = (crc^temp1);
          for (idy=8; idy>0; idy--)
          {
              // Save the value before the top bit is shifted out.
              temp2 = crc;
              crc <<= 1;
              if (0 != (temp2 & 128))
              {
                  crc ^= 0x2f;
              }
          } 
          
         //crc = CRC_J1850_Table[temp];
        }
		crc ^= 0xFF;
		return crc;
	} */

int Calc_Canfd_dlc(byte Dbc_dlc1)
	{
		if(Dbc_dlc > 8)
		    {
			 while (i<=7)
			  {
				if (CANFD_DLC[i]==Dbc_dlc)
				{
				return CAN_DLC[i];
				 break;
				}
				i++ ;
			}
		}
    else
	
	return Dbc_dlc1 ;
		
}
	
	int calc_Checksum(int data[], int Crc_len)
 {
	int crc;
	crc=0x00;
	
    crc = (data[0]+data[1]+data[2]+data[3]+data[4]+data[5]+data[6]) ;
      
	crc ^= 255;
	return crc;
 }
	//For Messages with DLC = 8, CAN FD data length =8
	//For Messages with DLC = 9, CAN FD data length =12
	//For Messages with DLC = 10, CAN FD data length =16
	//For Messages with DLC = 11, CAN FD data length =20
	//For Messages with DLC = 12, CAN FD data length =24
	//For Messages with DLC = 13, CAN FD data length =32
	//For Messages with DLC = 14, CAN FD data length =48
	//For Messages with DLC = 15, CAN FD data length =64
	

