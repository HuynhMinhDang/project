/*@!Encoding:1252*/

variables
{
    //Used interact between raw and the physical environment variables
    byte chgEv_GW_3B8_HU_Byroad = 0;
    byte chgEv_GW_3B8_HU_RoadCurvature = 0;
    byte chgEv_GW_3B8_HU_TunnelDistance = 0;
    byte chgEv_GW_3B8_HU_EnterTunnelInfo = 0;
    byte chgEv_GW_3B8_HU_SlopeDistance = 0;
    byte chgEv_GW_3B8_HU_EnterSlopeInfo = 0;
    byte chgEv_GW_3B8_HU_NavGuiganceStatus = 0;
    byte chgEv_GW_3B8_HU_TunnelLength = 0;
    byte chgEv_GW_3B8_HU_RoadCurvatureFar = 0;
    byte chgEv_GW_3C4_HU_RoadCurvature_30m = 0;
    byte chgEv_GW_3C4_HU_RoadCurvature_20m = 0;
    byte chgEv_GW_3C4_HU_To_NumchangeOfLanes_Dist = 0;
    byte chgEv_GW_3C4_HU_RoadCurvature_40m = 0;
    byte chgEv_GW_3C4_HU_RoadCurvature_10m = 0;
    byte chgEv_GW_3C4_HU_Lane_Changtype = 0;
    byte chgEv_GW_50_SRS_WarningLampStatus = 0;
    byte chgEv_GW_50_SRS_DriverBuckleSwitchStatus = 0;
    byte chgEv_GW_50_SRS_PassengerBuckleSwitchStatus = 0;
    byte chgEv_GW_50_SRS_CrashOutputStatus = 0;
    byte chgEv_GW_24F_EPS_TorqueAssistMode = 0;
    byte chgEv_GW_24F_EPS_IACC_abortreason = 0;
    byte chgEv_GW_24F_EPS_ConcussAvailabilityStatus = 0;
    byte chgEv_GW_500_HU_CurrentLocationLatitude = 0;
    byte chgEv_GW_500_HU_CurrentLocationLongitude = 0;
    byte chgEv_GW_500_HU_CurrentLocationValid = 0;
    byte chgEv_GW_501_HU_LocalTimeSecond = 0;
    byte chgEv_GW_501_HU_LocalTimeValid = 0;
    byte chgEv_GW_501_HU_LocalTimeHour = 0;
    byte chgEv_GW_501_HU_LocalTimeDate = 0;
    byte chgEv_GW_501_HU_LocalTimeMinute = 0;
    byte chgEv_GW_501_HU_LocalTimeYear = 0;
    byte chgEv_GW_501_HU_LocalTimeMonth = 0;
    byte chgEv_GW_3C7_HU_RoadCurvature_400m = 0;
    byte chgEv_GW_3C7_HU_MapMatchStatus = 0;
    byte chgEv_GW_3C7_HU_SlopeGradient_300m = 0;
    byte chgEv_GW_3C7_HU_RoadCurvature_100m = 0;
    byte chgEv_GW_3C7_HU_RoadCurvature_300m = 0;
    byte chgEv_GW_3C7_HU_RoadCurvature_600m = 0;
    byte chgEv_GW_3C6_HU_BranchInfo = 0;
    byte chgEv_GW_3C6_HU_RoadCurvature_70m = 0;
    byte chgEv_GW_3C6_HU_RoadCurvature_80m = 0;
    byte chgEv_GW_3C6_HU_RoadCurvature_90m = 0;
    byte chgEv_GW_3C6_HU_RoadCurvature_60m = 0;
    byte chgEv_GW_3C6_HU_RoadCurvature_50m = 0;
    byte chgEv_GW_1A8_TCU_ShiftPostionValid = 0;
    byte chgEv_GW_1A8_TCU_ActualDrivingGearValid = 0;
    byte chgEv_GW_1A8_TCU_GearShiftPosition = 0;
    byte chgEv_GW_1A8_TCU_ShiftInProgress = 0;
    byte chgEv_GW_1A8_TCU_ActualDrivingGear = 0;
    byte chgEv_GW_1A8_TCU_ShiftInProgressVld = 0;
    byte chgEv_GW_3C2_HU_Road_TrafficFlow = 0;
    byte chgEv_GW_3C2_HU_RampSide = 0;
    byte chgEv_GW_3C2_HU_To_Branch_Dis = 0;
    byte chgEv_GW_3C2_HU_FallingRockInfo = 0;
    byte chgEv_GW_3C2_HU_To_TrafficAccident_Dis = 0;
    byte chgEv_GW_3C2_HU_MapDataUpdateStatus = 0;
    byte chgEv_GW_3C2_HU_Construction_Info = 0;
    byte chgEv_GW_3C2_HU_To_Construction_Dis = 0;
    byte chgEv_GW_3C2_HU_LaneCnt = 0;
    byte chgEv_GW_3C2_HU_TrafficAccident_Info = 0;
    byte chgEv_GW_3C2_HU_ForwardRoadType = 0;
    byte chgEv_GW_3C2_HU_FallingRockDi = 0;
    byte chgEv_GW_3C2_HU_TollInfo = 0;
    byte chgEv_GW_3C2_HU_TollDis = 0;
    byte chgEv_GW_1C6_PCU_RealAccPedl = 0;
    byte chgEv_GW_1C6_PCU_RealAccPedlVld = 0;
    byte chgEv_GW_1C6_PCU_TarGearReqValid = 0;
    byte chgEv_GW_1C6_PCU_TarGearReq = 0;
    byte chgEv_GW_3AF_HU_NavStatus = 0;
    byte chgEv_GW_3AF_HU_EnterCurveInfo = 0;
    byte chgEv_GW_3AF_HU_NavSpeedLimitType = 0;
    byte chgEv_GW_3AF_HU_NavCountryCode = 0;
    byte chgEv_GW_3AF_HU_NavSpeedLimitUnits = 0;
    byte chgEv_GW_3AF_HU_NavSpeedLimit = 0;
    byte chgEv_GW_3AF_HU_NavCurrentRoadType = 0;
    byte chgEv_GW_3AF_HU_CurveDistance = 0;
    byte chgEv_GW_3AF_HU_RampDistance = 0;
    byte chgEv_GW_3AF_HU_NavSpeedLimitStatus = 0;
    byte chgEv_GW_3AF_HU_RampInfo = 0;
    byte chgEv_GW_3AF_HU_EnterRampInfo = 0;
    byte chgEv_GW_1A6_PCU_PwrTrainSts = 0;
    byte chgEv_GW_1A6_PCU_AccPedl = 0;
    byte chgEv_GW_394_HU_TLAEnable = 0;
    byte chgEv_GW_394_HU_ELKEnable = 0;
    byte chgEv_GW_17E_EPS_LatCtrlActive = 0;
    byte chgEv_GW_17E_EPS_MeasuredTorsionBarTorqValid = 0;
    byte chgEv_GW_17E_EPS_MeasuredTorsionBarTorque = 0;
    byte chgEv_GW_17E_EPS_LatCtrlAvailabilityStatus = 0;
    byte chgEv_GW_514_HU_OverspeedWarningOffset = 0;
    byte chgEv_GW_514_HU_LASWarningModeSelection = 0;
    byte chgEv_GW_514_HU_LDWShakeLev = 0;
    byte chgEv_GW_514_HU_HMAEnable = 0;
    byte chgEv_GW_514_HU_OverspeedWarningEnable = 0;
    byte chgEv_GW_514_HU_OverspeedSoundWarEnable = 0;
    byte chgEv_GW_514_HU_TSRSwitch = 0;
    byte chgEv_GW_514_HU_IACCEnable = 0;
    byte chgEv_GW_514_HU_LASModeSelection = 0;
    byte chgEv_GW_340_AC_FrBlowType = 0;
    byte chgEv_GW_28C_GW_MFS_IACCenable_switch_signal = 0;
    byte chgEv_GW_366_AC_EnvironmentalTemp = 0;
    byte chgEv_GW_366_AC_EnvironmentalTempVD = 0;
    byte chgEv_GW_530_IP_TotalOdometer = 0;
    byte chgEv_GW_362_PCU_DrvMod = 0;
    byte chgEv_GW_170_EPS_ActualTorsionBarTorq = 0;
    byte chgEv_GW_170_EPS_MinSafetyTorsionBarTorq = 0;
    byte chgEv_GW_170_EPS_MaxSafetyTorsionBarTorq = 0;
    byte chgEv_GW_180_SAS_SteeringAngleValid = 0;
    byte chgEv_GW_180_SAS_Calibrated = 0;
    byte chgEv_GW_180_SAS_TrimmingSts = 0;
    byte chgEv_GW_180_SAS_SteeringAngle = 0;
    byte chgEv_GW_180_SAS_SteeringAngleSpeed = 0;
    byte chgEv_GW_180_SAS_SASFailure = 0;
    byte chgEv_GW_3BB_HU_SpeedLimitDistance = 0;
    message GW_3B8        Msg_GW_3B8;
    msTimer Tm_GW_3B8;
    int Cycle_GW_3B8 = 100;
    message GW_3C4        Msg_GW_3C4;
    msTimer Tm_GW_3C4;
    int Cycle_GW_3C4 = 100;
    message GW_50        Msg_GW_50;
    msTimer Tm_GW_50;
    int Cycle_GW_50 = 500;
    message GW_24F        Msg_GW_24F;
    msTimer Tm_GW_24F;
    int Cycle_GW_24F = 20;
    message GW_500        Msg_GW_500;
    msTimer Tm_GW_500;
    int Cycle_GW_500 = 1000;
    message GW_501        Msg_GW_501;
    msTimer Tm_GW_501;
    int Cycle_GW_501 = 1000;
    message GW_3C7        Msg_GW_3C7;
    msTimer Tm_GW_3C7;
    int Cycle_GW_3C7 = 100;
    message GW_3C6        Msg_GW_3C6;
    msTimer Tm_GW_3C6;
    int Cycle_GW_3C6 = 100;
    message GW_1A8        Msg_GW_1A8;
    msTimer Tm_GW_1A8;
    int Cycle_GW_1A8 = 10;
    message GW_3C2        Msg_GW_3C2;
    msTimer Tm_GW_3C2;
    int Cycle_GW_3C2 = 100;
    message GW_1C6        Msg_GW_1C6;
    msTimer Tm_GW_1C6;
    int Cycle_GW_1C6 = 10;
    message GW_3AF        Msg_GW_3AF;
    msTimer Tm_GW_3AF;
    int Cycle_GW_3AF = 100;
    message GW_1A6        Msg_GW_1A6;
    msTimer Tm_GW_1A6;
    int Cycle_GW_1A6 = 10;
    message GW_394        Msg_GW_394;
    msTimer Tm_GW_394;
    int Cycle_GW_394 = 100;
    message GW_17E        Msg_GW_17E;
    msTimer Tm_GW_17E;
    int Cycle_GW_17E = 10;
    message GW_514        Msg_GW_514;
    message GW_340        Msg_GW_340;
    msTimer Tm_GW_340;
    int Cycle_GW_340 = 100;
    message GW_28C        Msg_GW_28C;
    msTimer Tm_GW_28C;
    int Cycle_GW_28C = 40;
    message GW_366        Msg_GW_366;
    msTimer Tm_GW_366;
    int Cycle_GW_366 = 100;
    message GW_530        Msg_GW_530;
    msTimer Tm_GW_530;
    int Cycle_GW_530 = 500;
    message GW_362        Msg_GW_362;
    msTimer Tm_GW_362;
    int Cycle_GW_362 = 100;
    message GW_170        Msg_GW_170;
    msTimer Tm_GW_170;
    int Cycle_GW_170 = 10;
    message GW_180        Msg_GW_180;
    msTimer Tm_GW_180;
    int Cycle_GW_180 = 10;
    message GW_3BB        Msg_GW_3BB;
    msTimer Tm_GW_3BB;
    int Cycle_GW_3BB = 100;
    
    int GW_3B8_HU_CRCCheck_3B8_counter =0;
    int GW_3B8_HU_CRCCheck_3B8_wrongvalctr =0;
    int GW_3B8_HU_RollingCounter_3B8_counter =0;
    int GW_3B8_HU_RollingCounter_3B8_wrongvalctr =0;
    int GW_3C4_HU_CRCCheck_3C4_counter =0;
    int GW_3C4_HU_CRCCheck_3C4_wrongvalctr =0;
    int GW_3C4_HU_RollingCounter_3C4_counter =0;
    int GW_3C4_HU_RollingCounter_3C4_wrongvalctr =0;
    int GW_50_SRS_CrashOutputStatusCheckSum_counter =0;
    int GW_50_SRS_CrashOutputStatusCheckSum_wrongvalctr =0;
    int GW_50_SRS_RollingCounter_id050_counter =0;
    int GW_50_SRS_RollingCounter_id050_wrongvalctr =0;
    int GW_24F_EPS_CRCCheck_24F_counter =0;
    int GW_24F_EPS_CRCCheck_24F_wrongvalctr =0;
    int GW_24F_EPS_RollingCounter_24F_counter =0;
    int GW_24F_EPS_RollingCounter_24F_wrongvalctr =0;
    int GW_3C7_HU_CRCCheck_3C7_counter =0;
    int GW_3C7_HU_CRCCheck_3C7_wrongvalctr =0;
    int GW_3C7_HU_RollingCounter_3C7_counter =0;
    int GW_3C7_HU_RollingCounter_3C7_wrongvalctr =0;
    int GW_3C6_HU_CRCCheck_3C6_counter =0;
    int GW_3C6_HU_CRCCheck_3C6_wrongvalctr =0;
    int GW_3C6_HU_RollingCounter_3C6_counter =0;
    int GW_3C6_HU_RollingCounter_3C6_wrongvalctr =0;
    int GW_1A8_TCU_CRCCheck_1A8_counter =0;
    int GW_1A8_TCU_CRCCheck_1A8_wrongvalctr =0;
    int GW_1A8_TCU_RollingCounter_1A8_counter =0;
    int GW_1A8_TCU_RollingCounter_1A8_wrongvalctr =0;
    int GW_3C2_HU_CRCCheck_3C2_counter =0;
    int GW_3C2_HU_CRCCheck_3C2_wrongvalctr =0;
    int GW_3C2_HU_RollingCounter_3C2_counter =0;
    int GW_3C2_HU_RollingCounter_3C2_wrongvalctr =0;
    int GW_3AF_HU_CRCCheck_3AF_counter =0;
    int GW_3AF_HU_CRCCheck_3AF_wrongvalctr =0;
    int GW_3AF_HU_RollingCounter_3AF_counter =0;
    int GW_3AF_HU_RollingCounter_3AF_wrongvalctr =0;
    int GW_17E_EPS_CRCCheck_17E_counter =0;
    int GW_17E_EPS_CRCCheck_17E_wrongvalctr =0;
    int GW_17E_EPS_RollingCounter_17E_counter =0;
    int GW_17E_EPS_RollingCounter_17E_wrongvalctr =0;
    int GW_28C_GW_MFS_CRCCheck_28C_counter =0;
    int GW_28C_GW_MFS_CRCCheck_28C_wrongvalctr =0;
    int GW_28C_GW_MFS_RollingCounter_28C_counter =0;
    int GW_28C_GW_MFS_RollingCounter_28C_wrongvalctr =0;
    int GW_170_EPS_CRCCheck_170_counter =0;
    int GW_170_EPS_CRCCheck_170_wrongvalctr =0;
    int GW_170_EPS_RollingCounter_170_counter =0;
    int GW_170_EPS_RollingCounter_170_wrongvalctr =0;
    int GW_180_SAS_CRCCheck_counter =0;
    int GW_180_SAS_CRCCheck_wrongvalctr =0;
    int GW_180_SAS_RollingCounter_counter =0;
    int GW_180_SAS_RollingCounter_wrongvalctr =0;
    
    ///CRC Polynomial for MQB     
    byte cb_CRC_POLY_MQB =0x2F;
	
    

    
        byte CRC_J1850_Table[256] = {
 /*0 - 7*/  0x00, 0x1D, 0x3A, 0x27, 0x74, 0x69, 0x4E, 0x53,
 /*8 - 15*/ 0xE8, 0xF5, 0xD2, 0xCF, 0x9C, 0x81, 0xA6, 0xBB,
 /*16 - 23*/ 0xCD, 0xD0, 0xF7, 0xEA, 0xB9, 0xA4, 0x83, 0x9E,
 /*24 - 31*/ 0x25, 0x38, 0x1F, 0x02, 0x51, 0x4C, 0x6B, 0x76,
 /*32 - 39*/ 0x87, 0x9A, 0xBD, 0xA0, 0xF3, 0xEE, 0xC9, 0xD4,
 /*40 - 47*/ 0x6F, 0x72, 0x55, 0x48, 0x1B, 0x06, 0x21, 0x3C,
 /*48 - 55*/ 0x4A, 0x57, 0x70, 0x6D, 0x3E, 0x23, 0x04, 0x19,
 /*56 - 63*/ 0xA2, 0xBF, 0x98, 0x85, 0xD6, 0xCB, 0xEC, 0xF1,
 /*64 - 71*/  0x13, 0x0E, 0x29, 0x34, 0x67, 0x7A, 0x5D, 0x40,
 /*72 - 79*/ 0xFB, 0xE6, 0xC1, 0xDC, 0x8F, 0x92, 0xB5, 0xA8,
 /*80 - 87*/ 0xDE, 0xC3, 0xE4, 0xF9, 0xAA, 0xB7, 0x90, 0x8D,
 /*88 - 95*/ 0x36, 0x2B, 0x0C, 0x11, 0x42, 0x5F, 0x78, 0x65,
 /*96 - 103*/ 0x94, 0x89, 0xAE, 0xB3, 0xE0, 0xFD, 0xDA, 0xC7,
 /*104 - 111*/ 0x7C, 0x61, 0x46, 0x5B, 0x08, 0x15, 0x32, 0x2F,
 /*112 - 119*/ 0x59, 0x44, 0x63, 0x7E, 0x2D, 0x30, 0x17, 0x0A,
 /*120 - 127*/ 0xB1, 0xAC, 0x8B, 0x96, 0xC5, 0xD8, 0xFF, 0xE2,
 /*128 - 135*/ 0x26, 0x3B, 0x1C, 0x01, 0x52, 0x4F, 0x68, 0x75,
 /*136 - 143*/ 0xCE, 0xD3, 0xF4, 0xE9, 0xBA, 0xA7, 0x80, 0x9D,
 /*144 - 151*/ 0xEB, 0xF6, 0xD1, 0xCC, 0x9F, 0x82, 0xA5, 0xB8,
 /*152 - 159*/ 0x03, 0x1E, 0x39, 0x24, 0x77, 0x6A, 0x4D, 0x50,
 /*160 - 167*/ 0xA1, 0xBC, 0x9B, 0x86, 0xD5, 0xC8, 0xEF, 0xF2,
 /*168 - 175*/ 0x49, 0x54, 0x73, 0x6E, 0x3D, 0x20, 0x07, 0x1A,
 /*176 - 183*/ 0x6C, 0x71, 0x56, 0x4B, 0x18, 0x05, 0x22, 0x3F,
 /*184 - 191*/ 0x84, 0x99, 0xBE, 0xA3, 0xF0, 0xED, 0xCA, 0xD7,
 /*192 - 199*/ 0x35, 0x28, 0x0F, 0x12, 0x41, 0x5C, 0x7B, 0x66,
 /*200 - 207*/ 0xDD, 0xC0, 0xE7, 0xFA, 0xA9, 0xB4, 0x93, 0x8E,
 /*208 - 215*/ 0xF8, 0xE5, 0xC2, 0xDF, 0x8C, 0x91, 0xB6, 0xAB,
 /*216 - 223*/ 0x10, 0x0D, 0x2A, 0x37, 0x64, 0x79, 0x5E, 0x43,
 /*224 - 231*/ 0xB2, 0xAF, 0x88, 0x95, 0xC6, 0xDB, 0xFC, 0xE1,
 /*232 - 239*/ 0x5A, 0x47, 0x60, 0x7D, 0x2E, 0x33, 0x14, 0x09,
 /*240 - 247*/ 0x7F, 0x62, 0x45, 0x58, 0x0B, 0x16, 0x31, 0x2C,
 /*248 - 255*/ 0x97, 0x8A, 0xAD, 0xB0, 0xE3, 0xFE, 0xD9, 0xC4
};

         
}


on start
{
    //Initialise cycle time and message timer 
    putValue(E_pubc_GW_GW_3B8_cycleTm,Cycle_GW_3B8);
    SetTimer( Tm_GW_3B8,100);
    putValue(E_pubc_GW_GW_3B8_Tm,1);
    putValue(E_pubc_GW_GW_3C4_cycleTm,Cycle_GW_3C4);
    SetTimer( Tm_GW_3C4,101);
    putValue(E_pubc_GW_GW_3C4_Tm,1);
    putValue(E_pubc_GW_GW_50_cycleTm,Cycle_GW_50);
    SetTimer( Tm_GW_50,102);
    putValue(E_pubc_GW_GW_50_Tm,1);
    putValue(E_pubc_GW_GW_24F_cycleTm,Cycle_GW_24F);
    SetTimer( Tm_GW_24F,103);
    putValue(E_pubc_GW_GW_24F_Tm,1);
    putValue(E_pubc_GW_GW_500_cycleTm,Cycle_GW_500);
    SetTimer( Tm_GW_500,104);
    putValue(E_pubc_GW_GW_500_Tm,1);
    putValue(E_pubc_GW_GW_501_cycleTm,Cycle_GW_501);
    SetTimer( Tm_GW_501,105);
    putValue(E_pubc_GW_GW_501_Tm,1);
    putValue(E_pubc_GW_GW_3C7_cycleTm,Cycle_GW_3C7);
    SetTimer( Tm_GW_3C7,106);
    putValue(E_pubc_GW_GW_3C7_Tm,1);
    putValue(E_pubc_GW_GW_3C6_cycleTm,Cycle_GW_3C6);
    SetTimer( Tm_GW_3C6,107);
    putValue(E_pubc_GW_GW_3C6_Tm,1);
    putValue(E_pubc_GW_GW_1A8_cycleTm,Cycle_GW_1A8);
    SetTimer( Tm_GW_1A8,108);
    putValue(E_pubc_GW_GW_1A8_Tm,1);
    putValue(E_pubc_GW_GW_3C2_cycleTm,Cycle_GW_3C2);
    SetTimer( Tm_GW_3C2,109);
    putValue(E_pubc_GW_GW_3C2_Tm,1);
    putValue(E_pubc_GW_GW_1C6_cycleTm,Cycle_GW_1C6);
    SetTimer( Tm_GW_1C6,110);
    putValue(E_pubc_GW_GW_1C6_Tm,1);
    putValue(E_pubc_GW_GW_3AF_cycleTm,Cycle_GW_3AF);
    SetTimer( Tm_GW_3AF,111);
    putValue(E_pubc_GW_GW_3AF_Tm,1);
    putValue(E_pubc_GW_GW_1A6_cycleTm,Cycle_GW_1A6);
    SetTimer( Tm_GW_1A6,112);
    putValue(E_pubc_GW_GW_1A6_Tm,1);
    putValue(E_pubc_GW_GW_394_cycleTm,Cycle_GW_394);
    SetTimer( Tm_GW_394,113);
    putValue(E_pubc_GW_GW_394_Tm,1);
    putValue(E_pubc_GW_GW_17E_cycleTm,Cycle_GW_17E);
    SetTimer( Tm_GW_17E,114);
    putValue(E_pubc_GW_GW_17E_Tm,1);
    putValue(E_pubc_GW_GW_340_cycleTm,Cycle_GW_340);
    SetTimer( Tm_GW_340,115);
    putValue(E_pubc_GW_GW_340_Tm,1);
    putValue(E_pubc_GW_GW_28C_cycleTm,Cycle_GW_28C);
    SetTimer( Tm_GW_28C,127);
    putValue(E_pubc_GW_GW_28C_Tm,1);
    putValue(E_pubc_GW_GW_366_cycleTm,Cycle_GW_366);
    SetTimer( Tm_GW_366,116);
    putValue(E_pubc_GW_GW_366_Tm,1);
    putValue(E_pubc_GW_GW_530_cycleTm,Cycle_GW_530);
    SetTimer( Tm_GW_530,117);
    putValue(E_pubc_GW_GW_530_Tm,1);
    putValue(E_pubc_GW_GW_362_cycleTm,Cycle_GW_362);
    SetTimer( Tm_GW_362,118);
    putValue(E_pubc_GW_GW_362_Tm,1);
    putValue(E_pubc_GW_GW_170_cycleTm,Cycle_GW_170);
    SetTimer( Tm_GW_170,119);
    putValue(E_pubc_GW_GW_170_Tm,1);
    putValue(E_pubc_GW_GW_180_cycleTm,Cycle_GW_180);
    SetTimer( Tm_GW_180,120);
    putValue(E_pubc_GW_GW_180_Tm,1);
    putValue(E_pubc_GW_GW_3BB_cycleTm,Cycle_GW_3BB);
    SetTimer( Tm_GW_3BB,121);
    putValue(E_pubc_GW_GW_3BB_Tm,1);
    
    //Initialise signals with init raw value
    Msg_GW_3B8.HU_Byroad   =getvalue(E_pubc_GW_GW_3B8_HU_Byroad_Rv);
    Msg_GW_3B8.HU_RoadCurvature   =getvalue(E_pubc_GW_GW_3B8_HU_RoadCurvature_Rv);
    Msg_GW_3B8.HU_TunnelDistance   =getvalue(E_pubc_GW_GW_3B8_HU_TunnelDistance_Rv);
    Msg_GW_3B8.HU_EnterTunnelInfo   =getvalue(E_pubc_GW_GW_3B8_HU_EnterTunnelInfo_Rv);
    Msg_GW_3B8.HU_SlopeDistance   =getvalue(E_pubc_GW_GW_3B8_HU_SlopeDistance_Rv);
    Msg_GW_3B8.HU_EnterSlopeInfo   =getvalue(E_pubc_GW_GW_3B8_HU_EnterSlopeInfo_Rv);
    Msg_GW_3B8.HU_NavGuiganceStatus   =getvalue(E_pubc_GW_GW_3B8_HU_NavGuiganceStatus_Rv);
    Msg_GW_3B8.HU_TunnelLength   =getvalue(E_pubc_GW_GW_3B8_HU_TunnelLength_Rv);
    Msg_GW_3B8.HU_RoadCurvatureFar   =getvalue(E_pubc_GW_GW_3B8_HU_RoadCurvatureFar_Rv);
    Msg_GW_3C4.HU_RoadCurvature_30m   =getvalue(E_pubc_GW_GW_3C4_HU_RoadCurvature_30m_Rv);
    Msg_GW_3C4.HU_RoadCurvature_20m   =getvalue(E_pubc_GW_GW_3C4_HU_RoadCurvature_20m_Rv);
    Msg_GW_3C4.HU_To_NumchangeOfLanes_Dist   =getvalue(E_pubc_GW_GW_3C4_HU_To_NumchangeOfLanes_Dist_Rv);
    Msg_GW_3C4.HU_RoadCurvature_40m   =getvalue(E_pubc_GW_GW_3C4_HU_RoadCurvature_40m_Rv);
    Msg_GW_3C4.HU_RoadCurvature_10m   =getvalue(E_pubc_GW_GW_3C4_HU_RoadCurvature_10m_Rv);
    Msg_GW_3C4.HU_Lane_Changtype   =getvalue(E_pubc_GW_GW_3C4_HU_Lane_Changtype_Rv);
    Msg_GW_50.SRS_WarningLampStatus   =getvalue(E_pubc_GW_GW_50_SRS_WarningLampStatus_Rv);
    Msg_GW_50.SRS_DriverBuckleSwitchStatus   =getvalue(E_pubc_GW_GW_50_SRS_DriverBuckleSwitchStatus_Rv);
    Msg_GW_50.SRS_PassengerBuckleSwitchStatus   =getvalue(E_pubc_GW_GW_50_SRS_PassengerBuckleSwitchStatus_Rv);
    Msg_GW_50.SRS_CrashOutputStatus   =getvalue(E_pubc_GW_GW_50_SRS_CrashOutputStatus_Rv);
    Msg_GW_24F.EPS_TorqueAssistMode   =getvalue(E_pubc_GW_GW_24F_EPS_TorqueAssistMode_Rv);
    Msg_GW_24F.EPS_IACC_abortreason   =getvalue(E_pubc_GW_GW_24F_EPS_IACC_abortreason_Rv);
    Msg_GW_24F.EPS_ConcussAvailabilityStatus   =getvalue(E_pubc_GW_GW_24F_EPS_ConcussAvailabilityStatus_Rv);
    Msg_GW_500.HU_CurrentLocationLatitude   =getvalue(E_pubc_GW_GW_500_HU_CurrentLocationLatitude_Rv);
    Msg_GW_500.HU_CurrentLocationLongitude   =getvalue(E_pubc_GW_GW_500_HU_CurrentLocationLongitude_Rv);
    Msg_GW_500.HU_CurrentLocationValid   =getvalue(E_pubc_GW_GW_500_HU_CurrentLocationValid_Rv);
    Msg_GW_501.HU_LocalTimeSecond   =getvalue(E_pubc_GW_GW_501_HU_LocalTimeSecond_Rv);
    Msg_GW_501.HU_LocalTimeValid   =getvalue(E_pubc_GW_GW_501_HU_LocalTimeValid_Rv);
    Msg_GW_501.HU_LocalTimeHour   =getvalue(E_pubc_GW_GW_501_HU_LocalTimeHour_Rv);
    Msg_GW_501.HU_LocalTimeDate   =getvalue(E_pubc_GW_GW_501_HU_LocalTimeDate_Rv);
    Msg_GW_501.HU_LocalTimeMinute   =getvalue(E_pubc_GW_GW_501_HU_LocalTimeMinute_Rv);
    Msg_GW_501.HU_LocalTimeYear   =getvalue(E_pubc_GW_GW_501_HU_LocalTimeYear_Rv);
    Msg_GW_501.HU_LocalTimeMonth   =getvalue(E_pubc_GW_GW_501_HU_LocalTimeMonth_Rv);
    Msg_GW_3C7.HU_RoadCurvature_400m   =getvalue(E_pubc_GW_GW_3C7_HU_RoadCurvature_400m_Rv);
    Msg_GW_3C7.HU_MapMatchStatus   =getvalue(E_pubc_GW_GW_3C7_HU_MapMatchStatus_Rv);
    Msg_GW_3C7.HU_SlopeGradient_300m   =getvalue(E_pubc_GW_GW_3C7_HU_SlopeGradient_300m_Rv);
    Msg_GW_3C7.HU_RoadCurvature_100m   =getvalue(E_pubc_GW_GW_3C7_HU_RoadCurvature_100m_Rv);
    Msg_GW_3C7.HU_RoadCurvature_300m   =getvalue(E_pubc_GW_GW_3C7_HU_RoadCurvature_300m_Rv);
    Msg_GW_3C7.HU_RoadCurvature_600m   =getvalue(E_pubc_GW_GW_3C7_HU_RoadCurvature_600m_Rv);
    Msg_GW_3C6.HU_BranchInfo   =getvalue(E_pubc_GW_GW_3C6_HU_BranchInfo_Rv);
    Msg_GW_3C6.HU_RoadCurvature_70m   =getvalue(E_pubc_GW_GW_3C6_HU_RoadCurvature_70m_Rv);
    Msg_GW_3C6.HU_RoadCurvature_80m   =getvalue(E_pubc_GW_GW_3C6_HU_RoadCurvature_80m_Rv);
    Msg_GW_3C6.HU_RoadCurvature_90m   =getvalue(E_pubc_GW_GW_3C6_HU_RoadCurvature_90m_Rv);
    Msg_GW_3C6.HU_RoadCurvature_60m   =getvalue(E_pubc_GW_GW_3C6_HU_RoadCurvature_60m_Rv);
    Msg_GW_3C6.HU_RoadCurvature_50m   =getvalue(E_pubc_GW_GW_3C6_HU_RoadCurvature_50m_Rv);
    Msg_GW_1A8.TCU_ShiftPostionValid   =getvalue(E_pubc_GW_GW_1A8_TCU_ShiftPostionValid_Rv);
    Msg_GW_1A8.TCU_ActualDrivingGearValid   =getvalue(E_pubc_GW_GW_1A8_TCU_ActualDrivingGearValid_Rv);
    Msg_GW_1A8.TCU_GearShiftPosition   =getvalue(E_pubc_GW_GW_1A8_TCU_GearShiftPosition_Rv);
    Msg_GW_1A8.TCU_ShiftInProgress   =getvalue(E_pubc_GW_GW_1A8_TCU_ShiftInProgress_Rv);
    Msg_GW_1A8.TCU_ActualDrivingGear   =getvalue(E_pubc_GW_GW_1A8_TCU_ActualDrivingGear_Rv);
    Msg_GW_1A8.TCU_ShiftInProgressVld   =getvalue(E_pubc_GW_GW_1A8_TCU_ShiftInProgressVld_Rv);
    Msg_GW_3C2.HU_Road_TrafficFlow   =getvalue(E_pubc_GW_GW_3C2_HU_Road_TrafficFlow_Rv);
    Msg_GW_3C2.HU_RampSide   =getvalue(E_pubc_GW_GW_3C2_HU_RampSide_Rv);
    Msg_GW_3C2.HU_To_Branch_Dis   =getvalue(E_pubc_GW_GW_3C2_HU_To_Branch_Dis_Rv);
    Msg_GW_3C2.HU_FallingRockInfo   =getvalue(E_pubc_GW_GW_3C2_HU_FallingRockInfo_Rv);
    Msg_GW_3C2.HU_To_TrafficAccident_Dis   =getvalue(E_pubc_GW_GW_3C2_HU_To_TrafficAccident_Dis_Rv);
    Msg_GW_3C2.HU_MapDataUpdateStatus   =getvalue(E_pubc_GW_GW_3C2_HU_MapDataUpdateStatus_Rv);
    Msg_GW_3C2.HU_Construction_Info   =getvalue(E_pubc_GW_GW_3C2_HU_Construction_Info_Rv);
    Msg_GW_3C2.HU_To_Construction_Dis   =getvalue(E_pubc_GW_GW_3C2_HU_To_Construction_Dis_Rv);
    Msg_GW_3C2.HU_LaneCnt   =getvalue(E_pubc_GW_GW_3C2_HU_LaneCnt_Rv);
    Msg_GW_3C2.HU_TrafficAccident_Info   =getvalue(E_pubc_GW_GW_3C2_HU_TrafficAccident_Info_Rv);
    Msg_GW_3C2.HU_ForwardRoadType   =getvalue(E_pubc_GW_GW_3C2_HU_ForwardRoadType_Rv);
    Msg_GW_3C2.HU_FallingRockDi   =getvalue(E_pubc_GW_GW_3C2_HU_FallingRockDi_Rv);
    Msg_GW_3C2.HU_TollInfo   =getvalue(E_pubc_GW_GW_3C2_HU_TollInfo_Rv);
    Msg_GW_3C2.HU_TollDis   =getvalue(E_pubc_GW_GW_3C2_HU_TollDis_Rv);
    Msg_GW_1C6.PCU_RealAccPedl   =getvalue(E_pubc_GW_GW_1C6_PCU_RealAccPedl_Rv);
    Msg_GW_1C6.PCU_RealAccPedlVld   =getvalue(E_pubc_GW_GW_1C6_PCU_RealAccPedlVld_Rv);
    Msg_GW_1C6.PCU_TarGearReqValid   =getvalue(E_pubc_GW_GW_1C6_PCU_TarGearReqValid_Rv);
    Msg_GW_1C6.PCU_TarGearReq   =getvalue(E_pubc_GW_GW_1C6_PCU_TarGearReq_Rv);
    Msg_GW_3AF.HU_NavStatus   =getvalue(E_pubc_GW_GW_3AF_HU_NavStatus_Rv);
    Msg_GW_3AF.HU_EnterCurveInfo   =getvalue(E_pubc_GW_GW_3AF_HU_EnterCurveInfo_Rv);
    Msg_GW_3AF.HU_NavSpeedLimitType   =getvalue(E_pubc_GW_GW_3AF_HU_NavSpeedLimitType_Rv);
    Msg_GW_3AF.HU_NavCountryCode   =getvalue(E_pubc_GW_GW_3AF_HU_NavCountryCode_Rv);
    Msg_GW_3AF.HU_NavSpeedLimitUnits   =getvalue(E_pubc_GW_GW_3AF_HU_NavSpeedLimitUnits_Rv);
    Msg_GW_3AF.HU_NavSpeedLimit   =getvalue(E_pubc_GW_GW_3AF_HU_NavSpeedLimit_Rv);
    Msg_GW_3AF.HU_NavCurrentRoadType   =getvalue(E_pubc_GW_GW_3AF_HU_NavCurrentRoadType_Rv);
    Msg_GW_3AF.HU_CurveDistance   =getvalue(E_pubc_GW_GW_3AF_HU_CurveDistance_Rv);
    Msg_GW_3AF.HU_RampDistance   =getvalue(E_pubc_GW_GW_3AF_HU_RampDistance_Rv);
    Msg_GW_3AF.HU_NavSpeedLimitStatus   =getvalue(E_pubc_GW_GW_3AF_HU_NavSpeedLimitStatus_Rv);
    Msg_GW_3AF.HU_RampInfo   =getvalue(E_pubc_GW_GW_3AF_HU_RampInfo_Rv);
    Msg_GW_3AF.HU_EnterRampInfo   =getvalue(E_pubc_GW_GW_3AF_HU_EnterRampInfo_Rv);
    Msg_GW_1A6.PCU_PwrTrainSts   =getvalue(E_pubc_GW_GW_1A6_PCU_PwrTrainSts_Rv);
    Msg_GW_1A6.PCU_AccPedl   =getvalue(E_pubc_GW_GW_1A6_PCU_AccPedl_Rv);
    Msg_GW_394.HU_TLAEnable   =getvalue(E_pubc_GW_GW_394_HU_TLAEnable_Rv);
    Msg_GW_394.HU_ELKEnable   =getvalue(E_pubc_GW_GW_394_HU_ELKEnable_Rv);
    Msg_GW_17E.EPS_LatCtrlActive   =getvalue(E_pubc_GW_GW_17E_EPS_LatCtrlActive_Rv);
    Msg_GW_17E.EPS_MeasuredTorsionBarTorqValid   =getvalue(E_pubc_GW_GW_17E_EPS_MeasuredTorsionBarTorqValid_Rv);
    Msg_GW_17E.EPS_MeasuredTorsionBarTorque   =getvalue(E_pubc_GW_GW_17E_EPS_MeasuredTorsionBarTorque_Rv);
    Msg_GW_17E.EPS_LatCtrlAvailabilityStatus   =getvalue(E_pubc_GW_GW_17E_EPS_LatCtrlAvailabilityStatus_Rv);
    Msg_GW_514.HU_OverspeedWarningOffset   =getvalue(E_pubc_GW_GW_514_HU_OverspeedWarningOffset_Rv);
    Msg_GW_514.HU_LASWarningModeSelection   =getvalue(E_pubc_GW_GW_514_HU_LASWarningModeSelection_Rv);
    Msg_GW_514.HU_LDWShakeLev   =getvalue(E_pubc_GW_GW_514_HU_LDWShakeLev_Rv);
    Msg_GW_514.HU_HMAEnable   =getvalue(E_pubc_GW_GW_514_HU_HMAEnable_Rv);
    Msg_GW_514.HU_OverspeedWarningEnable   =getvalue(E_pubc_GW_GW_514_HU_OverspeedWarningEnable_Rv);
    Msg_GW_514.HU_OverspeedSoundWarEnable   =getvalue(E_pubc_GW_GW_514_HU_OverspeedSoundWarEnable_Rv);
    Msg_GW_514.HU_TSRSwitch   =getvalue(E_pubc_GW_GW_514_HU_TSRSwitch_Rv);
    Msg_GW_514.HU_IACCEnable   =getvalue(E_pubc_GW_GW_514_HU_IACCEnable_Rv);
    Msg_GW_514.HU_LASModeSelection   =getvalue(E_pubc_GW_GW_514_HU_LASModeSelection_Rv);
    Msg_GW_340.AC_FrBlowType   =getvalue(E_pubc_GW_GW_340_AC_FrBlowType_Rv);
    Msg_GW_28C.GW_MFS_IACCenable_switch_signal   =getvalue(E_pubc_GW_GW_28C_GW_MFS_IACCenable_switch_signal_Rv);
    Msg_GW_366.AC_EnvironmentalTemp   =getvalue(E_pubc_GW_GW_366_AC_EnvironmentalTemp_Rv);
    Msg_GW_366.AC_EnvironmentalTempVD   =getvalue(E_pubc_GW_GW_366_AC_EnvironmentalTempVD_Rv);
    Msg_GW_530.IP_TotalOdometer   =getvalue(E_pubc_GW_GW_530_IP_TotalOdometer_Rv);
    Msg_GW_362.PCU_DrvMod   =getvalue(E_pubc_GW_GW_362_PCU_DrvMod_Rv);
    Msg_GW_170.EPS_ActualTorsionBarTorq   =getvalue(E_pubc_GW_GW_170_EPS_ActualTorsionBarTorq_Rv);
    Msg_GW_170.EPS_MinSafetyTorsionBarTorq   =getvalue(E_pubc_GW_GW_170_EPS_MinSafetyTorsionBarTorq_Rv);
    Msg_GW_170.EPS_MaxSafetyTorsionBarTorq   =getvalue(E_pubc_GW_GW_170_EPS_MaxSafetyTorsionBarTorq_Rv);
    Msg_GW_180.SAS_SteeringAngleValid   =getvalue(E_pubc_GW_GW_180_SAS_SteeringAngleValid_Rv);
    Msg_GW_180.SAS_Calibrated   =getvalue(E_pubc_GW_GW_180_SAS_Calibrated_Rv);
    Msg_GW_180.SAS_TrimmingSts   =getvalue(E_pubc_GW_GW_180_SAS_TrimmingSts_Rv);
    Msg_GW_180.SAS_SteeringAngle   =getvalue(E_pubc_GW_GW_180_SAS_SteeringAngle_Rv);
    Msg_GW_180.SAS_SteeringAngleSpeed   =getvalue(E_pubc_GW_GW_180_SAS_SteeringAngleSpeed_Rv);
    Msg_GW_180.SAS_SASFailure   =getvalue(E_pubc_GW_GW_180_SAS_SASFailure_Rv);
    Msg_GW_3BB.HU_SpeedLimitDistance   =getvalue(E_pubc_GW_GW_3BB_HU_SpeedLimitDistance_Rv);
}

on envVar E_pubc_GW_CycMsgsON
{
    // enable all the cyclic messages 
    putValue(E_pubc_GW_GW_3B8_Tm,1);
    putValue(E_pubc_GW_GW_3C4_Tm,1);
    putValue(E_pubc_GW_GW_50_Tm,1);
    putValue(E_pubc_GW_GW_24F_Tm,1);
    putValue(E_pubc_GW_GW_500_Tm,1);
    putValue(E_pubc_GW_GW_501_Tm,1);
    putValue(E_pubc_GW_GW_3C7_Tm,1);
    putValue(E_pubc_GW_GW_3C6_Tm,1);
    putValue(E_pubc_GW_GW_1A8_Tm,1);
    putValue(E_pubc_GW_GW_3C2_Tm,1);
    putValue(E_pubc_GW_GW_1C6_Tm,1);
    putValue(E_pubc_GW_GW_3AF_Tm,1);
    putValue(E_pubc_GW_GW_1A6_Tm,1);
    putValue(E_pubc_GW_GW_394_Tm,1);
    putValue(E_pubc_GW_GW_17E_Tm,1);
    putValue(E_pubc_GW_GW_340_Tm,1);
    putValue(E_pubc_GW_GW_28C_Tm,1);
    putValue(E_pubc_GW_GW_366_Tm,1);
    putValue(E_pubc_GW_GW_530_Tm,1);
    putValue(E_pubc_GW_GW_362_Tm,1);
    putValue(E_pubc_GW_GW_170_Tm,1);
    putValue(E_pubc_GW_GW_180_Tm,1);
    putValue(E_pubc_GW_GW_3BB_Tm,1);
}

on envVar E_pubc_GW_CycMsgsOFF
{
    // disable all the cyclic messages
    putValue(E_pubc_GW_GW_3B8_Tm,0);
    putValue(E_pubc_GW_GW_3C4_Tm,0);
    putValue(E_pubc_GW_GW_50_Tm,0);
    putValue(E_pubc_GW_GW_24F_Tm,0);
    putValue(E_pubc_GW_GW_500_Tm,0);
    putValue(E_pubc_GW_GW_501_Tm,0);
    putValue(E_pubc_GW_GW_3C7_Tm,0);
    putValue(E_pubc_GW_GW_3C6_Tm,0);
    putValue(E_pubc_GW_GW_1A8_Tm,0);
    putValue(E_pubc_GW_GW_3C2_Tm,0);
    putValue(E_pubc_GW_GW_1C6_Tm,0);
    putValue(E_pubc_GW_GW_3AF_Tm,0);
    putValue(E_pubc_GW_GW_1A6_Tm,0);
    putValue(E_pubc_GW_GW_394_Tm,0);
    putValue(E_pubc_GW_GW_17E_Tm,0);
    putValue(E_pubc_GW_GW_340_Tm,0);
    putValue(E_pubc_GW_GW_28C_Tm,0);
    putValue(E_pubc_GW_GW_366_Tm,0);
    putValue(E_pubc_GW_GW_530_Tm,0);
    putValue(E_pubc_GW_GW_362_Tm,0);
    putValue(E_pubc_GW_GW_170_Tm,0);
    putValue(E_pubc_GW_GW_180_Tm,0);
    putValue(E_pubc_GW_GW_3BB_Tm,0);
    
}






on timer Tm_GW_3B8
{
    //cyclic message timer 
    if(getValue(E_pubc_GW_GW_3B8_Tm) == 1)
    {
        
        //update the BZ Signal
        if(GW_3B8_HU_RollingCounter_3B8_wrongvalctr == 0)
        {
            update_GW_3B8_HU_RollingCounter_3B8_counter();
            Msg_GW_3B8.HU_RollingCounter_3B8= GW_3B8_HU_RollingCounter_3B8_counter;
        }
        else if(GW_3B8_HU_RollingCounter_3B8_wrongvalctr > 0)
        {
			GW_3B8_HU_RollingCounter_3B8_counter=GW_3B8_HU_RollingCounter_3B8_counter + GW_3B8_HU_RollingCounter_3B8_wrongvalctr;
			 Msg_GW_3B8.HU_RollingCounter_3B8= GW_3B8_HU_RollingCounter_3B8_counter;
             /* GW_3B8_HU_RollingCounter_3B8_wrongvalctr--;
             // if counter becomes zero, update panel controller to zero
             if(GW_3B8_HU_RollingCounter_3B8_wrongvalctr == 0)
             {
                putValue(E_pubc_GW_GW_3B8_HU_RollingCounter_3B8_wrongvalctr,0);
             } */
        }
        else
        {
            // do nothing
        }
    
        update_GW_3B8_CRC_CheckSum();
        output(Msg_GW_3B8);
        
    }
    //Reset Timer
    SetTimer(Tm_GW_3B8,Cycle_GW_3B8);
}

on envVar E_pubc_GW_GW_3B8_cycleTm
{
    // update the cycle time 
    Cycle_GW_3B8=getvalue(this);
}
on timer Tm_GW_3C4
{
    //cyclic message timer 
    if(getValue(E_pubc_GW_GW_3C4_Tm) == 1)
    {
        
        //update the BZ Signal
        if(GW_3C4_HU_RollingCounter_3C4_wrongvalctr == 0)
        {
            update_GW_3C4_HU_RollingCounter_3C4_counter();
            Msg_GW_3C4.HU_RollingCounter_3C4= GW_3C4_HU_RollingCounter_3C4_counter;
        }
        else if(GW_3C4_HU_RollingCounter_3C4_wrongvalctr > 0)
        {
			GW_3C4_HU_RollingCounter_3C4_counter=GW_3C4_HU_RollingCounter_3C4_counter + GW_3C4_HU_RollingCounter_3C4_wrongvalctr;
			 Msg_GW_3C4.HU_RollingCounter_3C4= GW_3C4_HU_RollingCounter_3C4_counter;
             /* GW_3C4_HU_RollingCounter_3C4_wrongvalctr--;
             // if counter becomes zero, update panel controller to zero
             if(GW_3C4_HU_RollingCounter_3C4_wrongvalctr == 0)
             {
                putValue(E_pubc_GW_GW_3C4_HU_RollingCounter_3C4_wrongvalctr,0);
             } */
        }
        else
        {
            // do nothing
        }
    
        update_GW_3C4_CRC_CheckSum();
        output(Msg_GW_3C4);
        
    }
    //Reset Timer
    SetTimer(Tm_GW_3C4,Cycle_GW_3C4);
}

on envVar E_pubc_GW_GW_3C4_cycleTm
{
    // update the cycle time 
    Cycle_GW_3C4=getvalue(this);
}
on timer Tm_GW_50
{
    //cyclic message timer 
    if(getValue(E_pubc_GW_GW_50_Tm) == 1)
    {
        
        //update the BZ Signal
        if(GW_50_SRS_RollingCounter_id050_wrongvalctr == 0)
        {
            update_GW_50_SRS_RollingCounter_id050_counter();
            Msg_GW_50.SRS_RollingCounter_id050= GW_50_SRS_RollingCounter_id050_counter;
        }
        else if(GW_50_SRS_RollingCounter_id050_wrongvalctr > 0)
        {
			GW_50_SRS_RollingCounter_id050_counter=GW_50_SRS_RollingCounter_id050_counter + GW_50_SRS_RollingCounter_id050_wrongvalctr;
			 Msg_GW_50.SRS_RollingCounter_id050= GW_50_SRS_RollingCounter_id050_counter;
             /* GW_50_SRS_RollingCounter_id050_wrongvalctr--;
             // if counter becomes zero, update panel controller to zero
             if(GW_50_SRS_RollingCounter_id050_wrongvalctr == 0)
             {
                putValue(E_pubc_GW_GW_50_SRS_RollingCounter_id050_wrongvalctr,0);
             } */
        }
        else
        {
            // do nothing
        }
    
        update_GW_50_CRC_CheckSum();
        output(Msg_GW_50);
        
    }
    //Reset Timer
    SetTimer(Tm_GW_50,Cycle_GW_50);
}

on envVar E_pubc_GW_GW_50_cycleTm
{
    // update the cycle time 
    Cycle_GW_50=getvalue(this);
}
on timer Tm_GW_24F
{
    //cyclic message timer 
    if(getValue(E_pubc_GW_GW_24F_Tm) == 1)
    {
        
        //update the BZ Signal
        if(GW_24F_EPS_RollingCounter_24F_wrongvalctr == 0)
        {
            update_GW_24F_EPS_RollingCounter_24F_counter();
            Msg_GW_24F.EPS_RollingCounter_24F= GW_24F_EPS_RollingCounter_24F_counter;
        }
        else if(GW_24F_EPS_RollingCounter_24F_wrongvalctr > 0)
        {
			GW_24F_EPS_RollingCounter_24F_counter=GW_24F_EPS_RollingCounter_24F_counter + GW_24F_EPS_RollingCounter_24F_wrongvalctr;
			 Msg_GW_24F.EPS_RollingCounter_24F= GW_24F_EPS_RollingCounter_24F_counter;
             /* GW_24F_EPS_RollingCounter_24F_wrongvalctr--;
             // if counter becomes zero, update panel controller to zero
             if(GW_24F_EPS_RollingCounter_24F_wrongvalctr == 0)
             {
                putValue(E_pubc_GW_GW_24F_EPS_RollingCounter_24F_wrongvalctr,0);
             } */
        }
        else
        {
            // do nothing
        }
    
        update_GW_24F_CRC_CheckSum();
        output(Msg_GW_24F);
        
    }
    //Reset Timer
    SetTimer(Tm_GW_24F,Cycle_GW_24F);
}

on envVar E_pubc_GW_GW_24F_cycleTm
{
    // update the cycle time 
    Cycle_GW_24F=getvalue(this);
}

on timer Tm_GW_500
{
    //cyclic message timer 
    if(getValue(E_pubc_GW_GW_500_Tm) == 1)
    {
        
    
        output(Msg_GW_500);
        
    }
    //Reset Timer
    SetTimer(Tm_GW_500,Cycle_GW_500);
}

on envVar E_pubc_GW_GW_500_cycleTm
{
    // update the cycle time 
    Cycle_GW_500=getvalue(this);
}
on timer Tm_GW_501
{
    //cyclic message timer 
    if(getValue(E_pubc_GW_GW_501_Tm) == 1)
    {
        
    
        output(Msg_GW_501);
        
    }
    //Reset Timer
    SetTimer(Tm_GW_501,Cycle_GW_501);
}

on envVar E_pubc_GW_GW_501_cycleTm
{
    // update the cycle time 
    Cycle_GW_501=getvalue(this);
}
on timer Tm_GW_3C7
{
    //cyclic message timer 
    if(getValue(E_pubc_GW_GW_3C7_Tm) == 1)
    {
        
        //update the BZ Signal
        if(GW_3C7_HU_RollingCounter_3C7_wrongvalctr == 0)
        {
            update_GW_3C7_HU_RollingCounter_3C7_counter();
            Msg_GW_3C7.HU_RollingCounter_3C7= GW_3C7_HU_RollingCounter_3C7_counter;
        }
        else if(GW_3C7_HU_RollingCounter_3C7_wrongvalctr > 0)
        {
			GW_3C7_HU_RollingCounter_3C7_counter=GW_3C7_HU_RollingCounter_3C7_counter + GW_3C7_HU_RollingCounter_3C7_wrongvalctr;
			 Msg_GW_3C7.HU_RollingCounter_3C7= GW_3C7_HU_RollingCounter_3C7_counter;
             /* GW_3C7_HU_RollingCounter_3C7_wrongvalctr--;
             // if counter becomes zero, update panel controller to zero
             if(GW_3C7_HU_RollingCounter_3C7_wrongvalctr == 0)
             {
                putValue(E_pubc_GW_GW_3C7_HU_RollingCounter_3C7_wrongvalctr,0);
             } */
        }
        else
        {
            // do nothing
        }
    
        update_GW_3C7_CRC_CheckSum();
        output(Msg_GW_3C7);
        
    }
    //Reset Timer
    SetTimer(Tm_GW_3C7,Cycle_GW_3C7);
}

on envVar E_pubc_GW_GW_3C7_cycleTm
{
    // update the cycle time 
    Cycle_GW_3C7=getvalue(this);
}
on timer Tm_GW_3C6
{
    //cyclic message timer 
    if(getValue(E_pubc_GW_GW_3C6_Tm) == 1)
    {
        
        //update the BZ Signal
        if(GW_3C6_HU_RollingCounter_3C6_wrongvalctr == 0)
        {
            update_GW_3C6_HU_RollingCounter_3C6_counter();
            Msg_GW_3C6.HU_RollingCounter_3C6= GW_3C6_HU_RollingCounter_3C6_counter;
        }
        else if(GW_3C6_HU_RollingCounter_3C6_wrongvalctr > 0)
        {
			GW_3C6_HU_RollingCounter_3C6_counter=GW_3C6_HU_RollingCounter_3C6_counter + GW_3C6_HU_RollingCounter_3C6_wrongvalctr;
			 Msg_GW_3C6.HU_RollingCounter_3C6= GW_3C6_HU_RollingCounter_3C6_counter;
             /* GW_3C6_HU_RollingCounter_3C6_wrongvalctr--;
             // if counter becomes zero, update panel controller to zero
             if(GW_3C6_HU_RollingCounter_3C6_wrongvalctr == 0)
             {
                putValue(E_pubc_GW_GW_3C6_HU_RollingCounter_3C6_wrongvalctr,0);
             } */
        }
        else
        {
            // do nothing
        }
    
        update_GW_3C6_CRC_CheckSum();
        output(Msg_GW_3C6);
        
    }
    //Reset Timer
    SetTimer(Tm_GW_3C6,Cycle_GW_3C6);
}

on envVar E_pubc_GW_GW_3C6_cycleTm
{
    // update the cycle time 
    Cycle_GW_3C6=getvalue(this);
}
on timer Tm_GW_1A8
{
    //cyclic message timer 
    if(getValue(E_pubc_GW_GW_1A8_Tm) == 1)
    {
        
        //update the BZ Signal
        if(GW_1A8_TCU_RollingCounter_1A8_wrongvalctr == 0)
        {
            update_GW_1A8_TCU_RollingCounter_1A8_counter();
            Msg_GW_1A8.TCU_RollingCounter_1A8= GW_1A8_TCU_RollingCounter_1A8_counter;
        }
        else if(GW_1A8_TCU_RollingCounter_1A8_wrongvalctr > 0)
        {
			GW_1A8_TCU_RollingCounter_1A8_counter=GW_1A8_TCU_RollingCounter_1A8_counter + GW_1A8_TCU_RollingCounter_1A8_wrongvalctr;
			 Msg_GW_1A8.TCU_RollingCounter_1A8= GW_1A8_TCU_RollingCounter_1A8_counter;
             /* GW_1A8_TCU_RollingCounter_1A8_wrongvalctr--;
             // if counter becomes zero, update panel controller to zero
             if(GW_1A8_TCU_RollingCounter_1A8_wrongvalctr == 0)
             {
                putValue(E_pubc_GW_GW_1A8_TCU_RollingCounter_1A8_wrongvalctr,0);
             } */
        }
        else
        {
            // do nothing
        }
    
        update_GW_1A8_CRC_CheckSum();
        output(Msg_GW_1A8);
        
    }
    //Reset Timer
    SetTimer(Tm_GW_1A8,Cycle_GW_1A8);
}

on envVar E_pubc_GW_GW_1A8_cycleTm
{
    // update the cycle time 
    Cycle_GW_1A8=getvalue(this);
}
on timer Tm_GW_3C2
{
    //cyclic message timer 
    if(getValue(E_pubc_GW_GW_3C2_Tm) == 1)
    {
        
        //update the BZ Signal
        if(GW_3C2_HU_RollingCounter_3C2_wrongvalctr == 0)
        {
            update_GW_3C2_HU_RollingCounter_3C2_counter();
            Msg_GW_3C2.HU_RollingCounter_3C2= GW_3C2_HU_RollingCounter_3C2_counter;
        }
        else if(GW_3C2_HU_RollingCounter_3C2_wrongvalctr > 0)
        {
			GW_3C2_HU_RollingCounter_3C2_counter=GW_3C2_HU_RollingCounter_3C2_counter + GW_3C2_HU_RollingCounter_3C2_wrongvalctr;
			 Msg_GW_3C2.HU_RollingCounter_3C2= GW_3C2_HU_RollingCounter_3C2_counter;
             /* GW_3C2_HU_RollingCounter_3C2_wrongvalctr--;
             // if counter becomes zero, update panel controller to zero
             if(GW_3C2_HU_RollingCounter_3C2_wrongvalctr == 0)
             {
                putValue(E_pubc_GW_GW_3C2_HU_RollingCounter_3C2_wrongvalctr,0);
             } */
        }
        else
        {
            // do nothing
        }
    
        update_GW_3C2_CRC_CheckSum();
        output(Msg_GW_3C2);
        
    }
    //Reset Timer
    SetTimer(Tm_GW_3C2,Cycle_GW_3C2);
}

on envVar E_pubc_GW_GW_3C2_cycleTm
{
    // update the cycle time 
    Cycle_GW_3C2=getvalue(this);
}
on timer Tm_GW_1C6
{
    //cyclic message timer 
    if(getValue(E_pubc_GW_GW_1C6_Tm) == 1)
    {
        
		//update the BZ Signal
	
        output(Msg_GW_1C6);
        
    }
    //Reset Timer
    SetTimer(Tm_GW_1C6,Cycle_GW_1C6);
}


on envVar E_pubc_GW_GW_1C6_cycleTm
{
    // update the cycle time 
    Cycle_GW_1C6=getvalue(this);
}
on timer Tm_GW_3AF
{
    //cyclic message timer 
    if(getValue(E_pubc_GW_GW_3AF_Tm) == 1)
    {
        
        //update the BZ Signal
        if(GW_3AF_HU_RollingCounter_3AF_wrongvalctr == 0)
        {
            update_GW_3AF_HU_RollingCounter_3AF_counter();
            Msg_GW_3AF.HU_RollingCounter_3AF= GW_3AF_HU_RollingCounter_3AF_counter;
        }
        else if(GW_3AF_HU_RollingCounter_3AF_wrongvalctr > 0)
        {
			GW_3AF_HU_RollingCounter_3AF_counter=GW_3AF_HU_RollingCounter_3AF_counter + GW_3AF_HU_RollingCounter_3AF_wrongvalctr;
			 Msg_GW_3AF.HU_RollingCounter_3AF= GW_3AF_HU_RollingCounter_3AF_counter;
             /* GW_3AF_HU_RollingCounter_3AF_wrongvalctr--;
             // if counter becomes zero, update panel controller to zero
             if(GW_3AF_HU_RollingCounter_3AF_wrongvalctr == 0)
             {
                putValue(E_pubc_GW_GW_3AF_HU_RollingCounter_3AF_wrongvalctr,0);
             } */
        }
        else
        {
            // do nothing
        }
    
        update_GW_3AF_CRC_CheckSum();
        output(Msg_GW_3AF);
        
    }
    //Reset Timer
    SetTimer(Tm_GW_3AF,Cycle_GW_3AF);
}

on envVar E_pubc_GW_GW_3AF_cycleTm
{
    // update the cycle time 
    Cycle_GW_3AF=getvalue(this);
}
on timer Tm_GW_1A6
{
    //cyclic message timer 
    if(getValue(E_pubc_GW_GW_1A6_Tm) == 1)
    {
        
        //update the BZ Signal
	
        output(Msg_GW_1A6);
        
    }
    //Reset Timer
    SetTimer(Tm_GW_1A6,Cycle_GW_1A6);
}

on envVar E_pubc_GW_GW_1A6_cycleTm
{
    // update the cycle time 
    Cycle_GW_1A6=getvalue(this);
}
on timer Tm_GW_394
{
    //cyclic message timer 
    if(getValue(E_pubc_GW_GW_394_Tm) == 1)
    {
        
    
        output(Msg_GW_394);
        
    }
    //Reset Timer
    SetTimer(Tm_GW_394,Cycle_GW_394);
}

on envVar E_pubc_GW_GW_394_cycleTm
{
    // update the cycle time 
    Cycle_GW_394=getvalue(this);
}
on timer Tm_GW_17E
{
    //cyclic message timer 
    if(getValue(E_pubc_GW_GW_17E_Tm) == 1)
    {
        
        //update the BZ Signal
        if(GW_17E_EPS_RollingCounter_17E_wrongvalctr == 0)
        {
            update_GW_17E_EPS_RollingCounter_17E_counter();
            Msg_GW_17E.EPS_RollingCounter_17E= GW_17E_EPS_RollingCounter_17E_counter;
        }
        else if(GW_17E_EPS_RollingCounter_17E_wrongvalctr > 0)
        {
			GW_17E_EPS_RollingCounter_17E_counter=GW_17E_EPS_RollingCounter_17E_counter + GW_17E_EPS_RollingCounter_17E_wrongvalctr;
			 Msg_GW_17E.EPS_RollingCounter_17E= GW_17E_EPS_RollingCounter_17E_counter;
             /* GW_17E_EPS_RollingCounter_17E_wrongvalctr--;
             // if counter becomes zero, update panel controller to zero
             if(GW_17E_EPS_RollingCounter_17E_wrongvalctr == 0)
             {
                putValue(E_pubc_GW_GW_17E_EPS_RollingCounter_17E_wrongvalctr,0);
             } */
        }
        else
        {
            // do nothing
        }
    
        update_GW_17E_CRC_CheckSum();
        output(Msg_GW_17E);
        
    }
    //Reset Timer
    SetTimer(Tm_GW_17E,Cycle_GW_17E);
}

on envVar E_pubc_GW_GW_17E_cycleTm
{
    // update the cycle time 
    Cycle_GW_17E=getvalue(this);
}
on timer Tm_GW_340
{
    //cyclic message timer 
    if(getValue(E_pubc_GW_GW_340_Tm) == 1)
    {
        
    
        output(Msg_GW_340);
        
    }
    //Reset Timer
    SetTimer(Tm_GW_340,Cycle_GW_340);
}

on envVar E_pubc_GW_GW_340_cycleTm
{
    // update the cycle time 
    Cycle_GW_340=getvalue(this);
}
on timer Tm_GW_28C
{
    //cyclic message timer 
    if(getValue(E_pubc_GW_GW_28C_Tm) == 1)
    {
        
        //update the BZ Signal
        if(GW_28C_GW_MFS_RollingCounter_28C_wrongvalctr == 0)
        {
            update_GW_28C_GW_MFS_RollingCounter_28C_counter();
            Msg_GW_28C.GW_MFS_RollingCounter_28C= GW_28C_GW_MFS_RollingCounter_28C_counter;
        }
        else if(GW_28C_GW_MFS_RollingCounter_28C_wrongvalctr > 0)
        {
			GW_28C_GW_MFS_RollingCounter_28C_counter=GW_28C_GW_MFS_RollingCounter_28C_counter + GW_28C_GW_MFS_RollingCounter_28C_wrongvalctr;
			 Msg_GW_28C.GW_MFS_RollingCounter_28C= GW_28C_GW_MFS_RollingCounter_28C_counter;
             /* GW_28C_GW_MFS_RollingCounter_28C_wrongvalctr--;
             // if counter becomes zero, update panel controller to zero
             if(GW_28C_GW_MFS_RollingCounter_28C_wrongvalctr == 0)
             {
                putValue(E_pubc_GW_GW_28C_GW_MFS_RollingCounter_28C_wrongvalctr,0);
             } */
        }
        else
        {
            // do nothing
        }
    
        update_GW_28C_CRC_CheckSum();
        output(Msg_GW_28C);
        
    }
    //Reset Timer
    SetTimer(Tm_GW_28C,Cycle_GW_28C);
}

on envVar E_pubc_GW_GW_28C_cycleTm
{
    // update the cycle time 
    Cycle_GW_28C=getvalue(this);
}
on timer Tm_GW_366
{
    //cyclic message timer 
    if(getValue(E_pubc_GW_GW_366_Tm) == 1)
    {
        
    
        output(Msg_GW_366);
        
    }
    //Reset Timer
    SetTimer(Tm_GW_366,Cycle_GW_366);
}

on envVar E_pubc_GW_GW_366_cycleTm
{
    // update the cycle time 
    Cycle_GW_366=getvalue(this);
}
on timer Tm_GW_530
{
    //cyclic message timer 
    if(getValue(E_pubc_GW_GW_530_Tm) == 1)
    {
        
    
        output(Msg_GW_530);
        
    }
    //Reset Timer
    SetTimer(Tm_GW_530,Cycle_GW_530);
}

on envVar E_pubc_GW_GW_530_cycleTm
{
    // update the cycle time 
    Cycle_GW_530=getvalue(this);
}
on timer Tm_GW_362
{
    //cyclic message timer 
    if(getValue(E_pubc_GW_GW_362_Tm) == 1)
    {
        
		//update the BZ Signal
	
        output(Msg_GW_362);
        
    }
    //Reset Timer
    SetTimer(Tm_GW_362,Cycle_GW_362);
}

on envVar E_pubc_GW_GW_362_cycleTm
{
    // update the cycle time 
    Cycle_GW_362=getvalue(this);
}
on timer Tm_GW_170
{
    //cyclic message timer 
    if(getValue(E_pubc_GW_GW_170_Tm) == 1)
    {
        
		//update the BZ Signal
        if(GW_170_EPS_RollingCounter_170_wrongvalctr == 0)
        {
            update_GW_170_EPS_RollingCounter_170_counter();
            Msg_GW_170.EPS_RollingCounter_170= GW_170_EPS_RollingCounter_170_counter;
        }
        else if(GW_170_EPS_RollingCounter_170_wrongvalctr > 0)
        {
			 GW_170_EPS_RollingCounter_170_counter=GW_170_EPS_RollingCounter_170_counter + GW_170_EPS_RollingCounter_170_wrongvalctr;
			  Msg_GW_170.EPS_RollingCounter_170= GW_170_EPS_RollingCounter_170_counter;
             /*GW_170_EPS_RollingCounter_170_wrongvalctr--;
             //if counter becomes zero, update panel controller to zero
             if(GW_170_EPS_RollingCounter_170_wrongvalctr == 0)
             {
                putValue(E_pubc_GW_GW_170_EPS_RollingCounter_170_wrongvalctr,0);
             }*/
        }
        else
        {
            // do nothing
        }
	
        update_GW_170_CRC_CheckSum();
        output(Msg_GW_170);
        
    }
    //Reset Timer
    SetTimer(Tm_GW_170,Cycle_GW_170);
}

on envVar E_pubc_GW_GW_170_cycleTm
{
    // update the cycle time 
    Cycle_GW_170=getvalue(this);
}
on timer Tm_GW_180
{
    //cyclic message timer 
    if(getValue(E_pubc_GW_GW_180_Tm) == 1)
    {
        
        //update the BZ Signal
        if(GW_180_SAS_RollingCounter_wrongvalctr == 0)
        {
            update_GW_180_SAS_RollingCounter_counter();
            Msg_GW_180.SAS_RollingCounter= GW_180_SAS_RollingCounter_counter;
        }
        else if(GW_180_SAS_RollingCounter_wrongvalctr > 0)
        {
			GW_180_SAS_RollingCounter_counter=GW_180_SAS_RollingCounter_counter + GW_180_SAS_RollingCounter_wrongvalctr;
			 Msg_GW_180.SAS_RollingCounter= GW_180_SAS_RollingCounter_counter;
             /* GW_180_SAS_RollingCounter_wrongvalctr--;
             // if counter becomes zero, update panel controller to zero
             if(GW_180_SAS_RollingCounter_wrongvalctr == 0)
             {
                putValue(E_pubc_GW_GW_180_SAS_RollingCounter_wrongvalctr,0);
             } */
        }
        else
        {
            // do nothing
        }
    
        update_GW_180_CRC_CheckSum();
        output(Msg_GW_180);
        
    }
    //Reset Timer
    SetTimer(Tm_GW_180,Cycle_GW_180);
}

on envVar E_pubc_GW_GW_180_cycleTm
{
    // update the cycle time 
    Cycle_GW_180=getvalue(this);
}
on timer Tm_GW_3BB
{
    //cyclic message timer 
    if(getValue(E_pubc_GW_GW_3BB_Tm) == 1)
    {
        
		//update the BZ Signal
	
        output(Msg_GW_3BB);
        
    }
    //Reset Timer
    SetTimer(Tm_GW_3BB,Cycle_GW_3BB);
}

on envVar E_pubc_GW_GW_3BB_cycleTm
{
    // update the cycle time 
    Cycle_GW_3BB=getvalue(this);
}

on envVar E_pubc_GW_GW_3B8_tx
{
    if(getValue(this))
    {       
        
        //update the BZ Signal
        if(GW_3B8_HU_RollingCounter_3B8_wrongvalctr == 0)
        {
            update_GW_3B8_HU_RollingCounter_3B8_counter();
            Msg_GW_3B8.HU_RollingCounter_3B8= GW_3B8_HU_RollingCounter_3B8_counter;
        }
        else if(GW_3B8_HU_RollingCounter_3B8_wrongvalctr > 0)
        {
			GW_3B8_HU_RollingCounter_3B8_counter=GW_3B8_HU_RollingCounter_3B8_counter + GW_3B8_HU_RollingCounter_3B8_wrongvalctr;
			 Msg_GW_3B8.HU_RollingCounter_3B8= GW_3B8_HU_RollingCounter_3B8_counter;
             /* GW_3B8_HU_RollingCounter_3B8_wrongvalctr--;
              // if counter becomes zero, update panel controller to zero
             if(GW_3B8_HU_RollingCounter_3B8_wrongvalctr == 0)
             {
                 putValue(E_pubc_GW_GW_3B8_HU_RollingCounter_3B8_wrongvalctr,0);
             } */
        }
        else
        {
            //do nothing
        }        
        //calculate the CRC CheckSum
        update_GW_3B8_CRC_CheckSum();

        output(Msg_GW_3B8);        
    }
}

on envVar E_pubc_GW_GW_3B8_Range
{
    qword rawstatus = 0ll;
    qword rawValue = 0ll;    
    
    rawstatus = getvalue(this);    
    // set all the signals with min raw /max raw /init raw
    switch (rawstatus) 
    {
     case(0) :
        rawValue= 0;
        putValue(E_pubc_GW_GW_3B8_HU_Byroad_Rv, rawValue);
        rawValue= 0;
        putValue(E_pubc_GW_GW_3B8_HU_RoadCurvature_Rv, rawValue);
        rawValue= 0;
        putValue(E_pubc_GW_GW_3B8_HU_TunnelDistance_Rv, rawValue);
        rawValue= 0;
        putValue(E_pubc_GW_GW_3B8_HU_EnterTunnelInfo_Rv, rawValue);
        rawValue= 0;
        putValue(E_pubc_GW_GW_3B8_HU_SlopeDistance_Rv, rawValue);
        rawValue= 0;
        putValue(E_pubc_GW_GW_3B8_HU_EnterSlopeInfo_Rv, rawValue);
        rawValue= 0;
        putValue(E_pubc_GW_GW_3B8_HU_NavGuiganceStatus_Rv, rawValue);
        rawValue= 0;
        putValue(E_pubc_GW_GW_3B8_HU_TunnelLength_Rv, rawValue);
        rawValue= 0;
        putValue(E_pubc_GW_GW_3B8_HU_RoadCurvatureFar_Rv, rawValue);
        break;
     case(1) :
        rawValue= 3;
        putValue(E_pubc_GW_GW_3B8_HU_Byroad_Rv, rawValue);
        rawValue= 1023;
        putValue(E_pubc_GW_GW_3B8_HU_RoadCurvature_Rv, rawValue);
        rawValue= 60;
        putValue(E_pubc_GW_GW_3B8_HU_TunnelDistance_Rv, rawValue);
        rawValue= 3;
        putValue(E_pubc_GW_GW_3B8_HU_EnterTunnelInfo_Rv, rawValue);
        rawValue= 60;
        putValue(E_pubc_GW_GW_3B8_HU_SlopeDistance_Rv, rawValue);
        rawValue= 3;
        putValue(E_pubc_GW_GW_3B8_HU_EnterSlopeInfo_Rv, rawValue);
        rawValue= 3;
        putValue(E_pubc_GW_GW_3B8_HU_NavGuiganceStatus_Rv, rawValue);
        rawValue= 63;
        putValue(E_pubc_GW_GW_3B8_HU_TunnelLength_Rv, rawValue);
        rawValue= 1023;
        putValue(E_pubc_GW_GW_3B8_HU_RoadCurvatureFar_Rv, rawValue);
        break;
     default :
        rawValue= 0;
        putValue(E_pubc_GW_GW_3B8_HU_Byroad_Rv, rawValue);
        rawValue= 0;
        putValue(E_pubc_GW_GW_3B8_HU_RoadCurvature_Rv, rawValue);
        rawValue= 0;
        putValue(E_pubc_GW_GW_3B8_HU_TunnelDistance_Rv, rawValue);
        rawValue= 0;
        putValue(E_pubc_GW_GW_3B8_HU_EnterTunnelInfo_Rv, rawValue);
        rawValue= 0;
        putValue(E_pubc_GW_GW_3B8_HU_SlopeDistance_Rv, rawValue);
        rawValue= 0;
        putValue(E_pubc_GW_GW_3B8_HU_EnterSlopeInfo_Rv, rawValue);
        rawValue= 0;
        putValue(E_pubc_GW_GW_3B8_HU_NavGuiganceStatus_Rv, rawValue);
        rawValue= 0;
        putValue(E_pubc_GW_GW_3B8_HU_TunnelLength_Rv, rawValue);
        rawValue= 0;
        putValue(E_pubc_GW_GW_3B8_HU_RoadCurvatureFar_Rv, rawValue);
      break;
   }
}

on envVar E_pubc_GW_GW_3B8_Dlc
{
    if(getValue(E_pubc_GW_GW_3B8_enDlc))
    {
        Msg_GW_3B8.dlc =getValue(this);
    }
    else
    {
        Msg_GW_3B8.dlc =8;
    }
}

on envVar E_pubc_GW_GW_3B8_enDlc
{
    //For Messages with DLC = 8, set wrong DLC to smaller than defined DLC
    //For Messages with DLC < 8 set wrong DLC to smaller/longer than defined DLC
    if(getValue(this))
    {
        Msg_GW_3B8.dlc =getValue(E_pubc_GW_GW_3B8_Dlc);
    }
    else
    {
        Msg_GW_3B8.dlc =8;
    }
}

on envVar E_pubc_GW_GW_3B8_HU_CRCCheck_3B8_wrongvalctr
{
    //update disturb count
    //disturb value range:(-1 = always send wrong value),( X>0 ,x is the number of Messages with wrong CHK sent)
    GW_3B8_HU_CRCCheck_3B8_wrongvalctr =getValue(this);    
}
on envVar E_pubc_GW_GW_3B8_HU_RollingCounter_3B8_wrongvalctr
{
    //update disturb count
    //disturb value range:(-1 = always send wrong value),( X>0 ,x is the number of Messages with wrong CHK sent)
    GW_3B8_HU_RollingCounter_3B8_wrongvalctr =getValue(this);    
}

on envVar E_pubc_GW_GW_3B8_HU_Byroad_Rv
{
    int64 rawValue = 0ll;
    float rawValue_float = 0.0;
    float phyValue = 0.0;        

    //set the signal with updated raw value
    if(getValue(E_pubc_GW_GW_3B8_HU_Byroad_SetVt)==0)
    {
        rawValue = getvalue(this);
        if(chgEv_GW_3B8_HU_Byroad == 0)
        {
            //type conversion to float
            rawValue_float = rawValue;        
            // raw to physical conversion
            phyValue = ((rawValue_float *1)+(0));
            putValue(E_pubc_GW_GW_3B8_HU_Byroad_Pv, phyValue);
            chgEv_GW_3B8_HU_Byroad = 1;
        }
        else
        {
            chgEv_GW_3B8_HU_Byroad = 0;
        }    
        //update the signal value
        Msg_GW_3B8.HU_Byroad=rawValue;        
    }                                                                           
}

on envVar E_pubc_GW_GW_3B8_HU_Byroad_Pv
{
    int64 rawValue = 0ll;
    float phyValue = 0.0;
    
    //update the raw value with physical value 
    if(getValue(E_pubc_GW_GW_3B8_HU_Byroad_SetVt)==0)
    {
        if(chgEv_GW_3B8_HU_Byroad == 0)
        {
            phyValue = getvalue(this);
            // physical to raw conversion
            rawValue = ((phyValue -(0))/1);
            putValue(E_pubc_GW_GW_3B8_HU_Byroad_Rv, rawValue);
            chgEv_GW_3B8_HU_Byroad = 1;  
        }
        else
        {
            chgEv_GW_3B8_HU_Byroad = 0;
        }
    }
}

on envVar E_pubc_GW_GW_3B8_HU_Byroad_Vt
{
    qword rawValue = 0ll;
    if(getValue(E_pubc_GW_GW_3B8_HU_Byroad_SetVt))
    {
        //update the signal value
        Msg_GW_3B8.HU_Byroad=getValue(this);
    }
}

on envVar E_pubc_GW_GW_3B8_HU_Byroad_SetVt
{
    if(getValue(E_pubc_GW_GW_3B8_HU_Byroad_SetVt))
    {
        //update the signal value
        Msg_GW_3B8.HU_Byroad=getvalue(E_pubc_GW_GW_3B8_HU_Byroad_Vt);
    }
    else
    {
        Msg_GW_3B8.HU_Byroad=getValue(E_pubc_GW_GW_3B8_HU_Byroad_Rv);
    }
}
 
on envVar E_pubc_GW_GW_3B8_HU_RoadCurvature_Rv
{
    int64 rawValue = 0ll;
    float rawValue_float = 0.0;
    float phyValue = 0.0;        

    //set the signal with updated raw value
    if(getValue(E_pubc_GW_GW_3B8_HU_RoadCurvature_SetVt)==0)
    {
        rawValue = getvalue(this);
        if(chgEv_GW_3B8_HU_RoadCurvature == 0)
        {
            //type conversion to float
            rawValue_float = rawValue;        
            // raw to physical conversion
            phyValue = ((rawValue_float *1)+(0));
            putValue(E_pubc_GW_GW_3B8_HU_RoadCurvature_Pv, phyValue);
            chgEv_GW_3B8_HU_RoadCurvature = 1;
        }
        else
        {
            chgEv_GW_3B8_HU_RoadCurvature = 0;
        }    
        //update the signal value
        Msg_GW_3B8.HU_RoadCurvature=rawValue;        
    }                                                                           
}

on envVar E_pubc_GW_GW_3B8_HU_RoadCurvature_Pv
{
    int64 rawValue = 0ll;
    float phyValue = 0.0;
    
    //update the raw value with physical value 
    if(getValue(E_pubc_GW_GW_3B8_HU_RoadCurvature_SetVt)==0)
    {
        if(chgEv_GW_3B8_HU_RoadCurvature == 0)
        {
            phyValue = getvalue(this);
            // physical to raw conversion
            rawValue = ((phyValue -(0))/1);
            putValue(E_pubc_GW_GW_3B8_HU_RoadCurvature_Rv, rawValue);
            chgEv_GW_3B8_HU_RoadCurvature = 1;  
        }
        else
        {
            chgEv_GW_3B8_HU_RoadCurvature = 0;
        }
    }
}

on envVar E_pubc_GW_GW_3B8_HU_RoadCurvature_Vt
{
    qword rawValue = 0ll;
    if(getValue(E_pubc_GW_GW_3B8_HU_RoadCurvature_SetVt))
    {
        //update the signal value
        Msg_GW_3B8.HU_RoadCurvature=getValue(this);
    }
}

on envVar E_pubc_GW_GW_3B8_HU_RoadCurvature_SetVt
{
    if(getValue(E_pubc_GW_GW_3B8_HU_RoadCurvature_SetVt))
    {
        //update the signal value
        Msg_GW_3B8.HU_RoadCurvature=getvalue(E_pubc_GW_GW_3B8_HU_RoadCurvature_Vt);
    }
    else
    {
        Msg_GW_3B8.HU_RoadCurvature=getValue(E_pubc_GW_GW_3B8_HU_RoadCurvature_Rv);
    }
}
 
on envVar E_pubc_GW_GW_3B8_HU_TunnelDistance_Rv
{
    int64 rawValue = 0ll;
    float rawValue_float = 0.0;
    float phyValue = 0.0;        

    //set the signal with updated raw value
    if(getValue(E_pubc_GW_GW_3B8_HU_TunnelDistance_SetVt)==0)
    {
        rawValue = getvalue(this);
        if(chgEv_GW_3B8_HU_TunnelDistance == 0)
        {
            //type conversion to float
            rawValue_float = rawValue;        
            // raw to physical conversion
            phyValue = ((rawValue_float *10)+(0));
            putValue(E_pubc_GW_GW_3B8_HU_TunnelDistance_Pv, phyValue);
            chgEv_GW_3B8_HU_TunnelDistance = 1;
        }
        else
        {
            chgEv_GW_3B8_HU_TunnelDistance = 0;
        }    
        //update the signal value
        Msg_GW_3B8.HU_TunnelDistance=rawValue;        
    }                                                                           
}

on envVar E_pubc_GW_GW_3B8_HU_TunnelDistance_Pv
{
    int64 rawValue = 0ll;
    float phyValue = 0.0;
    
    //update the raw value with physical value 
    if(getValue(E_pubc_GW_GW_3B8_HU_TunnelDistance_SetVt)==0)
    {
        if(chgEv_GW_3B8_HU_TunnelDistance == 0)
        {
            phyValue = getvalue(this);
            // physical to raw conversion
            rawValue = ((phyValue -(0))/10);
            putValue(E_pubc_GW_GW_3B8_HU_TunnelDistance_Rv, rawValue);
            chgEv_GW_3B8_HU_TunnelDistance = 1;  
        }
        else
        {
            chgEv_GW_3B8_HU_TunnelDistance = 0;
        }
    }
}

on envVar E_pubc_GW_GW_3B8_HU_TunnelDistance_Vt
{
    qword rawValue = 0ll;
    if(getValue(E_pubc_GW_GW_3B8_HU_TunnelDistance_SetVt))
    {
        //update the signal value
        Msg_GW_3B8.HU_TunnelDistance=getValue(this);
    }
}

on envVar E_pubc_GW_GW_3B8_HU_TunnelDistance_SetVt
{
    if(getValue(E_pubc_GW_GW_3B8_HU_TunnelDistance_SetVt))
    {
        //update the signal value
        Msg_GW_3B8.HU_TunnelDistance=getvalue(E_pubc_GW_GW_3B8_HU_TunnelDistance_Vt);
    }
    else
    {
        Msg_GW_3B8.HU_TunnelDistance=getValue(E_pubc_GW_GW_3B8_HU_TunnelDistance_Rv);
    }
}
 
on envVar E_pubc_GW_GW_3B8_HU_EnterTunnelInfo_Rv
{
    int64 rawValue = 0ll;
    float rawValue_float = 0.0;
    float phyValue = 0.0;        

    //set the signal with updated raw value
    if(getValue(E_pubc_GW_GW_3B8_HU_EnterTunnelInfo_SetVt)==0)
    {
        rawValue = getvalue(this);
        if(chgEv_GW_3B8_HU_EnterTunnelInfo == 0)
        {
            //type conversion to float
            rawValue_float = rawValue;        
            // raw to physical conversion
            phyValue = ((rawValue_float *1)+(0));
            putValue(E_pubc_GW_GW_3B8_HU_EnterTunnelInfo_Pv, phyValue);
            chgEv_GW_3B8_HU_EnterTunnelInfo = 1;
        }
        else
        {
            chgEv_GW_3B8_HU_EnterTunnelInfo = 0;
        }    
        //update the signal value
        Msg_GW_3B8.HU_EnterTunnelInfo=rawValue;        
    }                                                                           
}

on envVar E_pubc_GW_GW_3B8_HU_EnterTunnelInfo_Pv
{
    int64 rawValue = 0ll;
    float phyValue = 0.0;
    
    //update the raw value with physical value 
    if(getValue(E_pubc_GW_GW_3B8_HU_EnterTunnelInfo_SetVt)==0)
    {
        if(chgEv_GW_3B8_HU_EnterTunnelInfo == 0)
        {
            phyValue = getvalue(this);
            // physical to raw conversion
            rawValue = ((phyValue -(0))/1);
            putValue(E_pubc_GW_GW_3B8_HU_EnterTunnelInfo_Rv, rawValue);
            chgEv_GW_3B8_HU_EnterTunnelInfo = 1;  
        }
        else
        {
            chgEv_GW_3B8_HU_EnterTunnelInfo = 0;
        }
    }
}

on envVar E_pubc_GW_GW_3B8_HU_EnterTunnelInfo_Vt
{
    qword rawValue = 0ll;
    if(getValue(E_pubc_GW_GW_3B8_HU_EnterTunnelInfo_SetVt))
    {
        //update the signal value
        Msg_GW_3B8.HU_EnterTunnelInfo=getValue(this);
    }
}

on envVar E_pubc_GW_GW_3B8_HU_EnterTunnelInfo_SetVt
{
    if(getValue(E_pubc_GW_GW_3B8_HU_EnterTunnelInfo_SetVt))
    {
        //update the signal value
        Msg_GW_3B8.HU_EnterTunnelInfo=getvalue(E_pubc_GW_GW_3B8_HU_EnterTunnelInfo_Vt);
    }
    else
    {
        Msg_GW_3B8.HU_EnterTunnelInfo=getValue(E_pubc_GW_GW_3B8_HU_EnterTunnelInfo_Rv);
    }
}
 
on envVar E_pubc_GW_GW_3B8_HU_SlopeDistance_Rv
{
    int64 rawValue = 0ll;
    float rawValue_float = 0.0;
    float phyValue = 0.0;        

    //set the signal with updated raw value
    if(getValue(E_pubc_GW_GW_3B8_HU_SlopeDistance_SetVt)==0)
    {
        rawValue = getvalue(this);
        if(chgEv_GW_3B8_HU_SlopeDistance == 0)
        {
            //type conversion to float
            rawValue_float = rawValue;        
            // raw to physical conversion
            phyValue = ((rawValue_float *10)+(0));
            putValue(E_pubc_GW_GW_3B8_HU_SlopeDistance_Pv, phyValue);
            chgEv_GW_3B8_HU_SlopeDistance = 1;
        }
        else
        {
            chgEv_GW_3B8_HU_SlopeDistance = 0;
        }    
        //update the signal value
        Msg_GW_3B8.HU_SlopeDistance=rawValue;        
    }                                                                           
}

on envVar E_pubc_GW_GW_3B8_HU_SlopeDistance_Pv
{
    int64 rawValue = 0ll;
    float phyValue = 0.0;
    
    //update the raw value with physical value 
    if(getValue(E_pubc_GW_GW_3B8_HU_SlopeDistance_SetVt)==0)
    {
        if(chgEv_GW_3B8_HU_SlopeDistance == 0)
        {
            phyValue = getvalue(this);
            // physical to raw conversion
            rawValue = ((phyValue -(0))/10);
            putValue(E_pubc_GW_GW_3B8_HU_SlopeDistance_Rv, rawValue);
            chgEv_GW_3B8_HU_SlopeDistance = 1;  
        }
        else
        {
            chgEv_GW_3B8_HU_SlopeDistance = 0;
        }
    }
}

on envVar E_pubc_GW_GW_3B8_HU_SlopeDistance_Vt
{
    qword rawValue = 0ll;
    if(getValue(E_pubc_GW_GW_3B8_HU_SlopeDistance_SetVt))
    {
        //update the signal value
        Msg_GW_3B8.HU_SlopeDistance=getValue(this);
    }
}

on envVar E_pubc_GW_GW_3B8_HU_SlopeDistance_SetVt
{
    if(getValue(E_pubc_GW_GW_3B8_HU_SlopeDistance_SetVt))
    {
        //update the signal value
        Msg_GW_3B8.HU_SlopeDistance=getvalue(E_pubc_GW_GW_3B8_HU_SlopeDistance_Vt);
    }
    else
    {
        Msg_GW_3B8.HU_SlopeDistance=getValue(E_pubc_GW_GW_3B8_HU_SlopeDistance_Rv);
    }
}
 
on envVar E_pubc_GW_GW_3B8_HU_EnterSlopeInfo_Rv
{
    int64 rawValue = 0ll;
    float rawValue_float = 0.0;
    float phyValue = 0.0;        

    //set the signal with updated raw value
    if(getValue(E_pubc_GW_GW_3B8_HU_EnterSlopeInfo_SetVt)==0)
    {
        rawValue = getvalue(this);
        if(chgEv_GW_3B8_HU_EnterSlopeInfo == 0)
        {
            //type conversion to float
            rawValue_float = rawValue;        
            // raw to physical conversion
            phyValue = ((rawValue_float *1)+(0));
            putValue(E_pubc_GW_GW_3B8_HU_EnterSlopeInfo_Pv, phyValue);
            chgEv_GW_3B8_HU_EnterSlopeInfo = 1;
        }
        else
        {
            chgEv_GW_3B8_HU_EnterSlopeInfo = 0;
        }    
        //update the signal value
        Msg_GW_3B8.HU_EnterSlopeInfo=rawValue;        
    }                                                                           
}

on envVar E_pubc_GW_GW_3B8_HU_EnterSlopeInfo_Pv
{
    int64 rawValue = 0ll;
    float phyValue = 0.0;
    
    //update the raw value with physical value 
    if(getValue(E_pubc_GW_GW_3B8_HU_EnterSlopeInfo_SetVt)==0)
    {
        if(chgEv_GW_3B8_HU_EnterSlopeInfo == 0)
        {
            phyValue = getvalue(this);
            // physical to raw conversion
            rawValue = ((phyValue -(0))/1);
            putValue(E_pubc_GW_GW_3B8_HU_EnterSlopeInfo_Rv, rawValue);
            chgEv_GW_3B8_HU_EnterSlopeInfo = 1;  
        }
        else
        {
            chgEv_GW_3B8_HU_EnterSlopeInfo = 0;
        }
    }
}

on envVar E_pubc_GW_GW_3B8_HU_EnterSlopeInfo_Vt
{
    qword rawValue = 0ll;
    if(getValue(E_pubc_GW_GW_3B8_HU_EnterSlopeInfo_SetVt))
    {
        //update the signal value
        Msg_GW_3B8.HU_EnterSlopeInfo=getValue(this);
    }
}

on envVar E_pubc_GW_GW_3B8_HU_EnterSlopeInfo_SetVt
{
    if(getValue(E_pubc_GW_GW_3B8_HU_EnterSlopeInfo_SetVt))
    {
        //update the signal value
        Msg_GW_3B8.HU_EnterSlopeInfo=getvalue(E_pubc_GW_GW_3B8_HU_EnterSlopeInfo_Vt);
    }
    else
    {
        Msg_GW_3B8.HU_EnterSlopeInfo=getValue(E_pubc_GW_GW_3B8_HU_EnterSlopeInfo_Rv);
    }
}
 
on envVar E_pubc_GW_GW_3B8_HU_NavGuiganceStatus_Rv
{
    int64 rawValue = 0ll;
    float rawValue_float = 0.0;
    float phyValue = 0.0;        

    //set the signal with updated raw value
    if(getValue(E_pubc_GW_GW_3B8_HU_NavGuiganceStatus_SetVt)==0)
    {
        rawValue = getvalue(this);
        if(chgEv_GW_3B8_HU_NavGuiganceStatus == 0)
        {
            //type conversion to float
            rawValue_float = rawValue;        
            // raw to physical conversion
            phyValue = ((rawValue_float *1)+(0));
            putValue(E_pubc_GW_GW_3B8_HU_NavGuiganceStatus_Pv, phyValue);
            chgEv_GW_3B8_HU_NavGuiganceStatus = 1;
        }
        else
        {
            chgEv_GW_3B8_HU_NavGuiganceStatus = 0;
        }    
        //update the signal value
        Msg_GW_3B8.HU_NavGuiganceStatus=rawValue;        
    }                                                                           
}

on envVar E_pubc_GW_GW_3B8_HU_NavGuiganceStatus_Pv
{
    int64 rawValue = 0ll;
    float phyValue = 0.0;
    
    //update the raw value with physical value 
    if(getValue(E_pubc_GW_GW_3B8_HU_NavGuiganceStatus_SetVt)==0)
    {
        if(chgEv_GW_3B8_HU_NavGuiganceStatus == 0)
        {
            phyValue = getvalue(this);
            // physical to raw conversion
            rawValue = ((phyValue -(0))/1);
            putValue(E_pubc_GW_GW_3B8_HU_NavGuiganceStatus_Rv, rawValue);
            chgEv_GW_3B8_HU_NavGuiganceStatus = 1;  
        }
        else
        {
            chgEv_GW_3B8_HU_NavGuiganceStatus = 0;
        }
    }
}

on envVar E_pubc_GW_GW_3B8_HU_NavGuiganceStatus_Vt
{
    qword rawValue = 0ll;
    if(getValue(E_pubc_GW_GW_3B8_HU_NavGuiganceStatus_SetVt))
    {
        //update the signal value
        Msg_GW_3B8.HU_NavGuiganceStatus=getValue(this);
    }
}

on envVar E_pubc_GW_GW_3B8_HU_NavGuiganceStatus_SetVt
{
    if(getValue(E_pubc_GW_GW_3B8_HU_NavGuiganceStatus_SetVt))
    {
        //update the signal value
        Msg_GW_3B8.HU_NavGuiganceStatus=getvalue(E_pubc_GW_GW_3B8_HU_NavGuiganceStatus_Vt);
    }
    else
    {
        Msg_GW_3B8.HU_NavGuiganceStatus=getValue(E_pubc_GW_GW_3B8_HU_NavGuiganceStatus_Rv);
    }
}
 
on envVar E_pubc_GW_GW_3B8_HU_TunnelLength_Rv
{
    int64 rawValue = 0ll;
    float rawValue_float = 0.0;
    float phyValue = 0.0;        

    //set the signal with updated raw value
    if(getValue(E_pubc_GW_GW_3B8_HU_TunnelLength_SetVt)==0)
    {
        rawValue = getvalue(this);
        if(chgEv_GW_3B8_HU_TunnelLength == 0)
        {
            //type conversion to float
            rawValue_float = rawValue;        
            // raw to physical conversion
            phyValue = ((rawValue_float *1)+(0));
            putValue(E_pubc_GW_GW_3B8_HU_TunnelLength_Pv, phyValue);
            chgEv_GW_3B8_HU_TunnelLength = 1;
        }
        else
        {
            chgEv_GW_3B8_HU_TunnelLength = 0;
        }    
        //update the signal value
        Msg_GW_3B8.HU_TunnelLength=rawValue;        
    }                                                                           
}

on envVar E_pubc_GW_GW_3B8_HU_TunnelLength_Pv
{
    int64 rawValue = 0ll;
    float phyValue = 0.0;
    
    //update the raw value with physical value 
    if(getValue(E_pubc_GW_GW_3B8_HU_TunnelLength_SetVt)==0)
    {
        if(chgEv_GW_3B8_HU_TunnelLength == 0)
        {
            phyValue = getvalue(this);
            // physical to raw conversion
            rawValue = ((phyValue -(0))/1);
            putValue(E_pubc_GW_GW_3B8_HU_TunnelLength_Rv, rawValue);
            chgEv_GW_3B8_HU_TunnelLength = 1;  
        }
        else
        {
            chgEv_GW_3B8_HU_TunnelLength = 0;
        }
    }
}

on envVar E_pubc_GW_GW_3B8_HU_TunnelLength_Vt
{
    qword rawValue = 0ll;
    if(getValue(E_pubc_GW_GW_3B8_HU_TunnelLength_SetVt))
    {
        //update the signal value
        Msg_GW_3B8.HU_TunnelLength=getValue(this);
    }
}

on envVar E_pubc_GW_GW_3B8_HU_TunnelLength_SetVt
{
    if(getValue(E_pubc_GW_GW_3B8_HU_TunnelLength_SetVt))
    {
        //update the signal value
        Msg_GW_3B8.HU_TunnelLength=getvalue(E_pubc_GW_GW_3B8_HU_TunnelLength_Vt);
    }
    else
    {
        Msg_GW_3B8.HU_TunnelLength=getValue(E_pubc_GW_GW_3B8_HU_TunnelLength_Rv);
    }
}
 
on envVar E_pubc_GW_GW_3B8_HU_RoadCurvatureFar_Rv
{
    int64 rawValue = 0ll;
    float rawValue_float = 0.0;
    float phyValue = 0.0;        

    //set the signal with updated raw value
    if(getValue(E_pubc_GW_GW_3B8_HU_RoadCurvatureFar_SetVt)==0)
    {
        rawValue = getvalue(this);
        if(chgEv_GW_3B8_HU_RoadCurvatureFar == 0)
        {
            //type conversion to float
            rawValue_float = rawValue;        
            // raw to physical conversion
            phyValue = ((rawValue_float *1)+(0));
            putValue(E_pubc_GW_GW_3B8_HU_RoadCurvatureFar_Pv, phyValue);
            chgEv_GW_3B8_HU_RoadCurvatureFar = 1;
        }
        else
        {
            chgEv_GW_3B8_HU_RoadCurvatureFar = 0;
        }    
        //update the signal value
        Msg_GW_3B8.HU_RoadCurvatureFar=rawValue;        
    }                                                                           
}

on envVar E_pubc_GW_GW_3B8_HU_RoadCurvatureFar_Pv
{
    int64 rawValue = 0ll;
    float phyValue = 0.0;
    
    //update the raw value with physical value 
    if(getValue(E_pubc_GW_GW_3B8_HU_RoadCurvatureFar_SetVt)==0)
    {
        if(chgEv_GW_3B8_HU_RoadCurvatureFar == 0)
        {
            phyValue = getvalue(this);
            // physical to raw conversion
            rawValue = ((phyValue -(0))/1);
            putValue(E_pubc_GW_GW_3B8_HU_RoadCurvatureFar_Rv, rawValue);
            chgEv_GW_3B8_HU_RoadCurvatureFar = 1;  
        }
        else
        {
            chgEv_GW_3B8_HU_RoadCurvatureFar = 0;
        }
    }
}

on envVar E_pubc_GW_GW_3B8_HU_RoadCurvatureFar_Vt
{
    qword rawValue = 0ll;
    if(getValue(E_pubc_GW_GW_3B8_HU_RoadCurvatureFar_SetVt))
    {
        //update the signal value
        Msg_GW_3B8.HU_RoadCurvatureFar=getValue(this);
    }
}

on envVar E_pubc_GW_GW_3B8_HU_RoadCurvatureFar_SetVt
{
    if(getValue(E_pubc_GW_GW_3B8_HU_RoadCurvatureFar_SetVt))
    {
        //update the signal value
        Msg_GW_3B8.HU_RoadCurvatureFar=getvalue(E_pubc_GW_GW_3B8_HU_RoadCurvatureFar_Vt);
    }
    else
    {
        Msg_GW_3B8.HU_RoadCurvatureFar=getValue(E_pubc_GW_GW_3B8_HU_RoadCurvatureFar_Rv);
    }
}
 
 
on envVar E_pubc_GW_GW_3C4_tx
{
    if(getValue(this))
    {       
        
        //update the BZ Signal
        if(GW_3C4_HU_RollingCounter_3C4_wrongvalctr == 0)
        {
            update_GW_3C4_HU_RollingCounter_3C4_counter();
            Msg_GW_3C4.HU_RollingCounter_3C4= GW_3C4_HU_RollingCounter_3C4_counter;
        }
        else if(GW_3C4_HU_RollingCounter_3C4_wrongvalctr > 0)
        {
			GW_3C4_HU_RollingCounter_3C4_counter=GW_3C4_HU_RollingCounter_3C4_counter + GW_3C4_HU_RollingCounter_3C4_wrongvalctr;
			 Msg_GW_3C4.HU_RollingCounter_3C4= GW_3C4_HU_RollingCounter_3C4_counter;
             /* GW_3C4_HU_RollingCounter_3C4_wrongvalctr--;
              // if counter becomes zero, update panel controller to zero
             if(GW_3C4_HU_RollingCounter_3C4_wrongvalctr == 0)
             {
                 putValue(E_pubc_GW_GW_3C4_HU_RollingCounter_3C4_wrongvalctr,0);
             } */
        }
        else
        {
            //do nothing
        }        
        //calculate the CRC CheckSum
        update_GW_3C4_CRC_CheckSum();

        output(Msg_GW_3C4);        
    }
}

on envVar E_pubc_GW_GW_3C4_Range
{
    qword rawstatus = 0ll;
    qword rawValue = 0ll;    
    
    rawstatus = getvalue(this);    
    // set all the signals with min raw /max raw /init raw
    switch (rawstatus) 
    {
     case(0) :
        rawValue= 0;
        putValue(E_pubc_GW_GW_3C4_HU_RoadCurvature_30m_Rv, rawValue);
        rawValue= 0;
        putValue(E_pubc_GW_GW_3C4_HU_RoadCurvature_20m_Rv, rawValue);
        rawValue= 0;
        putValue(E_pubc_GW_GW_3C4_HU_To_NumchangeOfLanes_Dist_Rv, rawValue);
        rawValue= 0;
        putValue(E_pubc_GW_GW_3C4_HU_RoadCurvature_40m_Rv, rawValue);
        rawValue= 0;
        putValue(E_pubc_GW_GW_3C4_HU_RoadCurvature_10m_Rv, rawValue);
        rawValue= 0;
        putValue(E_pubc_GW_GW_3C4_HU_Lane_Changtype_Rv, rawValue);
        break;
     case(1) :
        rawValue= 1023;
        putValue(E_pubc_GW_GW_3C4_HU_RoadCurvature_30m_Rv, rawValue);
        rawValue= 1023;
        putValue(E_pubc_GW_GW_3C4_HU_RoadCurvature_20m_Rv, rawValue);
        rawValue= 60;
        putValue(E_pubc_GW_GW_3C4_HU_To_NumchangeOfLanes_Dist_Rv, rawValue);
        rawValue= 1023;
        putValue(E_pubc_GW_GW_3C4_HU_RoadCurvature_40m_Rv, rawValue);
        rawValue= 1023;
        putValue(E_pubc_GW_GW_3C4_HU_RoadCurvature_10m_Rv, rawValue);
        rawValue= 3;
        putValue(E_pubc_GW_GW_3C4_HU_Lane_Changtype_Rv, rawValue);
        break;
     default :
        rawValue= 0;
        putValue(E_pubc_GW_GW_3C4_HU_RoadCurvature_30m_Rv, rawValue);
        rawValue= 0;
        putValue(E_pubc_GW_GW_3C4_HU_RoadCurvature_20m_Rv, rawValue);
        rawValue= 0;
        putValue(E_pubc_GW_GW_3C4_HU_To_NumchangeOfLanes_Dist_Rv, rawValue);
        rawValue= 0;
        putValue(E_pubc_GW_GW_3C4_HU_RoadCurvature_40m_Rv, rawValue);
        rawValue= 0;
        putValue(E_pubc_GW_GW_3C4_HU_RoadCurvature_10m_Rv, rawValue);
        rawValue= 0;
        putValue(E_pubc_GW_GW_3C4_HU_Lane_Changtype_Rv, rawValue);
      break;
   }
}

on envVar E_pubc_GW_GW_3C4_Dlc
{
    if(getValue(E_pubc_GW_GW_3C4_enDlc))
    {
        Msg_GW_3C4.dlc =getValue(this);
    }
    else
    {
        Msg_GW_3C4.dlc =8;
    }
}

on envVar E_pubc_GW_GW_3C4_enDlc
{
    //For Messages with DLC = 8, set wrong DLC to smaller than defined DLC
    //For Messages with DLC < 8 set wrong DLC to smaller/longer than defined DLC
    if(getValue(this))
    {
        Msg_GW_3C4.dlc =getValue(E_pubc_GW_GW_3C4_Dlc);
    }
    else
    {
        Msg_GW_3C4.dlc =8;
    }
}

on envVar E_pubc_GW_GW_3C4_HU_CRCCheck_3C4_wrongvalctr
{
    //update disturb count
    //disturb value range:(-1 = always send wrong value),( X>0 ,x is the number of Messages with wrong CHK sent)
    GW_3C4_HU_CRCCheck_3C4_wrongvalctr =getValue(this);    
}
on envVar E_pubc_GW_GW_3C4_HU_RollingCounter_3C4_wrongvalctr
{
    //update disturb count
    //disturb value range:(-1 = always send wrong value),( X>0 ,x is the number of Messages with wrong CHK sent)
    GW_3C4_HU_RollingCounter_3C4_wrongvalctr =getValue(this);    
}

on envVar E_pubc_GW_GW_3C4_HU_RoadCurvature_30m_Rv
{
    int64 rawValue = 0ll;
    float rawValue_float = 0.0;
    float phyValue = 0.0;        

    //set the signal with updated raw value
    if(getValue(E_pubc_GW_GW_3C4_HU_RoadCurvature_30m_SetVt)==0)
    {
        rawValue = getvalue(this);
        if(chgEv_GW_3C4_HU_RoadCurvature_30m == 0)
        {
            //type conversion to float
            rawValue_float = rawValue;        
            // raw to physical conversion
            phyValue = ((rawValue_float *1)+(0));
            putValue(E_pubc_GW_GW_3C4_HU_RoadCurvature_30m_Pv, phyValue);
            chgEv_GW_3C4_HU_RoadCurvature_30m = 1;
        }
        else
        {
            chgEv_GW_3C4_HU_RoadCurvature_30m = 0;
        }    
        //update the signal value
        Msg_GW_3C4.HU_RoadCurvature_30m=rawValue;        
    }                                                                           
}

on envVar E_pubc_GW_GW_3C4_HU_RoadCurvature_30m_Pv
{
    int64 rawValue = 0ll;
    float phyValue = 0.0;
    
    //update the raw value with physical value 
    if(getValue(E_pubc_GW_GW_3C4_HU_RoadCurvature_30m_SetVt)==0)
    {
        if(chgEv_GW_3C4_HU_RoadCurvature_30m == 0)
        {
            phyValue = getvalue(this);
            // physical to raw conversion
            rawValue = ((phyValue -(0))/1);
            putValue(E_pubc_GW_GW_3C4_HU_RoadCurvature_30m_Rv, rawValue);
            chgEv_GW_3C4_HU_RoadCurvature_30m = 1;  
        }
        else
        {
            chgEv_GW_3C4_HU_RoadCurvature_30m = 0;
        }
    }
}

on envVar E_pubc_GW_GW_3C4_HU_RoadCurvature_30m_Vt
{
    qword rawValue = 0ll;
    if(getValue(E_pubc_GW_GW_3C4_HU_RoadCurvature_30m_SetVt))
    {
        //update the signal value
        Msg_GW_3C4.HU_RoadCurvature_30m=getValue(this);
    }
}

on envVar E_pubc_GW_GW_3C4_HU_RoadCurvature_30m_SetVt
{
    if(getValue(E_pubc_GW_GW_3C4_HU_RoadCurvature_30m_SetVt))
    {
        //update the signal value
        Msg_GW_3C4.HU_RoadCurvature_30m=getvalue(E_pubc_GW_GW_3C4_HU_RoadCurvature_30m_Vt);
    }
    else
    {
        Msg_GW_3C4.HU_RoadCurvature_30m=getValue(E_pubc_GW_GW_3C4_HU_RoadCurvature_30m_Rv);
    }
}
 
on envVar E_pubc_GW_GW_3C4_HU_RoadCurvature_20m_Rv
{
    int64 rawValue = 0ll;
    float rawValue_float = 0.0;
    float phyValue = 0.0;        

    //set the signal with updated raw value
    if(getValue(E_pubc_GW_GW_3C4_HU_RoadCurvature_20m_SetVt)==0)
    {
        rawValue = getvalue(this);
        if(chgEv_GW_3C4_HU_RoadCurvature_20m == 0)
        {
            //type conversion to float
            rawValue_float = rawValue;        
            // raw to physical conversion
            phyValue = ((rawValue_float *1)+(0));
            putValue(E_pubc_GW_GW_3C4_HU_RoadCurvature_20m_Pv, phyValue);
            chgEv_GW_3C4_HU_RoadCurvature_20m = 1;
        }
        else
        {
            chgEv_GW_3C4_HU_RoadCurvature_20m = 0;
        }    
        //update the signal value
        Msg_GW_3C4.HU_RoadCurvature_20m=rawValue;        
    }                                                                           
}

on envVar E_pubc_GW_GW_3C4_HU_RoadCurvature_20m_Pv
{
    int64 rawValue = 0ll;
    float phyValue = 0.0;
    
    //update the raw value with physical value 
    if(getValue(E_pubc_GW_GW_3C4_HU_RoadCurvature_20m_SetVt)==0)
    {
        if(chgEv_GW_3C4_HU_RoadCurvature_20m == 0)
        {
            phyValue = getvalue(this);
            // physical to raw conversion
            rawValue = ((phyValue -(0))/1);
            putValue(E_pubc_GW_GW_3C4_HU_RoadCurvature_20m_Rv, rawValue);
            chgEv_GW_3C4_HU_RoadCurvature_20m = 1;  
        }
        else
        {
            chgEv_GW_3C4_HU_RoadCurvature_20m = 0;
        }
    }
}

on envVar E_pubc_GW_GW_3C4_HU_RoadCurvature_20m_Vt
{
    qword rawValue = 0ll;
    if(getValue(E_pubc_GW_GW_3C4_HU_RoadCurvature_20m_SetVt))
    {
        //update the signal value
        Msg_GW_3C4.HU_RoadCurvature_20m=getValue(this);
    }
}

on envVar E_pubc_GW_GW_3C4_HU_RoadCurvature_20m_SetVt
{
    if(getValue(E_pubc_GW_GW_3C4_HU_RoadCurvature_20m_SetVt))
    {
        //update the signal value
        Msg_GW_3C4.HU_RoadCurvature_20m=getvalue(E_pubc_GW_GW_3C4_HU_RoadCurvature_20m_Vt);
    }
    else
    {
        Msg_GW_3C4.HU_RoadCurvature_20m=getValue(E_pubc_GW_GW_3C4_HU_RoadCurvature_20m_Rv);
    }
}
 
on envVar E_pubc_GW_GW_3C4_HU_To_NumchangeOfLanes_Dist_Rv
{
    int64 rawValue = 0ll;
    float rawValue_float = 0.0;
    float phyValue = 0.0;        

    //set the signal with updated raw value
    if(getValue(E_pubc_GW_GW_3C4_HU_To_NumchangeOfLanes_Dist_SetVt)==0)
    {
        rawValue = getvalue(this);
        if(chgEv_GW_3C4_HU_To_NumchangeOfLanes_Dist == 0)
        {
            //type conversion to float
            rawValue_float = rawValue;        
            // raw to physical conversion
            phyValue = ((rawValue_float *10)+(0));
            putValue(E_pubc_GW_GW_3C4_HU_To_NumchangeOfLanes_Dist_Pv, phyValue);
            chgEv_GW_3C4_HU_To_NumchangeOfLanes_Dist = 1;
        }
        else
        {
            chgEv_GW_3C4_HU_To_NumchangeOfLanes_Dist = 0;
        }    
        //update the signal value
        Msg_GW_3C4.HU_To_NumchangeOfLanes_Dist=rawValue;        
    }                                                                           
}

on envVar E_pubc_GW_GW_3C4_HU_To_NumchangeOfLanes_Dist_Pv
{
    int64 rawValue = 0ll;
    float phyValue = 0.0;
    
    //update the raw value with physical value 
    if(getValue(E_pubc_GW_GW_3C4_HU_To_NumchangeOfLanes_Dist_SetVt)==0)
    {
        if(chgEv_GW_3C4_HU_To_NumchangeOfLanes_Dist == 0)
        {
            phyValue = getvalue(this);
            // physical to raw conversion
            rawValue = ((phyValue -(0))/10);
            putValue(E_pubc_GW_GW_3C4_HU_To_NumchangeOfLanes_Dist_Rv, rawValue);
            chgEv_GW_3C4_HU_To_NumchangeOfLanes_Dist = 1;  
        }
        else
        {
            chgEv_GW_3C4_HU_To_NumchangeOfLanes_Dist = 0;
        }
    }
}

on envVar E_pubc_GW_GW_3C4_HU_To_NumchangeOfLanes_Dist_Vt
{
    qword rawValue = 0ll;
    if(getValue(E_pubc_GW_GW_3C4_HU_To_NumchangeOfLanes_Dist_SetVt))
    {
        //update the signal value
        Msg_GW_3C4.HU_To_NumchangeOfLanes_Dist=getValue(this);
    }
}

on envVar E_pubc_GW_GW_3C4_HU_To_NumchangeOfLanes_Dist_SetVt
{
    if(getValue(E_pubc_GW_GW_3C4_HU_To_NumchangeOfLanes_Dist_SetVt))
    {
        //update the signal value
        Msg_GW_3C4.HU_To_NumchangeOfLanes_Dist=getvalue(E_pubc_GW_GW_3C4_HU_To_NumchangeOfLanes_Dist_Vt);
    }
    else
    {
        Msg_GW_3C4.HU_To_NumchangeOfLanes_Dist=getValue(E_pubc_GW_GW_3C4_HU_To_NumchangeOfLanes_Dist_Rv);
    }
}
 
on envVar E_pubc_GW_GW_3C4_HU_RoadCurvature_40m_Rv
{
    int64 rawValue = 0ll;
    float rawValue_float = 0.0;
    float phyValue = 0.0;        

    //set the signal with updated raw value
    if(getValue(E_pubc_GW_GW_3C4_HU_RoadCurvature_40m_SetVt)==0)
    {
        rawValue = getvalue(this);
        if(chgEv_GW_3C4_HU_RoadCurvature_40m == 0)
        {
            //type conversion to float
            rawValue_float = rawValue;        
            // raw to physical conversion
            phyValue = ((rawValue_float *1)+(0));
            putValue(E_pubc_GW_GW_3C4_HU_RoadCurvature_40m_Pv, phyValue);
            chgEv_GW_3C4_HU_RoadCurvature_40m = 1;
        }
        else
        {
            chgEv_GW_3C4_HU_RoadCurvature_40m = 0;
        }    
        //update the signal value
        Msg_GW_3C4.HU_RoadCurvature_40m=rawValue;        
    }                                                                           
}

on envVar E_pubc_GW_GW_3C4_HU_RoadCurvature_40m_Pv
{
    int64 rawValue = 0ll;
    float phyValue = 0.0;
    
    //update the raw value with physical value 
    if(getValue(E_pubc_GW_GW_3C4_HU_RoadCurvature_40m_SetVt)==0)
    {
        if(chgEv_GW_3C4_HU_RoadCurvature_40m == 0)
        {
            phyValue = getvalue(this);
            // physical to raw conversion
            rawValue = ((phyValue -(0))/1);
            putValue(E_pubc_GW_GW_3C4_HU_RoadCurvature_40m_Rv, rawValue);
            chgEv_GW_3C4_HU_RoadCurvature_40m = 1;  
        }
        else
        {
            chgEv_GW_3C4_HU_RoadCurvature_40m = 0;
        }
    }
}

on envVar E_pubc_GW_GW_3C4_HU_RoadCurvature_40m_Vt
{
    qword rawValue = 0ll;
    if(getValue(E_pubc_GW_GW_3C4_HU_RoadCurvature_40m_SetVt))
    {
        //update the signal value
        Msg_GW_3C4.HU_RoadCurvature_40m=getValue(this);
    }
}

on envVar E_pubc_GW_GW_3C4_HU_RoadCurvature_40m_SetVt
{
    if(getValue(E_pubc_GW_GW_3C4_HU_RoadCurvature_40m_SetVt))
    {
        //update the signal value
        Msg_GW_3C4.HU_RoadCurvature_40m=getvalue(E_pubc_GW_GW_3C4_HU_RoadCurvature_40m_Vt);
    }
    else
    {
        Msg_GW_3C4.HU_RoadCurvature_40m=getValue(E_pubc_GW_GW_3C4_HU_RoadCurvature_40m_Rv);
    }
}
 
on envVar E_pubc_GW_GW_3C4_HU_RoadCurvature_10m_Rv
{
    int64 rawValue = 0ll;
    float rawValue_float = 0.0;
    float phyValue = 0.0;        

    //set the signal with updated raw value
    if(getValue(E_pubc_GW_GW_3C4_HU_RoadCurvature_10m_SetVt)==0)
    {
        rawValue = getvalue(this);
        if(chgEv_GW_3C4_HU_RoadCurvature_10m == 0)
        {
            //type conversion to float
            rawValue_float = rawValue;        
            // raw to physical conversion
            phyValue = ((rawValue_float *1)+(0));
            putValue(E_pubc_GW_GW_3C4_HU_RoadCurvature_10m_Pv, phyValue);
            chgEv_GW_3C4_HU_RoadCurvature_10m = 1;
        }
        else
        {
            chgEv_GW_3C4_HU_RoadCurvature_10m = 0;
        }    
        //update the signal value
        Msg_GW_3C4.HU_RoadCurvature_10m=rawValue;        
    }                                                                           
}

on envVar E_pubc_GW_GW_3C4_HU_RoadCurvature_10m_Pv
{
    int64 rawValue = 0ll;
    float phyValue = 0.0;
    
    //update the raw value with physical value 
    if(getValue(E_pubc_GW_GW_3C4_HU_RoadCurvature_10m_SetVt)==0)
    {
        if(chgEv_GW_3C4_HU_RoadCurvature_10m == 0)
        {
            phyValue = getvalue(this);
            // physical to raw conversion
            rawValue = ((phyValue -(0))/1);
            putValue(E_pubc_GW_GW_3C4_HU_RoadCurvature_10m_Rv, rawValue);
            chgEv_GW_3C4_HU_RoadCurvature_10m = 1;  
        }
        else
        {
            chgEv_GW_3C4_HU_RoadCurvature_10m = 0;
        }
    }
}

on envVar E_pubc_GW_GW_3C4_HU_RoadCurvature_10m_Vt
{
    qword rawValue = 0ll;
    if(getValue(E_pubc_GW_GW_3C4_HU_RoadCurvature_10m_SetVt))
    {
        //update the signal value
        Msg_GW_3C4.HU_RoadCurvature_10m=getValue(this);
    }
}

on envVar E_pubc_GW_GW_3C4_HU_RoadCurvature_10m_SetVt
{
    if(getValue(E_pubc_GW_GW_3C4_HU_RoadCurvature_10m_SetVt))
    {
        //update the signal value
        Msg_GW_3C4.HU_RoadCurvature_10m=getvalue(E_pubc_GW_GW_3C4_HU_RoadCurvature_10m_Vt);
    }
    else
    {
        Msg_GW_3C4.HU_RoadCurvature_10m=getValue(E_pubc_GW_GW_3C4_HU_RoadCurvature_10m_Rv);
    }
}
 
on envVar E_pubc_GW_GW_3C4_HU_Lane_Changtype_Rv
{
    int64 rawValue = 0ll;
    float rawValue_float = 0.0;
    float phyValue = 0.0;        

    //set the signal with updated raw value
    if(getValue(E_pubc_GW_GW_3C4_HU_Lane_Changtype_SetVt)==0)
    {
        rawValue = getvalue(this);
        if(chgEv_GW_3C4_HU_Lane_Changtype == 0)
        {
            //type conversion to float
            rawValue_float = rawValue;        
            // raw to physical conversion
            phyValue = ((rawValue_float *1)+(0));
            putValue(E_pubc_GW_GW_3C4_HU_Lane_Changtype_Pv, phyValue);
            chgEv_GW_3C4_HU_Lane_Changtype = 1;
        }
        else
        {
            chgEv_GW_3C4_HU_Lane_Changtype = 0;
        }    
        //update the signal value
        Msg_GW_3C4.HU_Lane_Changtype=rawValue;        
    }                                                                           
}

on envVar E_pubc_GW_GW_3C4_HU_Lane_Changtype_Pv
{
    int64 rawValue = 0ll;
    float phyValue = 0.0;
    
    //update the raw value with physical value 
    if(getValue(E_pubc_GW_GW_3C4_HU_Lane_Changtype_SetVt)==0)
    {
        if(chgEv_GW_3C4_HU_Lane_Changtype == 0)
        {
            phyValue = getvalue(this);
            // physical to raw conversion
            rawValue = ((phyValue -(0))/1);
            putValue(E_pubc_GW_GW_3C4_HU_Lane_Changtype_Rv, rawValue);
            chgEv_GW_3C4_HU_Lane_Changtype = 1;  
        }
        else
        {
            chgEv_GW_3C4_HU_Lane_Changtype = 0;
        }
    }
}

on envVar E_pubc_GW_GW_3C4_HU_Lane_Changtype_Vt
{
    qword rawValue = 0ll;
    if(getValue(E_pubc_GW_GW_3C4_HU_Lane_Changtype_SetVt))
    {
        //update the signal value
        Msg_GW_3C4.HU_Lane_Changtype=getValue(this);
    }
}

on envVar E_pubc_GW_GW_3C4_HU_Lane_Changtype_SetVt
{
    if(getValue(E_pubc_GW_GW_3C4_HU_Lane_Changtype_SetVt))
    {
        //update the signal value
        Msg_GW_3C4.HU_Lane_Changtype=getvalue(E_pubc_GW_GW_3C4_HU_Lane_Changtype_Vt);
    }
    else
    {
        Msg_GW_3C4.HU_Lane_Changtype=getValue(E_pubc_GW_GW_3C4_HU_Lane_Changtype_Rv);
    }
}
 
 
on envVar E_pubc_GW_GW_50_tx
{
    if(getValue(this))
    {       
        
        //update the BZ Signal
        if(GW_50_SRS_RollingCounter_id050_wrongvalctr == 0)
        {
            update_GW_50_SRS_RollingCounter_id050_counter();
            Msg_GW_50.SRS_RollingCounter_id050= GW_50_SRS_RollingCounter_id050_counter;
        }
        else if(GW_50_SRS_RollingCounter_id050_wrongvalctr > 0)
        {
			GW_50_SRS_RollingCounter_id050_counter=GW_50_SRS_RollingCounter_id050_counter + GW_50_SRS_RollingCounter_id050_wrongvalctr;
			 Msg_GW_50.SRS_RollingCounter_id050= GW_50_SRS_RollingCounter_id050_counter;
             /* GW_50_SRS_RollingCounter_id050_wrongvalctr--;
              // if counter becomes zero, update panel controller to zero
             if(GW_50_SRS_RollingCounter_id050_wrongvalctr == 0)
             {
                 putValue(E_pubc_GW_GW_50_SRS_RollingCounter_id050_wrongvalctr,0);
             } */
        }
        else
        {
            //do nothing
        }        
        update_GW_50_CRC_CheckSum();

        output(Msg_GW_50);        
    }
}

on envVar E_pubc_GW_GW_50_Range
{
    qword rawstatus = 0ll;
    qword rawValue = 0ll;    
    
    rawstatus = getvalue(this);    
    // set all the signals with min raw /max raw /init raw
    switch (rawstatus) 
    {
     case(0) :
        rawValue= 0;
        putValue(E_pubc_GW_GW_50_SRS_WarningLampStatus_Rv, rawValue);
        rawValue= 0;
        putValue(E_pubc_GW_GW_50_SRS_DriverBuckleSwitchStatus_Rv, rawValue);
        rawValue= 0;
        putValue(E_pubc_GW_GW_50_SRS_PassengerBuckleSwitchStatus_Rv, rawValue);
        rawValue= 0;
        putValue(E_pubc_GW_GW_50_SRS_CrashOutputStatus_Rv, rawValue);
        break;
     case(1) :
        rawValue= 3;
        putValue(E_pubc_GW_GW_50_SRS_WarningLampStatus_Rv, rawValue);
        rawValue= 3;
        putValue(E_pubc_GW_GW_50_SRS_DriverBuckleSwitchStatus_Rv, rawValue);
        rawValue= 3;
        putValue(E_pubc_GW_GW_50_SRS_PassengerBuckleSwitchStatus_Rv, rawValue);
        rawValue= 15;
        putValue(E_pubc_GW_GW_50_SRS_CrashOutputStatus_Rv, rawValue);
        break;
     default :
        rawValue= 0;
        putValue(E_pubc_GW_GW_50_SRS_WarningLampStatus_Rv, rawValue);
        rawValue= 0;
        putValue(E_pubc_GW_GW_50_SRS_DriverBuckleSwitchStatus_Rv, rawValue);
        rawValue= 0;
        putValue(E_pubc_GW_GW_50_SRS_PassengerBuckleSwitchStatus_Rv, rawValue);
        rawValue= 0;
        putValue(E_pubc_GW_GW_50_SRS_CrashOutputStatus_Rv, rawValue);
      break;
   }
}

on envVar E_pubc_GW_GW_50_Dlc
{
    if(getValue(E_pubc_GW_GW_50_enDlc))
    {
        Msg_GW_50.dlc =getValue(this);
    }
    else
    {
        Msg_GW_50.dlc =4;
    }
}

on envVar E_pubc_GW_GW_50_enDlc
{
    //For Messages with DLC = 8, set wrong DLC to smaller than defined DLC
    //For Messages with DLC < 8 set wrong DLC to smaller/longer than defined DLC
    if(getValue(this))
    {
        Msg_GW_50.dlc =getValue(E_pubc_GW_GW_50_Dlc);
    }
    else
    {
        Msg_GW_50.dlc =4;
    }
}

on envVar E_pubc_GW_GW_50_SRS_CrashOutputStatusCheckSum_wrongvalctr
{
    //update disturb count
    //disturb value range:(-1 = always send wrong value),( X>0 ,x is the number of Messages with wrong CHK sent)
    GW_50_SRS_CrashOutputStatusCheckSum_wrongvalctr =getValue(this);    
}
on envVar E_pubc_GW_GW_50_SRS_RollingCounter_id050_wrongvalctr
{
    //update disturb count
    //disturb value range:(-1 = always send wrong value),( X>0 ,x is the number of Messages with wrong CHK sent)
    GW_50_SRS_RollingCounter_id050_wrongvalctr =getValue(this);    
}

on envVar E_pubc_GW_GW_50_SRS_WarningLampStatus_Rv
{
    int64 rawValue = 0ll;
    float rawValue_float = 0.0;
    float phyValue = 0.0;        

    //set the signal with updated raw value
    if(getValue(E_pubc_GW_GW_50_SRS_WarningLampStatus_SetVt)==0)
    {
        rawValue = getvalue(this);
        if(chgEv_GW_50_SRS_WarningLampStatus == 0)
        {
            //type conversion to float
            rawValue_float = rawValue;        
            // raw to physical conversion
            phyValue = ((rawValue_float *1)+(0));
            putValue(E_pubc_GW_GW_50_SRS_WarningLampStatus_Pv, phyValue);
            chgEv_GW_50_SRS_WarningLampStatus = 1;
        }
        else
        {
            chgEv_GW_50_SRS_WarningLampStatus = 0;
        }    
        //update the signal value
        Msg_GW_50.SRS_WarningLampStatus=rawValue;        
    }                                                                           
}

on envVar E_pubc_GW_GW_50_SRS_WarningLampStatus_Pv
{
    int64 rawValue = 0ll;
    float phyValue = 0.0;
    
    //update the raw value with physical value 
    if(getValue(E_pubc_GW_GW_50_SRS_WarningLampStatus_SetVt)==0)
    {
        if(chgEv_GW_50_SRS_WarningLampStatus == 0)
        {
            phyValue = getvalue(this);
            // physical to raw conversion
            rawValue = ((phyValue -(0))/1);
            putValue(E_pubc_GW_GW_50_SRS_WarningLampStatus_Rv, rawValue);
            chgEv_GW_50_SRS_WarningLampStatus = 1;  
        }
        else
        {
            chgEv_GW_50_SRS_WarningLampStatus = 0;
        }
    }
}

on envVar E_pubc_GW_GW_50_SRS_WarningLampStatus_Vt
{
    qword rawValue = 0ll;
    if(getValue(E_pubc_GW_GW_50_SRS_WarningLampStatus_SetVt))
    {
        //update the signal value
        Msg_GW_50.SRS_WarningLampStatus=getValue(this);
    }
}

on envVar E_pubc_GW_GW_50_SRS_WarningLampStatus_SetVt
{
    if(getValue(E_pubc_GW_GW_50_SRS_WarningLampStatus_SetVt))
    {
        //update the signal value
        Msg_GW_50.SRS_WarningLampStatus=getvalue(E_pubc_GW_GW_50_SRS_WarningLampStatus_Vt);
    }
    else
    {
        Msg_GW_50.SRS_WarningLampStatus=getValue(E_pubc_GW_GW_50_SRS_WarningLampStatus_Rv);
    }
}
 
on envVar E_pubc_GW_GW_50_SRS_DriverBuckleSwitchStatus_Rv
{
    int64 rawValue = 0ll;
    float rawValue_float = 0.0;
    float phyValue = 0.0;        

    //set the signal with updated raw value
    if(getValue(E_pubc_GW_GW_50_SRS_DriverBuckleSwitchStatus_SetVt)==0)
    {
        rawValue = getvalue(this);
        if(chgEv_GW_50_SRS_DriverBuckleSwitchStatus == 0)
        {
            //type conversion to float
            rawValue_float = rawValue;        
            // raw to physical conversion
            phyValue = ((rawValue_float *1)+(0));
            putValue(E_pubc_GW_GW_50_SRS_DriverBuckleSwitchStatus_Pv, phyValue);
            chgEv_GW_50_SRS_DriverBuckleSwitchStatus = 1;
        }
        else
        {
            chgEv_GW_50_SRS_DriverBuckleSwitchStatus = 0;
        }    
        //update the signal value
        Msg_GW_50.SRS_DriverBuckleSwitchStatus=rawValue;        
    }                                                                           
}

on envVar E_pubc_GW_GW_50_SRS_DriverBuckleSwitchStatus_Pv
{
    int64 rawValue = 0ll;
    float phyValue = 0.0;
    
    //update the raw value with physical value 
    if(getValue(E_pubc_GW_GW_50_SRS_DriverBuckleSwitchStatus_SetVt)==0)
    {
        if(chgEv_GW_50_SRS_DriverBuckleSwitchStatus == 0)
        {
            phyValue = getvalue(this);
            // physical to raw conversion
            rawValue = ((phyValue -(0))/1);
            putValue(E_pubc_GW_GW_50_SRS_DriverBuckleSwitchStatus_Rv, rawValue);
            chgEv_GW_50_SRS_DriverBuckleSwitchStatus = 1;  
        }
        else
        {
            chgEv_GW_50_SRS_DriverBuckleSwitchStatus = 0;
        }
    }
}

on envVar E_pubc_GW_GW_50_SRS_DriverBuckleSwitchStatus_Vt
{
    qword rawValue = 0ll;
    if(getValue(E_pubc_GW_GW_50_SRS_DriverBuckleSwitchStatus_SetVt))
    {
        //update the signal value
        Msg_GW_50.SRS_DriverBuckleSwitchStatus=getValue(this);
    }
}

on envVar E_pubc_GW_GW_50_SRS_DriverBuckleSwitchStatus_SetVt
{
    if(getValue(E_pubc_GW_GW_50_SRS_DriverBuckleSwitchStatus_SetVt))
    {
        //update the signal value
        Msg_GW_50.SRS_DriverBuckleSwitchStatus=getvalue(E_pubc_GW_GW_50_SRS_DriverBuckleSwitchStatus_Vt);
    }
    else
    {
        Msg_GW_50.SRS_DriverBuckleSwitchStatus=getValue(E_pubc_GW_GW_50_SRS_DriverBuckleSwitchStatus_Rv);
    }
}
 
on envVar E_pubc_GW_GW_50_SRS_PassengerBuckleSwitchStatus_Rv
{
    int64 rawValue = 0ll;
    float rawValue_float = 0.0;
    float phyValue = 0.0;        

    //set the signal with updated raw value
    if(getValue(E_pubc_GW_GW_50_SRS_PassengerBuckleSwitchStatus_SetVt)==0)
    {
        rawValue = getvalue(this);
        if(chgEv_GW_50_SRS_PassengerBuckleSwitchStatus == 0)
        {
            //type conversion to float
            rawValue_float = rawValue;        
            // raw to physical conversion
            phyValue = ((rawValue_float *1)+(0));
            putValue(E_pubc_GW_GW_50_SRS_PassengerBuckleSwitchStatus_Pv, phyValue);
            chgEv_GW_50_SRS_PassengerBuckleSwitchStatus = 1;
        }
        else
        {
            chgEv_GW_50_SRS_PassengerBuckleSwitchStatus = 0;
        }    
        //update the signal value
        Msg_GW_50.SRS_PassengerBuckleSwitchStatus=rawValue;        
    }                                                                           
}

on envVar E_pubc_GW_GW_50_SRS_PassengerBuckleSwitchStatus_Pv
{
    int64 rawValue = 0ll;
    float phyValue = 0.0;
    
    //update the raw value with physical value 
    if(getValue(E_pubc_GW_GW_50_SRS_PassengerBuckleSwitchStatus_SetVt)==0)
    {
        if(chgEv_GW_50_SRS_PassengerBuckleSwitchStatus == 0)
        {
            phyValue = getvalue(this);
            // physical to raw conversion
            rawValue = ((phyValue -(0))/1);
            putValue(E_pubc_GW_GW_50_SRS_PassengerBuckleSwitchStatus_Rv, rawValue);
            chgEv_GW_50_SRS_PassengerBuckleSwitchStatus = 1;  
        }
        else
        {
            chgEv_GW_50_SRS_PassengerBuckleSwitchStatus = 0;
        }
    }
}

on envVar E_pubc_GW_GW_50_SRS_PassengerBuckleSwitchStatus_Vt
{
    qword rawValue = 0ll;
    if(getValue(E_pubc_GW_GW_50_SRS_PassengerBuckleSwitchStatus_SetVt))
    {
        //update the signal value
        Msg_GW_50.SRS_PassengerBuckleSwitchStatus=getValue(this);
    }
}

on envVar E_pubc_GW_GW_50_SRS_PassengerBuckleSwitchStatus_SetVt
{
    if(getValue(E_pubc_GW_GW_50_SRS_PassengerBuckleSwitchStatus_SetVt))
    {
        //update the signal value
        Msg_GW_50.SRS_PassengerBuckleSwitchStatus=getvalue(E_pubc_GW_GW_50_SRS_PassengerBuckleSwitchStatus_Vt);
    }
    else
    {
        Msg_GW_50.SRS_PassengerBuckleSwitchStatus=getValue(E_pubc_GW_GW_50_SRS_PassengerBuckleSwitchStatus_Rv);
    }
}
 
 
on envVar E_pubc_GW_GW_50_SRS_CrashOutputStatus_Rv
{
    int64 rawValue = 0ll;
    float rawValue_float = 0.0;
    float phyValue = 0.0;        

    //set the signal with updated raw value
    if(getValue(E_pubc_GW_GW_50_SRS_CrashOutputStatus_SetVt)==0)
    {
        rawValue = getvalue(this);
        if(chgEv_GW_50_SRS_CrashOutputStatus == 0)
        {
            //type conversion to float
            rawValue_float = rawValue;        
            // raw to physical conversion
            phyValue = ((rawValue_float *1)+(0));
            putValue(E_pubc_GW_GW_50_SRS_CrashOutputStatus_Pv, phyValue);
            chgEv_GW_50_SRS_CrashOutputStatus = 1;
        }
        else
        {
            chgEv_GW_50_SRS_CrashOutputStatus = 0;
        }    
        //update the signal value
        Msg_GW_50.SRS_CrashOutputStatus=rawValue;        
    }                                                                           
}

on envVar E_pubc_GW_GW_50_SRS_CrashOutputStatus_Pv
{
    int64 rawValue = 0ll;
    float phyValue = 0.0;
    
    //update the raw value with physical value 
    if(getValue(E_pubc_GW_GW_50_SRS_CrashOutputStatus_SetVt)==0)
    {
        if(chgEv_GW_50_SRS_CrashOutputStatus == 0)
        {
            phyValue = getvalue(this);
            // physical to raw conversion
            rawValue = ((phyValue -(0))/1);
            putValue(E_pubc_GW_GW_50_SRS_CrashOutputStatus_Rv, rawValue);
            chgEv_GW_50_SRS_CrashOutputStatus = 1;  
        }
        else
        {
            chgEv_GW_50_SRS_CrashOutputStatus = 0;
        }
    }
}

on envVar E_pubc_GW_GW_50_SRS_CrashOutputStatus_Vt
{
    qword rawValue = 0ll;
    if(getValue(E_pubc_GW_GW_50_SRS_CrashOutputStatus_SetVt))
    {
        //update the signal value
        Msg_GW_50.SRS_CrashOutputStatus=getValue(this);
    }
}

on envVar E_pubc_GW_GW_50_SRS_CrashOutputStatus_SetVt
{
    if(getValue(E_pubc_GW_GW_50_SRS_CrashOutputStatus_SetVt))
    {
        //update the signal value
        Msg_GW_50.SRS_CrashOutputStatus=getvalue(E_pubc_GW_GW_50_SRS_CrashOutputStatus_Vt);
    }
    else
    {
        Msg_GW_50.SRS_CrashOutputStatus=getValue(E_pubc_GW_GW_50_SRS_CrashOutputStatus_Rv);
    }
}
 
on envVar E_pubc_GW_GW_24F_tx
{
    if(getValue(this))
    {       
        
        //update the BZ Signal
        if(GW_24F_EPS_RollingCounter_24F_wrongvalctr == 0)
        {
            update_GW_24F_EPS_RollingCounter_24F_counter();
            Msg_GW_24F.EPS_RollingCounter_24F= GW_24F_EPS_RollingCounter_24F_counter;
        }
        else if(GW_24F_EPS_RollingCounter_24F_wrongvalctr > 0)
        {
			GW_24F_EPS_RollingCounter_24F_counter=GW_24F_EPS_RollingCounter_24F_counter + GW_24F_EPS_RollingCounter_24F_wrongvalctr;
			 Msg_GW_24F.EPS_RollingCounter_24F= GW_24F_EPS_RollingCounter_24F_counter;
             /* GW_24F_EPS_RollingCounter_24F_wrongvalctr--;
              // if counter becomes zero, update panel controller to zero
             if(GW_24F_EPS_RollingCounter_24F_wrongvalctr == 0)
             {
                 putValue(E_pubc_GW_GW_24F_EPS_RollingCounter_24F_wrongvalctr,0);
             } */
        }
        else
        {
            //do nothing
        }        
        //calculate the CRC CheckSum
        update_GW_24F_CRC_CheckSum();

        output(Msg_GW_24F);        
    }
}

on envVar E_pubc_GW_GW_24F_Range
{
    qword rawstatus = 0ll;
    qword rawValue = 0ll;    
    
    rawstatus = getvalue(this);    
    // set all the signals with min raw /max raw /init raw
    switch (rawstatus) 
    {
     case(0) :
        rawValue= 0;
        putValue(E_pubc_GW_GW_24F_EPS_TorqueAssistMode_Rv, rawValue);
        rawValue= 0;
        putValue(E_pubc_GW_GW_24F_EPS_IACC_abortreason_Rv, rawValue);
        rawValue= 0;
        putValue(E_pubc_GW_GW_24F_EPS_ConcussAvailabilityStatus_Rv, rawValue);
        break;
     case(1) :
        rawValue= 3;
        putValue(E_pubc_GW_GW_24F_EPS_TorqueAssistMode_Rv, rawValue);
        rawValue= 7;
        putValue(E_pubc_GW_GW_24F_EPS_IACC_abortreason_Rv, rawValue);
        rawValue= 3;
        putValue(E_pubc_GW_GW_24F_EPS_ConcussAvailabilityStatus_Rv, rawValue);
        break;
     default :
        rawValue= 0;
        putValue(E_pubc_GW_GW_24F_EPS_TorqueAssistMode_Rv, rawValue);
        rawValue= 0;
        putValue(E_pubc_GW_GW_24F_EPS_IACC_abortreason_Rv, rawValue);
        rawValue= 0;
        putValue(E_pubc_GW_GW_24F_EPS_ConcussAvailabilityStatus_Rv, rawValue);
      break;
   }
}

on envVar E_pubc_GW_GW_24F_Dlc
{
    if(getValue(E_pubc_GW_GW_24F_enDlc))
    {
        Msg_GW_24F.dlc =getValue(this);
    }
    else
    {
        Msg_GW_24F.dlc =8;
    }
}

on envVar E_pubc_GW_GW_24F_enDlc
{
    //For Messages with DLC = 8, set wrong DLC to smaller than defined DLC
    //For Messages with DLC < 8 set wrong DLC to smaller/longer than defined DLC
    if(getValue(this))
    {
        Msg_GW_24F.dlc =getValue(E_pubc_GW_GW_24F_Dlc);
    }
    else
    {
        Msg_GW_24F.dlc =8;
    }
}

on envVar E_pubc_GW_GW_24F_EPS_CRCCheck_24F_wrongvalctr
{
    //update disturb count
    //disturb value range:(-1 = always send wrong value),( X>0 ,x is the number of Messages with wrong CHK sent)
    GW_24F_EPS_CRCCheck_24F_wrongvalctr =getValue(this);    
}
on envVar E_pubc_GW_GW_24F_EPS_RollingCounter_24F_wrongvalctr
{
    //update disturb count
    //disturb value range:(-1 = always send wrong value),( X>0 ,x is the number of Messages with wrong CHK sent)
    GW_24F_EPS_RollingCounter_24F_wrongvalctr =getValue(this);    
}

on envVar E_pubc_GW_GW_24F_EPS_TorqueAssistMode_Rv
{
    int64 rawValue = 0ll;
    float rawValue_float = 0.0;
    float phyValue = 0.0;        

    //set the signal with updated raw value
    if(getValue(E_pubc_GW_GW_24F_EPS_TorqueAssistMode_SetVt)==0)
    {
        rawValue = getvalue(this);
        if(chgEv_GW_24F_EPS_TorqueAssistMode == 0)
        {
            //type conversion to float
            rawValue_float = rawValue;        
            // raw to physical conversion
            phyValue = ((rawValue_float *1)+(0));
            putValue(E_pubc_GW_GW_24F_EPS_TorqueAssistMode_Pv, phyValue);
            chgEv_GW_24F_EPS_TorqueAssistMode = 1;
        }
        else
        {
            chgEv_GW_24F_EPS_TorqueAssistMode = 0;
        }    
        //update the signal value
        Msg_GW_24F.EPS_TorqueAssistMode=rawValue;        
    }                                                                           
}

on envVar E_pubc_GW_GW_24F_EPS_TorqueAssistMode_Pv
{
    int64 rawValue = 0ll;
    float phyValue = 0.0;
    
    //update the raw value with physical value 
    if(getValue(E_pubc_GW_GW_24F_EPS_TorqueAssistMode_SetVt)==0)
    {
        if(chgEv_GW_24F_EPS_TorqueAssistMode == 0)
        {
            phyValue = getvalue(this);
            // physical to raw conversion
            rawValue = ((phyValue -(0))/1);
            putValue(E_pubc_GW_GW_24F_EPS_TorqueAssistMode_Rv, rawValue);
            chgEv_GW_24F_EPS_TorqueAssistMode = 1;  
        }
        else
        {
            chgEv_GW_24F_EPS_TorqueAssistMode = 0;
        }
    }
}

on envVar E_pubc_GW_GW_24F_EPS_TorqueAssistMode_Vt
{
    qword rawValue = 0ll;
    if(getValue(E_pubc_GW_GW_24F_EPS_TorqueAssistMode_SetVt))
    {
        //update the signal value
        Msg_GW_24F.EPS_TorqueAssistMode=getValue(this);
    }
}

on envVar E_pubc_GW_GW_24F_EPS_TorqueAssistMode_SetVt
{
    if(getValue(E_pubc_GW_GW_24F_EPS_TorqueAssistMode_SetVt))
    {
        //update the signal value
        Msg_GW_24F.EPS_TorqueAssistMode=getvalue(E_pubc_GW_GW_24F_EPS_TorqueAssistMode_Vt);
    }
    else
    {
        Msg_GW_24F.EPS_TorqueAssistMode=getValue(E_pubc_GW_GW_24F_EPS_TorqueAssistMode_Rv);
    }
}
 
on envVar E_pubc_GW_GW_24F_EPS_IACC_abortreason_Rv
{
    int64 rawValue = 0ll;
    float rawValue_float = 0.0;
    float phyValue = 0.0;        

    //set the signal with updated raw value
    if(getValue(E_pubc_GW_GW_24F_EPS_IACC_abortreason_SetVt)==0)
    {
        rawValue = getvalue(this);
        if(chgEv_GW_24F_EPS_IACC_abortreason == 0)
        {
            //type conversion to float
            rawValue_float = rawValue;        
            // raw to physical conversion
            phyValue = ((rawValue_float *1)+(0));
            putValue(E_pubc_GW_GW_24F_EPS_IACC_abortreason_Pv, phyValue);
            chgEv_GW_24F_EPS_IACC_abortreason = 1;
        }
        else
        {
            chgEv_GW_24F_EPS_IACC_abortreason = 0;
        }    
        //update the signal value
        Msg_GW_24F.EPS_IACC_abortreason=rawValue;        
    }                                                                           
}

on envVar E_pubc_GW_GW_24F_EPS_IACC_abortreason_Pv
{
    int64 rawValue = 0ll;
    float phyValue = 0.0;
    
    //update the raw value with physical value 
    if(getValue(E_pubc_GW_GW_24F_EPS_IACC_abortreason_SetVt)==0)
    {
        if(chgEv_GW_24F_EPS_IACC_abortreason == 0)
        {
            phyValue = getvalue(this);
            // physical to raw conversion
            rawValue = ((phyValue -(0))/1);
            putValue(E_pubc_GW_GW_24F_EPS_IACC_abortreason_Rv, rawValue);
            chgEv_GW_24F_EPS_IACC_abortreason = 1;  
        }
        else
        {
            chgEv_GW_24F_EPS_IACC_abortreason = 0;
        }
    }
}

on envVar E_pubc_GW_GW_24F_EPS_IACC_abortreason_Vt
{
    qword rawValue = 0ll;
    if(getValue(E_pubc_GW_GW_24F_EPS_IACC_abortreason_SetVt))
    {
        //update the signal value
        Msg_GW_24F.EPS_IACC_abortreason=getValue(this);
    }
}

on envVar E_pubc_GW_GW_24F_EPS_IACC_abortreason_SetVt
{
    if(getValue(E_pubc_GW_GW_24F_EPS_IACC_abortreason_SetVt))
    {
        //update the signal value
        Msg_GW_24F.EPS_IACC_abortreason=getvalue(E_pubc_GW_GW_24F_EPS_IACC_abortreason_Vt);
    }
    else
    {
        Msg_GW_24F.EPS_IACC_abortreason=getValue(E_pubc_GW_GW_24F_EPS_IACC_abortreason_Rv);
    }
}
 
on envVar E_pubc_GW_GW_24F_EPS_ConcussAvailabilityStatus_Rv
{
    int64 rawValue = 0ll;
    float rawValue_float = 0.0;
    float phyValue = 0.0;        

    //set the signal with updated raw value
    if(getValue(E_pubc_GW_GW_24F_EPS_ConcussAvailabilityStatus_SetVt)==0)
    {
        rawValue = getvalue(this);
        if(chgEv_GW_24F_EPS_ConcussAvailabilityStatus == 0)
        {
            //type conversion to float
            rawValue_float = rawValue;        
            // raw to physical conversion
            phyValue = ((rawValue_float *1)+(0));
            putValue(E_pubc_GW_GW_24F_EPS_ConcussAvailabilityStatus_Pv, phyValue);
            chgEv_GW_24F_EPS_ConcussAvailabilityStatus = 1;
        }
        else
        {
            chgEv_GW_24F_EPS_ConcussAvailabilityStatus = 0;
        }    
        //update the signal value
        Msg_GW_24F.EPS_ConcussAvailabilityStatus=rawValue;        
    }                                                                           
}

on envVar E_pubc_GW_GW_24F_EPS_ConcussAvailabilityStatus_Pv
{
    int64 rawValue = 0ll;
    float phyValue = 0.0;
    
    //update the raw value with physical value 
    if(getValue(E_pubc_GW_GW_24F_EPS_ConcussAvailabilityStatus_SetVt)==0)
    {
        if(chgEv_GW_24F_EPS_ConcussAvailabilityStatus == 0)
        {
            phyValue = getvalue(this);
            // physical to raw conversion
            rawValue = ((phyValue -(0))/1);
            putValue(E_pubc_GW_GW_24F_EPS_ConcussAvailabilityStatus_Rv, rawValue);
            chgEv_GW_24F_EPS_ConcussAvailabilityStatus = 1;  
        }
        else
        {
            chgEv_GW_24F_EPS_ConcussAvailabilityStatus = 0;
        }
    }
}

on envVar E_pubc_GW_GW_24F_EPS_ConcussAvailabilityStatus_Vt
{
    qword rawValue = 0ll;
    if(getValue(E_pubc_GW_GW_24F_EPS_ConcussAvailabilityStatus_SetVt))
    {
        //update the signal value
        Msg_GW_24F.EPS_ConcussAvailabilityStatus=getValue(this);
    }
}

on envVar E_pubc_GW_GW_24F_EPS_ConcussAvailabilityStatus_SetVt
{
    if(getValue(E_pubc_GW_GW_24F_EPS_ConcussAvailabilityStatus_SetVt))
    {
        //update the signal value
        Msg_GW_24F.EPS_ConcussAvailabilityStatus=getvalue(E_pubc_GW_GW_24F_EPS_ConcussAvailabilityStatus_Vt);
    }
    else
    {
        Msg_GW_24F.EPS_ConcussAvailabilityStatus=getValue(E_pubc_GW_GW_24F_EPS_ConcussAvailabilityStatus_Rv);
    }
}
 
 


 
on envVar E_pubc_GW_GW_500_tx
{
    if(getValue(this))
    {       
        

        output(Msg_GW_500);        
    }
}

on envVar E_pubc_GW_GW_500_Range
{
    qword rawstatus = 0ll;
    qword rawValue = 0ll;    
    
    rawstatus = getvalue(this);    
    // set all the signals with min raw /max raw /init raw
    switch (rawstatus) 
    {
     case(0) :
        rawValue= 44217727;
        putValue(E_pubc_GW_GW_500_HU_CurrentLocationLatitude_Rv, rawValue);
        rawValue= 88435455;
        putValue(E_pubc_GW_GW_500_HU_CurrentLocationLongitude_Rv, rawValue);
        rawValue= 0;
        putValue(E_pubc_GW_GW_500_HU_CurrentLocationValid_Rv, rawValue);
        break;
     case(1) :
        rawValue= 224217727;
        putValue(E_pubc_GW_GW_500_HU_CurrentLocationLatitude_Rv, rawValue);
        rawValue= 448435455;
        putValue(E_pubc_GW_GW_500_HU_CurrentLocationLongitude_Rv, rawValue);
        rawValue= 1;
        putValue(E_pubc_GW_GW_500_HU_CurrentLocationValid_Rv, rawValue);
        break;
     default :
        rawValue= 44217727;
        putValue(E_pubc_GW_GW_500_HU_CurrentLocationLatitude_Rv, rawValue);
        rawValue= 88435455;
        putValue(E_pubc_GW_GW_500_HU_CurrentLocationLongitude_Rv, rawValue);
        rawValue= 0;
        putValue(E_pubc_GW_GW_500_HU_CurrentLocationValid_Rv, rawValue);
      break;
   }
}

on envVar E_pubc_GW_GW_500_Dlc
{
    if(getValue(E_pubc_GW_GW_500_enDlc))
    {
        Msg_GW_500.dlc =getValue(this);
    }
    else
    {
        Msg_GW_500.dlc =8;
    }
}

on envVar E_pubc_GW_GW_500_enDlc
{
    //For Messages with DLC = 8, set wrong DLC to smaller than defined DLC
    //For Messages with DLC < 8 set wrong DLC to smaller/longer than defined DLC
    if(getValue(this))
    {
        Msg_GW_500.dlc =getValue(E_pubc_GW_GW_500_Dlc);
    }
    else
    {
        Msg_GW_500.dlc =8;
    }
}


on envVar E_pubc_GW_GW_500_HU_CurrentLocationLatitude_Rv
{
    int64 rawValue = 0ll;
    float rawValue_float = 0.0;
    float phyValue = 0.0;        

    //set the signal with updated raw value
    {
        rawValue = getvalue(this);
        if(chgEv_GW_500_HU_CurrentLocationLatitude == 0)
        {
            //type conversion to float
            rawValue_float = rawValue;        
            // raw to physical conversion
            phyValue = ((rawValue_float *1e-006)+(-134.217727));
            putValue(E_pubc_GW_GW_500_HU_CurrentLocationLatitude_Pv, phyValue);
            chgEv_GW_500_HU_CurrentLocationLatitude = 1;
        }
        else
        {
            chgEv_GW_500_HU_CurrentLocationLatitude = 0;
        }    
        //update the signal value
        Msg_GW_500.HU_CurrentLocationLatitude=rawValue;        
    }                                                                           
}

on envVar E_pubc_GW_GW_500_HU_CurrentLocationLatitude_Pv
{
    int64 rawValue = 0ll;
    float phyValue = 0.0;
    
    //update the raw value with physical value 
    {
        if(chgEv_GW_500_HU_CurrentLocationLatitude == 0)
        {
            phyValue = getvalue(this);
            // physical to raw conversion
            rawValue = ((phyValue -(-134.217727))/1e-006);
            putValue(E_pubc_GW_GW_500_HU_CurrentLocationLatitude_Rv, rawValue);
            chgEv_GW_500_HU_CurrentLocationLatitude = 1;  
        }
        else
        {
            chgEv_GW_500_HU_CurrentLocationLatitude = 0;
        }
    }
}


 
on envVar E_pubc_GW_GW_500_HU_CurrentLocationLongitude_Rv
{
    int64 rawValue = 0ll;
    float rawValue_float = 0.0;
    float phyValue = 0.0;        

    //set the signal with updated raw value
    {
        rawValue = getvalue(this);
        if(chgEv_GW_500_HU_CurrentLocationLongitude == 0)
        {
            //type conversion to float
            rawValue_float = rawValue;        
            // raw to physical conversion
            phyValue = ((rawValue_float *1e-006)+(-268.435455));
            putValue(E_pubc_GW_GW_500_HU_CurrentLocationLongitude_Pv, phyValue);
            chgEv_GW_500_HU_CurrentLocationLongitude = 1;
        }
        else
        {
            chgEv_GW_500_HU_CurrentLocationLongitude = 0;
        }    
        //update the signal value
        Msg_GW_500.HU_CurrentLocationLongitude=rawValue;        
    }                                                                           
}

on envVar E_pubc_GW_GW_500_HU_CurrentLocationLongitude_Pv
{
    int64 rawValue = 0ll;
    float phyValue = 0.0;
    
    //update the raw value with physical value 
    {
        if(chgEv_GW_500_HU_CurrentLocationLongitude == 0)
        {
            phyValue = getvalue(this);
            // physical to raw conversion
            rawValue = ((phyValue -(-268.435455))/1e-006);
            putValue(E_pubc_GW_GW_500_HU_CurrentLocationLongitude_Rv, rawValue);
            chgEv_GW_500_HU_CurrentLocationLongitude = 1;  
        }
        else
        {
            chgEv_GW_500_HU_CurrentLocationLongitude = 0;
        }
    }
}


 
on envVar E_pubc_GW_GW_500_HU_CurrentLocationValid_Rv
{
    int64 rawValue = 0ll;
    float rawValue_float = 0.0;
    float phyValue = 0.0;        

    //set the signal with updated raw value
    if(getValue(E_pubc_GW_GW_500_HU_CurrentLocationValid_SetVt)==0)
    {
        rawValue = getvalue(this);
        if(chgEv_GW_500_HU_CurrentLocationValid == 0)
        {
            //type conversion to float
            rawValue_float = rawValue;        
            // raw to physical conversion
            phyValue = ((rawValue_float *1)+(0));
            putValue(E_pubc_GW_GW_500_HU_CurrentLocationValid_Pv, phyValue);
            chgEv_GW_500_HU_CurrentLocationValid = 1;
        }
        else
        {
            chgEv_GW_500_HU_CurrentLocationValid = 0;
        }    
        //update the signal value
        Msg_GW_500.HU_CurrentLocationValid=rawValue;        
    }                                                                           
}

on envVar E_pubc_GW_GW_500_HU_CurrentLocationValid_Pv
{
    int64 rawValue = 0ll;
    float phyValue = 0.0;
    
    //update the raw value with physical value 
    if(getValue(E_pubc_GW_GW_500_HU_CurrentLocationValid_SetVt)==0)
    {
        if(chgEv_GW_500_HU_CurrentLocationValid == 0)
        {
            phyValue = getvalue(this);
            // physical to raw conversion
            rawValue = ((phyValue -(0))/1);
            putValue(E_pubc_GW_GW_500_HU_CurrentLocationValid_Rv, rawValue);
            chgEv_GW_500_HU_CurrentLocationValid = 1;  
        }
        else
        {
            chgEv_GW_500_HU_CurrentLocationValid = 0;
        }
    }
}

on envVar E_pubc_GW_GW_500_HU_CurrentLocationValid_Vt
{
    qword rawValue = 0ll;
    if(getValue(E_pubc_GW_GW_500_HU_CurrentLocationValid_SetVt))
    {
        //update the signal value
        Msg_GW_500.HU_CurrentLocationValid=getValue(this);
    }
}

on envVar E_pubc_GW_GW_500_HU_CurrentLocationValid_SetVt
{
    if(getValue(E_pubc_GW_GW_500_HU_CurrentLocationValid_SetVt))
    {
        //update the signal value
        Msg_GW_500.HU_CurrentLocationValid=getvalue(E_pubc_GW_GW_500_HU_CurrentLocationValid_Vt);
    }
    else
    {
        Msg_GW_500.HU_CurrentLocationValid=getValue(E_pubc_GW_GW_500_HU_CurrentLocationValid_Rv);
    }
}
 
on envVar E_pubc_GW_GW_501_tx
{
    if(getValue(this))
    {       
        

        output(Msg_GW_501);        
    }
}

on envVar E_pubc_GW_GW_501_Range
{
    qword rawstatus = 0ll;
    qword rawValue = 0ll;    
    
    rawstatus = getvalue(this);    
    // set all the signals with min raw /max raw /init raw
    switch (rawstatus) 
    {
     case(0) :
        rawValue= 0;
        putValue(E_pubc_GW_GW_501_HU_LocalTimeSecond_Rv, rawValue);
        rawValue= 0;
        putValue(E_pubc_GW_GW_501_HU_LocalTimeValid_Rv, rawValue);
        rawValue= 0;
        putValue(E_pubc_GW_GW_501_HU_LocalTimeHour_Rv, rawValue);
        rawValue= 1;
        putValue(E_pubc_GW_GW_501_HU_LocalTimeDate_Rv, rawValue);
        rawValue= 0;
        putValue(E_pubc_GW_GW_501_HU_LocalTimeMinute_Rv, rawValue);
        rawValue= 0;
        putValue(E_pubc_GW_GW_501_HU_LocalTimeYear_Rv, rawValue);
        rawValue= 1;
        putValue(E_pubc_GW_GW_501_HU_LocalTimeMonth_Rv, rawValue);
        break;
     case(1) :
        rawValue= 59;
        putValue(E_pubc_GW_GW_501_HU_LocalTimeSecond_Rv, rawValue);
        rawValue= 1;
        putValue(E_pubc_GW_GW_501_HU_LocalTimeValid_Rv, rawValue);
        rawValue= 23;
        putValue(E_pubc_GW_GW_501_HU_LocalTimeHour_Rv, rawValue);
        rawValue= 31;
        putValue(E_pubc_GW_GW_501_HU_LocalTimeDate_Rv, rawValue);
        rawValue= 59;
        putValue(E_pubc_GW_GW_501_HU_LocalTimeMinute_Rv, rawValue);
        rawValue= 255;
        putValue(E_pubc_GW_GW_501_HU_LocalTimeYear_Rv, rawValue);
        rawValue= 12;
        putValue(E_pubc_GW_GW_501_HU_LocalTimeMonth_Rv, rawValue);
        break;
     default :
        rawValue= 0;
        putValue(E_pubc_GW_GW_501_HU_LocalTimeSecond_Rv, rawValue);
        rawValue= 0;
        putValue(E_pubc_GW_GW_501_HU_LocalTimeValid_Rv, rawValue);
        rawValue= 0;
        putValue(E_pubc_GW_GW_501_HU_LocalTimeHour_Rv, rawValue);
        rawValue= 1;
        putValue(E_pubc_GW_GW_501_HU_LocalTimeDate_Rv, rawValue);
        rawValue= 0;
        putValue(E_pubc_GW_GW_501_HU_LocalTimeMinute_Rv, rawValue);
        rawValue= 0;
        putValue(E_pubc_GW_GW_501_HU_LocalTimeYear_Rv, rawValue);
        rawValue= 1;
        putValue(E_pubc_GW_GW_501_HU_LocalTimeMonth_Rv, rawValue);
      break;
   }
}

on envVar E_pubc_GW_GW_501_Dlc
{
    if(getValue(E_pubc_GW_GW_501_enDlc))
    {
        Msg_GW_501.dlc =getValue(this);
    }
    else
    {
        Msg_GW_501.dlc =8;
    }
}

on envVar E_pubc_GW_GW_501_enDlc
{
    //For Messages with DLC = 8, set wrong DLC to smaller than defined DLC
    //For Messages with DLC < 8 set wrong DLC to smaller/longer than defined DLC
    if(getValue(this))
    {
        Msg_GW_501.dlc =getValue(E_pubc_GW_GW_501_Dlc);
    }
    else
    {
        Msg_GW_501.dlc =8;
    }
}


on envVar E_pubc_GW_GW_501_HU_LocalTimeSecond_Rv
{
    int64 rawValue = 0ll;
    float rawValue_float = 0.0;
    float phyValue = 0.0;        

    //set the signal with updated raw value
    {
        rawValue = getvalue(this);
        if(chgEv_GW_501_HU_LocalTimeSecond == 0)
        {
            //type conversion to float
            rawValue_float = rawValue;        
            // raw to physical conversion
            phyValue = ((rawValue_float *1)+(0));
            putValue(E_pubc_GW_GW_501_HU_LocalTimeSecond_Pv, phyValue);
            chgEv_GW_501_HU_LocalTimeSecond = 1;
        }
        else
        {
            chgEv_GW_501_HU_LocalTimeSecond = 0;
        }    
        //update the signal value
        Msg_GW_501.HU_LocalTimeSecond=rawValue;        
    }                                                                           
}

on envVar E_pubc_GW_GW_501_HU_LocalTimeSecond_Pv
{
    int64 rawValue = 0ll;
    float phyValue = 0.0;
    
    //update the raw value with physical value 
    {
        if(chgEv_GW_501_HU_LocalTimeSecond == 0)
        {
            phyValue = getvalue(this);
            // physical to raw conversion
            rawValue = ((phyValue -(0))/1);
            putValue(E_pubc_GW_GW_501_HU_LocalTimeSecond_Rv, rawValue);
            chgEv_GW_501_HU_LocalTimeSecond = 1;  
        }
        else
        {
            chgEv_GW_501_HU_LocalTimeSecond = 0;
        }
    }
}


 
on envVar E_pubc_GW_GW_501_HU_LocalTimeValid_Rv
{
    int64 rawValue = 0ll;
    float rawValue_float = 0.0;
    float phyValue = 0.0;        

    //set the signal with updated raw value
    if(getValue(E_pubc_GW_GW_501_HU_LocalTimeValid_SetVt)==0)
    {
        rawValue = getvalue(this);
        if(chgEv_GW_501_HU_LocalTimeValid == 0)
        {
            //type conversion to float
            rawValue_float = rawValue;        
            // raw to physical conversion
            phyValue = ((rawValue_float *1)+(0));
            putValue(E_pubc_GW_GW_501_HU_LocalTimeValid_Pv, phyValue);
            chgEv_GW_501_HU_LocalTimeValid = 1;
        }
        else
        {
            chgEv_GW_501_HU_LocalTimeValid = 0;
        }    
        //update the signal value
        Msg_GW_501.HU_LocalTimeValid=rawValue;        
    }                                                                           
}

on envVar E_pubc_GW_GW_501_HU_LocalTimeValid_Pv
{
    int64 rawValue = 0ll;
    float phyValue = 0.0;
    
    //update the raw value with physical value 
    if(getValue(E_pubc_GW_GW_501_HU_LocalTimeValid_SetVt)==0)
    {
        if(chgEv_GW_501_HU_LocalTimeValid == 0)
        {
            phyValue = getvalue(this);
            // physical to raw conversion
            rawValue = ((phyValue -(0))/1);
            putValue(E_pubc_GW_GW_501_HU_LocalTimeValid_Rv, rawValue);
            chgEv_GW_501_HU_LocalTimeValid = 1;  
        }
        else
        {
            chgEv_GW_501_HU_LocalTimeValid = 0;
        }
    }
}

on envVar E_pubc_GW_GW_501_HU_LocalTimeValid_Vt
{
    qword rawValue = 0ll;
    if(getValue(E_pubc_GW_GW_501_HU_LocalTimeValid_SetVt))
    {
        //update the signal value
        Msg_GW_501.HU_LocalTimeValid=getValue(this);
    }
}

on envVar E_pubc_GW_GW_501_HU_LocalTimeValid_SetVt
{
    if(getValue(E_pubc_GW_GW_501_HU_LocalTimeValid_SetVt))
    {
        //update the signal value
        Msg_GW_501.HU_LocalTimeValid=getvalue(E_pubc_GW_GW_501_HU_LocalTimeValid_Vt);
    }
    else
    {
        Msg_GW_501.HU_LocalTimeValid=getValue(E_pubc_GW_GW_501_HU_LocalTimeValid_Rv);
    }
}
 
on envVar E_pubc_GW_GW_501_HU_LocalTimeHour_Rv
{
    int64 rawValue = 0ll;
    float rawValue_float = 0.0;
    float phyValue = 0.0;        

    //set the signal with updated raw value
    {
        rawValue = getvalue(this);
        if(chgEv_GW_501_HU_LocalTimeHour == 0)
        {
            //type conversion to float
            rawValue_float = rawValue;        
            // raw to physical conversion
            phyValue = ((rawValue_float *1)+(0));
            putValue(E_pubc_GW_GW_501_HU_LocalTimeHour_Pv, phyValue);
            chgEv_GW_501_HU_LocalTimeHour = 1;
        }
        else
        {
            chgEv_GW_501_HU_LocalTimeHour = 0;
        }    
        //update the signal value
        Msg_GW_501.HU_LocalTimeHour=rawValue;        
    }                                                                           
}

on envVar E_pubc_GW_GW_501_HU_LocalTimeHour_Pv
{
    int64 rawValue = 0ll;
    float phyValue = 0.0;
    
    //update the raw value with physical value 
    {
        if(chgEv_GW_501_HU_LocalTimeHour == 0)
        {
            phyValue = getvalue(this);
            // physical to raw conversion
            rawValue = ((phyValue -(0))/1);
            putValue(E_pubc_GW_GW_501_HU_LocalTimeHour_Rv, rawValue);
            chgEv_GW_501_HU_LocalTimeHour = 1;  
        }
        else
        {
            chgEv_GW_501_HU_LocalTimeHour = 0;
        }
    }
}


 
on envVar E_pubc_GW_GW_501_HU_LocalTimeDate_Rv
{
    int64 rawValue = 0ll;
    float rawValue_float = 0.0;
    float phyValue = 0.0;        

    //set the signal with updated raw value
    {
        rawValue = getvalue(this);
        if(chgEv_GW_501_HU_LocalTimeDate == 0)
        {
            //type conversion to float
            rawValue_float = rawValue;        
            // raw to physical conversion
            phyValue = ((rawValue_float *1)+(0));
            putValue(E_pubc_GW_GW_501_HU_LocalTimeDate_Pv, phyValue);
            chgEv_GW_501_HU_LocalTimeDate = 1;
        }
        else
        {
            chgEv_GW_501_HU_LocalTimeDate = 0;
        }    
        //update the signal value
        Msg_GW_501.HU_LocalTimeDate=rawValue;        
    }                                                                           
}

on envVar E_pubc_GW_GW_501_HU_LocalTimeDate_Pv
{
    int64 rawValue = 0ll;
    float phyValue = 0.0;
    
    //update the raw value with physical value 
    {
        if(chgEv_GW_501_HU_LocalTimeDate == 0)
        {
            phyValue = getvalue(this);
            // physical to raw conversion
            rawValue = ((phyValue -(0))/1);
            putValue(E_pubc_GW_GW_501_HU_LocalTimeDate_Rv, rawValue);
            chgEv_GW_501_HU_LocalTimeDate = 1;  
        }
        else
        {
            chgEv_GW_501_HU_LocalTimeDate = 0;
        }
    }
}


 
on envVar E_pubc_GW_GW_501_HU_LocalTimeMinute_Rv
{
    int64 rawValue = 0ll;
    float rawValue_float = 0.0;
    float phyValue = 0.0;        

    //set the signal with updated raw value
    {
        rawValue = getvalue(this);
        if(chgEv_GW_501_HU_LocalTimeMinute == 0)
        {
            //type conversion to float
            rawValue_float = rawValue;        
            // raw to physical conversion
            phyValue = ((rawValue_float *1)+(0));
            putValue(E_pubc_GW_GW_501_HU_LocalTimeMinute_Pv, phyValue);
            chgEv_GW_501_HU_LocalTimeMinute = 1;
        }
        else
        {
            chgEv_GW_501_HU_LocalTimeMinute = 0;
        }    
        //update the signal value
        Msg_GW_501.HU_LocalTimeMinute=rawValue;        
    }                                                                           
}

on envVar E_pubc_GW_GW_501_HU_LocalTimeMinute_Pv
{
    int64 rawValue = 0ll;
    float phyValue = 0.0;
    
    //update the raw value with physical value 
    {
        if(chgEv_GW_501_HU_LocalTimeMinute == 0)
        {
            phyValue = getvalue(this);
            // physical to raw conversion
            rawValue = ((phyValue -(0))/1);
            putValue(E_pubc_GW_GW_501_HU_LocalTimeMinute_Rv, rawValue);
            chgEv_GW_501_HU_LocalTimeMinute = 1;  
        }
        else
        {
            chgEv_GW_501_HU_LocalTimeMinute = 0;
        }
    }
}


 
on envVar E_pubc_GW_GW_501_HU_LocalTimeYear_Rv
{
    int64 rawValue = 0ll;
    float rawValue_float = 0.0;
    float phyValue = 0.0;        

    //set the signal with updated raw value
    {
        rawValue = getvalue(this);
        if(chgEv_GW_501_HU_LocalTimeYear == 0)
        {
            //type conversion to float
            rawValue_float = rawValue;        
            // raw to physical conversion
            phyValue = ((rawValue_float *1)+(2013));
            putValue(E_pubc_GW_GW_501_HU_LocalTimeYear_Pv, phyValue);
            chgEv_GW_501_HU_LocalTimeYear = 1;
        }
        else
        {
            chgEv_GW_501_HU_LocalTimeYear = 0;
        }    
        //update the signal value
        Msg_GW_501.HU_LocalTimeYear=rawValue;        
    }                                                                           
}

on envVar E_pubc_GW_GW_501_HU_LocalTimeYear_Pv
{
    int64 rawValue = 0ll;
    float phyValue = 0.0;
    
    //update the raw value with physical value 
    {
        if(chgEv_GW_501_HU_LocalTimeYear == 0)
        {
            phyValue = getvalue(this);
            // physical to raw conversion
            rawValue = ((phyValue -(2013))/1);
            putValue(E_pubc_GW_GW_501_HU_LocalTimeYear_Rv, rawValue);
            chgEv_GW_501_HU_LocalTimeYear = 1;  
        }
        else
        {
            chgEv_GW_501_HU_LocalTimeYear = 0;
        }
    }
}


 
on envVar E_pubc_GW_GW_501_HU_LocalTimeMonth_Rv
{
    int64 rawValue = 0ll;
    float rawValue_float = 0.0;
    float phyValue = 0.0;        

    //set the signal with updated raw value
    {
        rawValue = getvalue(this);
        if(chgEv_GW_501_HU_LocalTimeMonth == 0)
        {
            //type conversion to float
            rawValue_float = rawValue;        
            // raw to physical conversion
            phyValue = ((rawValue_float *1)+(0));
            putValue(E_pubc_GW_GW_501_HU_LocalTimeMonth_Pv, phyValue);
            chgEv_GW_501_HU_LocalTimeMonth = 1;
        }
        else
        {
            chgEv_GW_501_HU_LocalTimeMonth = 0;
        }    
        //update the signal value
        Msg_GW_501.HU_LocalTimeMonth=rawValue;        
    }                                                                           
}

on envVar E_pubc_GW_GW_501_HU_LocalTimeMonth_Pv
{
    int64 rawValue = 0ll;
    float phyValue = 0.0;
    
    //update the raw value with physical value 
    {
        if(chgEv_GW_501_HU_LocalTimeMonth == 0)
        {
            phyValue = getvalue(this);
            // physical to raw conversion
            rawValue = ((phyValue -(0))/1);
            putValue(E_pubc_GW_GW_501_HU_LocalTimeMonth_Rv, rawValue);
            chgEv_GW_501_HU_LocalTimeMonth = 1;  
        }
        else
        {
            chgEv_GW_501_HU_LocalTimeMonth = 0;
        }
    }
}


 
on envVar E_pubc_GW_GW_1C6_tx
{
    if(getValue(this))
    {       
        

        output(Msg_GW_1C6);        
    }
}

on envVar E_pubc_GW_GW_1C6_Range
{
    qword rawstatus = 0ll;
    qword rawValue = 0ll;    
    
    rawstatus = getvalue(this);    
    // set all the signals with min raw /max raw /init raw
    switch (rawstatus) 
    {
     case(0) :
        rawValue= 0;
        putValue(E_pubc_GW_GW_1C6_PCU_RealAccPedl_Rv, rawValue);
        rawValue= 0;
        putValue(E_pubc_GW_GW_1C6_PCU_RealAccPedlVld_Rv, rawValue);
        rawValue= 0;
        putValue(E_pubc_GW_GW_1C6_PCU_TarGearReqValid_Rv, rawValue);
        rawValue= 0;
        putValue(E_pubc_GW_GW_1C6_PCU_TarGearReq_Rv, rawValue);
        break;
     case(1) :
        rawValue= 254;
        putValue(E_pubc_GW_GW_1C6_PCU_RealAccPedl_Rv, rawValue);
        rawValue= 1;
        putValue(E_pubc_GW_GW_1C6_PCU_RealAccPedlVld_Rv, rawValue);
        rawValue= 1;
        putValue(E_pubc_GW_GW_1C6_PCU_TarGearReqValid_Rv, rawValue);
        rawValue= 15;
        putValue(E_pubc_GW_GW_1C6_PCU_TarGearReq_Rv, rawValue);
        break;
     default :
        rawValue= 0;
        putValue(E_pubc_GW_GW_1C6_PCU_RealAccPedl_Rv, rawValue);
        rawValue= 0;
        putValue(E_pubc_GW_GW_1C6_PCU_RealAccPedlVld_Rv, rawValue);
        rawValue= 0;
        putValue(E_pubc_GW_GW_1C6_PCU_TarGearReqValid_Rv, rawValue);
        rawValue= 0;
        putValue(E_pubc_GW_GW_1C6_PCU_TarGearReq_Rv, rawValue);
      break;
   }
}

on envVar E_pubc_GW_GW_1C6_Dlc
{
    if(getValue(E_pubc_GW_GW_1C6_enDlc))
    {
        Msg_GW_1C6.dlc =getValue(this);
    }
    else
    {   
	   Msg_GW_1C6.dlc = 8;
	   	
  }
}

on envVar E_pubc_GW_GW_1C6_enDlc
{
    //For Messages with DLC = 8, set wrong DLC to smaller than defined DLC
    //For Messages with DLC < 8 set wrong DLC to smaller/longer than defined DLC
    if(getValue(this))
    {
        Msg_GW_1C6.dlc =getValue(E_pubc_GW_GW_1C6_Dlc);
    }
    else
    {
	   Msg_GW_1C6.dlc = 8;
			
    }
}


on envVar E_pubc_GW_GW_1C6_PCU_RealAccPedl_Rv
{
    int64 rawValue = 0ll;
    float rawValue_float = 0.0;
    float phyValue = 0.0;        

    //set the signal with updated raw value
    {
        rawValue = getvalue(this);
        if(chgEv_GW_1C6_PCU_RealAccPedl == 0)
        {
            //type conversion to float
            rawValue_float = rawValue;        
            // raw to physical conversion
            phyValue = ((rawValue_float *0.392)+(0));
            putValue(E_pubc_GW_GW_1C6_PCU_RealAccPedl_Pv, phyValue);
            chgEv_GW_1C6_PCU_RealAccPedl = 1;
        }
        else
        {
            chgEv_GW_1C6_PCU_RealAccPedl = 0;
        }    
        //update the signal value
        Msg_GW_1C6.PCU_RealAccPedl=rawValue;        
    }                                                                           
}

on envVar E_pubc_GW_GW_1C6_PCU_RealAccPedl_Pv
{
    int64 rawValue = 0ll;
    float phyValue = 0.0;
    
    //update the raw value with physical value 
    {
        if(chgEv_GW_1C6_PCU_RealAccPedl == 0)
        {
            phyValue = getvalue(this);
            // physical to raw conversion
            rawValue = ((phyValue -(0))/0.392);
            putValue(E_pubc_GW_GW_1C6_PCU_RealAccPedl_Rv, rawValue);
            chgEv_GW_1C6_PCU_RealAccPedl = 1;  
        }
        else
        {
            chgEv_GW_1C6_PCU_RealAccPedl = 0;
        }
    }
}


 
on envVar E_pubc_GW_GW_1C6_PCU_RealAccPedlVld_Rv
{
    int64 rawValue = 0ll;
    float rawValue_float = 0.0;
    float phyValue = 0.0;        

    //set the signal with updated raw value
    if(getValue(E_pubc_GW_GW_1C6_PCU_RealAccPedlVld_SetVt)==0)
    {
        rawValue = getvalue(this);
        if(chgEv_GW_1C6_PCU_RealAccPedlVld == 0)
        {
            //type conversion to float
            rawValue_float = rawValue;        
            // raw to physical conversion
            phyValue = ((rawValue_float *1)+(0));
            putValue(E_pubc_GW_GW_1C6_PCU_RealAccPedlVld_Pv, phyValue);
            chgEv_GW_1C6_PCU_RealAccPedlVld = 1;
        }
        else
        {
            chgEv_GW_1C6_PCU_RealAccPedlVld = 0;
        }    
        //update the signal value
        Msg_GW_1C6.PCU_RealAccPedlVld=rawValue;        
    }                                                                           
}

on envVar E_pubc_GW_GW_1C6_PCU_RealAccPedlVld_Pv
{
    int64 rawValue = 0ll;
    float phyValue = 0.0;
    
    //update the raw value with physical value 
    if(getValue(E_pubc_GW_GW_1C6_PCU_RealAccPedlVld_SetVt)==0)
    {
        if(chgEv_GW_1C6_PCU_RealAccPedlVld == 0)
        {
            phyValue = getvalue(this);
            // physical to raw conversion
            rawValue = ((phyValue -(0))/1);
            putValue(E_pubc_GW_GW_1C6_PCU_RealAccPedlVld_Rv, rawValue);
            chgEv_GW_1C6_PCU_RealAccPedlVld = 1;  
        }
        else
        {
            chgEv_GW_1C6_PCU_RealAccPedlVld = 0;
        }
    }
}

on envVar E_pubc_GW_GW_1C6_PCU_RealAccPedlVld_Vt
{
    qword rawValue = 0ll;
    if(getValue(E_pubc_GW_GW_1C6_PCU_RealAccPedlVld_SetVt))
    {
        //update the signal value
        Msg_GW_1C6.PCU_RealAccPedlVld=getValue(this);
    }
}

on envVar E_pubc_GW_GW_1C6_PCU_RealAccPedlVld_SetVt
{
    if(getValue(E_pubc_GW_GW_1C6_PCU_RealAccPedlVld_SetVt))
    {
        //update the signal value
        Msg_GW_1C6.PCU_RealAccPedlVld=getvalue(E_pubc_GW_GW_1C6_PCU_RealAccPedlVld_Vt);
    }
    else
    {
        Msg_GW_1C6.PCU_RealAccPedlVld=getValue(E_pubc_GW_GW_1C6_PCU_RealAccPedlVld_Rv);
    }
}
 
on envVar E_pubc_GW_GW_1C6_PCU_TarGearReqValid_Rv
{
    int64 rawValue = 0ll;
    float rawValue_float = 0.0;
    float phyValue = 0.0;        

    //set the signal with updated raw value
    if(getValue(E_pubc_GW_GW_1C6_PCU_TarGearReqValid_SetVt)==0)
    {
        rawValue = getvalue(this);
        if(chgEv_GW_1C6_PCU_TarGearReqValid == 0)
        {
            //type conversion to float
            rawValue_float = rawValue;        
            // raw to physical conversion
            phyValue = ((rawValue_float *1)+(0));
            putValue(E_pubc_GW_GW_1C6_PCU_TarGearReqValid_Pv, phyValue);
            chgEv_GW_1C6_PCU_TarGearReqValid = 1;
        }
        else
        {
            chgEv_GW_1C6_PCU_TarGearReqValid = 0;
        }    
        //update the signal value
        Msg_GW_1C6.PCU_TarGearReqValid=rawValue;        
    }                                                                           
}

on envVar E_pubc_GW_GW_1C6_PCU_TarGearReqValid_Pv
{
    int64 rawValue = 0ll;
    float phyValue = 0.0;
    
    //update the raw value with physical value 
    if(getValue(E_pubc_GW_GW_1C6_PCU_TarGearReqValid_SetVt)==0)
    {
        if(chgEv_GW_1C6_PCU_TarGearReqValid == 0)
        {
            phyValue = getvalue(this);
            // physical to raw conversion
            rawValue = ((phyValue -(0))/1);
            putValue(E_pubc_GW_GW_1C6_PCU_TarGearReqValid_Rv, rawValue);
            chgEv_GW_1C6_PCU_TarGearReqValid = 1;  
        }
        else
        {
            chgEv_GW_1C6_PCU_TarGearReqValid = 0;
        }
    }
}

on envVar E_pubc_GW_GW_1C6_PCU_TarGearReqValid_Vt
{
    qword rawValue = 0ll;
    if(getValue(E_pubc_GW_GW_1C6_PCU_TarGearReqValid_SetVt))
    {
        //update the signal value
        Msg_GW_1C6.PCU_TarGearReqValid=getValue(this);
    }
}

on envVar E_pubc_GW_GW_1C6_PCU_TarGearReqValid_SetVt
{
    if(getValue(E_pubc_GW_GW_1C6_PCU_TarGearReqValid_SetVt))
    {
        //update the signal value
        Msg_GW_1C6.PCU_TarGearReqValid=getvalue(E_pubc_GW_GW_1C6_PCU_TarGearReqValid_Vt);
    }
    else
    {
        Msg_GW_1C6.PCU_TarGearReqValid=getValue(E_pubc_GW_GW_1C6_PCU_TarGearReqValid_Rv);
    }
}
 
on envVar E_pubc_GW_GW_1C6_PCU_TarGearReq_Rv
{
    int64 rawValue = 0ll;
    float rawValue_float = 0.0;
    float phyValue = 0.0;        

    //set the signal with updated raw value
    if(getValue(E_pubc_GW_GW_1C6_PCU_TarGearReq_SetVt)==0)
    {
        rawValue = getvalue(this);
        if(chgEv_GW_1C6_PCU_TarGearReq == 0)
        {
            //type conversion to float
            rawValue_float = rawValue;        
            // raw to physical conversion
            phyValue = ((rawValue_float *1)+(0));
            putValue(E_pubc_GW_GW_1C6_PCU_TarGearReq_Pv, phyValue);
            chgEv_GW_1C6_PCU_TarGearReq = 1;
        }
        else
        {
            chgEv_GW_1C6_PCU_TarGearReq = 0;
        }    
        //update the signal value
        Msg_GW_1C6.PCU_TarGearReq=rawValue;        
    }                                                                           
}

on envVar E_pubc_GW_GW_1C6_PCU_TarGearReq_Pv
{
    int64 rawValue = 0ll;
    float phyValue = 0.0;
    
    //update the raw value with physical value 
    if(getValue(E_pubc_GW_GW_1C6_PCU_TarGearReq_SetVt)==0)
    {
        if(chgEv_GW_1C6_PCU_TarGearReq == 0)
        {
            phyValue = getvalue(this);
            // physical to raw conversion
            rawValue = ((phyValue -(0))/1);
            putValue(E_pubc_GW_GW_1C6_PCU_TarGearReq_Rv, rawValue);
            chgEv_GW_1C6_PCU_TarGearReq = 1;  
        }
        else
        {
            chgEv_GW_1C6_PCU_TarGearReq = 0;
        }
    }
}

on envVar E_pubc_GW_GW_1C6_PCU_TarGearReq_Vt
{
    qword rawValue = 0ll;
    if(getValue(E_pubc_GW_GW_1C6_PCU_TarGearReq_SetVt))
    {
        //update the signal value
        Msg_GW_1C6.PCU_TarGearReq=getValue(this);
    }
}

on envVar E_pubc_GW_GW_1C6_PCU_TarGearReq_SetVt
{
    if(getValue(E_pubc_GW_GW_1C6_PCU_TarGearReq_SetVt))
    {
        //update the signal value
        Msg_GW_1C6.PCU_TarGearReq=getvalue(E_pubc_GW_GW_1C6_PCU_TarGearReq_Vt);
    }
    else
    {
        Msg_GW_1C6.PCU_TarGearReq=getValue(E_pubc_GW_GW_1C6_PCU_TarGearReq_Rv);
    }
}

 
on envVar E_pubc_GW_GW_3C7_tx
{
    if(getValue(this))
    {       
        
        //update the BZ Signal
        if(GW_3C7_HU_RollingCounter_3C7_wrongvalctr == 0)
        {
            update_GW_3C7_HU_RollingCounter_3C7_counter();
            Msg_GW_3C7.HU_RollingCounter_3C7= GW_3C7_HU_RollingCounter_3C7_counter;
        }
        else if(GW_3C7_HU_RollingCounter_3C7_wrongvalctr > 0)
        {
			GW_3C7_HU_RollingCounter_3C7_counter=GW_3C7_HU_RollingCounter_3C7_counter + GW_3C7_HU_RollingCounter_3C7_wrongvalctr;
			 Msg_GW_3C7.HU_RollingCounter_3C7= GW_3C7_HU_RollingCounter_3C7_counter;
             /* GW_3C7_HU_RollingCounter_3C7_wrongvalctr--;
              // if counter becomes zero, update panel controller to zero
             if(GW_3C7_HU_RollingCounter_3C7_wrongvalctr == 0)
             {
                 putValue(E_pubc_GW_GW_3C7_HU_RollingCounter_3C7_wrongvalctr,0);
             } */
        }
        else
        {
            //do nothing
        }        
        //calculate the CRC CheckSum
        update_GW_3C7_CRC_CheckSum();

        output(Msg_GW_3C7);        
    }
}

on envVar E_pubc_GW_GW_3C7_Range
{
    qword rawstatus = 0ll;
    qword rawValue = 0ll;    
    
    rawstatus = getvalue(this);    
    // set all the signals with min raw /max raw /init raw
    switch (rawstatus) 
    {
     case(0) :
        rawValue= 0;
        putValue(E_pubc_GW_GW_3C7_HU_RoadCurvature_400m_Rv, rawValue);
        rawValue= 0;
        putValue(E_pubc_GW_GW_3C7_HU_MapMatchStatus_Rv, rawValue);
        rawValue= 0;
        putValue(E_pubc_GW_GW_3C7_HU_SlopeGradient_300m_Rv, rawValue);
        rawValue= 0;
        putValue(E_pubc_GW_GW_3C7_HU_RoadCurvature_100m_Rv, rawValue);
        rawValue= 0;
        putValue(E_pubc_GW_GW_3C7_HU_RoadCurvature_300m_Rv, rawValue);
        rawValue= 0;
        putValue(E_pubc_GW_GW_3C7_HU_RoadCurvature_600m_Rv, rawValue);
        break;
     case(1) :
        rawValue= 1023;
        putValue(E_pubc_GW_GW_3C7_HU_RoadCurvature_400m_Rv, rawValue);
        rawValue= 3;
        putValue(E_pubc_GW_GW_3C7_HU_MapMatchStatus_Rv, rawValue);
        rawValue= 1022;
        putValue(E_pubc_GW_GW_3C7_HU_SlopeGradient_300m_Rv, rawValue);
        rawValue= 1023;
        putValue(E_pubc_GW_GW_3C7_HU_RoadCurvature_100m_Rv, rawValue);
        rawValue= 1023;
        putValue(E_pubc_GW_GW_3C7_HU_RoadCurvature_300m_Rv, rawValue);
        rawValue= 1023;
        putValue(E_pubc_GW_GW_3C7_HU_RoadCurvature_600m_Rv, rawValue);
        break;
     default :
        rawValue= 0;
        putValue(E_pubc_GW_GW_3C7_HU_RoadCurvature_400m_Rv, rawValue);
        rawValue= 0;
        putValue(E_pubc_GW_GW_3C7_HU_MapMatchStatus_Rv, rawValue);
        rawValue= 0;
        putValue(E_pubc_GW_GW_3C7_HU_SlopeGradient_300m_Rv, rawValue);
        rawValue= 0;
        putValue(E_pubc_GW_GW_3C7_HU_RoadCurvature_100m_Rv, rawValue);
        rawValue= 0;
        putValue(E_pubc_GW_GW_3C7_HU_RoadCurvature_300m_Rv, rawValue);
        rawValue= 0;
        putValue(E_pubc_GW_GW_3C7_HU_RoadCurvature_600m_Rv, rawValue);
      break;
   }
}

on envVar E_pubc_GW_GW_3C7_Dlc
{
    if(getValue(E_pubc_GW_GW_3C7_enDlc))
    {
        Msg_GW_3C7.dlc =getValue(this);
    }
    else
    {
        Msg_GW_3C7.dlc =8;
    }
}

on envVar E_pubc_GW_GW_3C7_enDlc
{
    //For Messages with DLC = 8, set wrong DLC to smaller than defined DLC
    //For Messages with DLC < 8 set wrong DLC to smaller/longer than defined DLC
    if(getValue(this))
    {
        Msg_GW_3C7.dlc =getValue(E_pubc_GW_GW_3C7_Dlc);
    }
    else
    {
        Msg_GW_3C7.dlc =8;
    }
}

on envVar E_pubc_GW_GW_3C7_HU_CRCCheck_3C7_wrongvalctr
{
    //update disturb count
    //disturb value range:(-1 = always send wrong value),( X>0 ,x is the number of Messages with wrong CHK sent)
    GW_3C7_HU_CRCCheck_3C7_wrongvalctr =getValue(this);    
}
on envVar E_pubc_GW_GW_3C7_HU_RollingCounter_3C7_wrongvalctr
{
    //update disturb count
    //disturb value range:(-1 = always send wrong value),( X>0 ,x is the number of Messages with wrong CHK sent)
    GW_3C7_HU_RollingCounter_3C7_wrongvalctr =getValue(this);    
}

on envVar E_pubc_GW_GW_3C7_HU_RoadCurvature_400m_Rv
{
    int64 rawValue = 0ll;
    float rawValue_float = 0.0;
    float phyValue = 0.0;        

    //set the signal with updated raw value
    if(getValue(E_pubc_GW_GW_3C7_HU_RoadCurvature_400m_SetVt)==0)
    {
        rawValue = getvalue(this);
        if(chgEv_GW_3C7_HU_RoadCurvature_400m == 0)
        {
            //type conversion to float
            rawValue_float = rawValue;        
            // raw to physical conversion
            phyValue = ((rawValue_float *1)+(0));
            putValue(E_pubc_GW_GW_3C7_HU_RoadCurvature_400m_Pv, phyValue);
            chgEv_GW_3C7_HU_RoadCurvature_400m = 1;
        }
        else
        {
            chgEv_GW_3C7_HU_RoadCurvature_400m = 0;
        }    
        //update the signal value
        Msg_GW_3C7.HU_RoadCurvature_400m=rawValue;        
    }                                                                           
}

on envVar E_pubc_GW_GW_3C7_HU_RoadCurvature_400m_Pv
{
    int64 rawValue = 0ll;
    float phyValue = 0.0;
    
    //update the raw value with physical value 
    if(getValue(E_pubc_GW_GW_3C7_HU_RoadCurvature_400m_SetVt)==0)
    {
        if(chgEv_GW_3C7_HU_RoadCurvature_400m == 0)
        {
            phyValue = getvalue(this);
            // physical to raw conversion
            rawValue = ((phyValue -(0))/1);
            putValue(E_pubc_GW_GW_3C7_HU_RoadCurvature_400m_Rv, rawValue);
            chgEv_GW_3C7_HU_RoadCurvature_400m = 1;  
        }
        else
        {
            chgEv_GW_3C7_HU_RoadCurvature_400m = 0;
        }
    }
}

on envVar E_pubc_GW_GW_3C7_HU_RoadCurvature_400m_Vt
{
    qword rawValue = 0ll;
    if(getValue(E_pubc_GW_GW_3C7_HU_RoadCurvature_400m_SetVt))
    {
        //update the signal value
        Msg_GW_3C7.HU_RoadCurvature_400m=getValue(this);
    }
}

on envVar E_pubc_GW_GW_3C7_HU_RoadCurvature_400m_SetVt
{
    if(getValue(E_pubc_GW_GW_3C7_HU_RoadCurvature_400m_SetVt))
    {
        //update the signal value
        Msg_GW_3C7.HU_RoadCurvature_400m=getvalue(E_pubc_GW_GW_3C7_HU_RoadCurvature_400m_Vt);
    }
    else
    {
        Msg_GW_3C7.HU_RoadCurvature_400m=getValue(E_pubc_GW_GW_3C7_HU_RoadCurvature_400m_Rv);
    }
}
 
on envVar E_pubc_GW_GW_3C7_HU_MapMatchStatus_Rv
{
    int64 rawValue = 0ll;
    float rawValue_float = 0.0;
    float phyValue = 0.0;        

    //set the signal with updated raw value
    if(getValue(E_pubc_GW_GW_3C7_HU_MapMatchStatus_SetVt)==0)
    {
        rawValue = getvalue(this);
        if(chgEv_GW_3C7_HU_MapMatchStatus == 0)
        {
            //type conversion to float
            rawValue_float = rawValue;        
            // raw to physical conversion
            phyValue = ((rawValue_float *1)+(0));
            putValue(E_pubc_GW_GW_3C7_HU_MapMatchStatus_Pv, phyValue);
            chgEv_GW_3C7_HU_MapMatchStatus = 1;
        }
        else
        {
            chgEv_GW_3C7_HU_MapMatchStatus = 0;
        }    
        //update the signal value
        Msg_GW_3C7.HU_MapMatchStatus=rawValue;        
    }                                                                           
}

on envVar E_pubc_GW_GW_3C7_HU_MapMatchStatus_Pv
{
    int64 rawValue = 0ll;
    float phyValue = 0.0;
    
    //update the raw value with physical value 
    if(getValue(E_pubc_GW_GW_3C7_HU_MapMatchStatus_SetVt)==0)
    {
        if(chgEv_GW_3C7_HU_MapMatchStatus == 0)
        {
            phyValue = getvalue(this);
            // physical to raw conversion
            rawValue = ((phyValue -(0))/1);
            putValue(E_pubc_GW_GW_3C7_HU_MapMatchStatus_Rv, rawValue);
            chgEv_GW_3C7_HU_MapMatchStatus = 1;  
        }
        else
        {
            chgEv_GW_3C7_HU_MapMatchStatus = 0;
        }
    }
}

on envVar E_pubc_GW_GW_3C7_HU_MapMatchStatus_Vt
{
    qword rawValue = 0ll;
    if(getValue(E_pubc_GW_GW_3C7_HU_MapMatchStatus_SetVt))
    {
        //update the signal value
        Msg_GW_3C7.HU_MapMatchStatus=getValue(this);
    }
}

on envVar E_pubc_GW_GW_3C7_HU_MapMatchStatus_SetVt
{
    if(getValue(E_pubc_GW_GW_3C7_HU_MapMatchStatus_SetVt))
    {
        //update the signal value
        Msg_GW_3C7.HU_MapMatchStatus=getvalue(E_pubc_GW_GW_3C7_HU_MapMatchStatus_Vt);
    }
    else
    {
        Msg_GW_3C7.HU_MapMatchStatus=getValue(E_pubc_GW_GW_3C7_HU_MapMatchStatus_Rv);
    }
}
 
on envVar E_pubc_GW_GW_3C7_HU_SlopeGradient_300m_Rv
{
    int64 rawValue = 0ll;
    float rawValue_float = 0.0;
    float phyValue = 0.0;        

    //set the signal with updated raw value
    if(getValue(E_pubc_GW_GW_3C7_HU_SlopeGradient_300m_SetVt)==0)
    {
        rawValue = getvalue(this);
        if(chgEv_GW_3C7_HU_SlopeGradient_300m == 0)
        {
            //type conversion to float
            rawValue_float = rawValue;        
            // raw to physical conversion
            phyValue = ((rawValue_float *0.1)+(-51.1));
            putValue(E_pubc_GW_GW_3C7_HU_SlopeGradient_300m_Pv, phyValue);
            chgEv_GW_3C7_HU_SlopeGradient_300m = 1;
        }
        else
        {
            chgEv_GW_3C7_HU_SlopeGradient_300m = 0;
        }    
        //update the signal value
        Msg_GW_3C7.HU_SlopeGradient_300m=rawValue;        
    }                                                                           
}

on envVar E_pubc_GW_GW_3C7_HU_SlopeGradient_300m_Pv
{
    int64 rawValue = 0ll;
    float phyValue = 0.0;
    
    //update the raw value with physical value 
    if(getValue(E_pubc_GW_GW_3C7_HU_SlopeGradient_300m_SetVt)==0)
    {
        if(chgEv_GW_3C7_HU_SlopeGradient_300m == 0)
        {
            phyValue = getvalue(this);
            // physical to raw conversion
            rawValue = ((phyValue -(-51.1))/0.1);
            putValue(E_pubc_GW_GW_3C7_HU_SlopeGradient_300m_Rv, rawValue);
            chgEv_GW_3C7_HU_SlopeGradient_300m = 1;  
        }
        else
        {
            chgEv_GW_3C7_HU_SlopeGradient_300m = 0;
        }
    }
}

on envVar E_pubc_GW_GW_3C7_HU_SlopeGradient_300m_Vt
{
    qword rawValue = 0ll;
    if(getValue(E_pubc_GW_GW_3C7_HU_SlopeGradient_300m_SetVt))
    {
        //update the signal value
        Msg_GW_3C7.HU_SlopeGradient_300m=getValue(this);
    }
}

on envVar E_pubc_GW_GW_3C7_HU_SlopeGradient_300m_SetVt
{
    if(getValue(E_pubc_GW_GW_3C7_HU_SlopeGradient_300m_SetVt))
    {
        //update the signal value
        Msg_GW_3C7.HU_SlopeGradient_300m=getvalue(E_pubc_GW_GW_3C7_HU_SlopeGradient_300m_Vt);
    }
    else
    {
        Msg_GW_3C7.HU_SlopeGradient_300m=getValue(E_pubc_GW_GW_3C7_HU_SlopeGradient_300m_Rv);
    }
}
 
on envVar E_pubc_GW_GW_3C7_HU_RoadCurvature_100m_Rv
{
    int64 rawValue = 0ll;
    float rawValue_float = 0.0;
    float phyValue = 0.0;        

    //set the signal with updated raw value
    if(getValue(E_pubc_GW_GW_3C7_HU_RoadCurvature_100m_SetVt)==0)
    {
        rawValue = getvalue(this);
        if(chgEv_GW_3C7_HU_RoadCurvature_100m == 0)
        {
            //type conversion to float
            rawValue_float = rawValue;        
            // raw to physical conversion
            phyValue = ((rawValue_float *1)+(0));
            putValue(E_pubc_GW_GW_3C7_HU_RoadCurvature_100m_Pv, phyValue);
            chgEv_GW_3C7_HU_RoadCurvature_100m = 1;
        }
        else
        {
            chgEv_GW_3C7_HU_RoadCurvature_100m = 0;
        }    
        //update the signal value
        Msg_GW_3C7.HU_RoadCurvature_100m=rawValue;        
    }                                                                           
}

on envVar E_pubc_GW_GW_3C7_HU_RoadCurvature_100m_Pv
{
    int64 rawValue = 0ll;
    float phyValue = 0.0;
    
    //update the raw value with physical value 
    if(getValue(E_pubc_GW_GW_3C7_HU_RoadCurvature_100m_SetVt)==0)
    {
        if(chgEv_GW_3C7_HU_RoadCurvature_100m == 0)
        {
            phyValue = getvalue(this);
            // physical to raw conversion
            rawValue = ((phyValue -(0))/1);
            putValue(E_pubc_GW_GW_3C7_HU_RoadCurvature_100m_Rv, rawValue);
            chgEv_GW_3C7_HU_RoadCurvature_100m = 1;  
        }
        else
        {
            chgEv_GW_3C7_HU_RoadCurvature_100m = 0;
        }
    }
}

on envVar E_pubc_GW_GW_3C7_HU_RoadCurvature_100m_Vt
{
    qword rawValue = 0ll;
    if(getValue(E_pubc_GW_GW_3C7_HU_RoadCurvature_100m_SetVt))
    {
        //update the signal value
        Msg_GW_3C7.HU_RoadCurvature_100m=getValue(this);
    }
}

on envVar E_pubc_GW_GW_3C7_HU_RoadCurvature_100m_SetVt
{
    if(getValue(E_pubc_GW_GW_3C7_HU_RoadCurvature_100m_SetVt))
    {
        //update the signal value
        Msg_GW_3C7.HU_RoadCurvature_100m=getvalue(E_pubc_GW_GW_3C7_HU_RoadCurvature_100m_Vt);
    }
    else
    {
        Msg_GW_3C7.HU_RoadCurvature_100m=getValue(E_pubc_GW_GW_3C7_HU_RoadCurvature_100m_Rv);
    }
}
 
on envVar E_pubc_GW_GW_3C7_HU_RoadCurvature_300m_Rv
{
    int64 rawValue = 0ll;
    float rawValue_float = 0.0;
    float phyValue = 0.0;        

    //set the signal with updated raw value
    if(getValue(E_pubc_GW_GW_3C7_HU_RoadCurvature_300m_SetVt)==0)
    {
        rawValue = getvalue(this);
        if(chgEv_GW_3C7_HU_RoadCurvature_300m == 0)
        {
            //type conversion to float
            rawValue_float = rawValue;        
            // raw to physical conversion
            phyValue = ((rawValue_float *1)+(0));
            putValue(E_pubc_GW_GW_3C7_HU_RoadCurvature_300m_Pv, phyValue);
            chgEv_GW_3C7_HU_RoadCurvature_300m = 1;
        }
        else
        {
            chgEv_GW_3C7_HU_RoadCurvature_300m = 0;
        }    
        //update the signal value
        Msg_GW_3C7.HU_RoadCurvature_300m=rawValue;        
    }                                                                           
}

on envVar E_pubc_GW_GW_3C7_HU_RoadCurvature_300m_Pv
{
    int64 rawValue = 0ll;
    float phyValue = 0.0;
    
    //update the raw value with physical value 
    if(getValue(E_pubc_GW_GW_3C7_HU_RoadCurvature_300m_SetVt)==0)
    {
        if(chgEv_GW_3C7_HU_RoadCurvature_300m == 0)
        {
            phyValue = getvalue(this);
            // physical to raw conversion
            rawValue = ((phyValue -(0))/1);
            putValue(E_pubc_GW_GW_3C7_HU_RoadCurvature_300m_Rv, rawValue);
            chgEv_GW_3C7_HU_RoadCurvature_300m = 1;  
        }
        else
        {
            chgEv_GW_3C7_HU_RoadCurvature_300m = 0;
        }
    }
}

on envVar E_pubc_GW_GW_3C7_HU_RoadCurvature_300m_Vt
{
    qword rawValue = 0ll;
    if(getValue(E_pubc_GW_GW_3C7_HU_RoadCurvature_300m_SetVt))
    {
        //update the signal value
        Msg_GW_3C7.HU_RoadCurvature_300m=getValue(this);
    }
}

on envVar E_pubc_GW_GW_3C7_HU_RoadCurvature_300m_SetVt
{
    if(getValue(E_pubc_GW_GW_3C7_HU_RoadCurvature_300m_SetVt))
    {
        //update the signal value
        Msg_GW_3C7.HU_RoadCurvature_300m=getvalue(E_pubc_GW_GW_3C7_HU_RoadCurvature_300m_Vt);
    }
    else
    {
        Msg_GW_3C7.HU_RoadCurvature_300m=getValue(E_pubc_GW_GW_3C7_HU_RoadCurvature_300m_Rv);
    }
}
 
on envVar E_pubc_GW_GW_3C7_HU_RoadCurvature_600m_Rv
{
    int64 rawValue = 0ll;
    float rawValue_float = 0.0;
    float phyValue = 0.0;        

    //set the signal with updated raw value
    if(getValue(E_pubc_GW_GW_3C7_HU_RoadCurvature_600m_SetVt)==0)
    {
        rawValue = getvalue(this);
        if(chgEv_GW_3C7_HU_RoadCurvature_600m == 0)
        {
            //type conversion to float
            rawValue_float = rawValue;        
            // raw to physical conversion
            phyValue = ((rawValue_float *1)+(0));
            putValue(E_pubc_GW_GW_3C7_HU_RoadCurvature_600m_Pv, phyValue);
            chgEv_GW_3C7_HU_RoadCurvature_600m = 1;
        }
        else
        {
            chgEv_GW_3C7_HU_RoadCurvature_600m = 0;
        }    
        //update the signal value
        Msg_GW_3C7.HU_RoadCurvature_600m=rawValue;        
    }                                                                           
}

on envVar E_pubc_GW_GW_3C7_HU_RoadCurvature_600m_Pv
{
    int64 rawValue = 0ll;
    float phyValue = 0.0;
    
    //update the raw value with physical value 
    if(getValue(E_pubc_GW_GW_3C7_HU_RoadCurvature_600m_SetVt)==0)
    {
        if(chgEv_GW_3C7_HU_RoadCurvature_600m == 0)
        {
            phyValue = getvalue(this);
            // physical to raw conversion
            rawValue = ((phyValue -(0))/1);
            putValue(E_pubc_GW_GW_3C7_HU_RoadCurvature_600m_Rv, rawValue);
            chgEv_GW_3C7_HU_RoadCurvature_600m = 1;  
        }
        else
        {
            chgEv_GW_3C7_HU_RoadCurvature_600m = 0;
        }
    }
}

on envVar E_pubc_GW_GW_3C7_HU_RoadCurvature_600m_Vt
{
    qword rawValue = 0ll;
    if(getValue(E_pubc_GW_GW_3C7_HU_RoadCurvature_600m_SetVt))
    {
        //update the signal value
        Msg_GW_3C7.HU_RoadCurvature_600m=getValue(this);
    }
}

on envVar E_pubc_GW_GW_3C7_HU_RoadCurvature_600m_SetVt
{
    if(getValue(E_pubc_GW_GW_3C7_HU_RoadCurvature_600m_SetVt))
    {
        //update the signal value
        Msg_GW_3C7.HU_RoadCurvature_600m=getvalue(E_pubc_GW_GW_3C7_HU_RoadCurvature_600m_Vt);
    }
    else
    {
        Msg_GW_3C7.HU_RoadCurvature_600m=getValue(E_pubc_GW_GW_3C7_HU_RoadCurvature_600m_Rv);
    }
}
 
on envVar E_pubc_GW_GW_3C6_tx
{
    if(getValue(this))
    {       
        
        //update the BZ Signal
        if(GW_3C6_HU_RollingCounter_3C6_wrongvalctr == 0)
        {
            update_GW_3C6_HU_RollingCounter_3C6_counter();
            Msg_GW_3C6.HU_RollingCounter_3C6= GW_3C6_HU_RollingCounter_3C6_counter;
        }
        else if(GW_3C6_HU_RollingCounter_3C6_wrongvalctr > 0)
        {
			GW_3C6_HU_RollingCounter_3C6_counter=GW_3C6_HU_RollingCounter_3C6_counter + GW_3C6_HU_RollingCounter_3C6_wrongvalctr;
			 Msg_GW_3C6.HU_RollingCounter_3C6= GW_3C6_HU_RollingCounter_3C6_counter;
             /* GW_3C6_HU_RollingCounter_3C6_wrongvalctr--;
              // if counter becomes zero, update panel controller to zero
             if(GW_3C6_HU_RollingCounter_3C6_wrongvalctr == 0)
             {
                 putValue(E_pubc_GW_GW_3C6_HU_RollingCounter_3C6_wrongvalctr,0);
             } */
        }
        else
        {
            //do nothing
        }        
        //calculate the CRC CheckSum
        update_GW_3C6_CRC_CheckSum();

        output(Msg_GW_3C6);        
    }
}

on envVar E_pubc_GW_GW_3C6_Range
{
    qword rawstatus = 0ll;
    qword rawValue = 0ll;    
    
    rawstatus = getvalue(this);    
    // set all the signals with min raw /max raw /init raw
    switch (rawstatus) 
    {
     case(0) :
        rawValue= 0;
        putValue(E_pubc_GW_GW_3C6_HU_BranchInfo_Rv, rawValue);
        rawValue= 0;
        putValue(E_pubc_GW_GW_3C6_HU_RoadCurvature_70m_Rv, rawValue);
        rawValue= 0;
        putValue(E_pubc_GW_GW_3C6_HU_RoadCurvature_80m_Rv, rawValue);
        rawValue= 0;
        putValue(E_pubc_GW_GW_3C6_HU_RoadCurvature_90m_Rv, rawValue);
        rawValue= 0;
        putValue(E_pubc_GW_GW_3C6_HU_RoadCurvature_60m_Rv, rawValue);
        rawValue= 0;
        putValue(E_pubc_GW_GW_3C6_HU_RoadCurvature_50m_Rv, rawValue);
        break;
     case(1) :
        rawValue= 3;
        putValue(E_pubc_GW_GW_3C6_HU_BranchInfo_Rv, rawValue);
        rawValue= 1023;
        putValue(E_pubc_GW_GW_3C6_HU_RoadCurvature_70m_Rv, rawValue);
        rawValue= 1023;
        putValue(E_pubc_GW_GW_3C6_HU_RoadCurvature_80m_Rv, rawValue);
        rawValue= 1023;
        putValue(E_pubc_GW_GW_3C6_HU_RoadCurvature_90m_Rv, rawValue);
        rawValue= 1023;
        putValue(E_pubc_GW_GW_3C6_HU_RoadCurvature_60m_Rv, rawValue);
        rawValue= 1023;
        putValue(E_pubc_GW_GW_3C6_HU_RoadCurvature_50m_Rv, rawValue);
        break;
     default :
        rawValue= 0;
        putValue(E_pubc_GW_GW_3C6_HU_BranchInfo_Rv, rawValue);
        rawValue= 0;
        putValue(E_pubc_GW_GW_3C6_HU_RoadCurvature_70m_Rv, rawValue);
        rawValue= 0;
        putValue(E_pubc_GW_GW_3C6_HU_RoadCurvature_80m_Rv, rawValue);
        rawValue= 0;
        putValue(E_pubc_GW_GW_3C6_HU_RoadCurvature_90m_Rv, rawValue);
        rawValue= 0;
        putValue(E_pubc_GW_GW_3C6_HU_RoadCurvature_60m_Rv, rawValue);
        rawValue= 0;
        putValue(E_pubc_GW_GW_3C6_HU_RoadCurvature_50m_Rv, rawValue);
      break;
   }
}

on envVar E_pubc_GW_GW_3C6_Dlc
{
    if(getValue(E_pubc_GW_GW_3C6_enDlc))
    {
        Msg_GW_3C6.dlc =getValue(this);
    }
    else
    {
        Msg_GW_3C6.dlc =8;
    }
}

on envVar E_pubc_GW_GW_3C6_enDlc
{
    //For Messages with DLC = 8, set wrong DLC to smaller than defined DLC
    //For Messages with DLC < 8 set wrong DLC to smaller/longer than defined DLC
    if(getValue(this))
    {
        Msg_GW_3C6.dlc =getValue(E_pubc_GW_GW_3C6_Dlc);
    }
    else
    {
        Msg_GW_3C6.dlc =8;
    }
}

on envVar E_pubc_GW_GW_3C6_HU_CRCCheck_3C6_wrongvalctr
{
    //update disturb count
    //disturb value range:(-1 = always send wrong value),( X>0 ,x is the number of Messages with wrong CHK sent)
    GW_3C6_HU_CRCCheck_3C6_wrongvalctr =getValue(this);    
}
on envVar E_pubc_GW_GW_3C6_HU_RollingCounter_3C6_wrongvalctr
{
    //update disturb count
    //disturb value range:(-1 = always send wrong value),( X>0 ,x is the number of Messages with wrong CHK sent)
    GW_3C6_HU_RollingCounter_3C6_wrongvalctr =getValue(this);    
}

on envVar E_pubc_GW_GW_3C6_HU_BranchInfo_Rv
{
    int64 rawValue = 0ll;
    float rawValue_float = 0.0;
    float phyValue = 0.0;        

    //set the signal with updated raw value
    if(getValue(E_pubc_GW_GW_3C6_HU_BranchInfo_SetVt)==0)
    {
        rawValue = getvalue(this);
        if(chgEv_GW_3C6_HU_BranchInfo == 0)
        {
            //type conversion to float
            rawValue_float = rawValue;        
            // raw to physical conversion
            phyValue = ((rawValue_float *1)+(0));
            putValue(E_pubc_GW_GW_3C6_HU_BranchInfo_Pv, phyValue);
            chgEv_GW_3C6_HU_BranchInfo = 1;
        }
        else
        {
            chgEv_GW_3C6_HU_BranchInfo = 0;
        }    
        //update the signal value
        Msg_GW_3C6.HU_BranchInfo=rawValue;        
    }                                                                           
}

on envVar E_pubc_GW_GW_3C6_HU_BranchInfo_Pv
{
    int64 rawValue = 0ll;
    float phyValue = 0.0;
    
    //update the raw value with physical value 
    if(getValue(E_pubc_GW_GW_3C6_HU_BranchInfo_SetVt)==0)
    {
        if(chgEv_GW_3C6_HU_BranchInfo == 0)
        {
            phyValue = getvalue(this);
            // physical to raw conversion
            rawValue = ((phyValue -(0))/1);
            putValue(E_pubc_GW_GW_3C6_HU_BranchInfo_Rv, rawValue);
            chgEv_GW_3C6_HU_BranchInfo = 1;  
        }
        else
        {
            chgEv_GW_3C6_HU_BranchInfo = 0;
        }
    }
}

on envVar E_pubc_GW_GW_3C6_HU_BranchInfo_Vt
{
    qword rawValue = 0ll;
    if(getValue(E_pubc_GW_GW_3C6_HU_BranchInfo_SetVt))
    {
        //update the signal value
        Msg_GW_3C6.HU_BranchInfo=getValue(this);
    }
}

on envVar E_pubc_GW_GW_3C6_HU_BranchInfo_SetVt
{
    if(getValue(E_pubc_GW_GW_3C6_HU_BranchInfo_SetVt))
    {
        //update the signal value
        Msg_GW_3C6.HU_BranchInfo=getvalue(E_pubc_GW_GW_3C6_HU_BranchInfo_Vt);
    }
    else
    {
        Msg_GW_3C6.HU_BranchInfo=getValue(E_pubc_GW_GW_3C6_HU_BranchInfo_Rv);
    }
}
 
on envVar E_pubc_GW_GW_3C6_HU_RoadCurvature_70m_Rv
{
    int64 rawValue = 0ll;
    float rawValue_float = 0.0;
    float phyValue = 0.0;        

    //set the signal with updated raw value
    if(getValue(E_pubc_GW_GW_3C6_HU_RoadCurvature_70m_SetVt)==0)
    {
        rawValue = getvalue(this);
        if(chgEv_GW_3C6_HU_RoadCurvature_70m == 0)
        {
            //type conversion to float
            rawValue_float = rawValue;        
            // raw to physical conversion
            phyValue = ((rawValue_float *1)+(0));
            putValue(E_pubc_GW_GW_3C6_HU_RoadCurvature_70m_Pv, phyValue);
            chgEv_GW_3C6_HU_RoadCurvature_70m = 1;
        }
        else
        {
            chgEv_GW_3C6_HU_RoadCurvature_70m = 0;
        }    
        //update the signal value
        Msg_GW_3C6.HU_RoadCurvature_70m=rawValue;        
    }                                                                           
}

on envVar E_pubc_GW_GW_3C6_HU_RoadCurvature_70m_Pv
{
    int64 rawValue = 0ll;
    float phyValue = 0.0;
    
    //update the raw value with physical value 
    if(getValue(E_pubc_GW_GW_3C6_HU_RoadCurvature_70m_SetVt)==0)
    {
        if(chgEv_GW_3C6_HU_RoadCurvature_70m == 0)
        {
            phyValue = getvalue(this);
            // physical to raw conversion
            rawValue = ((phyValue -(0))/1);
            putValue(E_pubc_GW_GW_3C6_HU_RoadCurvature_70m_Rv, rawValue);
            chgEv_GW_3C6_HU_RoadCurvature_70m = 1;  
        }
        else
        {
            chgEv_GW_3C6_HU_RoadCurvature_70m = 0;
        }
    }
}

on envVar E_pubc_GW_GW_3C6_HU_RoadCurvature_70m_Vt
{
    qword rawValue = 0ll;
    if(getValue(E_pubc_GW_GW_3C6_HU_RoadCurvature_70m_SetVt))
    {
        //update the signal value
        Msg_GW_3C6.HU_RoadCurvature_70m=getValue(this);
    }
}

on envVar E_pubc_GW_GW_3C6_HU_RoadCurvature_70m_SetVt
{
    if(getValue(E_pubc_GW_GW_3C6_HU_RoadCurvature_70m_SetVt))
    {
        //update the signal value
        Msg_GW_3C6.HU_RoadCurvature_70m=getvalue(E_pubc_GW_GW_3C6_HU_RoadCurvature_70m_Vt);
    }
    else
    {
        Msg_GW_3C6.HU_RoadCurvature_70m=getValue(E_pubc_GW_GW_3C6_HU_RoadCurvature_70m_Rv);
    }
}
 
on envVar E_pubc_GW_GW_3C6_HU_RoadCurvature_80m_Rv
{
    int64 rawValue = 0ll;
    float rawValue_float = 0.0;
    float phyValue = 0.0;        

    //set the signal with updated raw value
    if(getValue(E_pubc_GW_GW_3C6_HU_RoadCurvature_80m_SetVt)==0)
    {
        rawValue = getvalue(this);
        if(chgEv_GW_3C6_HU_RoadCurvature_80m == 0)
        {
            //type conversion to float
            rawValue_float = rawValue;        
            // raw to physical conversion
            phyValue = ((rawValue_float *1)+(0));
            putValue(E_pubc_GW_GW_3C6_HU_RoadCurvature_80m_Pv, phyValue);
            chgEv_GW_3C6_HU_RoadCurvature_80m = 1;
        }
        else
        {
            chgEv_GW_3C6_HU_RoadCurvature_80m = 0;
        }    
        //update the signal value
        Msg_GW_3C6.HU_RoadCurvature_80m=rawValue;        
    }                                                                           
}

on envVar E_pubc_GW_GW_3C6_HU_RoadCurvature_80m_Pv
{
    int64 rawValue = 0ll;
    float phyValue = 0.0;
    
    //update the raw value with physical value 
    if(getValue(E_pubc_GW_GW_3C6_HU_RoadCurvature_80m_SetVt)==0)
    {
        if(chgEv_GW_3C6_HU_RoadCurvature_80m == 0)
        {
            phyValue = getvalue(this);
            // physical to raw conversion
            rawValue = ((phyValue -(0))/1);
            putValue(E_pubc_GW_GW_3C6_HU_RoadCurvature_80m_Rv, rawValue);
            chgEv_GW_3C6_HU_RoadCurvature_80m = 1;  
        }
        else
        {
            chgEv_GW_3C6_HU_RoadCurvature_80m = 0;
        }
    }
}

on envVar E_pubc_GW_GW_3C6_HU_RoadCurvature_80m_Vt
{
    qword rawValue = 0ll;
    if(getValue(E_pubc_GW_GW_3C6_HU_RoadCurvature_80m_SetVt))
    {
        //update the signal value
        Msg_GW_3C6.HU_RoadCurvature_80m=getValue(this);
    }
}

on envVar E_pubc_GW_GW_3C6_HU_RoadCurvature_80m_SetVt
{
    if(getValue(E_pubc_GW_GW_3C6_HU_RoadCurvature_80m_SetVt))
    {
        //update the signal value
        Msg_GW_3C6.HU_RoadCurvature_80m=getvalue(E_pubc_GW_GW_3C6_HU_RoadCurvature_80m_Vt);
    }
    else
    {
        Msg_GW_3C6.HU_RoadCurvature_80m=getValue(E_pubc_GW_GW_3C6_HU_RoadCurvature_80m_Rv);
    }
}
 
on envVar E_pubc_GW_GW_3C6_HU_RoadCurvature_90m_Rv
{
    int64 rawValue = 0ll;
    float rawValue_float = 0.0;
    float phyValue = 0.0;        

    //set the signal with updated raw value
    if(getValue(E_pubc_GW_GW_3C6_HU_RoadCurvature_90m_SetVt)==0)
    {
        rawValue = getvalue(this);
        if(chgEv_GW_3C6_HU_RoadCurvature_90m == 0)
        {
            //type conversion to float
            rawValue_float = rawValue;        
            // raw to physical conversion
            phyValue = ((rawValue_float *1)+(0));
            putValue(E_pubc_GW_GW_3C6_HU_RoadCurvature_90m_Pv, phyValue);
            chgEv_GW_3C6_HU_RoadCurvature_90m = 1;
        }
        else
        {
            chgEv_GW_3C6_HU_RoadCurvature_90m = 0;
        }    
        //update the signal value
        Msg_GW_3C6.HU_RoadCurvature_90m=rawValue;        
    }                                                                           
}

on envVar E_pubc_GW_GW_3C6_HU_RoadCurvature_90m_Pv
{
    int64 rawValue = 0ll;
    float phyValue = 0.0;
    
    //update the raw value with physical value 
    if(getValue(E_pubc_GW_GW_3C6_HU_RoadCurvature_90m_SetVt)==0)
    {
        if(chgEv_GW_3C6_HU_RoadCurvature_90m == 0)
        {
            phyValue = getvalue(this);
            // physical to raw conversion
            rawValue = ((phyValue -(0))/1);
            putValue(E_pubc_GW_GW_3C6_HU_RoadCurvature_90m_Rv, rawValue);
            chgEv_GW_3C6_HU_RoadCurvature_90m = 1;  
        }
        else
        {
            chgEv_GW_3C6_HU_RoadCurvature_90m = 0;
        }
    }
}

on envVar E_pubc_GW_GW_3C6_HU_RoadCurvature_90m_Vt
{
    qword rawValue = 0ll;
    if(getValue(E_pubc_GW_GW_3C6_HU_RoadCurvature_90m_SetVt))
    {
        //update the signal value
        Msg_GW_3C6.HU_RoadCurvature_90m=getValue(this);
    }
}

on envVar E_pubc_GW_GW_3C6_HU_RoadCurvature_90m_SetVt
{
    if(getValue(E_pubc_GW_GW_3C6_HU_RoadCurvature_90m_SetVt))
    {
        //update the signal value
        Msg_GW_3C6.HU_RoadCurvature_90m=getvalue(E_pubc_GW_GW_3C6_HU_RoadCurvature_90m_Vt);
    }
    else
    {
        Msg_GW_3C6.HU_RoadCurvature_90m=getValue(E_pubc_GW_GW_3C6_HU_RoadCurvature_90m_Rv);
    }
}
 
on envVar E_pubc_GW_GW_3C6_HU_RoadCurvature_60m_Rv
{
    int64 rawValue = 0ll;
    float rawValue_float = 0.0;
    float phyValue = 0.0;        

    //set the signal with updated raw value
    if(getValue(E_pubc_GW_GW_3C6_HU_RoadCurvature_60m_SetVt)==0)
    {
        rawValue = getvalue(this);
        if(chgEv_GW_3C6_HU_RoadCurvature_60m == 0)
        {
            //type conversion to float
            rawValue_float = rawValue;        
            // raw to physical conversion
            phyValue = ((rawValue_float *1)+(0));
            putValue(E_pubc_GW_GW_3C6_HU_RoadCurvature_60m_Pv, phyValue);
            chgEv_GW_3C6_HU_RoadCurvature_60m = 1;
        }
        else
        {
            chgEv_GW_3C6_HU_RoadCurvature_60m = 0;
        }    
        //update the signal value
        Msg_GW_3C6.HU_RoadCurvature_60m=rawValue;        
    }                                                                           
}

on envVar E_pubc_GW_GW_3C6_HU_RoadCurvature_60m_Pv
{
    int64 rawValue = 0ll;
    float phyValue = 0.0;
    
    //update the raw value with physical value 
    if(getValue(E_pubc_GW_GW_3C6_HU_RoadCurvature_60m_SetVt)==0)
    {
        if(chgEv_GW_3C6_HU_RoadCurvature_60m == 0)
        {
            phyValue = getvalue(this);
            // physical to raw conversion
            rawValue = ((phyValue -(0))/1);
            putValue(E_pubc_GW_GW_3C6_HU_RoadCurvature_60m_Rv, rawValue);
            chgEv_GW_3C6_HU_RoadCurvature_60m = 1;  
        }
        else
        {
            chgEv_GW_3C6_HU_RoadCurvature_60m = 0;
        }
    }
}

on envVar E_pubc_GW_GW_3C6_HU_RoadCurvature_60m_Vt
{
    qword rawValue = 0ll;
    if(getValue(E_pubc_GW_GW_3C6_HU_RoadCurvature_60m_SetVt))
    {
        //update the signal value
        Msg_GW_3C6.HU_RoadCurvature_60m=getValue(this);
    }
}

on envVar E_pubc_GW_GW_3C6_HU_RoadCurvature_60m_SetVt
{
    if(getValue(E_pubc_GW_GW_3C6_HU_RoadCurvature_60m_SetVt))
    {
        //update the signal value
        Msg_GW_3C6.HU_RoadCurvature_60m=getvalue(E_pubc_GW_GW_3C6_HU_RoadCurvature_60m_Vt);
    }
    else
    {
        Msg_GW_3C6.HU_RoadCurvature_60m=getValue(E_pubc_GW_GW_3C6_HU_RoadCurvature_60m_Rv);
    }
}
 
on envVar E_pubc_GW_GW_3C6_HU_RoadCurvature_50m_Rv
{
    int64 rawValue = 0ll;
    float rawValue_float = 0.0;
    float phyValue = 0.0;        

    //set the signal with updated raw value
    if(getValue(E_pubc_GW_GW_3C6_HU_RoadCurvature_50m_SetVt)==0)
    {
        rawValue = getvalue(this);
        if(chgEv_GW_3C6_HU_RoadCurvature_50m == 0)
        {
            //type conversion to float
            rawValue_float = rawValue;        
            // raw to physical conversion
            phyValue = ((rawValue_float *1)+(0));
            putValue(E_pubc_GW_GW_3C6_HU_RoadCurvature_50m_Pv, phyValue);
            chgEv_GW_3C6_HU_RoadCurvature_50m = 1;
        }
        else
        {
            chgEv_GW_3C6_HU_RoadCurvature_50m = 0;
        }    
        //update the signal value
        Msg_GW_3C6.HU_RoadCurvature_50m=rawValue;        
    }                                                                           
}

on envVar E_pubc_GW_GW_3C6_HU_RoadCurvature_50m_Pv
{
    int64 rawValue = 0ll;
    float phyValue = 0.0;
    
    //update the raw value with physical value 
    if(getValue(E_pubc_GW_GW_3C6_HU_RoadCurvature_50m_SetVt)==0)
    {
        if(chgEv_GW_3C6_HU_RoadCurvature_50m == 0)
        {
            phyValue = getvalue(this);
            // physical to raw conversion
            rawValue = ((phyValue -(0))/1);
            putValue(E_pubc_GW_GW_3C6_HU_RoadCurvature_50m_Rv, rawValue);
            chgEv_GW_3C6_HU_RoadCurvature_50m = 1;  
        }
        else
        {
            chgEv_GW_3C6_HU_RoadCurvature_50m = 0;
        }
    }
}

on envVar E_pubc_GW_GW_3C6_HU_RoadCurvature_50m_Vt
{
    qword rawValue = 0ll;
    if(getValue(E_pubc_GW_GW_3C6_HU_RoadCurvature_50m_SetVt))
    {
        //update the signal value
        Msg_GW_3C6.HU_RoadCurvature_50m=getValue(this);
    }
}

on envVar E_pubc_GW_GW_3C6_HU_RoadCurvature_50m_SetVt
{
    if(getValue(E_pubc_GW_GW_3C6_HU_RoadCurvature_50m_SetVt))
    {
        //update the signal value
        Msg_GW_3C6.HU_RoadCurvature_50m=getvalue(E_pubc_GW_GW_3C6_HU_RoadCurvature_50m_Vt);
    }
    else
    {
        Msg_GW_3C6.HU_RoadCurvature_50m=getValue(E_pubc_GW_GW_3C6_HU_RoadCurvature_50m_Rv);
    }
}
 
on envVar E_pubc_GW_GW_1A8_tx
{
    if(getValue(this))
    {       
        
        //update the BZ Signal
        if(GW_1A8_TCU_RollingCounter_1A8_wrongvalctr == 0)
        {
            update_GW_1A8_TCU_RollingCounter_1A8_counter();
            Msg_GW_1A8.TCU_RollingCounter_1A8= GW_1A8_TCU_RollingCounter_1A8_counter;
        }
        else if(GW_1A8_TCU_RollingCounter_1A8_wrongvalctr > 0)
        {
			GW_1A8_TCU_RollingCounter_1A8_counter=GW_1A8_TCU_RollingCounter_1A8_counter + GW_1A8_TCU_RollingCounter_1A8_wrongvalctr;
			 Msg_GW_1A8.TCU_RollingCounter_1A8= GW_1A8_TCU_RollingCounter_1A8_counter;
             /* GW_1A8_TCU_RollingCounter_1A8_wrongvalctr--;
              // if counter becomes zero, update panel controller to zero
             if(GW_1A8_TCU_RollingCounter_1A8_wrongvalctr == 0)
             {
                 putValue(E_pubc_GW_GW_1A8_TCU_RollingCounter_1A8_wrongvalctr,0);
             } */
        }
        else
        {
            //do nothing
        }        
        //calculate the CRC CheckSum
        update_GW_1A8_CRC_CheckSum();

        output(Msg_GW_1A8);        
    }
}

on envVar E_pubc_GW_GW_1A8_Range
{
    qword rawstatus = 0ll;
    qword rawValue = 0ll;    
    
    rawstatus = getvalue(this);    
    // set all the signals with min raw /max raw /init raw
    switch (rawstatus) 
    {
     case(0) :
        rawValue= 0;
        putValue(E_pubc_GW_GW_1A8_TCU_ShiftPostionValid_Rv, rawValue);
        rawValue= 0;
        putValue(E_pubc_GW_GW_1A8_TCU_ActualDrivingGearValid_Rv, rawValue);
        rawValue= 0;
        putValue(E_pubc_GW_GW_1A8_TCU_GearShiftPosition_Rv, rawValue);
        rawValue= 0;
        putValue(E_pubc_GW_GW_1A8_TCU_ShiftInProgress_Rv, rawValue);
        rawValue= 0;
        putValue(E_pubc_GW_GW_1A8_TCU_ActualDrivingGear_Rv, rawValue);
        rawValue= 0;
        putValue(E_pubc_GW_GW_1A8_TCU_ShiftInProgressVld_Rv, rawValue);
        break;
     case(1) :
        rawValue= 1;
        putValue(E_pubc_GW_GW_1A8_TCU_ShiftPostionValid_Rv, rawValue);
        rawValue= 1;
        putValue(E_pubc_GW_GW_1A8_TCU_ActualDrivingGearValid_Rv, rawValue);
        rawValue= 15;
        putValue(E_pubc_GW_GW_1A8_TCU_GearShiftPosition_Rv, rawValue);
        rawValue= 1;
        putValue(E_pubc_GW_GW_1A8_TCU_ShiftInProgress_Rv, rawValue);
        rawValue= 15;
        putValue(E_pubc_GW_GW_1A8_TCU_ActualDrivingGear_Rv, rawValue);
        rawValue= 1;
        putValue(E_pubc_GW_GW_1A8_TCU_ShiftInProgressVld_Rv, rawValue);
        break;
     default :
        rawValue= 0;
        putValue(E_pubc_GW_GW_1A8_TCU_ShiftPostionValid_Rv, rawValue);
        rawValue= 0;
        putValue(E_pubc_GW_GW_1A8_TCU_ActualDrivingGearValid_Rv, rawValue);
        rawValue= 0;
        putValue(E_pubc_GW_GW_1A8_TCU_GearShiftPosition_Rv, rawValue);
        rawValue= 0;
        putValue(E_pubc_GW_GW_1A8_TCU_ShiftInProgress_Rv, rawValue);
        rawValue= 0;
        putValue(E_pubc_GW_GW_1A8_TCU_ActualDrivingGear_Rv, rawValue);
        rawValue= 0;
        putValue(E_pubc_GW_GW_1A8_TCU_ShiftInProgressVld_Rv, rawValue);
      break;
   }
}

on envVar E_pubc_GW_GW_1A8_Dlc
{
    if(getValue(E_pubc_GW_GW_1A8_enDlc))
    {
        Msg_GW_1A8.dlc =getValue(this);
    }
    else
    {
        Msg_GW_1A8.dlc =8;
    }
}

on envVar E_pubc_GW_GW_1A8_enDlc
{
    //For Messages with DLC = 8, set wrong DLC to smaller than defined DLC
    //For Messages with DLC < 8 set wrong DLC to smaller/longer than defined DLC
    if(getValue(this))
    {
        Msg_GW_1A8.dlc =getValue(E_pubc_GW_GW_1A8_Dlc);
    }
    else
    {
        Msg_GW_1A8.dlc =8;
    }
}

on envVar E_pubc_GW_GW_1A8_TCU_CRCCheck_1A8_wrongvalctr
{
    //update disturb count
    //disturb value range:(-1 = always send wrong value),( X>0 ,x is the number of Messages with wrong CHK sent)
    GW_1A8_TCU_CRCCheck_1A8_wrongvalctr =getValue(this);    
}
on envVar E_pubc_GW_GW_1A8_TCU_RollingCounter_1A8_wrongvalctr
{
    //update disturb count
    //disturb value range:(-1 = always send wrong value),( X>0 ,x is the number of Messages with wrong CHK sent)
    GW_1A8_TCU_RollingCounter_1A8_wrongvalctr =getValue(this);    
}

on envVar E_pubc_GW_GW_1A8_TCU_ShiftPostionValid_Rv
{
    int64 rawValue = 0ll;
    float rawValue_float = 0.0;
    float phyValue = 0.0;        

    //set the signal with updated raw value
    if(getValue(E_pubc_GW_GW_1A8_TCU_ShiftPostionValid_SetVt)==0)
    {
        rawValue = getvalue(this);
        if(chgEv_GW_1A8_TCU_ShiftPostionValid == 0)
        {
            //type conversion to float
            rawValue_float = rawValue;        
            // raw to physical conversion
            phyValue = ((rawValue_float *1)+(0));
            putValue(E_pubc_GW_GW_1A8_TCU_ShiftPostionValid_Pv, phyValue);
            chgEv_GW_1A8_TCU_ShiftPostionValid = 1;
        }
        else
        {
            chgEv_GW_1A8_TCU_ShiftPostionValid = 0;
        }    
        //update the signal value
        Msg_GW_1A8.TCU_ShiftPostionValid=rawValue;        
    }                                                                           
}

on envVar E_pubc_GW_GW_1A8_TCU_ShiftPostionValid_Pv
{
    int64 rawValue = 0ll;
    float phyValue = 0.0;
    
    //update the raw value with physical value 
    if(getValue(E_pubc_GW_GW_1A8_TCU_ShiftPostionValid_SetVt)==0)
    {
        if(chgEv_GW_1A8_TCU_ShiftPostionValid == 0)
        {
            phyValue = getvalue(this);
            // physical to raw conversion
            rawValue = ((phyValue -(0))/1);
            putValue(E_pubc_GW_GW_1A8_TCU_ShiftPostionValid_Rv, rawValue);
            chgEv_GW_1A8_TCU_ShiftPostionValid = 1;  
        }
        else
        {
            chgEv_GW_1A8_TCU_ShiftPostionValid = 0;
        }
    }
}

on envVar E_pubc_GW_GW_1A8_TCU_ShiftPostionValid_Vt
{
    qword rawValue = 0ll;
    if(getValue(E_pubc_GW_GW_1A8_TCU_ShiftPostionValid_SetVt))
    {
        //update the signal value
        Msg_GW_1A8.TCU_ShiftPostionValid=getValue(this);
    }
}

on envVar E_pubc_GW_GW_1A8_TCU_ShiftPostionValid_SetVt
{
    if(getValue(E_pubc_GW_GW_1A8_TCU_ShiftPostionValid_SetVt))
    {
        //update the signal value
        Msg_GW_1A8.TCU_ShiftPostionValid=getvalue(E_pubc_GW_GW_1A8_TCU_ShiftPostionValid_Vt);
    }
    else
    {
        Msg_GW_1A8.TCU_ShiftPostionValid=getValue(E_pubc_GW_GW_1A8_TCU_ShiftPostionValid_Rv);
    }
}
 
on envVar E_pubc_GW_GW_1A8_TCU_ActualDrivingGearValid_Rv
{
    int64 rawValue = 0ll;
    float rawValue_float = 0.0;
    float phyValue = 0.0;        

    //set the signal with updated raw value
    if(getValue(E_pubc_GW_GW_1A8_TCU_ActualDrivingGearValid_SetVt)==0)
    {
        rawValue = getvalue(this);
        if(chgEv_GW_1A8_TCU_ActualDrivingGearValid == 0)
        {
            //type conversion to float
            rawValue_float = rawValue;        
            // raw to physical conversion
            phyValue = ((rawValue_float *1)+(0));
            putValue(E_pubc_GW_GW_1A8_TCU_ActualDrivingGearValid_Pv, phyValue);
            chgEv_GW_1A8_TCU_ActualDrivingGearValid = 1;
        }
        else
        {
            chgEv_GW_1A8_TCU_ActualDrivingGearValid = 0;
        }    
        //update the signal value
        Msg_GW_1A8.TCU_ActualDrivingGearValid=rawValue;        
    }                                                                           
}
on envVar E_pubc_GW_GW_1A8_TCU_ActualDrivingGearValid_Pv
{
    int64 rawValue = 0ll;
    float phyValue = 0.0;
    
    //update the raw value with physical value 
    if(getValue(E_pubc_GW_GW_1A8_TCU_ActualDrivingGearValid_SetVt)==0)
    {
        if(chgEv_GW_1A8_TCU_ActualDrivingGearValid == 0)
        {
            phyValue = getvalue(this);
            // physical to raw conversion
            rawValue = ((phyValue -(0))/1);
            putValue(E_pubc_GW_GW_1A8_TCU_ActualDrivingGearValid_Rv, rawValue);
            chgEv_GW_1A8_TCU_ActualDrivingGearValid = 1;  
        }
        else
        {
            chgEv_GW_1A8_TCU_ActualDrivingGearValid = 0;
        }
    }
}
on envVar E_pubc_GW_GW_1A8_TCU_ActualDrivingGearValid_Vt
{
    qword rawValue = 0ll;
    if(getValue(E_pubc_GW_GW_1A8_TCU_ActualDrivingGearValid_SetVt))
    {
        //update the signal value
        Msg_GW_1A8.TCU_ActualDrivingGearValid=getValue(this);
    }
}
on envVar E_pubc_GW_GW_1A8_TCU_ActualDrivingGearValid_SetVt
{
    if(getValue(E_pubc_GW_GW_1A8_TCU_ActualDrivingGearValid_SetVt))
    {
        //update the signal value
        Msg_GW_1A8.TCU_ActualDrivingGearValid=getvalue(E_pubc_GW_GW_1A8_TCU_ActualDrivingGearValid_Vt);
    }
    else
    {
        Msg_GW_1A8.TCU_ActualDrivingGearValid=getValue(E_pubc_GW_GW_1A8_TCU_ActualDrivingGearValid_Rv);
    }
}
on envVar E_pubc_GW_GW_1A8_TCU_GearShiftPosition_Rv
{
    int64 rawValue = 0ll;
    float rawValue_float = 0.0;
    float phyValue = 0.0;        

    //set the signal with updated raw value
    if(getValue(E_pubc_GW_GW_1A8_TCU_GearShiftPosition_SetVt)==0)
    {
        rawValue = getvalue(this);
        if(chgEv_GW_1A8_TCU_GearShiftPosition == 0)
        {
            //type conversion to float
            rawValue_float = rawValue;        
            // raw to physical conversion
            phyValue = ((rawValue_float *1)+(0));
            putValue(E_pubc_GW_GW_1A8_TCU_GearShiftPosition_Pv, phyValue);
            chgEv_GW_1A8_TCU_GearShiftPosition = 1;
        }
        else
        {
            chgEv_GW_1A8_TCU_GearShiftPosition = 0;
        }    
        //update the signal value
        Msg_GW_1A8.TCU_GearShiftPosition=rawValue;        
    }                                                                           
}

on envVar E_pubc_GW_GW_1A8_TCU_GearShiftPosition_Pv
{
    int64 rawValue = 0ll;
    float phyValue = 0.0;
    
    //update the raw value with physical value 
    if(getValue(E_pubc_GW_GW_1A8_TCU_GearShiftPosition_SetVt)==0)
    {
        if(chgEv_GW_1A8_TCU_GearShiftPosition == 0)
        {
            phyValue = getvalue(this);
            // physical to raw conversion
            rawValue = ((phyValue -(0))/1);
            putValue(E_pubc_GW_GW_1A8_TCU_GearShiftPosition_Rv, rawValue);
            chgEv_GW_1A8_TCU_GearShiftPosition = 1;  
        }
        else
        {
            chgEv_GW_1A8_TCU_GearShiftPosition = 0;
        }
    }
}

on envVar E_pubc_GW_GW_1A8_TCU_GearShiftPosition_Vt
{
    qword rawValue = 0ll;
    if(getValue(E_pubc_GW_GW_1A8_TCU_GearShiftPosition_SetVt))
    {
        //update the signal value
        Msg_GW_1A8.TCU_GearShiftPosition=getValue(this);
    }
}

on envVar E_pubc_GW_GW_1A8_TCU_GearShiftPosition_SetVt
{
    if(getValue(E_pubc_GW_GW_1A8_TCU_GearShiftPosition_SetVt))
    {
        //update the signal value
        Msg_GW_1A8.TCU_GearShiftPosition=getvalue(E_pubc_GW_GW_1A8_TCU_GearShiftPosition_Vt);
    }
    else
    {
        Msg_GW_1A8.TCU_GearShiftPosition=getValue(E_pubc_GW_GW_1A8_TCU_GearShiftPosition_Rv);
    }
}
 
on envVar E_pubc_GW_GW_1A8_TCU_ShiftInProgress_Rv
{
    int64 rawValue = 0ll;
    float rawValue_float = 0.0;
    float phyValue = 0.0;        

    //set the signal with updated raw value
    if(getValue(E_pubc_GW_GW_1A8_TCU_ShiftInProgress_SetVt)==0)
    {
        rawValue = getvalue(this);
        if(chgEv_GW_1A8_TCU_ShiftInProgress == 0)
        {
            //type conversion to float
            rawValue_float = rawValue;        
            // raw to physical conversion
            phyValue = ((rawValue_float *1)+(0));
            putValue(E_pubc_GW_GW_1A8_TCU_ShiftInProgress_Pv, phyValue);
            chgEv_GW_1A8_TCU_ShiftInProgress = 1;
        }
        else
        {
            chgEv_GW_1A8_TCU_ShiftInProgress = 0;
        }    
        //update the signal value
        Msg_GW_1A8.TCU_ShiftInProgress=rawValue;        
    }                                                                           
}

on envVar E_pubc_GW_GW_1A8_TCU_ShiftInProgress_Pv
{
    int64 rawValue = 0ll;
    float phyValue = 0.0;
    
    //update the raw value with physical value 
    if(getValue(E_pubc_GW_GW_1A8_TCU_ShiftInProgress_SetVt)==0)
    {
        if(chgEv_GW_1A8_TCU_ShiftInProgress == 0)
        {
            phyValue = getvalue(this);
            // physical to raw conversion
            rawValue = ((phyValue -(0))/1);
            putValue(E_pubc_GW_GW_1A8_TCU_ShiftInProgress_Rv, rawValue);
            chgEv_GW_1A8_TCU_ShiftInProgress = 1;  
        }
        else
        {
            chgEv_GW_1A8_TCU_ShiftInProgress = 0;
        }
    }
}

on envVar E_pubc_GW_GW_1A8_TCU_ShiftInProgress_Vt
{
    qword rawValue = 0ll;
    if(getValue(E_pubc_GW_GW_1A8_TCU_ShiftInProgress_SetVt))
    {
        //update the signal value
        Msg_GW_1A8.TCU_ShiftInProgress=getValue(this);
    }
}

on envVar E_pubc_GW_GW_1A8_TCU_ShiftInProgress_SetVt
{
    if(getValue(E_pubc_GW_GW_1A8_TCU_ShiftInProgress_SetVt))
    {
        //update the signal value
        Msg_GW_1A8.TCU_ShiftInProgress=getvalue(E_pubc_GW_GW_1A8_TCU_ShiftInProgress_Vt);
    }
    else
    {
        Msg_GW_1A8.TCU_ShiftInProgress=getValue(E_pubc_GW_GW_1A8_TCU_ShiftInProgress_Rv);
    }
}
 
on envVar E_pubc_GW_GW_1A8_TCU_ActualDrivingGear_Rv
{
    int64 rawValue = 0ll;
    float rawValue_float = 0.0;
    float phyValue = 0.0;        

    //set the signal with updated raw value
    if(getValue(E_pubc_GW_GW_1A8_TCU_ActualDrivingGear_SetVt)==0)
    {
        rawValue = getvalue(this);
        if(chgEv_GW_1A8_TCU_ActualDrivingGear == 0)
        {
            //type conversion to float
            rawValue_float = rawValue;        
            // raw to physical conversion
            phyValue = ((rawValue_float *1)+(0));
            putValue(E_pubc_GW_GW_1A8_TCU_ActualDrivingGear_Pv, phyValue);
            chgEv_GW_1A8_TCU_ActualDrivingGear = 1;
        }
        else
        {
            chgEv_GW_1A8_TCU_ActualDrivingGear = 0;
        }    
        //update the signal value
        Msg_GW_1A8.TCU_ActualDrivingGear=rawValue;        
    }                                                                           
}

on envVar E_pubc_GW_GW_1A8_TCU_ActualDrivingGear_Pv
{
    int64 rawValue = 0ll;
    float phyValue = 0.0;
    
    //update the raw value with physical value 
    if(getValue(E_pubc_GW_GW_1A8_TCU_ActualDrivingGear_SetVt)==0)
    {
        if(chgEv_GW_1A8_TCU_ActualDrivingGear == 0)
        {
            phyValue = getvalue(this);
            // physical to raw conversion
            rawValue = ((phyValue -(0))/1);
            putValue(E_pubc_GW_GW_1A8_TCU_ActualDrivingGear_Rv, rawValue);
            chgEv_GW_1A8_TCU_ActualDrivingGear = 1;  
        }
        else
        {
            chgEv_GW_1A8_TCU_ActualDrivingGear = 0;
        }
    }
}

on envVar E_pubc_GW_GW_1A8_TCU_ActualDrivingGear_Vt
{
    qword rawValue = 0ll;
    if(getValue(E_pubc_GW_GW_1A8_TCU_ActualDrivingGear_SetVt))
    {
        //update the signal value
        Msg_GW_1A8.TCU_ActualDrivingGear=getValue(this);
    }
}

on envVar E_pubc_GW_GW_1A8_TCU_ActualDrivingGear_SetVt
{
    if(getValue(E_pubc_GW_GW_1A8_TCU_ActualDrivingGear_SetVt))
    {
        //update the signal value
        Msg_GW_1A8.TCU_ActualDrivingGear=getvalue(E_pubc_GW_GW_1A8_TCU_ActualDrivingGear_Vt);
    }
    else
    {
        Msg_GW_1A8.TCU_ActualDrivingGear=getValue(E_pubc_GW_GW_1A8_TCU_ActualDrivingGear_Rv);
    }
}
 
on envVar E_pubc_GW_GW_1A8_TCU_ShiftInProgressVld_Rv
{
    int64 rawValue = 0ll;
    float rawValue_float = 0.0;
    float phyValue = 0.0;        

    //set the signal with updated raw value
    if(getValue(E_pubc_GW_GW_1A8_TCU_ShiftInProgressVld_SetVt)==0)
    {
        rawValue = getvalue(this);
        if(chgEv_GW_1A8_TCU_ShiftInProgressVld == 0)
        {
            //type conversion to float
            rawValue_float = rawValue;        
            // raw to physical conversion
            phyValue = ((rawValue_float *1)+(0));
            putValue(E_pubc_GW_GW_1A8_TCU_ShiftInProgressVld_Pv, phyValue);
            chgEv_GW_1A8_TCU_ShiftInProgressVld = 1;
        }
        else
        {
            chgEv_GW_1A8_TCU_ShiftInProgressVld = 0;
        }    
        //update the signal value
        Msg_GW_1A8.TCU_ShiftInProgressVld=rawValue;        
    }                                                                           
}
on envVar E_pubc_GW_GW_1A8_TCU_ShiftInProgressVld_Pv
{
    int64 rawValue = 0ll;
    float phyValue = 0.0;
    
    //update the raw value with physical value 
    if(getValue(E_pubc_GW_GW_1A8_TCU_ShiftInProgressVld_SetVt)==0)
    {
        if(chgEv_GW_1A8_TCU_ShiftInProgressVld == 0)
        {
            phyValue = getvalue(this);
            // physical to raw conversion
            rawValue = ((phyValue -(0))/1);
            putValue(E_pubc_GW_GW_1A8_TCU_ShiftInProgressVld_Rv, rawValue);
            chgEv_GW_1A8_TCU_ShiftInProgressVld = 1;  
        }
        else
        {
            chgEv_GW_1A8_TCU_ShiftInProgressVld = 0;
        }
    }
}
on envVar E_pubc_GW_GW_1A8_TCU_ShiftInProgressVld_Vt
{
    qword rawValue = 0ll;
    if(getValue(E_pubc_GW_GW_1A8_TCU_ShiftInProgressVld_SetVt))
    {
        //update the signal value
        Msg_GW_1A8.TCU_ShiftInProgressVld=getValue(this);
    }
}
on envVar E_pubc_GW_GW_1A8_TCU_ShiftInProgressVld_SetVt
{
    if(getValue(E_pubc_GW_GW_1A8_TCU_ShiftInProgressVld_SetVt))
    {
        //update the signal value
        Msg_GW_1A8.TCU_ShiftInProgressVld=getvalue(E_pubc_GW_GW_1A8_TCU_ShiftInProgressVld_Vt);
    }
    else
    {
        Msg_GW_1A8.TCU_ShiftInProgressVld=getValue(E_pubc_GW_GW_1A8_TCU_ShiftInProgressVld_Rv);
    }
}
on envVar E_pubc_GW_GW_3C2_tx
{
    if(getValue(this))
    {       
        
        //update the BZ Signal
        if(GW_3C2_HU_RollingCounter_3C2_wrongvalctr == 0)
        {
            update_GW_3C2_HU_RollingCounter_3C2_counter();
            Msg_GW_3C2.HU_RollingCounter_3C2= GW_3C2_HU_RollingCounter_3C2_counter;
        }
        else if(GW_3C2_HU_RollingCounter_3C2_wrongvalctr > 0)
        {
			GW_3C2_HU_RollingCounter_3C2_counter=GW_3C2_HU_RollingCounter_3C2_counter + GW_3C2_HU_RollingCounter_3C2_wrongvalctr;
			 Msg_GW_3C2.HU_RollingCounter_3C2= GW_3C2_HU_RollingCounter_3C2_counter;
             /* GW_3C2_HU_RollingCounter_3C2_wrongvalctr--;
              // if counter becomes zero, update panel controller to zero
             if(GW_3C2_HU_RollingCounter_3C2_wrongvalctr == 0)
             {
                 putValue(E_pubc_GW_GW_3C2_HU_RollingCounter_3C2_wrongvalctr,0);
             } */
        }
        else
        {
            //do nothing
        }        
        //calculate the CRC CheckSum
        update_GW_3C2_CRC_CheckSum();

        output(Msg_GW_3C2);        
    }
}

on envVar E_pubc_GW_GW_3C2_Range
{
    qword rawstatus = 0ll;
    qword rawValue = 0ll;    
    
    rawstatus = getvalue(this);    
    // set all the signals with min raw /max raw /init raw
    switch (rawstatus) 
    {
     case(0) :
        rawValue= 0;
        putValue(E_pubc_GW_GW_3C2_HU_Road_TrafficFlow_Rv, rawValue);
        rawValue= 0;
        putValue(E_pubc_GW_GW_3C2_HU_RampSide_Rv, rawValue);
        rawValue= 0;
        putValue(E_pubc_GW_GW_3C2_HU_To_Branch_Dis_Rv, rawValue);
        rawValue= 0;
        putValue(E_pubc_GW_GW_3C2_HU_FallingRockInfo_Rv, rawValue);
        rawValue= 0;
        putValue(E_pubc_GW_GW_3C2_HU_To_TrafficAccident_Dis_Rv, rawValue);
        rawValue= 0;
        putValue(E_pubc_GW_GW_3C2_HU_MapDataUpdateStatus_Rv, rawValue);
        rawValue= 0;
        putValue(E_pubc_GW_GW_3C2_HU_Construction_Info_Rv, rawValue);
        rawValue= 0;
        putValue(E_pubc_GW_GW_3C2_HU_To_Construction_Dis_Rv, rawValue);
        rawValue= 0;
        putValue(E_pubc_GW_GW_3C2_HU_LaneCnt_Rv, rawValue);
        rawValue= 0;
        putValue(E_pubc_GW_GW_3C2_HU_TrafficAccident_Info_Rv, rawValue);
        rawValue= 0;
        putValue(E_pubc_GW_GW_3C2_HU_ForwardRoadType_Rv, rawValue);
        rawValue= 0;
        putValue(E_pubc_GW_GW_3C2_HU_FallingRockDi_Rv, rawValue);
        rawValue= 0;
        putValue(E_pubc_GW_GW_3C2_HU_TollInfo_Rv, rawValue);
        rawValue= 0;
        putValue(E_pubc_GW_GW_3C2_HU_TollDis_Rv, rawValue);
        break;
     case(1) :
        rawValue= 7;
        putValue(E_pubc_GW_GW_3C2_HU_Road_TrafficFlow_Rv, rawValue);
        rawValue= 3;
        putValue(E_pubc_GW_GW_3C2_HU_RampSide_Rv, rawValue);
        rawValue= 60;
        putValue(E_pubc_GW_GW_3C2_HU_To_Branch_Dis_Rv, rawValue);
        rawValue= 3;
        putValue(E_pubc_GW_GW_3C2_HU_FallingRockInfo_Rv, rawValue);
        rawValue= 60;
        putValue(E_pubc_GW_GW_3C2_HU_To_TrafficAccident_Dis_Rv, rawValue);
        rawValue= 7;
        putValue(E_pubc_GW_GW_3C2_HU_MapDataUpdateStatus_Rv, rawValue);
        rawValue= 3;
        putValue(E_pubc_GW_GW_3C2_HU_Construction_Info_Rv, rawValue);
        rawValue= 60;
        putValue(E_pubc_GW_GW_3C2_HU_To_Construction_Dis_Rv, rawValue);
        rawValue= 7;
        putValue(E_pubc_GW_GW_3C2_HU_LaneCnt_Rv, rawValue);
        rawValue= 3;
        putValue(E_pubc_GW_GW_3C2_HU_TrafficAccident_Info_Rv, rawValue);
        rawValue= 7;
        putValue(E_pubc_GW_GW_3C2_HU_ForwardRoadType_Rv, rawValue);
        rawValue= 60;
        putValue(E_pubc_GW_GW_3C2_HU_FallingRockDi_Rv, rawValue);
        rawValue= 3;
        putValue(E_pubc_GW_GW_3C2_HU_TollInfo_Rv, rawValue);
        rawValue= 60;
        putValue(E_pubc_GW_GW_3C2_HU_TollDis_Rv, rawValue);
        break;
     default :
        rawValue= 0;
        putValue(E_pubc_GW_GW_3C2_HU_Road_TrafficFlow_Rv, rawValue);
        rawValue= 0;
        putValue(E_pubc_GW_GW_3C2_HU_RampSide_Rv, rawValue);
        rawValue= 0;
        putValue(E_pubc_GW_GW_3C2_HU_To_Branch_Dis_Rv, rawValue);
        rawValue= 0;
        putValue(E_pubc_GW_GW_3C2_HU_FallingRockInfo_Rv, rawValue);
        rawValue= 0;
        putValue(E_pubc_GW_GW_3C2_HU_To_TrafficAccident_Dis_Rv, rawValue);
        rawValue= 0;
        putValue(E_pubc_GW_GW_3C2_HU_MapDataUpdateStatus_Rv, rawValue);
        rawValue= 0;
        putValue(E_pubc_GW_GW_3C2_HU_Construction_Info_Rv, rawValue);
        rawValue= 0;
        putValue(E_pubc_GW_GW_3C2_HU_To_Construction_Dis_Rv, rawValue);
        rawValue= 0;
        putValue(E_pubc_GW_GW_3C2_HU_LaneCnt_Rv, rawValue);
        rawValue= 0;
        putValue(E_pubc_GW_GW_3C2_HU_TrafficAccident_Info_Rv, rawValue);
        rawValue= 0;
        putValue(E_pubc_GW_GW_3C2_HU_ForwardRoadType_Rv, rawValue);
        rawValue= 0;
        putValue(E_pubc_GW_GW_3C2_HU_FallingRockDi_Rv, rawValue);
        rawValue= 0;
        putValue(E_pubc_GW_GW_3C2_HU_TollInfo_Rv, rawValue);
        rawValue= 0;
        putValue(E_pubc_GW_GW_3C2_HU_TollDis_Rv, rawValue);
      break;
   }
}

on envVar E_pubc_GW_GW_3C2_Dlc
{
    if(getValue(E_pubc_GW_GW_3C2_enDlc))
    {
        Msg_GW_3C2.dlc =getValue(this);
    }
    else
    {
        Msg_GW_3C2.dlc =8;
    }
}

on envVar E_pubc_GW_GW_3C2_enDlc
{
    //For Messages with DLC = 8, set wrong DLC to smaller than defined DLC
    //For Messages with DLC < 8 set wrong DLC to smaller/longer than defined DLC
    if(getValue(this))
    {
        Msg_GW_3C2.dlc =getValue(E_pubc_GW_GW_3C2_Dlc);
    }
    else
    {
        Msg_GW_3C2.dlc =8;
    }
}

on envVar E_pubc_GW_GW_3C2_HU_CRCCheck_3C2_wrongvalctr
{
    //update disturb count
    //disturb value range:(-1 = always send wrong value),( X>0 ,x is the number of Messages with wrong CHK sent)
    GW_3C2_HU_CRCCheck_3C2_wrongvalctr =getValue(this);    
}
on envVar E_pubc_GW_GW_3C2_HU_RollingCounter_3C2_wrongvalctr
{
    //update disturb count
    //disturb value range:(-1 = always send wrong value),( X>0 ,x is the number of Messages with wrong CHK sent)
    GW_3C2_HU_RollingCounter_3C2_wrongvalctr =getValue(this);    
}

on envVar E_pubc_GW_GW_3C2_HU_Road_TrafficFlow_Rv
{
    int64 rawValue = 0ll;
    float rawValue_float = 0.0;
    float phyValue = 0.0;        

    //set the signal with updated raw value
    if(getValue(E_pubc_GW_GW_3C2_HU_Road_TrafficFlow_SetVt)==0)
    {
        rawValue = getvalue(this);
        if(chgEv_GW_3C2_HU_Road_TrafficFlow == 0)
        {
            //type conversion to float
            rawValue_float = rawValue;        
            // raw to physical conversion
            phyValue = ((rawValue_float *1)+(0));
            putValue(E_pubc_GW_GW_3C2_HU_Road_TrafficFlow_Pv, phyValue);
            chgEv_GW_3C2_HU_Road_TrafficFlow = 1;
        }
        else
        {
            chgEv_GW_3C2_HU_Road_TrafficFlow = 0;
        }    
        //update the signal value
        Msg_GW_3C2.HU_Road_TrafficFlow=rawValue;        
    }                                                                           
}

on envVar E_pubc_GW_GW_3C2_HU_Road_TrafficFlow_Pv
{
    int64 rawValue = 0ll;
    float phyValue = 0.0;
    
    //update the raw value with physical value 
    if(getValue(E_pubc_GW_GW_3C2_HU_Road_TrafficFlow_SetVt)==0)
    {
        if(chgEv_GW_3C2_HU_Road_TrafficFlow == 0)
        {
            phyValue = getvalue(this);
            // physical to raw conversion
            rawValue = ((phyValue -(0))/1);
            putValue(E_pubc_GW_GW_3C2_HU_Road_TrafficFlow_Rv, rawValue);
            chgEv_GW_3C2_HU_Road_TrafficFlow = 1;  
        }
        else
        {
            chgEv_GW_3C2_HU_Road_TrafficFlow = 0;
        }
    }
}

on envVar E_pubc_GW_GW_3C2_HU_Road_TrafficFlow_Vt
{
    qword rawValue = 0ll;
    if(getValue(E_pubc_GW_GW_3C2_HU_Road_TrafficFlow_SetVt))
    {
        //update the signal value
        Msg_GW_3C2.HU_Road_TrafficFlow=getValue(this);
    }
}

on envVar E_pubc_GW_GW_3C2_HU_Road_TrafficFlow_SetVt
{
    if(getValue(E_pubc_GW_GW_3C2_HU_Road_TrafficFlow_SetVt))
    {
        //update the signal value
        Msg_GW_3C2.HU_Road_TrafficFlow=getvalue(E_pubc_GW_GW_3C2_HU_Road_TrafficFlow_Vt);
    }
    else
    {
        Msg_GW_3C2.HU_Road_TrafficFlow=getValue(E_pubc_GW_GW_3C2_HU_Road_TrafficFlow_Rv);
    }
}
 
on envVar E_pubc_GW_GW_3C2_HU_RampSide_Rv
{
    int64 rawValue = 0ll;
    float rawValue_float = 0.0;
    float phyValue = 0.0;        

    //set the signal with updated raw value
    if(getValue(E_pubc_GW_GW_3C2_HU_RampSide_SetVt)==0)
    {
        rawValue = getvalue(this);
        if(chgEv_GW_3C2_HU_RampSide == 0)
        {
            //type conversion to float
            rawValue_float = rawValue;        
            // raw to physical conversion
            phyValue = ((rawValue_float *1)+(0));
            putValue(E_pubc_GW_GW_3C2_HU_RampSide_Pv, phyValue);
            chgEv_GW_3C2_HU_RampSide = 1;
        }
        else
        {
            chgEv_GW_3C2_HU_RampSide = 0;
        }    
        //update the signal value
        Msg_GW_3C2.HU_RampSide=rawValue;        
    }                                                                           
}

on envVar E_pubc_GW_GW_3C2_HU_RampSide_Pv
{
    int64 rawValue = 0ll;
    float phyValue = 0.0;
    
    //update the raw value with physical value 
    if(getValue(E_pubc_GW_GW_3C2_HU_RampSide_SetVt)==0)
    {
        if(chgEv_GW_3C2_HU_RampSide == 0)
        {
            phyValue = getvalue(this);
            // physical to raw conversion
            rawValue = ((phyValue -(0))/1);
            putValue(E_pubc_GW_GW_3C2_HU_RampSide_Rv, rawValue);
            chgEv_GW_3C2_HU_RampSide = 1;  
        }
        else
        {
            chgEv_GW_3C2_HU_RampSide = 0;
        }
    }
}

on envVar E_pubc_GW_GW_3C2_HU_RampSide_Vt
{
    qword rawValue = 0ll;
    if(getValue(E_pubc_GW_GW_3C2_HU_RampSide_SetVt))
    {
        //update the signal value
        Msg_GW_3C2.HU_RampSide=getValue(this);
    }
}

on envVar E_pubc_GW_GW_3C2_HU_RampSide_SetVt
{
    if(getValue(E_pubc_GW_GW_3C2_HU_RampSide_SetVt))
    {
        //update the signal value
        Msg_GW_3C2.HU_RampSide=getvalue(E_pubc_GW_GW_3C2_HU_RampSide_Vt);
    }
    else
    {
        Msg_GW_3C2.HU_RampSide=getValue(E_pubc_GW_GW_3C2_HU_RampSide_Rv);
    }
}
 
on envVar E_pubc_GW_GW_3C2_HU_To_Branch_Dis_Rv
{
    int64 rawValue = 0ll;
    float rawValue_float = 0.0;
    float phyValue = 0.0;        

    //set the signal with updated raw value
    if(getValue(E_pubc_GW_GW_3C2_HU_To_Branch_Dis_SetVt)==0)
    {
        rawValue = getvalue(this);
        if(chgEv_GW_3C2_HU_To_Branch_Dis == 0)
        {
            //type conversion to float
            rawValue_float = rawValue;        
            // raw to physical conversion
            phyValue = ((rawValue_float *10)+(0));
            putValue(E_pubc_GW_GW_3C2_HU_To_Branch_Dis_Pv, phyValue);
            chgEv_GW_3C2_HU_To_Branch_Dis = 1;
        }
        else
        {
            chgEv_GW_3C2_HU_To_Branch_Dis = 0;
        }    
        //update the signal value
        Msg_GW_3C2.HU_To_Branch_Dis=rawValue;        
    }                                                                           
}

on envVar E_pubc_GW_GW_3C2_HU_To_Branch_Dis_Pv
{
    int64 rawValue = 0ll;
    float phyValue = 0.0;
    
    //update the raw value with physical value 
    if(getValue(E_pubc_GW_GW_3C2_HU_To_Branch_Dis_SetVt)==0)
    {
        if(chgEv_GW_3C2_HU_To_Branch_Dis == 0)
        {
            phyValue = getvalue(this);
            // physical to raw conversion
            rawValue = ((phyValue -(0))/10);
            putValue(E_pubc_GW_GW_3C2_HU_To_Branch_Dis_Rv, rawValue);
            chgEv_GW_3C2_HU_To_Branch_Dis = 1;  
        }
        else
        {
            chgEv_GW_3C2_HU_To_Branch_Dis = 0;
        }
    }
}

on envVar E_pubc_GW_GW_3C2_HU_To_Branch_Dis_Vt
{
    qword rawValue = 0ll;
    if(getValue(E_pubc_GW_GW_3C2_HU_To_Branch_Dis_SetVt))
    {
        //update the signal value
        Msg_GW_3C2.HU_To_Branch_Dis=getValue(this);
    }
}

on envVar E_pubc_GW_GW_3C2_HU_To_Branch_Dis_SetVt
{
    if(getValue(E_pubc_GW_GW_3C2_HU_To_Branch_Dis_SetVt))
    {
        //update the signal value
        Msg_GW_3C2.HU_To_Branch_Dis=getvalue(E_pubc_GW_GW_3C2_HU_To_Branch_Dis_Vt);
    }
    else
    {
        Msg_GW_3C2.HU_To_Branch_Dis=getValue(E_pubc_GW_GW_3C2_HU_To_Branch_Dis_Rv);
    }
}
 
on envVar E_pubc_GW_GW_3C2_HU_FallingRockInfo_Rv
{
    int64 rawValue = 0ll;
    float rawValue_float = 0.0;
    float phyValue = 0.0;        

    //set the signal with updated raw value
    if(getValue(E_pubc_GW_GW_3C2_HU_FallingRockInfo_SetVt)==0)
    {
        rawValue = getvalue(this);
        if(chgEv_GW_3C2_HU_FallingRockInfo == 0)
        {
            //type conversion to float
            rawValue_float = rawValue;        
            // raw to physical conversion
            phyValue = ((rawValue_float *1)+(0));
            putValue(E_pubc_GW_GW_3C2_HU_FallingRockInfo_Pv, phyValue);
            chgEv_GW_3C2_HU_FallingRockInfo = 1;
        }
        else
        {
            chgEv_GW_3C2_HU_FallingRockInfo = 0;
        }    
        //update the signal value
        Msg_GW_3C2.HU_FallingRockInfo=rawValue;        
    }                                                                           
}

on envVar E_pubc_GW_GW_3C2_HU_FallingRockInfo_Pv
{
    int64 rawValue = 0ll;
    float phyValue = 0.0;
    
    //update the raw value with physical value 
    if(getValue(E_pubc_GW_GW_3C2_HU_FallingRockInfo_SetVt)==0)
    {
        if(chgEv_GW_3C2_HU_FallingRockInfo == 0)
        {
            phyValue = getvalue(this);
            // physical to raw conversion
            rawValue = ((phyValue -(0))/1);
            putValue(E_pubc_GW_GW_3C2_HU_FallingRockInfo_Rv, rawValue);
            chgEv_GW_3C2_HU_FallingRockInfo = 1;  
        }
        else
        {
            chgEv_GW_3C2_HU_FallingRockInfo = 0;
        }
    }
}

on envVar E_pubc_GW_GW_3C2_HU_FallingRockInfo_Vt
{
    qword rawValue = 0ll;
    if(getValue(E_pubc_GW_GW_3C2_HU_FallingRockInfo_SetVt))
    {
        //update the signal value
        Msg_GW_3C2.HU_FallingRockInfo=getValue(this);
    }
}

on envVar E_pubc_GW_GW_3C2_HU_FallingRockInfo_SetVt
{
    if(getValue(E_pubc_GW_GW_3C2_HU_FallingRockInfo_SetVt))
    {
        //update the signal value
        Msg_GW_3C2.HU_FallingRockInfo=getvalue(E_pubc_GW_GW_3C2_HU_FallingRockInfo_Vt);
    }
    else
    {
        Msg_GW_3C2.HU_FallingRockInfo=getValue(E_pubc_GW_GW_3C2_HU_FallingRockInfo_Rv);
    }
}
 
on envVar E_pubc_GW_GW_3C2_HU_To_TrafficAccident_Dis_Rv
{
    int64 rawValue = 0ll;
    float rawValue_float = 0.0;
    float phyValue = 0.0;        

    //set the signal with updated raw value
    if(getValue(E_pubc_GW_GW_3C2_HU_To_TrafficAccident_Dis_SetVt)==0)
    {
        rawValue = getvalue(this);
        if(chgEv_GW_3C2_HU_To_TrafficAccident_Dis == 0)
        {
            //type conversion to float
            rawValue_float = rawValue;        
            // raw to physical conversion
            phyValue = ((rawValue_float *10)+(0));
            putValue(E_pubc_GW_GW_3C2_HU_To_TrafficAccident_Dis_Pv, phyValue);
            chgEv_GW_3C2_HU_To_TrafficAccident_Dis = 1;
        }
        else
        {
            chgEv_GW_3C2_HU_To_TrafficAccident_Dis = 0;
        }    
        //update the signal value
        Msg_GW_3C2.HU_To_TrafficAccident_Dis=rawValue;        
    }                                                                           
}

on envVar E_pubc_GW_GW_3C2_HU_To_TrafficAccident_Dis_Pv
{
    int64 rawValue = 0ll;
    float phyValue = 0.0;
    
    //update the raw value with physical value 
    if(getValue(E_pubc_GW_GW_3C2_HU_To_TrafficAccident_Dis_SetVt)==0)
    {
        if(chgEv_GW_3C2_HU_To_TrafficAccident_Dis == 0)
        {
            phyValue = getvalue(this);
            // physical to raw conversion
            rawValue = ((phyValue -(0))/10);
            putValue(E_pubc_GW_GW_3C2_HU_To_TrafficAccident_Dis_Rv, rawValue);
            chgEv_GW_3C2_HU_To_TrafficAccident_Dis = 1;  
        }
        else
        {
            chgEv_GW_3C2_HU_To_TrafficAccident_Dis = 0;
        }
    }
}

on envVar E_pubc_GW_GW_3C2_HU_To_TrafficAccident_Dis_Vt
{
    qword rawValue = 0ll;
    if(getValue(E_pubc_GW_GW_3C2_HU_To_TrafficAccident_Dis_SetVt))
    {
        //update the signal value
        Msg_GW_3C2.HU_To_TrafficAccident_Dis=getValue(this);
    }
}

on envVar E_pubc_GW_GW_3C2_HU_To_TrafficAccident_Dis_SetVt
{
    if(getValue(E_pubc_GW_GW_3C2_HU_To_TrafficAccident_Dis_SetVt))
    {
        //update the signal value
        Msg_GW_3C2.HU_To_TrafficAccident_Dis=getvalue(E_pubc_GW_GW_3C2_HU_To_TrafficAccident_Dis_Vt);
    }
    else
    {
        Msg_GW_3C2.HU_To_TrafficAccident_Dis=getValue(E_pubc_GW_GW_3C2_HU_To_TrafficAccident_Dis_Rv);
    }
}
 
on envVar E_pubc_GW_GW_3C2_HU_MapDataUpdateStatus_Rv
{
    int64 rawValue = 0ll;
    float rawValue_float = 0.0;
    float phyValue = 0.0;        

    //set the signal with updated raw value
    if(getValue(E_pubc_GW_GW_3C2_HU_MapDataUpdateStatus_SetVt)==0)
    {
        rawValue = getvalue(this);
        if(chgEv_GW_3C2_HU_MapDataUpdateStatus == 0)
        {
            //type conversion to float
            rawValue_float = rawValue;        
            // raw to physical conversion
            phyValue = ((rawValue_float *1)+(0));
            putValue(E_pubc_GW_GW_3C2_HU_MapDataUpdateStatus_Pv, phyValue);
            chgEv_GW_3C2_HU_MapDataUpdateStatus = 1;
        }
        else
        {
            chgEv_GW_3C2_HU_MapDataUpdateStatus = 0;
        }    
        //update the signal value
        Msg_GW_3C2.HU_MapDataUpdateStatus=rawValue;        
    }                                                                           
}

on envVar E_pubc_GW_GW_3C2_HU_MapDataUpdateStatus_Pv
{
    int64 rawValue = 0ll;
    float phyValue = 0.0;
    
    //update the raw value with physical value 
    if(getValue(E_pubc_GW_GW_3C2_HU_MapDataUpdateStatus_SetVt)==0)
    {
        if(chgEv_GW_3C2_HU_MapDataUpdateStatus == 0)
        {
            phyValue = getvalue(this);
            // physical to raw conversion
            rawValue = ((phyValue -(0))/1);
            putValue(E_pubc_GW_GW_3C2_HU_MapDataUpdateStatus_Rv, rawValue);
            chgEv_GW_3C2_HU_MapDataUpdateStatus = 1;  
        }
        else
        {
            chgEv_GW_3C2_HU_MapDataUpdateStatus = 0;
        }
    }
}

on envVar E_pubc_GW_GW_3C2_HU_MapDataUpdateStatus_Vt
{
    qword rawValue = 0ll;
    if(getValue(E_pubc_GW_GW_3C2_HU_MapDataUpdateStatus_SetVt))
    {
        //update the signal value
        Msg_GW_3C2.HU_MapDataUpdateStatus=getValue(this);
    }
}

on envVar E_pubc_GW_GW_3C2_HU_MapDataUpdateStatus_SetVt
{
    if(getValue(E_pubc_GW_GW_3C2_HU_MapDataUpdateStatus_SetVt))
    {
        //update the signal value
        Msg_GW_3C2.HU_MapDataUpdateStatus=getvalue(E_pubc_GW_GW_3C2_HU_MapDataUpdateStatus_Vt);
    }
    else
    {
        Msg_GW_3C2.HU_MapDataUpdateStatus=getValue(E_pubc_GW_GW_3C2_HU_MapDataUpdateStatus_Rv);
    }
}
 
on envVar E_pubc_GW_GW_3C2_HU_Construction_Info_Rv
{
    int64 rawValue = 0ll;
    float rawValue_float = 0.0;
    float phyValue = 0.0;        

    //set the signal with updated raw value
    if(getValue(E_pubc_GW_GW_3C2_HU_Construction_Info_SetVt)==0)
    {
        rawValue = getvalue(this);
        if(chgEv_GW_3C2_HU_Construction_Info == 0)
        {
            //type conversion to float
            rawValue_float = rawValue;        
            // raw to physical conversion
            phyValue = ((rawValue_float *1)+(0));
            putValue(E_pubc_GW_GW_3C2_HU_Construction_Info_Pv, phyValue);
            chgEv_GW_3C2_HU_Construction_Info = 1;
        }
        else
        {
            chgEv_GW_3C2_HU_Construction_Info = 0;
        }    
        //update the signal value
        Msg_GW_3C2.HU_Construction_Info=rawValue;        
    }                                                                           
}

on envVar E_pubc_GW_GW_3C2_HU_Construction_Info_Pv
{
    int64 rawValue = 0ll;
    float phyValue = 0.0;
    
    //update the raw value with physical value 
    if(getValue(E_pubc_GW_GW_3C2_HU_Construction_Info_SetVt)==0)
    {
        if(chgEv_GW_3C2_HU_Construction_Info == 0)
        {
            phyValue = getvalue(this);
            // physical to raw conversion
            rawValue = ((phyValue -(0))/1);
            putValue(E_pubc_GW_GW_3C2_HU_Construction_Info_Rv, rawValue);
            chgEv_GW_3C2_HU_Construction_Info = 1;  
        }
        else
        {
            chgEv_GW_3C2_HU_Construction_Info = 0;
        }
    }
}

on envVar E_pubc_GW_GW_3C2_HU_Construction_Info_Vt
{
    qword rawValue = 0ll;
    if(getValue(E_pubc_GW_GW_3C2_HU_Construction_Info_SetVt))
    {
        //update the signal value
        Msg_GW_3C2.HU_Construction_Info=getValue(this);
    }
}

on envVar E_pubc_GW_GW_3C2_HU_Construction_Info_SetVt
{
    if(getValue(E_pubc_GW_GW_3C2_HU_Construction_Info_SetVt))
    {
        //update the signal value
        Msg_GW_3C2.HU_Construction_Info=getvalue(E_pubc_GW_GW_3C2_HU_Construction_Info_Vt);
    }
    else
    {
        Msg_GW_3C2.HU_Construction_Info=getValue(E_pubc_GW_GW_3C2_HU_Construction_Info_Rv);
    }
}
 
on envVar E_pubc_GW_GW_3C2_HU_To_Construction_Dis_Rv
{
    int64 rawValue = 0ll;
    float rawValue_float = 0.0;
    float phyValue = 0.0;        

    //set the signal with updated raw value
    if(getValue(E_pubc_GW_GW_3C2_HU_To_Construction_Dis_SetVt)==0)
    {
        rawValue = getvalue(this);
        if(chgEv_GW_3C2_HU_To_Construction_Dis == 0)
        {
            //type conversion to float
            rawValue_float = rawValue;        
            // raw to physical conversion
            phyValue = ((rawValue_float *10)+(0));
            putValue(E_pubc_GW_GW_3C2_HU_To_Construction_Dis_Pv, phyValue);
            chgEv_GW_3C2_HU_To_Construction_Dis = 1;
        }
        else
        {
            chgEv_GW_3C2_HU_To_Construction_Dis = 0;
        }    
        //update the signal value
        Msg_GW_3C2.HU_To_Construction_Dis=rawValue;        
    }                                                                           
}

on envVar E_pubc_GW_GW_3C2_HU_To_Construction_Dis_Pv
{
    int64 rawValue = 0ll;
    float phyValue = 0.0;
    
    //update the raw value with physical value 
    if(getValue(E_pubc_GW_GW_3C2_HU_To_Construction_Dis_SetVt)==0)
    {
        if(chgEv_GW_3C2_HU_To_Construction_Dis == 0)
        {
            phyValue = getvalue(this);
            // physical to raw conversion
            rawValue = ((phyValue -(0))/10);
            putValue(E_pubc_GW_GW_3C2_HU_To_Construction_Dis_Rv, rawValue);
            chgEv_GW_3C2_HU_To_Construction_Dis = 1;  
        }
        else
        {
            chgEv_GW_3C2_HU_To_Construction_Dis = 0;
        }
    }
}

on envVar E_pubc_GW_GW_3C2_HU_To_Construction_Dis_Vt
{
    qword rawValue = 0ll;
    if(getValue(E_pubc_GW_GW_3C2_HU_To_Construction_Dis_SetVt))
    {
        //update the signal value
        Msg_GW_3C2.HU_To_Construction_Dis=getValue(this);
    }
}

on envVar E_pubc_GW_GW_3C2_HU_To_Construction_Dis_SetVt
{
    if(getValue(E_pubc_GW_GW_3C2_HU_To_Construction_Dis_SetVt))
    {
        //update the signal value
        Msg_GW_3C2.HU_To_Construction_Dis=getvalue(E_pubc_GW_GW_3C2_HU_To_Construction_Dis_Vt);
    }
    else
    {
        Msg_GW_3C2.HU_To_Construction_Dis=getValue(E_pubc_GW_GW_3C2_HU_To_Construction_Dis_Rv);
    }
}
 
on envVar E_pubc_GW_GW_3C2_HU_LaneCnt_Rv
{
    int64 rawValue = 0ll;
    float rawValue_float = 0.0;
    float phyValue = 0.0;        

    //set the signal with updated raw value
    if(getValue(E_pubc_GW_GW_3C2_HU_LaneCnt_SetVt)==0)
    {
        rawValue = getvalue(this);
        if(chgEv_GW_3C2_HU_LaneCnt == 0)
        {
            //type conversion to float
            rawValue_float = rawValue;        
            // raw to physical conversion
            phyValue = ((rawValue_float *1)+(0));
            putValue(E_pubc_GW_GW_3C2_HU_LaneCnt_Pv, phyValue);
            chgEv_GW_3C2_HU_LaneCnt = 1;
        }
        else
        {
            chgEv_GW_3C2_HU_LaneCnt = 0;
        }    
        //update the signal value
        Msg_GW_3C2.HU_LaneCnt=rawValue;        
    }                                                                           
}

on envVar E_pubc_GW_GW_3C2_HU_LaneCnt_Pv
{
    int64 rawValue = 0ll;
    float phyValue = 0.0;
    
    //update the raw value with physical value 
    if(getValue(E_pubc_GW_GW_3C2_HU_LaneCnt_SetVt)==0)
    {
        if(chgEv_GW_3C2_HU_LaneCnt == 0)
        {
            phyValue = getvalue(this);
            // physical to raw conversion
            rawValue = ((phyValue -(0))/1);
            putValue(E_pubc_GW_GW_3C2_HU_LaneCnt_Rv, rawValue);
            chgEv_GW_3C2_HU_LaneCnt = 1;  
        }
        else
        {
            chgEv_GW_3C2_HU_LaneCnt = 0;
        }
    }
}

on envVar E_pubc_GW_GW_3C2_HU_LaneCnt_Vt
{
    qword rawValue = 0ll;
    if(getValue(E_pubc_GW_GW_3C2_HU_LaneCnt_SetVt))
    {
        //update the signal value
        Msg_GW_3C2.HU_LaneCnt=getValue(this);
    }
}

on envVar E_pubc_GW_GW_3C2_HU_LaneCnt_SetVt
{
    if(getValue(E_pubc_GW_GW_3C2_HU_LaneCnt_SetVt))
    {
        //update the signal value
        Msg_GW_3C2.HU_LaneCnt=getvalue(E_pubc_GW_GW_3C2_HU_LaneCnt_Vt);
    }
    else
    {
        Msg_GW_3C2.HU_LaneCnt=getValue(E_pubc_GW_GW_3C2_HU_LaneCnt_Rv);
    }
}
 
on envVar E_pubc_GW_GW_3C2_HU_TrafficAccident_Info_Rv
{
    int64 rawValue = 0ll;
    float rawValue_float = 0.0;
    float phyValue = 0.0;        

    //set the signal with updated raw value
    if(getValue(E_pubc_GW_GW_3C2_HU_TrafficAccident_Info_SetVt)==0)
    {
        rawValue = getvalue(this);
        if(chgEv_GW_3C2_HU_TrafficAccident_Info == 0)
        {
            //type conversion to float
            rawValue_float = rawValue;        
            // raw to physical conversion
            phyValue = ((rawValue_float *1)+(0));
            putValue(E_pubc_GW_GW_3C2_HU_TrafficAccident_Info_Pv, phyValue);
            chgEv_GW_3C2_HU_TrafficAccident_Info = 1;
        }
        else
        {
            chgEv_GW_3C2_HU_TrafficAccident_Info = 0;
        }    
        //update the signal value
        Msg_GW_3C2.HU_TrafficAccident_Info=rawValue;        
    }                                                                           
}

on envVar E_pubc_GW_GW_3C2_HU_TrafficAccident_Info_Pv
{
    int64 rawValue = 0ll;
    float phyValue = 0.0;
    
    //update the raw value with physical value 
    if(getValue(E_pubc_GW_GW_3C2_HU_TrafficAccident_Info_SetVt)==0)
    {
        if(chgEv_GW_3C2_HU_TrafficAccident_Info == 0)
        {
            phyValue = getvalue(this);
            // physical to raw conversion
            rawValue = ((phyValue -(0))/1);
            putValue(E_pubc_GW_GW_3C2_HU_TrafficAccident_Info_Rv, rawValue);
            chgEv_GW_3C2_HU_TrafficAccident_Info = 1;  
        }
        else
        {
            chgEv_GW_3C2_HU_TrafficAccident_Info = 0;
        }
    }
}

on envVar E_pubc_GW_GW_3C2_HU_TrafficAccident_Info_Vt
{
    qword rawValue = 0ll;
    if(getValue(E_pubc_GW_GW_3C2_HU_TrafficAccident_Info_SetVt))
    {
        //update the signal value
        Msg_GW_3C2.HU_TrafficAccident_Info=getValue(this);
    }
}

on envVar E_pubc_GW_GW_3C2_HU_TrafficAccident_Info_SetVt
{
    if(getValue(E_pubc_GW_GW_3C2_HU_TrafficAccident_Info_SetVt))
    {
        //update the signal value
        Msg_GW_3C2.HU_TrafficAccident_Info=getvalue(E_pubc_GW_GW_3C2_HU_TrafficAccident_Info_Vt);
    }
    else
    {
        Msg_GW_3C2.HU_TrafficAccident_Info=getValue(E_pubc_GW_GW_3C2_HU_TrafficAccident_Info_Rv);
    }
}
 
on envVar E_pubc_GW_GW_3C2_HU_ForwardRoadType_Rv
{
    int64 rawValue = 0ll;
    float rawValue_float = 0.0;
    float phyValue = 0.0;        

    //set the signal with updated raw value
    if(getValue(E_pubc_GW_GW_3C2_HU_ForwardRoadType_SetVt)==0)
    {
        rawValue = getvalue(this);
        if(chgEv_GW_3C2_HU_ForwardRoadType == 0)
        {
            //type conversion to float
            rawValue_float = rawValue;        
            // raw to physical conversion
            phyValue = ((rawValue_float *1)+(0));
            putValue(E_pubc_GW_GW_3C2_HU_ForwardRoadType_Pv, phyValue);
            chgEv_GW_3C2_HU_ForwardRoadType = 1;
        }
        else
        {
            chgEv_GW_3C2_HU_ForwardRoadType = 0;
        }    
        //update the signal value
        Msg_GW_3C2.HU_ForwardRoadType=rawValue;        
    }                                                                           
}

on envVar E_pubc_GW_GW_3C2_HU_ForwardRoadType_Pv
{
    int64 rawValue = 0ll;
    float phyValue = 0.0;
    
    //update the raw value with physical value 
    if(getValue(E_pubc_GW_GW_3C2_HU_ForwardRoadType_SetVt)==0)
    {
        if(chgEv_GW_3C2_HU_ForwardRoadType == 0)
        {
            phyValue = getvalue(this);
            // physical to raw conversion
            rawValue = ((phyValue -(0))/1);
            putValue(E_pubc_GW_GW_3C2_HU_ForwardRoadType_Rv, rawValue);
            chgEv_GW_3C2_HU_ForwardRoadType = 1;  
        }
        else
        {
            chgEv_GW_3C2_HU_ForwardRoadType = 0;
        }
    }
}

on envVar E_pubc_GW_GW_3C2_HU_ForwardRoadType_Vt
{
    qword rawValue = 0ll;
    if(getValue(E_pubc_GW_GW_3C2_HU_ForwardRoadType_SetVt))
    {
        //update the signal value
        Msg_GW_3C2.HU_ForwardRoadType=getValue(this);
    }
}

on envVar E_pubc_GW_GW_3C2_HU_ForwardRoadType_SetVt
{
    if(getValue(E_pubc_GW_GW_3C2_HU_ForwardRoadType_SetVt))
    {
        //update the signal value
        Msg_GW_3C2.HU_ForwardRoadType=getvalue(E_pubc_GW_GW_3C2_HU_ForwardRoadType_Vt);
    }
    else
    {
        Msg_GW_3C2.HU_ForwardRoadType=getValue(E_pubc_GW_GW_3C2_HU_ForwardRoadType_Rv);
    }
}
 
on envVar E_pubc_GW_GW_3C2_HU_FallingRockDi_Rv
{
    int64 rawValue = 0ll;
    float rawValue_float = 0.0;
    float phyValue = 0.0;        

    //set the signal with updated raw value
    if(getValue(E_pubc_GW_GW_3C2_HU_FallingRockDi_SetVt)==0)
    {
        rawValue = getvalue(this);
        if(chgEv_GW_3C2_HU_FallingRockDi == 0)
        {
            //type conversion to float
            rawValue_float = rawValue;        
            // raw to physical conversion
            phyValue = ((rawValue_float *10)+(0));
            putValue(E_pubc_GW_GW_3C2_HU_FallingRockDi_Pv, phyValue);
            chgEv_GW_3C2_HU_FallingRockDi = 1;
        }
        else
        {
            chgEv_GW_3C2_HU_FallingRockDi = 0;
        }    
        //update the signal value
        Msg_GW_3C2.HU_FallingRockDi=rawValue;        
    }                                                                           
}

on envVar E_pubc_GW_GW_3C2_HU_FallingRockDi_Pv
{
    int64 rawValue = 0ll;
    float phyValue = 0.0;
    
    //update the raw value with physical value 
    if(getValue(E_pubc_GW_GW_3C2_HU_FallingRockDi_SetVt)==0)
    {
        if(chgEv_GW_3C2_HU_FallingRockDi == 0)
        {
            phyValue = getvalue(this);
            // physical to raw conversion
            rawValue = ((phyValue -(0))/10);
            putValue(E_pubc_GW_GW_3C2_HU_FallingRockDi_Rv, rawValue);
            chgEv_GW_3C2_HU_FallingRockDi = 1;  
        }
        else
        {
            chgEv_GW_3C2_HU_FallingRockDi = 0;
        }
    }
}

on envVar E_pubc_GW_GW_3C2_HU_FallingRockDi_Vt
{
    qword rawValue = 0ll;
    if(getValue(E_pubc_GW_GW_3C2_HU_FallingRockDi_SetVt))
    {
        //update the signal value
        Msg_GW_3C2.HU_FallingRockDi=getValue(this);
    }
}

on envVar E_pubc_GW_GW_3C2_HU_FallingRockDi_SetVt
{
    if(getValue(E_pubc_GW_GW_3C2_HU_FallingRockDi_SetVt))
    {
        //update the signal value
        Msg_GW_3C2.HU_FallingRockDi=getvalue(E_pubc_GW_GW_3C2_HU_FallingRockDi_Vt);
    }
    else
    {
        Msg_GW_3C2.HU_FallingRockDi=getValue(E_pubc_GW_GW_3C2_HU_FallingRockDi_Rv);
    }
}
 
on envVar E_pubc_GW_GW_3C2_HU_TollInfo_Rv
{
    int64 rawValue = 0ll;
    float rawValue_float = 0.0;
    float phyValue = 0.0;        

    //set the signal with updated raw value
    if(getValue(E_pubc_GW_GW_3C2_HU_TollInfo_SetVt)==0)
    {
        rawValue = getvalue(this);
        if(chgEv_GW_3C2_HU_TollInfo == 0)
        {
            //type conversion to float
            rawValue_float = rawValue;        
            // raw to physical conversion
            phyValue = ((rawValue_float *1)+(0));
            putValue(E_pubc_GW_GW_3C2_HU_TollInfo_Pv, phyValue);
            chgEv_GW_3C2_HU_TollInfo = 1;
        }
        else
        {
            chgEv_GW_3C2_HU_TollInfo = 0;
        }    
        //update the signal value
        Msg_GW_3C2.HU_TollInfo=rawValue;        
    }                                                                           
}

on envVar E_pubc_GW_GW_3C2_HU_TollInfo_Pv
{
    int64 rawValue = 0ll;
    float phyValue = 0.0;
    
    //update the raw value with physical value 
    if(getValue(E_pubc_GW_GW_3C2_HU_TollInfo_SetVt)==0)
    {
        if(chgEv_GW_3C2_HU_TollInfo == 0)
        {
            phyValue = getvalue(this);
            // physical to raw conversion
            rawValue = ((phyValue -(0))/1);
            putValue(E_pubc_GW_GW_3C2_HU_TollInfo_Rv, rawValue);
            chgEv_GW_3C2_HU_TollInfo = 1;  
        }
        else
        {
            chgEv_GW_3C2_HU_TollInfo = 0;
        }
    }
}

on envVar E_pubc_GW_GW_3C2_HU_TollInfo_Vt
{
    qword rawValue = 0ll;
    if(getValue(E_pubc_GW_GW_3C2_HU_TollInfo_SetVt))
    {
        //update the signal value
        Msg_GW_3C2.HU_TollInfo=getValue(this);
    }
}

on envVar E_pubc_GW_GW_3C2_HU_TollInfo_SetVt
{
    if(getValue(E_pubc_GW_GW_3C2_HU_TollInfo_SetVt))
    {
        //update the signal value
        Msg_GW_3C2.HU_TollInfo=getvalue(E_pubc_GW_GW_3C2_HU_TollInfo_Vt);
    }
    else
    {
        Msg_GW_3C2.HU_TollInfo=getValue(E_pubc_GW_GW_3C2_HU_TollInfo_Rv);
    }
}
 
on envVar E_pubc_GW_GW_3C2_HU_TollDis_Rv
{
    int64 rawValue = 0ll;
    float rawValue_float = 0.0;
    float phyValue = 0.0;        

    //set the signal with updated raw value
    if(getValue(E_pubc_GW_GW_3C2_HU_TollDis_SetVt)==0)
    {
        rawValue = getvalue(this);
        if(chgEv_GW_3C2_HU_TollDis == 0)
        {
            //type conversion to float
            rawValue_float = rawValue;        
            // raw to physical conversion
            phyValue = ((rawValue_float *10)+(0));
            putValue(E_pubc_GW_GW_3C2_HU_TollDis_Pv, phyValue);
            chgEv_GW_3C2_HU_TollDis = 1;
        }
        else
        {
            chgEv_GW_3C2_HU_TollDis = 0;
        }    
        //update the signal value
        Msg_GW_3C2.HU_TollDis=rawValue;        
    }                                                                           
}

on envVar E_pubc_GW_GW_3C2_HU_TollDis_Pv
{
    int64 rawValue = 0ll;
    float phyValue = 0.0;
    
    //update the raw value with physical value 
    if(getValue(E_pubc_GW_GW_3C2_HU_TollDis_SetVt)==0)
    {
        if(chgEv_GW_3C2_HU_TollDis == 0)
        {
            phyValue = getvalue(this);
            // physical to raw conversion
            rawValue = ((phyValue -(0))/10);
            putValue(E_pubc_GW_GW_3C2_HU_TollDis_Rv, rawValue);
            chgEv_GW_3C2_HU_TollDis = 1;  
        }
        else
        {
            chgEv_GW_3C2_HU_TollDis = 0;
        }
    }
}

on envVar E_pubc_GW_GW_3C2_HU_TollDis_Vt
{
    qword rawValue = 0ll;
    if(getValue(E_pubc_GW_GW_3C2_HU_TollDis_SetVt))
    {
        //update the signal value
        Msg_GW_3C2.HU_TollDis=getValue(this);
    }
}

on envVar E_pubc_GW_GW_3C2_HU_TollDis_SetVt
{
    if(getValue(E_pubc_GW_GW_3C2_HU_TollDis_SetVt))
    {
        //update the signal value
        Msg_GW_3C2.HU_TollDis=getvalue(E_pubc_GW_GW_3C2_HU_TollDis_Vt);
    }
    else
    {
        Msg_GW_3C2.HU_TollDis=getValue(E_pubc_GW_GW_3C2_HU_TollDis_Rv);
    }
}
 

 
on envVar E_pubc_GW_GW_3AF_tx
{
    if(getValue(this))
    {       
        
        //update the BZ Signal
        if(GW_3AF_HU_RollingCounter_3AF_wrongvalctr == 0)
        {
            update_GW_3AF_HU_RollingCounter_3AF_counter();
            Msg_GW_3AF.HU_RollingCounter_3AF= GW_3AF_HU_RollingCounter_3AF_counter;
        }
        else if(GW_3AF_HU_RollingCounter_3AF_wrongvalctr > 0)
        {
			GW_3AF_HU_RollingCounter_3AF_counter=GW_3AF_HU_RollingCounter_3AF_counter + GW_3AF_HU_RollingCounter_3AF_wrongvalctr;
			 Msg_GW_3AF.HU_RollingCounter_3AF= GW_3AF_HU_RollingCounter_3AF_counter;
             /* GW_3AF_HU_RollingCounter_3AF_wrongvalctr--;
              // if counter becomes zero, update panel controller to zero
             if(GW_3AF_HU_RollingCounter_3AF_wrongvalctr == 0)
             {
                 putValue(E_pubc_GW_GW_3AF_HU_RollingCounter_3AF_wrongvalctr,0);
             } */
        }
        else
        {
            //do nothing
        }        
        //calculate the CRC CheckSum
        update_GW_3AF_CRC_CheckSum();

        output(Msg_GW_3AF);        
    }
}

on envVar E_pubc_GW_GW_3AF_Range
{
    qword rawstatus = 0ll;
    qword rawValue = 0ll;    
    
    rawstatus = getvalue(this);    
    // set all the signals with min raw /max raw /init raw
    switch (rawstatus) 
    {
     case(0) :
        rawValue= 0;
        putValue(E_pubc_GW_GW_3AF_HU_NavStatus_Rv, rawValue);
        rawValue= 0;
        putValue(E_pubc_GW_GW_3AF_HU_EnterCurveInfo_Rv, rawValue);
        rawValue= 0;
        putValue(E_pubc_GW_GW_3AF_HU_NavSpeedLimitType_Rv, rawValue);
        rawValue= 0;
        putValue(E_pubc_GW_GW_3AF_HU_NavCountryCode_Rv, rawValue);
        rawValue= 0;
        putValue(E_pubc_GW_GW_3AF_HU_NavSpeedLimitUnits_Rv, rawValue);
        rawValue= 0;
        putValue(E_pubc_GW_GW_3AF_HU_NavSpeedLimit_Rv, rawValue);
        rawValue= 0;
        putValue(E_pubc_GW_GW_3AF_HU_NavCurrentRoadType_Rv, rawValue);
        rawValue= 0;
        putValue(E_pubc_GW_GW_3AF_HU_CurveDistance_Rv, rawValue);
        rawValue= 0;
        putValue(E_pubc_GW_GW_3AF_HU_RampDistance_Rv, rawValue);
        rawValue= 0;
        putValue(E_pubc_GW_GW_3AF_HU_NavSpeedLimitStatus_Rv, rawValue);
        rawValue= 0;
        putValue(E_pubc_GW_GW_3AF_HU_RampInfo_Rv, rawValue);
        rawValue= 0;
        putValue(E_pubc_GW_GW_3AF_HU_EnterRampInfo_Rv, rawValue);
        break;
     case(1) :
        rawValue= 1;
        putValue(E_pubc_GW_GW_3AF_HU_NavStatus_Rv, rawValue);
        rawValue= 3;
        putValue(E_pubc_GW_GW_3AF_HU_EnterCurveInfo_Rv, rawValue);
        rawValue= 3;
        putValue(E_pubc_GW_GW_3AF_HU_NavSpeedLimitType_Rv, rawValue);
        rawValue= 255;
        putValue(E_pubc_GW_GW_3AF_HU_NavCountryCode_Rv, rawValue);
        rawValue= 3;
        putValue(E_pubc_GW_GW_3AF_HU_NavSpeedLimitUnits_Rv, rawValue);
        rawValue= 255;
        putValue(E_pubc_GW_GW_3AF_HU_NavSpeedLimit_Rv, rawValue);
        rawValue= 7;
        putValue(E_pubc_GW_GW_3AF_HU_NavCurrentRoadType_Rv, rawValue);
        rawValue= 60;
        putValue(E_pubc_GW_GW_3AF_HU_CurveDistance_Rv, rawValue);
        rawValue= 300;
        putValue(E_pubc_GW_GW_3AF_HU_RampDistance_Rv, rawValue);
        rawValue= 3;
        putValue(E_pubc_GW_GW_3AF_HU_NavSpeedLimitStatus_Rv, rawValue);
        rawValue= 3;
        putValue(E_pubc_GW_GW_3AF_HU_RampInfo_Rv, rawValue);
        rawValue= 3;
        putValue(E_pubc_GW_GW_3AF_HU_EnterRampInfo_Rv, rawValue);
        break;
     default :
        rawValue= 0;
        putValue(E_pubc_GW_GW_3AF_HU_NavStatus_Rv, rawValue);
        rawValue= 0;
        putValue(E_pubc_GW_GW_3AF_HU_EnterCurveInfo_Rv, rawValue);
        rawValue= 0;
        putValue(E_pubc_GW_GW_3AF_HU_NavSpeedLimitType_Rv, rawValue);
        rawValue= 0;
        putValue(E_pubc_GW_GW_3AF_HU_NavCountryCode_Rv, rawValue);
        rawValue= 0;
        putValue(E_pubc_GW_GW_3AF_HU_NavSpeedLimitUnits_Rv, rawValue);
        rawValue= 0;
        putValue(E_pubc_GW_GW_3AF_HU_NavSpeedLimit_Rv, rawValue);
        rawValue= 0;
        putValue(E_pubc_GW_GW_3AF_HU_NavCurrentRoadType_Rv, rawValue);
        rawValue= 0;
        putValue(E_pubc_GW_GW_3AF_HU_CurveDistance_Rv, rawValue);
        rawValue= 0;
        putValue(E_pubc_GW_GW_3AF_HU_RampDistance_Rv, rawValue);
        rawValue= 0;
        putValue(E_pubc_GW_GW_3AF_HU_NavSpeedLimitStatus_Rv, rawValue);
        rawValue= 0;
        putValue(E_pubc_GW_GW_3AF_HU_RampInfo_Rv, rawValue);
        rawValue= 0;
        putValue(E_pubc_GW_GW_3AF_HU_EnterRampInfo_Rv, rawValue);
      break;
   }
}

on envVar E_pubc_GW_GW_3AF_Dlc
{
    if(getValue(E_pubc_GW_GW_3AF_enDlc))
    {
        Msg_GW_3AF.dlc =getValue(this);
    }
    else
    {
        Msg_GW_3AF.dlc =8;
    }
}

on envVar E_pubc_GW_GW_3AF_enDlc
{
    //For Messages with DLC = 8, set wrong DLC to smaller than defined DLC
    //For Messages with DLC < 8 set wrong DLC to smaller/longer than defined DLC
    if(getValue(this))
    {
        Msg_GW_3AF.dlc =getValue(E_pubc_GW_GW_3AF_Dlc);
    }
    else
    {
        Msg_GW_3AF.dlc =8;
    }
}

on envVar E_pubc_GW_GW_3AF_HU_CRCCheck_3AF_wrongvalctr
{
    //update disturb count
    //disturb value range:(-1 = always send wrong value),( X>0 ,x is the number of Messages with wrong CHK sent)
    GW_3AF_HU_CRCCheck_3AF_wrongvalctr =getValue(this);    
}
on envVar E_pubc_GW_GW_3AF_HU_RollingCounter_3AF_wrongvalctr
{
    //update disturb count
    //disturb value range:(-1 = always send wrong value),( X>0 ,x is the number of Messages with wrong CHK sent)
    GW_3AF_HU_RollingCounter_3AF_wrongvalctr =getValue(this);    
}

on envVar E_pubc_GW_GW_3AF_HU_NavStatus_Rv
{
    int64 rawValue = 0ll;
    float rawValue_float = 0.0;
    float phyValue = 0.0;        

    //set the signal with updated raw value
    if(getValue(E_pubc_GW_GW_3AF_HU_NavStatus_SetVt)==0)
    {
        rawValue = getvalue(this);
        if(chgEv_GW_3AF_HU_NavStatus == 0)
        {
            //type conversion to float
            rawValue_float = rawValue;        
            // raw to physical conversion
            phyValue = ((rawValue_float *1)+(0));
            putValue(E_pubc_GW_GW_3AF_HU_NavStatus_Pv, phyValue);
            chgEv_GW_3AF_HU_NavStatus = 1;
        }
        else
        {
            chgEv_GW_3AF_HU_NavStatus = 0;
        }    
        //update the signal value
        Msg_GW_3AF.HU_NavStatus=rawValue;        
    }                                                                           
}

on envVar E_pubc_GW_GW_3AF_HU_NavStatus_Pv
{
    int64 rawValue = 0ll;
    float phyValue = 0.0;
    
    //update the raw value with physical value 
    if(getValue(E_pubc_GW_GW_3AF_HU_NavStatus_SetVt)==0)
    {
        if(chgEv_GW_3AF_HU_NavStatus == 0)
        {
            phyValue = getvalue(this);
            // physical to raw conversion
            rawValue = ((phyValue -(0))/1);
            putValue(E_pubc_GW_GW_3AF_HU_NavStatus_Rv, rawValue);
            chgEv_GW_3AF_HU_NavStatus = 1;  
        }
        else
        {
            chgEv_GW_3AF_HU_NavStatus = 0;
        }
    }
}

on envVar E_pubc_GW_GW_3AF_HU_NavStatus_Vt
{
    qword rawValue = 0ll;
    if(getValue(E_pubc_GW_GW_3AF_HU_NavStatus_SetVt))
    {
        //update the signal value
        Msg_GW_3AF.HU_NavStatus=getValue(this);
    }
}

on envVar E_pubc_GW_GW_3AF_HU_NavStatus_SetVt
{
    if(getValue(E_pubc_GW_GW_3AF_HU_NavStatus_SetVt))
    {
        //update the signal value
        Msg_GW_3AF.HU_NavStatus=getvalue(E_pubc_GW_GW_3AF_HU_NavStatus_Vt);
    }
    else
    {
        Msg_GW_3AF.HU_NavStatus=getValue(E_pubc_GW_GW_3AF_HU_NavStatus_Rv);
    }
}
 
on envVar E_pubc_GW_GW_3AF_HU_EnterCurveInfo_Rv
{
    int64 rawValue = 0ll;
    float rawValue_float = 0.0;
    float phyValue = 0.0;        

    //set the signal with updated raw value
    if(getValue(E_pubc_GW_GW_3AF_HU_EnterCurveInfo_SetVt)==0)
    {
        rawValue = getvalue(this);
        if(chgEv_GW_3AF_HU_EnterCurveInfo == 0)
        {
            //type conversion to float
            rawValue_float = rawValue;        
            // raw to physical conversion
            phyValue = ((rawValue_float *1)+(0));
            putValue(E_pubc_GW_GW_3AF_HU_EnterCurveInfo_Pv, phyValue);
            chgEv_GW_3AF_HU_EnterCurveInfo = 1;
        }
        else
        {
            chgEv_GW_3AF_HU_EnterCurveInfo = 0;
        }    
        //update the signal value
        Msg_GW_3AF.HU_EnterCurveInfo=rawValue;        
    }                                                                           
}

on envVar E_pubc_GW_GW_3AF_HU_EnterCurveInfo_Pv
{
    int64 rawValue = 0ll;
    float phyValue = 0.0;
    
    //update the raw value with physical value 
    if(getValue(E_pubc_GW_GW_3AF_HU_EnterCurveInfo_SetVt)==0)
    {
        if(chgEv_GW_3AF_HU_EnterCurveInfo == 0)
        {
            phyValue = getvalue(this);
            // physical to raw conversion
            rawValue = ((phyValue -(0))/1);
            putValue(E_pubc_GW_GW_3AF_HU_EnterCurveInfo_Rv, rawValue);
            chgEv_GW_3AF_HU_EnterCurveInfo = 1;  
        }
        else
        {
            chgEv_GW_3AF_HU_EnterCurveInfo = 0;
        }
    }
}

on envVar E_pubc_GW_GW_3AF_HU_EnterCurveInfo_Vt
{
    qword rawValue = 0ll;
    if(getValue(E_pubc_GW_GW_3AF_HU_EnterCurveInfo_SetVt))
    {
        //update the signal value
        Msg_GW_3AF.HU_EnterCurveInfo=getValue(this);
    }
}

on envVar E_pubc_GW_GW_3AF_HU_EnterCurveInfo_SetVt
{
    if(getValue(E_pubc_GW_GW_3AF_HU_EnterCurveInfo_SetVt))
    {
        //update the signal value
        Msg_GW_3AF.HU_EnterCurveInfo=getvalue(E_pubc_GW_GW_3AF_HU_EnterCurveInfo_Vt);
    }
    else
    {
        Msg_GW_3AF.HU_EnterCurveInfo=getValue(E_pubc_GW_GW_3AF_HU_EnterCurveInfo_Rv);
    }
}
 
on envVar E_pubc_GW_GW_3AF_HU_NavSpeedLimitType_Rv
{
    int64 rawValue = 0ll;
    float rawValue_float = 0.0;
    float phyValue = 0.0;        

    //set the signal with updated raw value
    if(getValue(E_pubc_GW_GW_3AF_HU_NavSpeedLimitType_SetVt)==0)
    {
        rawValue = getvalue(this);
        if(chgEv_GW_3AF_HU_NavSpeedLimitType == 0)
        {
            //type conversion to float
            rawValue_float = rawValue;        
            // raw to physical conversion
            phyValue = ((rawValue_float *1)+(0));
            putValue(E_pubc_GW_GW_3AF_HU_NavSpeedLimitType_Pv, phyValue);
            chgEv_GW_3AF_HU_NavSpeedLimitType = 1;
        }
        else
        {
            chgEv_GW_3AF_HU_NavSpeedLimitType = 0;
        }    
        //update the signal value
        Msg_GW_3AF.HU_NavSpeedLimitType=rawValue;        
    }                                                                           
}

on envVar E_pubc_GW_GW_3AF_HU_NavSpeedLimitType_Pv
{
    int64 rawValue = 0ll;
    float phyValue = 0.0;
    
    //update the raw value with physical value 
    if(getValue(E_pubc_GW_GW_3AF_HU_NavSpeedLimitType_SetVt)==0)
    {
        if(chgEv_GW_3AF_HU_NavSpeedLimitType == 0)
        {
            phyValue = getvalue(this);
            // physical to raw conversion
            rawValue = ((phyValue -(0))/1);
            putValue(E_pubc_GW_GW_3AF_HU_NavSpeedLimitType_Rv, rawValue);
            chgEv_GW_3AF_HU_NavSpeedLimitType = 1;  
        }
        else
        {
            chgEv_GW_3AF_HU_NavSpeedLimitType = 0;
        }
    }
}

on envVar E_pubc_GW_GW_3AF_HU_NavSpeedLimitType_Vt
{
    qword rawValue = 0ll;
    if(getValue(E_pubc_GW_GW_3AF_HU_NavSpeedLimitType_SetVt))
    {
        //update the signal value
        Msg_GW_3AF.HU_NavSpeedLimitType=getValue(this);
    }
}

on envVar E_pubc_GW_GW_3AF_HU_NavSpeedLimitType_SetVt
{
    if(getValue(E_pubc_GW_GW_3AF_HU_NavSpeedLimitType_SetVt))
    {
        //update the signal value
        Msg_GW_3AF.HU_NavSpeedLimitType=getvalue(E_pubc_GW_GW_3AF_HU_NavSpeedLimitType_Vt);
    }
    else
    {
        Msg_GW_3AF.HU_NavSpeedLimitType=getValue(E_pubc_GW_GW_3AF_HU_NavSpeedLimitType_Rv);
    }
}
 
on envVar E_pubc_GW_GW_3AF_HU_NavCountryCode_Rv
{
    int64 rawValue = 0ll;
    float rawValue_float = 0.0;
    float phyValue = 0.0;        

    //set the signal with updated raw value
    {
        rawValue = getvalue(this);
        if(chgEv_GW_3AF_HU_NavCountryCode == 0)
        {
            //type conversion to float
            rawValue_float = rawValue;        
            // raw to physical conversion
            phyValue = ((rawValue_float *1)+(0));
            putValue(E_pubc_GW_GW_3AF_HU_NavCountryCode_Pv, phyValue);
            chgEv_GW_3AF_HU_NavCountryCode = 1;
        }
        else
        {
            chgEv_GW_3AF_HU_NavCountryCode = 0;
        }    
        //update the signal value
        Msg_GW_3AF.HU_NavCountryCode=rawValue;        
    }                                                                           
}

on envVar E_pubc_GW_GW_3AF_HU_NavCountryCode_Pv
{
    int64 rawValue = 0ll;
    float phyValue = 0.0;
    
    //update the raw value with physical value 
    {
        if(chgEv_GW_3AF_HU_NavCountryCode == 0)
        {
            phyValue = getvalue(this);
            // physical to raw conversion
            rawValue = ((phyValue -(0))/1);
            putValue(E_pubc_GW_GW_3AF_HU_NavCountryCode_Rv, rawValue);
            chgEv_GW_3AF_HU_NavCountryCode = 1;  
        }
        else
        {
            chgEv_GW_3AF_HU_NavCountryCode = 0;
        }
    }
}


 
on envVar E_pubc_GW_GW_3AF_HU_NavSpeedLimitUnits_Rv
{
    int64 rawValue = 0ll;
    float rawValue_float = 0.0;
    float phyValue = 0.0;        

    //set the signal with updated raw value
    if(getValue(E_pubc_GW_GW_3AF_HU_NavSpeedLimitUnits_SetVt)==0)
    {
        rawValue = getvalue(this);
        if(chgEv_GW_3AF_HU_NavSpeedLimitUnits == 0)
        {
            //type conversion to float
            rawValue_float = rawValue;        
            // raw to physical conversion
            phyValue = ((rawValue_float *1)+(0));
            putValue(E_pubc_GW_GW_3AF_HU_NavSpeedLimitUnits_Pv, phyValue);
            chgEv_GW_3AF_HU_NavSpeedLimitUnits = 1;
        }
        else
        {
            chgEv_GW_3AF_HU_NavSpeedLimitUnits = 0;
        }    
        //update the signal value
        Msg_GW_3AF.HU_NavSpeedLimitUnits=rawValue;        
    }                                                                           
}

on envVar E_pubc_GW_GW_3AF_HU_NavSpeedLimitUnits_Pv
{
    int64 rawValue = 0ll;
    float phyValue = 0.0;
    
    //update the raw value with physical value 
    if(getValue(E_pubc_GW_GW_3AF_HU_NavSpeedLimitUnits_SetVt)==0)
    {
        if(chgEv_GW_3AF_HU_NavSpeedLimitUnits == 0)
        {
            phyValue = getvalue(this);
            // physical to raw conversion
            rawValue = ((phyValue -(0))/1);
            putValue(E_pubc_GW_GW_3AF_HU_NavSpeedLimitUnits_Rv, rawValue);
            chgEv_GW_3AF_HU_NavSpeedLimitUnits = 1;  
        }
        else
        {
            chgEv_GW_3AF_HU_NavSpeedLimitUnits = 0;
        }
    }
}

on envVar E_pubc_GW_GW_3AF_HU_NavSpeedLimitUnits_Vt
{
    qword rawValue = 0ll;
    if(getValue(E_pubc_GW_GW_3AF_HU_NavSpeedLimitUnits_SetVt))
    {
        //update the signal value
        Msg_GW_3AF.HU_NavSpeedLimitUnits=getValue(this);
    }
}

on envVar E_pubc_GW_GW_3AF_HU_NavSpeedLimitUnits_SetVt
{
    if(getValue(E_pubc_GW_GW_3AF_HU_NavSpeedLimitUnits_SetVt))
    {
        //update the signal value
        Msg_GW_3AF.HU_NavSpeedLimitUnits=getvalue(E_pubc_GW_GW_3AF_HU_NavSpeedLimitUnits_Vt);
    }
    else
    {
        Msg_GW_3AF.HU_NavSpeedLimitUnits=getValue(E_pubc_GW_GW_3AF_HU_NavSpeedLimitUnits_Rv);
    }
}
 
on envVar E_pubc_GW_GW_3AF_HU_NavSpeedLimit_Rv
{
    int64 rawValue = 0ll;
    float rawValue_float = 0.0;
    float phyValue = 0.0;        

    //set the signal with updated raw value
    if(getValue(E_pubc_GW_GW_3AF_HU_NavSpeedLimit_SetVt)==0)
    {
        rawValue = getvalue(this);
        if(chgEv_GW_3AF_HU_NavSpeedLimit == 0)
        {
            //type conversion to float
            rawValue_float = rawValue;        
            // raw to physical conversion
            phyValue = ((rawValue_float *1)+(0));
            putValue(E_pubc_GW_GW_3AF_HU_NavSpeedLimit_Pv, phyValue);
            chgEv_GW_3AF_HU_NavSpeedLimit = 1;
        }
        else
        {
            chgEv_GW_3AF_HU_NavSpeedLimit = 0;
        }    
        //update the signal value
        Msg_GW_3AF.HU_NavSpeedLimit=rawValue;        
    }                                                                           
}

on envVar E_pubc_GW_GW_3AF_HU_NavSpeedLimit_Pv
{
    int64 rawValue = 0ll;
    float phyValue = 0.0;
    
    //update the raw value with physical value 
    if(getValue(E_pubc_GW_GW_3AF_HU_NavSpeedLimit_SetVt)==0)
    {
        if(chgEv_GW_3AF_HU_NavSpeedLimit == 0)
        {
            phyValue = getvalue(this);
            // physical to raw conversion
            rawValue = ((phyValue -(0))/1);
            putValue(E_pubc_GW_GW_3AF_HU_NavSpeedLimit_Rv, rawValue);
            chgEv_GW_3AF_HU_NavSpeedLimit = 1;  
        }
        else
        {
            chgEv_GW_3AF_HU_NavSpeedLimit = 0;
        }
    }
}

on envVar E_pubc_GW_GW_3AF_HU_NavSpeedLimit_Vt
{
    qword rawValue = 0ll;
    if(getValue(E_pubc_GW_GW_3AF_HU_NavSpeedLimit_SetVt))
    {
        //update the signal value
        Msg_GW_3AF.HU_NavSpeedLimit=getValue(this);
    }
}

on envVar E_pubc_GW_GW_3AF_HU_NavSpeedLimit_SetVt
{
    if(getValue(E_pubc_GW_GW_3AF_HU_NavSpeedLimit_SetVt))
    {
        //update the signal value
        Msg_GW_3AF.HU_NavSpeedLimit=getvalue(E_pubc_GW_GW_3AF_HU_NavSpeedLimit_Vt);
    }
    else
    {
        Msg_GW_3AF.HU_NavSpeedLimit=getValue(E_pubc_GW_GW_3AF_HU_NavSpeedLimit_Rv);
    }
}
 
on envVar E_pubc_GW_GW_3AF_HU_NavCurrentRoadType_Rv
{
    int64 rawValue = 0ll;
    float rawValue_float = 0.0;
    float phyValue = 0.0;        

    //set the signal with updated raw value
    if(getValue(E_pubc_GW_GW_3AF_HU_NavCurrentRoadType_SetVt)==0)
    {
        rawValue = getvalue(this);
        if(chgEv_GW_3AF_HU_NavCurrentRoadType == 0)
        {
            //type conversion to float
            rawValue_float = rawValue;        
            // raw to physical conversion
            phyValue = ((rawValue_float *1)+(0));
            putValue(E_pubc_GW_GW_3AF_HU_NavCurrentRoadType_Pv, phyValue);
            chgEv_GW_3AF_HU_NavCurrentRoadType = 1;
        }
        else
        {
            chgEv_GW_3AF_HU_NavCurrentRoadType = 0;
        }    
        //update the signal value
        Msg_GW_3AF.HU_NavCurrentRoadType=rawValue;        
    }                                                                           
}

on envVar E_pubc_GW_GW_3AF_HU_NavCurrentRoadType_Pv
{
    int64 rawValue = 0ll;
    float phyValue = 0.0;
    
    //update the raw value with physical value 
    if(getValue(E_pubc_GW_GW_3AF_HU_NavCurrentRoadType_SetVt)==0)
    {
        if(chgEv_GW_3AF_HU_NavCurrentRoadType == 0)
        {
            phyValue = getvalue(this);
            // physical to raw conversion
            rawValue = ((phyValue -(0))/1);
            putValue(E_pubc_GW_GW_3AF_HU_NavCurrentRoadType_Rv, rawValue);
            chgEv_GW_3AF_HU_NavCurrentRoadType = 1;  
        }
        else
        {
            chgEv_GW_3AF_HU_NavCurrentRoadType = 0;
        }
    }
}

on envVar E_pubc_GW_GW_3AF_HU_NavCurrentRoadType_Vt
{
    qword rawValue = 0ll;
    if(getValue(E_pubc_GW_GW_3AF_HU_NavCurrentRoadType_SetVt))
    {
        //update the signal value
        Msg_GW_3AF.HU_NavCurrentRoadType=getValue(this);
    }
}

on envVar E_pubc_GW_GW_3AF_HU_NavCurrentRoadType_SetVt
{
    if(getValue(E_pubc_GW_GW_3AF_HU_NavCurrentRoadType_SetVt))
    {
        //update the signal value
        Msg_GW_3AF.HU_NavCurrentRoadType=getvalue(E_pubc_GW_GW_3AF_HU_NavCurrentRoadType_Vt);
    }
    else
    {
        Msg_GW_3AF.HU_NavCurrentRoadType=getValue(E_pubc_GW_GW_3AF_HU_NavCurrentRoadType_Rv);
    }
}
 
on envVar E_pubc_GW_GW_3AF_HU_CurveDistance_Rv
{
    int64 rawValue = 0ll;
    float rawValue_float = 0.0;
    float phyValue = 0.0;        

    //set the signal with updated raw value
    if(getValue(E_pubc_GW_GW_3AF_HU_CurveDistance_SetVt)==0)
    {
        rawValue = getvalue(this);
        if(chgEv_GW_3AF_HU_CurveDistance == 0)
        {
            //type conversion to float
            rawValue_float = rawValue;        
            // raw to physical conversion
            phyValue = ((rawValue_float *10)+(0));
            putValue(E_pubc_GW_GW_3AF_HU_CurveDistance_Pv, phyValue);
            chgEv_GW_3AF_HU_CurveDistance = 1;
        }
        else
        {
            chgEv_GW_3AF_HU_CurveDistance = 0;
        }    
        //update the signal value
        Msg_GW_3AF.HU_CurveDistance=rawValue;        
    }                                                                           
}

on envVar E_pubc_GW_GW_3AF_HU_CurveDistance_Pv
{
    int64 rawValue = 0ll;
    float phyValue = 0.0;
    
    //update the raw value with physical value 
    if(getValue(E_pubc_GW_GW_3AF_HU_CurveDistance_SetVt)==0)
    {
        if(chgEv_GW_3AF_HU_CurveDistance == 0)
        {
            phyValue = getvalue(this);
            // physical to raw conversion
            rawValue = ((phyValue -(0))/10);
            putValue(E_pubc_GW_GW_3AF_HU_CurveDistance_Rv, rawValue);
            chgEv_GW_3AF_HU_CurveDistance = 1;  
        }
        else
        {
            chgEv_GW_3AF_HU_CurveDistance = 0;
        }
    }
}

on envVar E_pubc_GW_GW_3AF_HU_CurveDistance_Vt
{
    qword rawValue = 0ll;
    if(getValue(E_pubc_GW_GW_3AF_HU_CurveDistance_SetVt))
    {
        //update the signal value
        Msg_GW_3AF.HU_CurveDistance=getValue(this);
    }
}

on envVar E_pubc_GW_GW_3AF_HU_CurveDistance_SetVt
{
    if(getValue(E_pubc_GW_GW_3AF_HU_CurveDistance_SetVt))
    {
        //update the signal value
        Msg_GW_3AF.HU_CurveDistance=getvalue(E_pubc_GW_GW_3AF_HU_CurveDistance_Vt);
    }
    else
    {
        Msg_GW_3AF.HU_CurveDistance=getValue(E_pubc_GW_GW_3AF_HU_CurveDistance_Rv);
    }
}
 
on envVar E_pubc_GW_GW_3AF_HU_RampDistance_Rv
{
    int64 rawValue = 0ll;
    float rawValue_float = 0.0;
    float phyValue = 0.0;        

    //set the signal with updated raw value
    if(getValue(E_pubc_GW_GW_3AF_HU_RampDistance_SetVt)==0)
    {
        rawValue = getvalue(this);
        if(chgEv_GW_3AF_HU_RampDistance == 0)
        {
            //type conversion to float
            rawValue_float = rawValue;        
            // raw to physical conversion
            phyValue = ((rawValue_float *10)+(0));
            putValue(E_pubc_GW_GW_3AF_HU_RampDistance_Pv, phyValue);
            chgEv_GW_3AF_HU_RampDistance = 1;
        }
        else
        {
            chgEv_GW_3AF_HU_RampDistance = 0;
        }    
        //update the signal value
        Msg_GW_3AF.HU_RampDistance=rawValue;        
    }                                                                           
}

on envVar E_pubc_GW_GW_3AF_HU_RampDistance_Pv
{
    int64 rawValue = 0ll;
    float phyValue = 0.0;
    
    //update the raw value with physical value 
    if(getValue(E_pubc_GW_GW_3AF_HU_RampDistance_SetVt)==0)
    {
        if(chgEv_GW_3AF_HU_RampDistance == 0)
        {
            phyValue = getvalue(this);
            // physical to raw conversion
            rawValue = ((phyValue -(0))/10);
            putValue(E_pubc_GW_GW_3AF_HU_RampDistance_Rv, rawValue);
            chgEv_GW_3AF_HU_RampDistance = 1;  
        }
        else
        {
            chgEv_GW_3AF_HU_RampDistance = 0;
        }
    }
}

on envVar E_pubc_GW_GW_3AF_HU_RampDistance_Vt
{
    qword rawValue = 0ll;
    if(getValue(E_pubc_GW_GW_3AF_HU_RampDistance_SetVt))
    {
        //update the signal value
        Msg_GW_3AF.HU_RampDistance=getValue(this);
    }
}

on envVar E_pubc_GW_GW_3AF_HU_RampDistance_SetVt
{
    if(getValue(E_pubc_GW_GW_3AF_HU_RampDistance_SetVt))
    {
        //update the signal value
        Msg_GW_3AF.HU_RampDistance=getvalue(E_pubc_GW_GW_3AF_HU_RampDistance_Vt);
    }
    else
    {
        Msg_GW_3AF.HU_RampDistance=getValue(E_pubc_GW_GW_3AF_HU_RampDistance_Rv);
    }
}
 
on envVar E_pubc_GW_GW_3AF_HU_NavSpeedLimitStatus_Rv
{
    int64 rawValue = 0ll;
    float rawValue_float = 0.0;
    float phyValue = 0.0;        

    //set the signal with updated raw value
    if(getValue(E_pubc_GW_GW_3AF_HU_NavSpeedLimitStatus_SetVt)==0)
    {
        rawValue = getvalue(this);
        if(chgEv_GW_3AF_HU_NavSpeedLimitStatus == 0)
        {
            //type conversion to float
            rawValue_float = rawValue;        
            // raw to physical conversion
            phyValue = ((rawValue_float *1)+(0));
            putValue(E_pubc_GW_GW_3AF_HU_NavSpeedLimitStatus_Pv, phyValue);
            chgEv_GW_3AF_HU_NavSpeedLimitStatus = 1;
        }
        else
        {
            chgEv_GW_3AF_HU_NavSpeedLimitStatus = 0;
        }    
        //update the signal value
        Msg_GW_3AF.HU_NavSpeedLimitStatus=rawValue;        
    }                                                                           
}

on envVar E_pubc_GW_GW_3AF_HU_NavSpeedLimitStatus_Pv
{
    int64 rawValue = 0ll;
    float phyValue = 0.0;
    
    //update the raw value with physical value 
    if(getValue(E_pubc_GW_GW_3AF_HU_NavSpeedLimitStatus_SetVt)==0)
    {
        if(chgEv_GW_3AF_HU_NavSpeedLimitStatus == 0)
        {
            phyValue = getvalue(this);
            // physical to raw conversion
            rawValue = ((phyValue -(0))/1);
            putValue(E_pubc_GW_GW_3AF_HU_NavSpeedLimitStatus_Rv, rawValue);
            chgEv_GW_3AF_HU_NavSpeedLimitStatus = 1;  
        }
        else
        {
            chgEv_GW_3AF_HU_NavSpeedLimitStatus = 0;
        }
    }
}

on envVar E_pubc_GW_GW_3AF_HU_NavSpeedLimitStatus_Vt
{
    qword rawValue = 0ll;
    if(getValue(E_pubc_GW_GW_3AF_HU_NavSpeedLimitStatus_SetVt))
    {
        //update the signal value
        Msg_GW_3AF.HU_NavSpeedLimitStatus=getValue(this);
    }
}

on envVar E_pubc_GW_GW_3AF_HU_NavSpeedLimitStatus_SetVt
{
    if(getValue(E_pubc_GW_GW_3AF_HU_NavSpeedLimitStatus_SetVt))
    {
        //update the signal value
        Msg_GW_3AF.HU_NavSpeedLimitStatus=getvalue(E_pubc_GW_GW_3AF_HU_NavSpeedLimitStatus_Vt);
    }
    else
    {
        Msg_GW_3AF.HU_NavSpeedLimitStatus=getValue(E_pubc_GW_GW_3AF_HU_NavSpeedLimitStatus_Rv);
    }
}
 
on envVar E_pubc_GW_GW_3AF_HU_RampInfo_Rv
{
    int64 rawValue = 0ll;
    float rawValue_float = 0.0;
    float phyValue = 0.0;        

    //set the signal with updated raw value
    if(getValue(E_pubc_GW_GW_3AF_HU_RampInfo_SetVt)==0)
    {
        rawValue = getvalue(this);
        if(chgEv_GW_3AF_HU_RampInfo == 0)
        {
            //type conversion to float
            rawValue_float = rawValue;        
            // raw to physical conversion
            phyValue = ((rawValue_float *1)+(0));
            putValue(E_pubc_GW_GW_3AF_HU_RampInfo_Pv, phyValue);
            chgEv_GW_3AF_HU_RampInfo = 1;
        }
        else
        {
            chgEv_GW_3AF_HU_RampInfo = 0;
        }    
        //update the signal value
        Msg_GW_3AF.HU_RampInfo=rawValue;        
    }                                                                           
}

on envVar E_pubc_GW_GW_3AF_HU_RampInfo_Pv
{
    int64 rawValue = 0ll;
    float phyValue = 0.0;
    
    //update the raw value with physical value 
    if(getValue(E_pubc_GW_GW_3AF_HU_RampInfo_SetVt)==0)
    {
        if(chgEv_GW_3AF_HU_RampInfo == 0)
        {
            phyValue = getvalue(this);
            // physical to raw conversion
            rawValue = ((phyValue -(0))/1);
            putValue(E_pubc_GW_GW_3AF_HU_RampInfo_Rv, rawValue);
            chgEv_GW_3AF_HU_RampInfo = 1;  
        }
        else
        {
            chgEv_GW_3AF_HU_RampInfo = 0;
        }
    }
}

on envVar E_pubc_GW_GW_3AF_HU_RampInfo_Vt
{
    qword rawValue = 0ll;
    if(getValue(E_pubc_GW_GW_3AF_HU_RampInfo_SetVt))
    {
        //update the signal value
        Msg_GW_3AF.HU_RampInfo=getValue(this);
    }
}

on envVar E_pubc_GW_GW_3AF_HU_RampInfo_SetVt
{
    if(getValue(E_pubc_GW_GW_3AF_HU_RampInfo_SetVt))
    {
        //update the signal value
        Msg_GW_3AF.HU_RampInfo=getvalue(E_pubc_GW_GW_3AF_HU_RampInfo_Vt);
    }
    else
    {
        Msg_GW_3AF.HU_RampInfo=getValue(E_pubc_GW_GW_3AF_HU_RampInfo_Rv);
    }
}
 
on envVar E_pubc_GW_GW_3AF_HU_EnterRampInfo_Rv
{
    int64 rawValue = 0ll;
    float rawValue_float = 0.0;
    float phyValue = 0.0;        

    //set the signal with updated raw value
    if(getValue(E_pubc_GW_GW_3AF_HU_EnterRampInfo_SetVt)==0)
    {
        rawValue = getvalue(this);
        if(chgEv_GW_3AF_HU_EnterRampInfo == 0)
        {
            //type conversion to float
            rawValue_float = rawValue;        
            // raw to physical conversion
            phyValue = ((rawValue_float *1)+(0));
            putValue(E_pubc_GW_GW_3AF_HU_EnterRampInfo_Pv, phyValue);
            chgEv_GW_3AF_HU_EnterRampInfo = 1;
        }
        else
        {
            chgEv_GW_3AF_HU_EnterRampInfo = 0;
        }    
        //update the signal value
        Msg_GW_3AF.HU_EnterRampInfo=rawValue;        
    }                                                                           
}

on envVar E_pubc_GW_GW_3AF_HU_EnterRampInfo_Pv
{
    int64 rawValue = 0ll;
    float phyValue = 0.0;
    
    //update the raw value with physical value 
    if(getValue(E_pubc_GW_GW_3AF_HU_EnterRampInfo_SetVt)==0)
    {
        if(chgEv_GW_3AF_HU_EnterRampInfo == 0)
        {
            phyValue = getvalue(this);
            // physical to raw conversion
            rawValue = ((phyValue -(0))/1);
            putValue(E_pubc_GW_GW_3AF_HU_EnterRampInfo_Rv, rawValue);
            chgEv_GW_3AF_HU_EnterRampInfo = 1;  
        }
        else
        {
            chgEv_GW_3AF_HU_EnterRampInfo = 0;
        }
    }
}

on envVar E_pubc_GW_GW_3AF_HU_EnterRampInfo_Vt
{
    qword rawValue = 0ll;
    if(getValue(E_pubc_GW_GW_3AF_HU_EnterRampInfo_SetVt))
    {
        //update the signal value
        Msg_GW_3AF.HU_EnterRampInfo=getValue(this);
    }
}

on envVar E_pubc_GW_GW_3AF_HU_EnterRampInfo_SetVt
{
    if(getValue(E_pubc_GW_GW_3AF_HU_EnterRampInfo_SetVt))
    {
        //update the signal value
        Msg_GW_3AF.HU_EnterRampInfo=getvalue(E_pubc_GW_GW_3AF_HU_EnterRampInfo_Vt);
    }
    else
    {
        Msg_GW_3AF.HU_EnterRampInfo=getValue(E_pubc_GW_GW_3AF_HU_EnterRampInfo_Rv);
    }
}
 
on envVar E_pubc_GW_GW_1A6_tx
{
    if(getValue(this))
    {       
        

        output(Msg_GW_1A6);        
    }
}

on envVar E_pubc_GW_GW_1A6_Range
{
    qword rawstatus = 0ll;
    qword rawValue = 0ll;    
    
    rawstatus = getvalue(this);    
    // set all the signals with min raw /max raw /init raw
    switch (rawstatus) 
    {
     case(0) :
        rawValue= 0;
        putValue(E_pubc_GW_GW_1A6_PCU_PwrTrainSts_Rv, rawValue);
        rawValue= 0;
        putValue(E_pubc_GW_GW_1A6_PCU_AccPedl_Rv, rawValue);
        break;
     case(1) :
        rawValue= 3;
        putValue(E_pubc_GW_GW_1A6_PCU_PwrTrainSts_Rv, rawValue);
        rawValue= 254;
        putValue(E_pubc_GW_GW_1A6_PCU_AccPedl_Rv, rawValue);
        break;
     default :
        rawValue= 0;
        putValue(E_pubc_GW_GW_1A6_PCU_PwrTrainSts_Rv, rawValue);
        rawValue= 0;
        putValue(E_pubc_GW_GW_1A6_PCU_AccPedl_Rv, rawValue);
      break;
   }
}

on envVar E_pubc_GW_GW_1A6_Dlc
{
    if(getValue(E_pubc_GW_GW_1A6_enDlc))
    {
        Msg_GW_1A6.dlc =getValue(this);
    }
    else
    {
        Msg_GW_1A6.dlc =8;
    }
}

on envVar E_pubc_GW_GW_1A6_enDlc
{
    //For Messages with DLC = 8, set wrong DLC to smaller than defined DLC
    //For Messages with DLC < 8 set wrong DLC to smaller/longer than defined DLC
    if(getValue(this))
    {
        Msg_GW_1A6.dlc =getValue(E_pubc_GW_GW_1A6_Dlc);
    }
    else
    {
        Msg_GW_1A6.dlc =8;
    }
}


on envVar E_pubc_GW_GW_1A6_PCU_PwrTrainSts_Rv
{
    int64 rawValue = 0ll;
    float rawValue_float = 0.0;
    float phyValue = 0.0;        

    //set the signal with updated raw value
    {
        rawValue = getvalue(this);
        if(chgEv_GW_1A6_PCU_PwrTrainSts == 0)
        {
            //type conversion to float
            rawValue_float = rawValue;        
            // raw to physical conversion
            phyValue = ((rawValue_float *1)+(0));
            putValue(E_pubc_GW_GW_1A6_PCU_PwrTrainSts_Pv, phyValue);
            chgEv_GW_1A6_PCU_PwrTrainSts = 1;
        }
        else
        {
            chgEv_GW_1A6_PCU_PwrTrainSts = 0;
        }    
        //update the signal value
        Msg_GW_1A6.PCU_PwrTrainSts=rawValue;        
    }                                                                           
}

on envVar E_pubc_GW_GW_1A6_PCU_PwrTrainSts_Pv
{
    int64 rawValue = 0ll;
    float phyValue = 0.0;
    
    //update the raw value with physical value 
    {
        if(chgEv_GW_1A6_PCU_PwrTrainSts == 0)
        {
            phyValue = getvalue(this);
            // physical to raw conversion
            rawValue = ((phyValue -(0))/1);
            putValue(E_pubc_GW_GW_1A6_PCU_PwrTrainSts_Rv, rawValue);
            chgEv_GW_1A6_PCU_PwrTrainSts = 1;  
        }
        else
        {
            chgEv_GW_1A6_PCU_PwrTrainSts = 0;
        }
    }
}


 
on envVar E_pubc_GW_GW_362_tx
{
    if(getValue(this))
    {       
        

        output(Msg_GW_362);        
    }
}

on envVar E_pubc_GW_GW_362_Range
{
    qword rawstatus = 0ll;
    qword rawValue = 0ll;    
    
    rawstatus = getvalue(this);    
    // set all the signals with min raw /max raw /init raw
    switch (rawstatus) 
    {
     case(0) :
        rawValue= 0;
        putValue(E_pubc_GW_GW_362_PCU_DrvMod_Rv, rawValue);
        break;
     case(1) :
        rawValue= 7;
        putValue(E_pubc_GW_GW_362_PCU_DrvMod_Rv, rawValue);
        break;
     default :
        rawValue= 0;
        putValue(E_pubc_GW_GW_362_PCU_DrvMod_Rv, rawValue);
      break;
   }
}

on envVar E_pubc_GW_GW_362_Dlc
{
    if(getValue(E_pubc_GW_GW_362_enDlc))
    {
        Msg_GW_362.dlc =getValue(this);
    }
    else
    {   
	   Msg_GW_362.dlc = 8;
	   	
  }
}

on envVar E_pubc_GW_GW_362_enDlc
{
    //For Messages with DLC = 8, set wrong DLC to smaller than defined DLC
    //For Messages with DLC < 8 set wrong DLC to smaller/longer than defined DLC
    if(getValue(this))
    {
        Msg_GW_362.dlc =getValue(E_pubc_GW_GW_362_Dlc);
    }
    else
    {
	   Msg_GW_362.dlc = 8;
			
    }
}

on envVar E_pubc_GW_GW_1A6_PCU_AccPedl_Rv
{
    int64 rawValue = 0ll;
    float rawValue_float = 0.0;
    float phyValue = 0.0;        

    //set the signal with updated raw value
    {
        rawValue = getvalue(this);
        if(chgEv_GW_1A6_PCU_AccPedl == 0)
        {
            //type conversion to float
            rawValue_float = rawValue;        
            // raw to physical conversion
            phyValue = ((rawValue_float *0.392)+(0));
            putValue(E_pubc_GW_GW_1A6_PCU_AccPedl_Pv, phyValue);
            chgEv_GW_1A6_PCU_AccPedl = 1;
        }
        else
        {
            chgEv_GW_1A6_PCU_AccPedl = 0;
        }    
        //update the signal value
        Msg_GW_1A6.PCU_AccPedl=rawValue;        
    }                                                                           
}

on envVar E_pubc_GW_GW_1A6_PCU_AccPedl_Pv
{
    int64 rawValue = 0ll;
    float phyValue = 0.0;
    
    //update the raw value with physical value 
    {
        if(chgEv_GW_1A6_PCU_AccPedl == 0)
        {
            phyValue = getvalue(this);
            // physical to raw conversion
            rawValue = ((phyValue -(0))/0.392);
            putValue(E_pubc_GW_GW_1A6_PCU_AccPedl_Rv, rawValue);
            chgEv_GW_1A6_PCU_AccPedl = 1;  
        }
        else
        {
            chgEv_GW_1A6_PCU_AccPedl = 0;
        }
    }
}


on envVar E_pubc_GW_GW_362_PCU_DrvMod_Rv
{
    int64 rawValue = 0ll;
    float rawValue_float = 0.0;
    float phyValue = 0.0;        

    //set the signal with updated raw value
    if(getValue(E_pubc_GW_GW_362_PCU_DrvMod_SetVt)==0)
    {
        rawValue = getvalue(this);
        if(chgEv_GW_362_PCU_DrvMod == 0)
        {
            //type conversion to float
            rawValue_float = rawValue;        
            // raw to physical conversion
            phyValue = ((rawValue_float *1)+(0));
            putValue(E_pubc_GW_GW_362_PCU_DrvMod_Pv, phyValue);
            chgEv_GW_362_PCU_DrvMod = 1;
        }
        else
        {
            chgEv_GW_362_PCU_DrvMod = 0;
        }    
        //update the signal value
        Msg_GW_362.PCU_DrvMod=rawValue;        
    }                                                                           
}

on envVar E_pubc_GW_GW_362_PCU_DrvMod_Pv
{
    int64 rawValue = 0ll;
    float phyValue = 0.0;
    
    //update the raw value with physical value 
    if(getValue(E_pubc_GW_GW_362_PCU_DrvMod_SetVt)==0)
    {
        if(chgEv_GW_362_PCU_DrvMod == 0)
        {
            phyValue = getvalue(this);
            // physical to raw conversion
            rawValue = ((phyValue -(0))/1);
            putValue(E_pubc_GW_GW_362_PCU_DrvMod_Rv, rawValue);
            chgEv_GW_362_PCU_DrvMod = 1;  
        }
        else
        {
            chgEv_GW_362_PCU_DrvMod = 0;
        }
    }
}

on envVar E_pubc_GW_GW_362_PCU_DrvMod_Vt
{
    qword rawValue = 0ll;
    if(getValue(E_pubc_GW_GW_362_PCU_DrvMod_SetVt))
    {
        //update the signal value
        Msg_GW_362.PCU_DrvMod=getValue(this);
    }
}

on envVar E_pubc_GW_GW_362_PCU_DrvMod_SetVt
{
    if(getValue(E_pubc_GW_GW_362_PCU_DrvMod_SetVt))
    {
        //update the signal value
        Msg_GW_362.PCU_DrvMod=getvalue(E_pubc_GW_GW_362_PCU_DrvMod_Vt);
    }
    else
    {
        Msg_GW_362.PCU_DrvMod=getValue(E_pubc_GW_GW_362_PCU_DrvMod_Rv);
    }
}
on envVar E_pubc_GW_GW_170_tx
{
    if(getValue(this))
    {       
        
        //update the BZ Signal
        if(GW_170_EPS_RollingCounter_170_wrongvalctr == 0)
        {
            update_GW_170_EPS_RollingCounter_170_counter();
            Msg_GW_170.EPS_RollingCounter_170= GW_170_EPS_RollingCounter_170_counter;
        }
        else if(GW_170_EPS_RollingCounter_170_wrongvalctr > 0)
        {
			GW_170_EPS_RollingCounter_170_counter=GW_170_EPS_RollingCounter_170_counter + GW_170_EPS_RollingCounter_170_wrongvalctr;
			 Msg_GW_170.EPS_RollingCounter_170= GW_170_EPS_RollingCounter_170_counter;
             /*GW_170_EPS_RollingCounter_170_wrongvalctr--;
              // if counter becomes zero, update panel controller to zero
             if(GW_170_EPS_RollingCounter_170_wrongvalctr == 0)
             {
                 putValue(E_pubc_GW_GW_170_EPS_RollingCounter_170_wrongvalctr,0);
             } */
        }
        else
        { 
			// do nothing
        }    
        //calculate the CRC CheckSum
        update_GW_170_CRC_CheckSum();

        output(Msg_GW_170);        
    }
}

on envVar E_pubc_GW_GW_170_Range
{
    qword rawstatus = 0ll;
    qword rawValue = 0ll;    
    
    rawstatus = getvalue(this);    
    // set all the signals with min raw /max raw /init raw
    switch (rawstatus) 
    {
     case(0) :
        rawValue= 0;
        putValue(E_pubc_GW_GW_170_EPS_ActualTorsionBarTorq_Rv, rawValue);
        rawValue= 0;
        putValue(E_pubc_GW_GW_170_EPS_MinSafetyTorsionBarTorq_Rv, rawValue);
        rawValue= 0;
        putValue(E_pubc_GW_GW_170_EPS_MaxSafetyTorsionBarTorq_Rv, rawValue);
        break;
     case(1) :
        rawValue= 2046;
        putValue(E_pubc_GW_GW_170_EPS_ActualTorsionBarTorq_Rv, rawValue);
        rawValue= 2046;
        putValue(E_pubc_GW_GW_170_EPS_MinSafetyTorsionBarTorq_Rv, rawValue);
        rawValue= 2046;
        putValue(E_pubc_GW_GW_170_EPS_MaxSafetyTorsionBarTorq_Rv, rawValue);
        break;
     default :
        rawValue= 0;
        putValue(E_pubc_GW_GW_170_EPS_ActualTorsionBarTorq_Rv, rawValue);
        rawValue= 0;
        putValue(E_pubc_GW_GW_170_EPS_MinSafetyTorsionBarTorq_Rv, rawValue);
        rawValue= 0;
        putValue(E_pubc_GW_GW_170_EPS_MaxSafetyTorsionBarTorq_Rv, rawValue);
      break;
   }
}

on envVar E_pubc_GW_GW_170_Dlc
{
    if(getValue(E_pubc_GW_GW_170_enDlc))
    {
        Msg_GW_170.dlc =getValue(this);
    }
    else
    {   
	   Msg_GW_170.dlc = 8;
	   	
  }
}

on envVar E_pubc_GW_GW_170_enDlc
{
    //For Messages with DLC = 8, set wrong DLC to smaller than defined DLC
    //For Messages with DLC < 8 set wrong DLC to smaller/longer than defined DLC
    if(getValue(this))
    {
        Msg_GW_170.dlc =getValue(E_pubc_GW_GW_170_Dlc);
    }
    else
    {
	   Msg_GW_170.dlc = 8;
			
    }
}

on envVar E_pubc_GW_GW_170_EPS_CRCCheck_170_wrongvalctr
{
    //update disturb count
    //disturb value range:(-1 = always send wrong value),( X>0 ,x is the number of Messages with wrong CHK sent)
    GW_170_EPS_CRCCheck_170_wrongvalctr =getValue(this);    
}
on envVar E_pubc_GW_GW_170_EPS_RollingCounter_170_wrongvalctr
{
    //update disturb count
    //disturb value range:(-1 = always send wrong value),( X>0 ,x is the number of Messages with wrong CHK sent)
    GW_170_EPS_RollingCounter_170_wrongvalctr =getValue(this);    
}

on envVar E_pubc_GW_GW_170_EPS_ActualTorsionBarTorq_Rv
{
    int64 rawValue = 0ll;
    float rawValue_float = 0.0;
    float phyValue = 0.0;        

    //set the signal with updated raw value
    {
        rawValue = getvalue(this);
        if(chgEv_GW_170_EPS_ActualTorsionBarTorq == 0)
        {
            //type conversion to float
            rawValue_float = rawValue;        
            // raw to physical conversion
            phyValue = ((rawValue_float *0.02)+(-20.48));
            putValue(E_pubc_GW_GW_170_EPS_ActualTorsionBarTorq_Pv, phyValue);
            chgEv_GW_170_EPS_ActualTorsionBarTorq = 1;
        }
        else
        {
            chgEv_GW_170_EPS_ActualTorsionBarTorq = 0;
        }    
        //update the signal value
        Msg_GW_170.EPS_ActualTorsionBarTorq=rawValue;        
    }                                                                           
}

on envVar E_pubc_GW_GW_170_EPS_ActualTorsionBarTorq_Pv
{
    int64 rawValue = 0ll;
    float phyValue = 0.0;
    
    //update the raw value with physical value 
    {
        if(chgEv_GW_170_EPS_ActualTorsionBarTorq == 0)
        {
            phyValue = getvalue(this);
            // physical to raw conversion
            rawValue = ((phyValue -(-20.48))/0.02);
            putValue(E_pubc_GW_GW_170_EPS_ActualTorsionBarTorq_Rv, rawValue);
            chgEv_GW_170_EPS_ActualTorsionBarTorq = 1;  
        }
        else
        {
            chgEv_GW_170_EPS_ActualTorsionBarTorq = 0;
        }
    }
}


 
on envVar E_pubc_GW_GW_170_EPS_MinSafetyTorsionBarTorq_Rv
{
    int64 rawValue = 0ll;
    float rawValue_float = 0.0;
    float phyValue = 0.0;        

    //set the signal with updated raw value
    {
        rawValue = getvalue(this);
        if(chgEv_GW_170_EPS_MinSafetyTorsionBarTorq == 0)
        {
            //type conversion to float
            rawValue_float = rawValue;        
            // raw to physical conversion
            phyValue = ((rawValue_float *0.02)+(-20.48));
            putValue(E_pubc_GW_GW_170_EPS_MinSafetyTorsionBarTorq_Pv, phyValue);
            chgEv_GW_170_EPS_MinSafetyTorsionBarTorq = 1;
        }
        else
        {
            chgEv_GW_170_EPS_MinSafetyTorsionBarTorq = 0;
        }    
        //update the signal value
        Msg_GW_170.EPS_MinSafetyTorsionBarTorq=rawValue;        
    }                                                                           
}

on envVar E_pubc_GW_GW_170_EPS_MinSafetyTorsionBarTorq_Pv
{
    int64 rawValue = 0ll;
    float phyValue = 0.0;
    
    //update the raw value with physical value 
    {
        if(chgEv_GW_170_EPS_MinSafetyTorsionBarTorq == 0)
        {
            phyValue = getvalue(this);
            // physical to raw conversion
            rawValue = ((phyValue -(-20.48))/0.02);
            putValue(E_pubc_GW_GW_170_EPS_MinSafetyTorsionBarTorq_Rv, rawValue);
            chgEv_GW_170_EPS_MinSafetyTorsionBarTorq = 1;  
        }
        else
        {
            chgEv_GW_170_EPS_MinSafetyTorsionBarTorq = 0;
        }
    }
}


 
on envVar E_pubc_GW_GW_170_EPS_MaxSafetyTorsionBarTorq_Rv
{
    int64 rawValue = 0ll;
    float rawValue_float = 0.0;
    float phyValue = 0.0;        

    //set the signal with updated raw value
    {
        rawValue = getvalue(this);
        if(chgEv_GW_170_EPS_MaxSafetyTorsionBarTorq == 0)
        {
            //type conversion to float
            rawValue_float = rawValue;        
            // raw to physical conversion
            phyValue = ((rawValue_float *0.02)+(-20.48));
            putValue(E_pubc_GW_GW_170_EPS_MaxSafetyTorsionBarTorq_Pv, phyValue);
            chgEv_GW_170_EPS_MaxSafetyTorsionBarTorq = 1;
        }
        else
        {
            chgEv_GW_170_EPS_MaxSafetyTorsionBarTorq = 0;
        }    
        //update the signal value
        Msg_GW_170.EPS_MaxSafetyTorsionBarTorq=rawValue;        
    }                                                                           
}

on envVar E_pubc_GW_GW_170_EPS_MaxSafetyTorsionBarTorq_Pv
{
    int64 rawValue = 0ll;
    float phyValue = 0.0;
    
    //update the raw value with physical value 
    {
        if(chgEv_GW_170_EPS_MaxSafetyTorsionBarTorq == 0)
        {
            phyValue = getvalue(this);
            // physical to raw conversion
            rawValue = ((phyValue -(-20.48))/0.02);
            putValue(E_pubc_GW_GW_170_EPS_MaxSafetyTorsionBarTorq_Rv, rawValue);
            chgEv_GW_170_EPS_MaxSafetyTorsionBarTorq = 1;  
        }
        else
        {
            chgEv_GW_170_EPS_MaxSafetyTorsionBarTorq = 0;
        }
    }
}
 
on envVar E_pubc_GW_GW_394_tx
{
    if(getValue(this))
    {       
        

        output(Msg_GW_394);        
    }
}

on envVar E_pubc_GW_GW_394_Range
{
    qword rawstatus = 0ll;
    qword rawValue = 0ll;    
    
    rawstatus = getvalue(this);    
    // set all the signals with min raw /max raw /init raw
    switch (rawstatus) 
    {
     case(0) :
        rawValue= 0;
        putValue(E_pubc_GW_GW_394_HU_TLAEnable_Rv, rawValue);
        rawValue= 0;
        putValue(E_pubc_GW_GW_394_HU_ELKEnable_Rv, rawValue);
        break;
     case(1) :
        rawValue= 3;
        putValue(E_pubc_GW_GW_394_HU_TLAEnable_Rv, rawValue);
        rawValue= 3;
        putValue(E_pubc_GW_GW_394_HU_ELKEnable_Rv, rawValue);
        break;
     default :
        rawValue= 0;
        putValue(E_pubc_GW_GW_394_HU_TLAEnable_Rv, rawValue);
        rawValue= 0;
        putValue(E_pubc_GW_GW_394_HU_ELKEnable_Rv, rawValue);
      break;
   }
}

on envVar E_pubc_GW_GW_394_Dlc
{
    if(getValue(E_pubc_GW_GW_394_enDlc))
    {
        Msg_GW_394.dlc =getValue(this);
    }
    else
    {
        Msg_GW_394.dlc =8;
    }
}

on envVar E_pubc_GW_GW_394_enDlc
{
    //For Messages with DLC = 8, set wrong DLC to smaller than defined DLC
    //For Messages with DLC < 8 set wrong DLC to smaller/longer than defined DLC
    if(getValue(this))
    {
        Msg_GW_394.dlc =getValue(E_pubc_GW_GW_394_Dlc);
    }
    else
    {
        Msg_GW_394.dlc =8;
    }
}


on envVar E_pubc_GW_GW_394_HU_TLAEnable_Rv
{
    int64 rawValue = 0ll;
    float rawValue_float = 0.0;
    float phyValue = 0.0;        

    //set the signal with updated raw value
    if(getValue(E_pubc_GW_GW_394_HU_TLAEnable_SetVt)==0)
    {
        rawValue = getvalue(this);
        if(chgEv_GW_394_HU_TLAEnable == 0)
        {
            //type conversion to float
            rawValue_float = rawValue;        
            // raw to physical conversion
            phyValue = ((rawValue_float *1)+(0));
            putValue(E_pubc_GW_GW_394_HU_TLAEnable_Pv, phyValue);
            chgEv_GW_394_HU_TLAEnable = 1;
        }
        else
        {
            chgEv_GW_394_HU_TLAEnable = 0;
        }    
        //update the signal value
        Msg_GW_394.HU_TLAEnable=rawValue;        
    }                                                                           
}

on envVar E_pubc_GW_GW_394_HU_TLAEnable_Pv
{
    int64 rawValue = 0ll;
    float phyValue = 0.0;
    
    //update the raw value with physical value 
    if(getValue(E_pubc_GW_GW_394_HU_TLAEnable_SetVt)==0)
    {
        if(chgEv_GW_394_HU_TLAEnable == 0)
        {
            phyValue = getvalue(this);
            // physical to raw conversion
            rawValue = ((phyValue -(0))/1);
            putValue(E_pubc_GW_GW_394_HU_TLAEnable_Rv, rawValue);
            chgEv_GW_394_HU_TLAEnable = 1;  
        }
        else
        {
            chgEv_GW_394_HU_TLAEnable = 0;
        }
    }
}

on envVar E_pubc_GW_GW_394_HU_TLAEnable_Vt
{
    qword rawValue = 0ll;
    if(getValue(E_pubc_GW_GW_394_HU_TLAEnable_SetVt))
    {
        //update the signal value
        Msg_GW_394.HU_TLAEnable=getValue(this);
    }
}

on envVar E_pubc_GW_GW_394_HU_TLAEnable_SetVt
{
    if(getValue(E_pubc_GW_GW_394_HU_TLAEnable_SetVt))
    {
        //update the signal value
        Msg_GW_394.HU_TLAEnable=getvalue(E_pubc_GW_GW_394_HU_TLAEnable_Vt);
    }
    else
    {
        Msg_GW_394.HU_TLAEnable=getValue(E_pubc_GW_GW_394_HU_TLAEnable_Rv);
    }
}
 
on envVar E_pubc_GW_GW_394_HU_ELKEnable_Rv
{
    int64 rawValue = 0ll;
    float rawValue_float = 0.0;
    float phyValue = 0.0;        

    //set the signal with updated raw value
    if(getValue(E_pubc_GW_GW_394_HU_ELKEnable_SetVt)==0)
    {
        rawValue = getvalue(this);
        if(chgEv_GW_394_HU_ELKEnable == 0)
        {
            //type conversion to float
            rawValue_float = rawValue;        
            // raw to physical conversion
            phyValue = ((rawValue_float *1)+(0));
            putValue(E_pubc_GW_GW_394_HU_ELKEnable_Pv, phyValue);
            chgEv_GW_394_HU_ELKEnable = 1;
        }
        else
        {
            chgEv_GW_394_HU_ELKEnable = 0;
        }    
        //update the signal value
        Msg_GW_394.HU_ELKEnable=rawValue;        
    }                                                                           
}

on envVar E_pubc_GW_GW_394_HU_ELKEnable_Pv
{
    int64 rawValue = 0ll;
    float phyValue = 0.0;
    
    //update the raw value with physical value 
    if(getValue(E_pubc_GW_GW_394_HU_ELKEnable_SetVt)==0)
    {
        if(chgEv_GW_394_HU_ELKEnable == 0)
        {
            phyValue = getvalue(this);
            // physical to raw conversion
            rawValue = ((phyValue -(0))/1);
            putValue(E_pubc_GW_GW_394_HU_ELKEnable_Rv, rawValue);
            chgEv_GW_394_HU_ELKEnable = 1;  
        }
        else
        {
            chgEv_GW_394_HU_ELKEnable = 0;
        }
    }
}

on envVar E_pubc_GW_GW_394_HU_ELKEnable_Vt
{
    qword rawValue = 0ll;
    if(getValue(E_pubc_GW_GW_394_HU_ELKEnable_SetVt))
    {
        //update the signal value
        Msg_GW_394.HU_ELKEnable=getValue(this);
    }
}

on envVar E_pubc_GW_GW_394_HU_ELKEnable_SetVt
{
    if(getValue(E_pubc_GW_GW_394_HU_ELKEnable_SetVt))
    {
        //update the signal value
        Msg_GW_394.HU_ELKEnable=getvalue(E_pubc_GW_GW_394_HU_ELKEnable_Vt);
    }
    else
    {
        Msg_GW_394.HU_ELKEnable=getValue(E_pubc_GW_GW_394_HU_ELKEnable_Rv);
    }
}
 
 
on envVar E_pubc_GW_GW_17E_tx
{
    if(getValue(this))
    {       
        
        //update the BZ Signal
        if(GW_17E_EPS_RollingCounter_17E_wrongvalctr == 0)
        {
            update_GW_17E_EPS_RollingCounter_17E_counter();
            Msg_GW_17E.EPS_RollingCounter_17E= GW_17E_EPS_RollingCounter_17E_counter;
        }
        else if(GW_17E_EPS_RollingCounter_17E_wrongvalctr > 0)
        {
			GW_17E_EPS_RollingCounter_17E_counter=GW_17E_EPS_RollingCounter_17E_counter + GW_17E_EPS_RollingCounter_17E_wrongvalctr;
			 Msg_GW_17E.EPS_RollingCounter_17E= GW_17E_EPS_RollingCounter_17E_counter;
             /* GW_17E_EPS_RollingCounter_17E_wrongvalctr--;
              // if counter becomes zero, update panel controller to zero
             if(GW_17E_EPS_RollingCounter_17E_wrongvalctr == 0)
             {
                 putValue(E_pubc_GW_GW_17E_EPS_RollingCounter_17E_wrongvalctr,0);
             } */
        }
        else
        {
            //do nothing
        }        
        //calculate the CRC CheckSum
        update_GW_17E_CRC_CheckSum();

        output(Msg_GW_17E);        
    }
}

on envVar E_pubc_GW_GW_17E_Range
{
    qword rawstatus = 0ll;
    qword rawValue = 0ll;    
    
    rawstatus = getvalue(this);    
    // set all the signals with min raw /max raw /init raw
    switch (rawstatus) 
    {
     case(0) :
        rawValue= 0;
        putValue(E_pubc_GW_GW_17E_EPS_LatCtrlActive_Rv, rawValue);
        rawValue= 0;
        putValue(E_pubc_GW_GW_17E_EPS_MeasuredTorsionBarTorqValid_Rv, rawValue);
        rawValue= 0;
        putValue(E_pubc_GW_GW_17E_EPS_MeasuredTorsionBarTorque_Rv, rawValue);
        rawValue= 0;
        putValue(E_pubc_GW_GW_17E_EPS_LatCtrlAvailabilityStatus_Rv, rawValue);
        break;
     case(1) :
        rawValue= 1;
        putValue(E_pubc_GW_GW_17E_EPS_LatCtrlActive_Rv, rawValue);
        rawValue= 1;
        putValue(E_pubc_GW_GW_17E_EPS_MeasuredTorsionBarTorqValid_Rv, rawValue);
        rawValue= 2046;
        putValue(E_pubc_GW_GW_17E_EPS_MeasuredTorsionBarTorque_Rv, rawValue);
        rawValue= 3;
        putValue(E_pubc_GW_GW_17E_EPS_LatCtrlAvailabilityStatus_Rv, rawValue);
        break;
     default :
        rawValue= 0;
        putValue(E_pubc_GW_GW_17E_EPS_LatCtrlActive_Rv, rawValue);
        rawValue= 0;
        putValue(E_pubc_GW_GW_17E_EPS_MeasuredTorsionBarTorqValid_Rv, rawValue);
        rawValue= 0;
        putValue(E_pubc_GW_GW_17E_EPS_MeasuredTorsionBarTorque_Rv, rawValue);
        rawValue= 0;
        putValue(E_pubc_GW_GW_17E_EPS_LatCtrlAvailabilityStatus_Rv, rawValue);
      break;
   }
}

on envVar E_pubc_GW_GW_17E_Dlc
{
    if(getValue(E_pubc_GW_GW_17E_enDlc))
    {
        Msg_GW_17E.dlc =getValue(this);
    }
    else
    {
        Msg_GW_17E.dlc =8;
    }
}

on envVar E_pubc_GW_GW_17E_enDlc
{
    //For Messages with DLC = 8, set wrong DLC to smaller than defined DLC
    //For Messages with DLC < 8 set wrong DLC to smaller/longer than defined DLC
    if(getValue(this))
    {
        Msg_GW_17E.dlc =getValue(E_pubc_GW_GW_17E_Dlc);
    }
    else
    {
        Msg_GW_17E.dlc =8;
    }
}

on envVar E_pubc_GW_GW_17E_EPS_CRCCheck_17E_wrongvalctr
{
    //update disturb count
    //disturb value range:(-1 = always send wrong value),( X>0 ,x is the number of Messages with wrong CHK sent)
    GW_17E_EPS_CRCCheck_17E_wrongvalctr =getValue(this);    
}
on envVar E_pubc_GW_GW_17E_EPS_RollingCounter_17E_wrongvalctr
{
    //update disturb count
    //disturb value range:(-1 = always send wrong value),( X>0 ,x is the number of Messages with wrong CHK sent)
    GW_17E_EPS_RollingCounter_17E_wrongvalctr =getValue(this);    
}

on envVar E_pubc_GW_GW_17E_EPS_LatCtrlActive_Rv
{
    int64 rawValue = 0ll;
    float rawValue_float = 0.0;
    float phyValue = 0.0;        

    //set the signal with updated raw value
    if(getValue(E_pubc_GW_GW_17E_EPS_LatCtrlActive_SetVt)==0)
    {
        rawValue = getvalue(this);
        if(chgEv_GW_17E_EPS_LatCtrlActive == 0)
        {
            //type conversion to float
            rawValue_float = rawValue;        
            // raw to physical conversion
            phyValue = ((rawValue_float *1)+(0));
            putValue(E_pubc_GW_GW_17E_EPS_LatCtrlActive_Pv, phyValue);
            chgEv_GW_17E_EPS_LatCtrlActive = 1;
        }
        else
        {
            chgEv_GW_17E_EPS_LatCtrlActive = 0;
        }    
        //update the signal value
        Msg_GW_17E.EPS_LatCtrlActive=rawValue;        
    }                                                                           
}

on envVar E_pubc_GW_GW_17E_EPS_LatCtrlActive_Pv
{
    int64 rawValue = 0ll;
    float phyValue = 0.0;
    
    //update the raw value with physical value 
    if(getValue(E_pubc_GW_GW_17E_EPS_LatCtrlActive_SetVt)==0)
    {
        if(chgEv_GW_17E_EPS_LatCtrlActive == 0)
        {
            phyValue = getvalue(this);
            // physical to raw conversion
            rawValue = ((phyValue -(0))/1);
            putValue(E_pubc_GW_GW_17E_EPS_LatCtrlActive_Rv, rawValue);
            chgEv_GW_17E_EPS_LatCtrlActive = 1;  
        }
        else
        {
            chgEv_GW_17E_EPS_LatCtrlActive = 0;
        }
    }
}

on envVar E_pubc_GW_GW_17E_EPS_LatCtrlActive_Vt
{
    qword rawValue = 0ll;
    if(getValue(E_pubc_GW_GW_17E_EPS_LatCtrlActive_SetVt))
    {
        //update the signal value
        Msg_GW_17E.EPS_LatCtrlActive=getValue(this);
    }
}

on envVar E_pubc_GW_GW_17E_EPS_LatCtrlActive_SetVt
{
    if(getValue(E_pubc_GW_GW_17E_EPS_LatCtrlActive_SetVt))
    {
        //update the signal value
        Msg_GW_17E.EPS_LatCtrlActive=getvalue(E_pubc_GW_GW_17E_EPS_LatCtrlActive_Vt);
    }
    else
    {
        Msg_GW_17E.EPS_LatCtrlActive=getValue(E_pubc_GW_GW_17E_EPS_LatCtrlActive_Rv);
    }
}
 
on envVar E_pubc_GW_GW_17E_EPS_MeasuredTorsionBarTorqValid_Rv
{
    int64 rawValue = 0ll;
    float rawValue_float = 0.0;
    float phyValue = 0.0;        

    //set the signal with updated raw value
    if(getValue(E_pubc_GW_GW_17E_EPS_MeasuredTorsionBarTorqValid_SetVt)==0)
    {
        rawValue = getvalue(this);
        if(chgEv_GW_17E_EPS_MeasuredTorsionBarTorqValid == 0)
        {
            //type conversion to float
            rawValue_float = rawValue;        
            // raw to physical conversion
            phyValue = ((rawValue_float *1)+(0));
            putValue(E_pubc_GW_GW_17E_EPS_MeasuredTorsionBarTorqValid_Pv, phyValue);
            chgEv_GW_17E_EPS_MeasuredTorsionBarTorqValid = 1;
        }
        else
        {
            chgEv_GW_17E_EPS_MeasuredTorsionBarTorqValid = 0;
        }    
        //update the signal value
        Msg_GW_17E.EPS_MeasuredTorsionBarTorqValid=rawValue;        
    }                                                                           
}

on envVar E_pubc_GW_GW_17E_EPS_MeasuredTorsionBarTorqValid_Pv
{
    int64 rawValue = 0ll;
    float phyValue = 0.0;
    
    //update the raw value with physical value 
    if(getValue(E_pubc_GW_GW_17E_EPS_MeasuredTorsionBarTorqValid_SetVt)==0)
    {
        if(chgEv_GW_17E_EPS_MeasuredTorsionBarTorqValid == 0)
        {
            phyValue = getvalue(this);
            // physical to raw conversion
            rawValue = ((phyValue -(0))/1);
            putValue(E_pubc_GW_GW_17E_EPS_MeasuredTorsionBarTorqValid_Rv, rawValue);
            chgEv_GW_17E_EPS_MeasuredTorsionBarTorqValid = 1;  
        }
        else
        {
            chgEv_GW_17E_EPS_MeasuredTorsionBarTorqValid = 0;
        }
    }
}

on envVar E_pubc_GW_GW_17E_EPS_MeasuredTorsionBarTorqValid_Vt
{
    qword rawValue = 0ll;
    if(getValue(E_pubc_GW_GW_17E_EPS_MeasuredTorsionBarTorqValid_SetVt))
    {
        //update the signal value
        Msg_GW_17E.EPS_MeasuredTorsionBarTorqValid=getValue(this);
    }
}

on envVar E_pubc_GW_GW_17E_EPS_MeasuredTorsionBarTorqValid_SetVt
{
    if(getValue(E_pubc_GW_GW_17E_EPS_MeasuredTorsionBarTorqValid_SetVt))
    {
        //update the signal value
        Msg_GW_17E.EPS_MeasuredTorsionBarTorqValid=getvalue(E_pubc_GW_GW_17E_EPS_MeasuredTorsionBarTorqValid_Vt);
    }
    else
    {
        Msg_GW_17E.EPS_MeasuredTorsionBarTorqValid=getValue(E_pubc_GW_GW_17E_EPS_MeasuredTorsionBarTorqValid_Rv);
    }
}
 
on envVar E_pubc_GW_GW_17E_EPS_MeasuredTorsionBarTorque_Rv
{
    int64 rawValue = 0ll;
    float rawValue_float = 0.0;
    float phyValue = 0.0;        

    //set the signal with updated raw value
    {
        rawValue = getvalue(this);
        if(chgEv_GW_17E_EPS_MeasuredTorsionBarTorque == 0)
        {
            //type conversion to float
            rawValue_float = rawValue;        
            // raw to physical conversion
            phyValue = ((rawValue_float *0.01)+(-10.23));
            putValue(E_pubc_GW_GW_17E_EPS_MeasuredTorsionBarTorque_Pv, phyValue);
            chgEv_GW_17E_EPS_MeasuredTorsionBarTorque = 1;
        }
        else
        {
            chgEv_GW_17E_EPS_MeasuredTorsionBarTorque = 0;
        }    
        //update the signal value
        Msg_GW_17E.EPS_MeasuredTorsionBarTorque=rawValue;        
    }                                                                           
}

on envVar E_pubc_GW_GW_17E_EPS_MeasuredTorsionBarTorque_Pv
{
    int64 rawValue = 0ll;
    float phyValue = 0.0;
    
    //update the raw value with physical value 
    {
        if(chgEv_GW_17E_EPS_MeasuredTorsionBarTorque == 0)
        {
            phyValue = getvalue(this);
            // physical to raw conversion
            rawValue = ((phyValue -(-10.23))/0.01);
            putValue(E_pubc_GW_GW_17E_EPS_MeasuredTorsionBarTorque_Rv, rawValue);
            chgEv_GW_17E_EPS_MeasuredTorsionBarTorque = 1;  
        }
        else
        {
            chgEv_GW_17E_EPS_MeasuredTorsionBarTorque = 0;
        }
    }
}


 
on envVar E_pubc_GW_GW_17E_EPS_LatCtrlAvailabilityStatus_Rv
{
    int64 rawValue = 0ll;
    float rawValue_float = 0.0;
    float phyValue = 0.0;        

    //set the signal with updated raw value
    if(getValue(E_pubc_GW_GW_17E_EPS_LatCtrlAvailabilityStatus_SetVt)==0)
    {
        rawValue = getvalue(this);
        if(chgEv_GW_17E_EPS_LatCtrlAvailabilityStatus == 0)
        {
            //type conversion to float
            rawValue_float = rawValue;        
            // raw to physical conversion
            phyValue = ((rawValue_float *1)+(0));
            putValue(E_pubc_GW_GW_17E_EPS_LatCtrlAvailabilityStatus_Pv, phyValue);
            chgEv_GW_17E_EPS_LatCtrlAvailabilityStatus = 1;
        }
        else
        {
            chgEv_GW_17E_EPS_LatCtrlAvailabilityStatus = 0;
        }    
        //update the signal value
        Msg_GW_17E.EPS_LatCtrlAvailabilityStatus=rawValue;        
    }                                                                           
}

on envVar E_pubc_GW_GW_17E_EPS_LatCtrlAvailabilityStatus_Pv
{
    int64 rawValue = 0ll;
    float phyValue = 0.0;
    
    //update the raw value with physical value 
    if(getValue(E_pubc_GW_GW_17E_EPS_LatCtrlAvailabilityStatus_SetVt)==0)
    {
        if(chgEv_GW_17E_EPS_LatCtrlAvailabilityStatus == 0)
        {
            phyValue = getvalue(this);
            // physical to raw conversion
            rawValue = ((phyValue -(0))/1);
            putValue(E_pubc_GW_GW_17E_EPS_LatCtrlAvailabilityStatus_Rv, rawValue);
            chgEv_GW_17E_EPS_LatCtrlAvailabilityStatus = 1;  
        }
        else
        {
            chgEv_GW_17E_EPS_LatCtrlAvailabilityStatus = 0;
        }
    }
}

on envVar E_pubc_GW_GW_17E_EPS_LatCtrlAvailabilityStatus_Vt
{
    qword rawValue = 0ll;
    if(getValue(E_pubc_GW_GW_17E_EPS_LatCtrlAvailabilityStatus_SetVt))
    {
        //update the signal value
        Msg_GW_17E.EPS_LatCtrlAvailabilityStatus=getValue(this);
    }
}

on envVar E_pubc_GW_GW_17E_EPS_LatCtrlAvailabilityStatus_SetVt
{
    if(getValue(E_pubc_GW_GW_17E_EPS_LatCtrlAvailabilityStatus_SetVt))
    {
        //update the signal value
        Msg_GW_17E.EPS_LatCtrlAvailabilityStatus=getvalue(E_pubc_GW_GW_17E_EPS_LatCtrlAvailabilityStatus_Vt);
    }
    else
    {
        Msg_GW_17E.EPS_LatCtrlAvailabilityStatus=getValue(E_pubc_GW_GW_17E_EPS_LatCtrlAvailabilityStatus_Rv);
    }
}
 
 
on envVar E_pubc_GW_GW_514_tx
{
    if(getValue(this))
    {       
        

        output(Msg_GW_514);        
    }
}

on envVar E_pubc_GW_GW_514_Range
{
    qword rawstatus = 0ll;
    qword rawValue = 0ll;    
    
    rawstatus = getvalue(this);    
    // set all the signals with min raw /max raw /init raw
    switch (rawstatus) 
    {
     case(0) :
        rawValue= 0;
        putValue(E_pubc_GW_GW_514_HU_OverspeedWarningOffset_Rv, rawValue);
        rawValue= 0;
        putValue(E_pubc_GW_GW_514_HU_LASWarningModeSelection_Rv, rawValue);
        rawValue= 0;
        putValue(E_pubc_GW_GW_514_HU_LDWShakeLev_Rv, rawValue);
        rawValue= 0;
        putValue(E_pubc_GW_GW_514_HU_HMAEnable_Rv, rawValue);
        rawValue= 0;
        putValue(E_pubc_GW_GW_514_HU_OverspeedWarningEnable_Rv, rawValue);
        rawValue= 0;
        putValue(E_pubc_GW_GW_514_HU_OverspeedSoundWarEnable_Rv, rawValue);
        rawValue= 0;
        putValue(E_pubc_GW_GW_514_HU_TSRSwitch_Rv, rawValue);
        rawValue= 0;
        putValue(E_pubc_GW_GW_514_HU_IACCEnable_Rv, rawValue);
        rawValue= 0;
        putValue(E_pubc_GW_GW_514_HU_LASModeSelection_Rv, rawValue);
        break;
     case(1) :
        rawValue= 20;
        putValue(E_pubc_GW_GW_514_HU_OverspeedWarningOffset_Rv, rawValue);
        rawValue= 7;
        putValue(E_pubc_GW_GW_514_HU_LASWarningModeSelection_Rv, rawValue);
        rawValue= 3;
        putValue(E_pubc_GW_GW_514_HU_LDWShakeLev_Rv, rawValue);
        rawValue= 1;
        putValue(E_pubc_GW_GW_514_HU_HMAEnable_Rv, rawValue);
        rawValue= 3;
        putValue(E_pubc_GW_GW_514_HU_OverspeedWarningEnable_Rv, rawValue);
        rawValue= 3;
        putValue(E_pubc_GW_GW_514_HU_OverspeedSoundWarEnable_Rv, rawValue);
        rawValue= 1;
        putValue(E_pubc_GW_GW_514_HU_TSRSwitch_Rv, rawValue);
        rawValue= 3;
        putValue(E_pubc_GW_GW_514_HU_IACCEnable_Rv, rawValue);
        rawValue= 7;
        putValue(E_pubc_GW_GW_514_HU_LASModeSelection_Rv, rawValue);
        break;
     default :
        rawValue= 0;
        putValue(E_pubc_GW_GW_514_HU_OverspeedWarningOffset_Rv, rawValue);
        rawValue= 0;
        putValue(E_pubc_GW_GW_514_HU_LASWarningModeSelection_Rv, rawValue);
        rawValue= 0;
        putValue(E_pubc_GW_GW_514_HU_LDWShakeLev_Rv, rawValue);
        rawValue= 0;
        putValue(E_pubc_GW_GW_514_HU_HMAEnable_Rv, rawValue);
        rawValue= 0;
        putValue(E_pubc_GW_GW_514_HU_OverspeedWarningEnable_Rv, rawValue);
        rawValue= 0;
        putValue(E_pubc_GW_GW_514_HU_OverspeedSoundWarEnable_Rv, rawValue);
        rawValue= 0;
        putValue(E_pubc_GW_GW_514_HU_TSRSwitch_Rv, rawValue);
        rawValue= 0;
        putValue(E_pubc_GW_GW_514_HU_IACCEnable_Rv, rawValue);
        rawValue= 0;
        putValue(E_pubc_GW_GW_514_HU_LASModeSelection_Rv, rawValue);
      break;
   }
}

on envVar E_pubc_GW_GW_514_Dlc
{
    if(getValue(E_pubc_GW_GW_514_enDlc))
    {
        Msg_GW_514.dlc =getValue(this);
    }
    else
    {
        Msg_GW_514.dlc =8;
    }
}

on envVar E_pubc_GW_GW_514_enDlc
{
    //For Messages with DLC = 8, set wrong DLC to smaller than defined DLC
    //For Messages with DLC < 8 set wrong DLC to smaller/longer than defined DLC
    if(getValue(this))
    {
        Msg_GW_514.dlc =getValue(E_pubc_GW_GW_514_Dlc);
    }
    else
    {
        Msg_GW_514.dlc =8;
    }
}


on envVar E_pubc_GW_GW_514_HU_OverspeedWarningOffset_Rv
{
    int64 rawValue = 0ll;
    float rawValue_float = 0.0;
    float phyValue = 0.0;        

    //set the signal with updated raw value
    if(getValue(E_pubc_GW_GW_514_HU_OverspeedWarningOffset_SetVt)==0)
    {
        rawValue = getvalue(this);
        if(chgEv_GW_514_HU_OverspeedWarningOffset == 0)
        {
            //type conversion to float
            rawValue_float = rawValue;        
            // raw to physical conversion
            phyValue = ((rawValue_float *1)+(-10));
            putValue(E_pubc_GW_GW_514_HU_OverspeedWarningOffset_Pv, phyValue);
            chgEv_GW_514_HU_OverspeedWarningOffset = 1;
        }
        else
        {
            chgEv_GW_514_HU_OverspeedWarningOffset = 0;
        }    
        //update the signal value
        Msg_GW_514.HU_OverspeedWarningOffset=rawValue;        
    }                                                                           
}

on envVar E_pubc_GW_GW_514_HU_OverspeedWarningOffset_Pv
{
    int64 rawValue = 0ll;
    float phyValue = 0.0;
    
    //update the raw value with physical value 
    if(getValue(E_pubc_GW_GW_514_HU_OverspeedWarningOffset_SetVt)==0)
    {
        if(chgEv_GW_514_HU_OverspeedWarningOffset == 0)
        {
            phyValue = getvalue(this);
            // physical to raw conversion
            rawValue = ((phyValue -(-10))/1);
            putValue(E_pubc_GW_GW_514_HU_OverspeedWarningOffset_Rv, rawValue);
            chgEv_GW_514_HU_OverspeedWarningOffset = 1;  
        }
        else
        {
            chgEv_GW_514_HU_OverspeedWarningOffset = 0;
        }
    }
}

on envVar E_pubc_GW_GW_514_HU_OverspeedWarningOffset_Vt
{
    qword rawValue = 0ll;
    if(getValue(E_pubc_GW_GW_514_HU_OverspeedWarningOffset_SetVt))
    {
        //update the signal value
        Msg_GW_514.HU_OverspeedWarningOffset=getValue(this);
    }
}

on envVar E_pubc_GW_GW_514_HU_OverspeedWarningOffset_SetVt
{
    if(getValue(E_pubc_GW_GW_514_HU_OverspeedWarningOffset_SetVt))
    {
        //update the signal value
        Msg_GW_514.HU_OverspeedWarningOffset=getvalue(E_pubc_GW_GW_514_HU_OverspeedWarningOffset_Vt);
    }
    else
    {
        Msg_GW_514.HU_OverspeedWarningOffset=getValue(E_pubc_GW_GW_514_HU_OverspeedWarningOffset_Rv);
    }
}
 
on envVar E_pubc_GW_GW_514_HU_LASWarningModeSelection_Rv
{
    int64 rawValue = 0ll;
    float rawValue_float = 0.0;
    float phyValue = 0.0;        

    //set the signal with updated raw value
    if(getValue(E_pubc_GW_GW_514_HU_LASWarningModeSelection_SetVt)==0)
    {
        rawValue = getvalue(this);
        if(chgEv_GW_514_HU_LASWarningModeSelection == 0)
        {
            //type conversion to float
            rawValue_float = rawValue;        
            // raw to physical conversion
            phyValue = ((rawValue_float *1)+(0));
            putValue(E_pubc_GW_GW_514_HU_LASWarningModeSelection_Pv, phyValue);
            chgEv_GW_514_HU_LASWarningModeSelection = 1;
        }
        else
        {
            chgEv_GW_514_HU_LASWarningModeSelection = 0;
        }    
        //update the signal value
        Msg_GW_514.HU_LASWarningModeSelection=rawValue;        
    }                                                                           
}

on envVar E_pubc_GW_GW_514_HU_LASWarningModeSelection_Pv
{
    int64 rawValue = 0ll;
    float phyValue = 0.0;
    
    //update the raw value with physical value 
    if(getValue(E_pubc_GW_GW_514_HU_LASWarningModeSelection_SetVt)==0)
    {
        if(chgEv_GW_514_HU_LASWarningModeSelection == 0)
        {
            phyValue = getvalue(this);
            // physical to raw conversion
            rawValue = ((phyValue -(0))/1);
            putValue(E_pubc_GW_GW_514_HU_LASWarningModeSelection_Rv, rawValue);
            chgEv_GW_514_HU_LASWarningModeSelection = 1;  
        }
        else
        {
            chgEv_GW_514_HU_LASWarningModeSelection = 0;
        }
    }
}

on envVar E_pubc_GW_GW_514_HU_LASWarningModeSelection_Vt
{
    qword rawValue = 0ll;
    if(getValue(E_pubc_GW_GW_514_HU_LASWarningModeSelection_SetVt))
    {
        //update the signal value
        Msg_GW_514.HU_LASWarningModeSelection=getValue(this);
    }
}

on envVar E_pubc_GW_GW_514_HU_LASWarningModeSelection_SetVt
{
    if(getValue(E_pubc_GW_GW_514_HU_LASWarningModeSelection_SetVt))
    {
        //update the signal value
        Msg_GW_514.HU_LASWarningModeSelection=getvalue(E_pubc_GW_GW_514_HU_LASWarningModeSelection_Vt);
    }
    else
    {
        Msg_GW_514.HU_LASWarningModeSelection=getValue(E_pubc_GW_GW_514_HU_LASWarningModeSelection_Rv);
    }
}
 
on envVar E_pubc_GW_GW_514_HU_LDWShakeLev_Rv
{
    int64 rawValue = 0ll;
    float rawValue_float = 0.0;
    float phyValue = 0.0;        

    //set the signal with updated raw value
    if(getValue(E_pubc_GW_GW_514_HU_LDWShakeLev_SetVt)==0)
    {
        rawValue = getvalue(this);
        if(chgEv_GW_514_HU_LDWShakeLev == 0)
        {
            //type conversion to float
            rawValue_float = rawValue;        
            // raw to physical conversion
            phyValue = ((rawValue_float *1)+(0));
            putValue(E_pubc_GW_GW_514_HU_LDWShakeLev_Pv, phyValue);
            chgEv_GW_514_HU_LDWShakeLev = 1;
        }
        else
        {
            chgEv_GW_514_HU_LDWShakeLev = 0;
        }    
        //update the signal value
        Msg_GW_514.HU_LDWShakeLev=rawValue;        
    }                                                                           
}

on envVar E_pubc_GW_GW_514_HU_LDWShakeLev_Pv
{
    int64 rawValue = 0ll;
    float phyValue = 0.0;
    
    //update the raw value with physical value 
    if(getValue(E_pubc_GW_GW_514_HU_LDWShakeLev_SetVt)==0)
    {
        if(chgEv_GW_514_HU_LDWShakeLev == 0)
        {
            phyValue = getvalue(this);
            // physical to raw conversion
            rawValue = ((phyValue -(0))/1);
            putValue(E_pubc_GW_GW_514_HU_LDWShakeLev_Rv, rawValue);
            chgEv_GW_514_HU_LDWShakeLev = 1;  
        }
        else
        {
            chgEv_GW_514_HU_LDWShakeLev = 0;
        }
    }
}

on envVar E_pubc_GW_GW_514_HU_LDWShakeLev_Vt
{
    qword rawValue = 0ll;
    if(getValue(E_pubc_GW_GW_514_HU_LDWShakeLev_SetVt))
    {
        //update the signal value
        Msg_GW_514.HU_LDWShakeLev=getValue(this);
    }
}

on envVar E_pubc_GW_GW_514_HU_LDWShakeLev_SetVt
{
    if(getValue(E_pubc_GW_GW_514_HU_LDWShakeLev_SetVt))
    {
        //update the signal value
        Msg_GW_514.HU_LDWShakeLev=getvalue(E_pubc_GW_GW_514_HU_LDWShakeLev_Vt);
    }
    else
    {
        Msg_GW_514.HU_LDWShakeLev=getValue(E_pubc_GW_GW_514_HU_LDWShakeLev_Rv);
    }
}
 
on envVar E_pubc_GW_GW_514_HU_HMAEnable_Rv
{
    int64 rawValue = 0ll;
    float rawValue_float = 0.0;
    float phyValue = 0.0;        

    //set the signal with updated raw value
    if(getValue(E_pubc_GW_GW_514_HU_HMAEnable_SetVt)==0)
    {
        rawValue = getvalue(this);
        if(chgEv_GW_514_HU_HMAEnable == 0)
        {
            //type conversion to float
            rawValue_float = rawValue;        
            // raw to physical conversion
            phyValue = ((rawValue_float *1)+(0));
            putValue(E_pubc_GW_GW_514_HU_HMAEnable_Pv, phyValue);
            chgEv_GW_514_HU_HMAEnable = 1;
        }
        else
        {
            chgEv_GW_514_HU_HMAEnable = 0;
        }    
        //update the signal value
        Msg_GW_514.HU_HMAEnable=rawValue;        
    }                                                                           
}

on envVar E_pubc_GW_GW_514_HU_HMAEnable_Pv
{
    int64 rawValue = 0ll;
    float phyValue = 0.0;
    
    //update the raw value with physical value 
    if(getValue(E_pubc_GW_GW_514_HU_HMAEnable_SetVt)==0)
    {
        if(chgEv_GW_514_HU_HMAEnable == 0)
        {
            phyValue = getvalue(this);
            // physical to raw conversion
            rawValue = ((phyValue -(0))/1);
            putValue(E_pubc_GW_GW_514_HU_HMAEnable_Rv, rawValue);
            chgEv_GW_514_HU_HMAEnable = 1;  
        }
        else
        {
            chgEv_GW_514_HU_HMAEnable = 0;
        }
    }
}

on envVar E_pubc_GW_GW_514_HU_HMAEnable_Vt
{
    qword rawValue = 0ll;
    if(getValue(E_pubc_GW_GW_514_HU_HMAEnable_SetVt))
    {
        //update the signal value
        Msg_GW_514.HU_HMAEnable=getValue(this);
    }
}

on envVar E_pubc_GW_GW_514_HU_HMAEnable_SetVt
{
    if(getValue(E_pubc_GW_GW_514_HU_HMAEnable_SetVt))
    {
        //update the signal value
        Msg_GW_514.HU_HMAEnable=getvalue(E_pubc_GW_GW_514_HU_HMAEnable_Vt);
    }
    else
    {
        Msg_GW_514.HU_HMAEnable=getValue(E_pubc_GW_GW_514_HU_HMAEnable_Rv);
    }
}
 
on envVar E_pubc_GW_GW_514_HU_OverspeedWarningEnable_Rv
{
    int64 rawValue = 0ll;
    float rawValue_float = 0.0;
    float phyValue = 0.0;        

    //set the signal with updated raw value
    if(getValue(E_pubc_GW_GW_514_HU_OverspeedWarningEnable_SetVt)==0)
    {
        rawValue = getvalue(this);
        if(chgEv_GW_514_HU_OverspeedWarningEnable == 0)
        {
            //type conversion to float
            rawValue_float = rawValue;        
            // raw to physical conversion
            phyValue = ((rawValue_float *1)+(0));
            putValue(E_pubc_GW_GW_514_HU_OverspeedWarningEnable_Pv, phyValue);
            chgEv_GW_514_HU_OverspeedWarningEnable = 1;
        }
        else
        {
            chgEv_GW_514_HU_OverspeedWarningEnable = 0;
        }    
        //update the signal value
        Msg_GW_514.HU_OverspeedWarningEnable=rawValue;        
    }                                                                           
}

on envVar E_pubc_GW_GW_514_HU_OverspeedWarningEnable_Pv
{
    int64 rawValue = 0ll;
    float phyValue = 0.0;
    
    //update the raw value with physical value 
    if(getValue(E_pubc_GW_GW_514_HU_OverspeedWarningEnable_SetVt)==0)
    {
        if(chgEv_GW_514_HU_OverspeedWarningEnable == 0)
        {
            phyValue = getvalue(this);
            // physical to raw conversion
            rawValue = ((phyValue -(0))/1);
            putValue(E_pubc_GW_GW_514_HU_OverspeedWarningEnable_Rv, rawValue);
            chgEv_GW_514_HU_OverspeedWarningEnable = 1;  
        }
        else
        {
            chgEv_GW_514_HU_OverspeedWarningEnable = 0;
        }
    }
}

on envVar E_pubc_GW_GW_514_HU_OverspeedWarningEnable_Vt
{
    qword rawValue = 0ll;
    if(getValue(E_pubc_GW_GW_514_HU_OverspeedWarningEnable_SetVt))
    {
        //update the signal value
        Msg_GW_514.HU_OverspeedWarningEnable=getValue(this);
    }
}

on envVar E_pubc_GW_GW_514_HU_OverspeedWarningEnable_SetVt
{
    if(getValue(E_pubc_GW_GW_514_HU_OverspeedWarningEnable_SetVt))
    {
        //update the signal value
        Msg_GW_514.HU_OverspeedWarningEnable=getvalue(E_pubc_GW_GW_514_HU_OverspeedWarningEnable_Vt);
    }
    else
    {
        Msg_GW_514.HU_OverspeedWarningEnable=getValue(E_pubc_GW_GW_514_HU_OverspeedWarningEnable_Rv);
    }
}
 
on envVar E_pubc_GW_GW_514_HU_OverspeedSoundWarEnable_Rv
{
    int64 rawValue = 0ll;
    float rawValue_float = 0.0;
    float phyValue = 0.0;        

    //set the signal with updated raw value
    if(getValue(E_pubc_GW_GW_514_HU_OverspeedSoundWarEnable_SetVt)==0)
    {
        rawValue = getvalue(this);
        if(chgEv_GW_514_HU_OverspeedSoundWarEnable == 0)
        {
            //type conversion to float
            rawValue_float = rawValue;        
            // raw to physical conversion
            phyValue = ((rawValue_float *1)+(0));
            putValue(E_pubc_GW_GW_514_HU_OverspeedSoundWarEnable_Pv, phyValue);
            chgEv_GW_514_HU_OverspeedSoundWarEnable = 1;
        }
        else
        {
            chgEv_GW_514_HU_OverspeedSoundWarEnable = 0;
        }    
        //update the signal value
        Msg_GW_514.HU_OverspeedSoundWarEnable=rawValue;        
    }                                                                           
}

on envVar E_pubc_GW_GW_514_HU_OverspeedSoundWarEnable_Pv
{
    int64 rawValue = 0ll;
    float phyValue = 0.0;
    
    //update the raw value with physical value 
    if(getValue(E_pubc_GW_GW_514_HU_OverspeedSoundWarEnable_SetVt)==0)
    {
        if(chgEv_GW_514_HU_OverspeedSoundWarEnable == 0)
        {
            phyValue = getvalue(this);
            // physical to raw conversion
            rawValue = ((phyValue -(0))/1);
            putValue(E_pubc_GW_GW_514_HU_OverspeedSoundWarEnable_Rv, rawValue);
            chgEv_GW_514_HU_OverspeedSoundWarEnable = 1;  
        }
        else
        {
            chgEv_GW_514_HU_OverspeedSoundWarEnable = 0;
        }
    }
}

on envVar E_pubc_GW_GW_514_HU_OverspeedSoundWarEnable_Vt
{
    qword rawValue = 0ll;
    if(getValue(E_pubc_GW_GW_514_HU_OverspeedSoundWarEnable_SetVt))
    {
        //update the signal value
        Msg_GW_514.HU_OverspeedSoundWarEnable=getValue(this);
    }
}

on envVar E_pubc_GW_GW_514_HU_OverspeedSoundWarEnable_SetVt
{
    if(getValue(E_pubc_GW_GW_514_HU_OverspeedSoundWarEnable_SetVt))
    {
        //update the signal value
        Msg_GW_514.HU_OverspeedSoundWarEnable=getvalue(E_pubc_GW_GW_514_HU_OverspeedSoundWarEnable_Vt);
    }
    else
    {
        Msg_GW_514.HU_OverspeedSoundWarEnable=getValue(E_pubc_GW_GW_514_HU_OverspeedSoundWarEnable_Rv);
    }
}
 
on envVar E_pubc_GW_GW_514_HU_TSRSwitch_Rv
{
    int64 rawValue = 0ll;
    float rawValue_float = 0.0;
    float phyValue = 0.0;        

    //set the signal with updated raw value
    if(getValue(E_pubc_GW_GW_514_HU_TSRSwitch_SetVt)==0)
    {
        rawValue = getvalue(this);
        if(chgEv_GW_514_HU_TSRSwitch == 0)
        {
            //type conversion to float
            rawValue_float = rawValue;        
            // raw to physical conversion
            phyValue = ((rawValue_float *1)+(0));
            putValue(E_pubc_GW_GW_514_HU_TSRSwitch_Pv, phyValue);
            chgEv_GW_514_HU_TSRSwitch = 1;
        }
        else
        {
            chgEv_GW_514_HU_TSRSwitch = 0;
        }    
        //update the signal value
        Msg_GW_514.HU_TSRSwitch=rawValue;        
    }                                                                           
}

on envVar E_pubc_GW_GW_514_HU_TSRSwitch_Pv
{
    int64 rawValue = 0ll;
    float phyValue = 0.0;
    
    //update the raw value with physical value 
    if(getValue(E_pubc_GW_GW_514_HU_TSRSwitch_SetVt)==0)
    {
        if(chgEv_GW_514_HU_TSRSwitch == 0)
        {
            phyValue = getvalue(this);
            // physical to raw conversion
            rawValue = ((phyValue -(0))/1);
            putValue(E_pubc_GW_GW_514_HU_TSRSwitch_Rv, rawValue);
            chgEv_GW_514_HU_TSRSwitch = 1;  
        }
        else
        {
            chgEv_GW_514_HU_TSRSwitch = 0;
        }
    }
}

on envVar E_pubc_GW_GW_514_HU_TSRSwitch_Vt
{
    qword rawValue = 0ll;
    if(getValue(E_pubc_GW_GW_514_HU_TSRSwitch_SetVt))
    {
        //update the signal value
        Msg_GW_514.HU_TSRSwitch=getValue(this);
    }
}

on envVar E_pubc_GW_GW_514_HU_TSRSwitch_SetVt
{
    if(getValue(E_pubc_GW_GW_514_HU_TSRSwitch_SetVt))
    {
        //update the signal value
        Msg_GW_514.HU_TSRSwitch=getvalue(E_pubc_GW_GW_514_HU_TSRSwitch_Vt);
    }
    else
    {
        Msg_GW_514.HU_TSRSwitch=getValue(E_pubc_GW_GW_514_HU_TSRSwitch_Rv);
    }
}
 
on envVar E_pubc_GW_GW_514_HU_IACCEnable_Rv
{
    int64 rawValue = 0ll;
    float rawValue_float = 0.0;
    float phyValue = 0.0;        

    //set the signal with updated raw value
    if(getValue(E_pubc_GW_GW_514_HU_IACCEnable_SetVt)==0)
    {
        rawValue = getvalue(this);
        if(chgEv_GW_514_HU_IACCEnable == 0)
        {
            //type conversion to float
            rawValue_float = rawValue;        
            // raw to physical conversion
            phyValue = ((rawValue_float *1)+(0));
            putValue(E_pubc_GW_GW_514_HU_IACCEnable_Pv, phyValue);
            chgEv_GW_514_HU_IACCEnable = 1;
        }
        else
        {
            chgEv_GW_514_HU_IACCEnable = 0;
        }    
        //update the signal value
        Msg_GW_514.HU_IACCEnable=rawValue;        
    }                                                                           
}

on envVar E_pubc_GW_GW_514_HU_IACCEnable_Pv
{
    int64 rawValue = 0ll;
    float phyValue = 0.0;
    
    //update the raw value with physical value 
    if(getValue(E_pubc_GW_GW_514_HU_IACCEnable_SetVt)==0)
    {
        if(chgEv_GW_514_HU_IACCEnable == 0)
        {
            phyValue = getvalue(this);
            // physical to raw conversion
            rawValue = ((phyValue -(0))/1);
            putValue(E_pubc_GW_GW_514_HU_IACCEnable_Rv, rawValue);
            chgEv_GW_514_HU_IACCEnable = 1;  
        }
        else
        {
            chgEv_GW_514_HU_IACCEnable = 0;
        }
    }
}

on envVar E_pubc_GW_GW_514_HU_IACCEnable_Vt
{
    qword rawValue = 0ll;
    if(getValue(E_pubc_GW_GW_514_HU_IACCEnable_SetVt))
    {
        //update the signal value
        Msg_GW_514.HU_IACCEnable=getValue(this);
    }
}

on envVar E_pubc_GW_GW_514_HU_IACCEnable_SetVt
{
    if(getValue(E_pubc_GW_GW_514_HU_IACCEnable_SetVt))
    {
        //update the signal value
        Msg_GW_514.HU_IACCEnable=getvalue(E_pubc_GW_GW_514_HU_IACCEnable_Vt);
    }
    else
    {
        Msg_GW_514.HU_IACCEnable=getValue(E_pubc_GW_GW_514_HU_IACCEnable_Rv);
    }
}
 
on envVar E_pubc_GW_GW_514_HU_LASModeSelection_Rv
{
    int64 rawValue = 0ll;
    float rawValue_float = 0.0;
    float phyValue = 0.0;        

    //set the signal with updated raw value
    if(getValue(E_pubc_GW_GW_514_HU_LASModeSelection_SetVt)==0)
    {
        rawValue = getvalue(this);
        if(chgEv_GW_514_HU_LASModeSelection == 0)
        {
            //type conversion to float
            rawValue_float = rawValue;        
            // raw to physical conversion
            phyValue = ((rawValue_float *1)+(0));
            putValue(E_pubc_GW_GW_514_HU_LASModeSelection_Pv, phyValue);
            chgEv_GW_514_HU_LASModeSelection = 1;
        }
        else
        {
            chgEv_GW_514_HU_LASModeSelection = 0;
        }    
        //update the signal value
        Msg_GW_514.HU_LASModeSelection=rawValue;        
    }                                                                           
}

on envVar E_pubc_GW_GW_514_HU_LASModeSelection_Pv
{
    int64 rawValue = 0ll;
    float phyValue = 0.0;
    
    //update the raw value with physical value 
    if(getValue(E_pubc_GW_GW_514_HU_LASModeSelection_SetVt)==0)
    {
        if(chgEv_GW_514_HU_LASModeSelection == 0)
        {
            phyValue = getvalue(this);
            // physical to raw conversion
            rawValue = ((phyValue -(0))/1);
            putValue(E_pubc_GW_GW_514_HU_LASModeSelection_Rv, rawValue);
            chgEv_GW_514_HU_LASModeSelection = 1;  
        }
        else
        {
            chgEv_GW_514_HU_LASModeSelection = 0;
        }
    }
}

on envVar E_pubc_GW_GW_514_HU_LASModeSelection_Vt
{
    qword rawValue = 0ll;
    if(getValue(E_pubc_GW_GW_514_HU_LASModeSelection_SetVt))
    {
        //update the signal value
        Msg_GW_514.HU_LASModeSelection=getValue(this);
    }
}

on envVar E_pubc_GW_GW_514_HU_LASModeSelection_SetVt
{
    if(getValue(E_pubc_GW_GW_514_HU_LASModeSelection_SetVt))
    {
        //update the signal value
        Msg_GW_514.HU_LASModeSelection=getvalue(E_pubc_GW_GW_514_HU_LASModeSelection_Vt);
    }
    else
    {
        Msg_GW_514.HU_LASModeSelection=getValue(E_pubc_GW_GW_514_HU_LASModeSelection_Rv);
    }
}
 

 
on envVar E_pubc_GW_GW_340_tx
{
    if(getValue(this))
    {       
        

        output(Msg_GW_340);        
    }
}

on envVar E_pubc_GW_GW_340_Range
{
    qword rawstatus = 0ll;
    qword rawValue = 0ll;    
    
    rawstatus = getvalue(this);    
    // set all the signals with min raw /max raw /init raw
    switch (rawstatus) 
    {
     case(0) :
        rawValue= 0;
        putValue(E_pubc_GW_GW_340_AC_FrBlowType_Rv, rawValue);
        break;
     case(1) :
        rawValue= 7;
        putValue(E_pubc_GW_GW_340_AC_FrBlowType_Rv, rawValue);
        break;
     default :
        rawValue= 0;
        putValue(E_pubc_GW_GW_340_AC_FrBlowType_Rv, rawValue);
      break;
   }
}

on envVar E_pubc_GW_GW_340_Dlc
{
    if(getValue(E_pubc_GW_GW_340_enDlc))
    {
        Msg_GW_340.dlc =getValue(this);
    }
    else
    {
        Msg_GW_340.dlc =8;
    }
}

on envVar E_pubc_GW_GW_340_enDlc
{
    //For Messages with DLC = 8, set wrong DLC to smaller than defined DLC
    //For Messages with DLC < 8 set wrong DLC to smaller/longer than defined DLC
    if(getValue(this))
    {
        Msg_GW_340.dlc =getValue(E_pubc_GW_GW_340_Dlc);
    }
    else
    {
        Msg_GW_340.dlc =8;
    }
}


on envVar E_pubc_GW_GW_340_AC_FrBlowType_Rv
{
    int64 rawValue = 0ll;
    float rawValue_float = 0.0;
    float phyValue = 0.0;        

    //set the signal with updated raw value
    if(getValue(E_pubc_GW_GW_340_AC_FrBlowType_SetVt)==0)
    {
        rawValue = getvalue(this);
        if(chgEv_GW_340_AC_FrBlowType == 0)
        {
            //type conversion to float
            rawValue_float = rawValue;        
            // raw to physical conversion
            phyValue = ((rawValue_float *1)+(0));
            putValue(E_pubc_GW_GW_340_AC_FrBlowType_Pv, phyValue);
            chgEv_GW_340_AC_FrBlowType = 1;
        }
        else
        {
            chgEv_GW_340_AC_FrBlowType = 0;
        }    
        //update the signal value
        Msg_GW_340.AC_FrBlowType=rawValue;        
    }                                                                           
}

on envVar E_pubc_GW_GW_340_AC_FrBlowType_Pv
{
    int64 rawValue = 0ll;
    float phyValue = 0.0;
    
    //update the raw value with physical value 
    if(getValue(E_pubc_GW_GW_340_AC_FrBlowType_SetVt)==0)
    {
        if(chgEv_GW_340_AC_FrBlowType == 0)
        {
            phyValue = getvalue(this);
            // physical to raw conversion
            rawValue = ((phyValue -(0))/1);
            putValue(E_pubc_GW_GW_340_AC_FrBlowType_Rv, rawValue);
            chgEv_GW_340_AC_FrBlowType = 1;  
        }
        else
        {
            chgEv_GW_340_AC_FrBlowType = 0;
        }
    }
}

on envVar E_pubc_GW_GW_340_AC_FrBlowType_Vt
{
    qword rawValue = 0ll;
    if(getValue(E_pubc_GW_GW_340_AC_FrBlowType_SetVt))
    {
        //update the signal value
        Msg_GW_340.AC_FrBlowType=getValue(this);
    }
}

on envVar E_pubc_GW_GW_340_AC_FrBlowType_SetVt
{
    if(getValue(E_pubc_GW_GW_340_AC_FrBlowType_SetVt))
    {
        //update the signal value
        Msg_GW_340.AC_FrBlowType=getvalue(E_pubc_GW_GW_340_AC_FrBlowType_Vt);
    }
    else
    {
        Msg_GW_340.AC_FrBlowType=getValue(E_pubc_GW_GW_340_AC_FrBlowType_Rv);
    }
}
 
on envVar E_pubc_GW_GW_28C_tx
{
    if(getValue(this))
    {       
        
        //update the BZ Signal
        if(GW_28C_GW_MFS_RollingCounter_28C_wrongvalctr == 0)
        {
            update_GW_28C_GW_MFS_RollingCounter_28C_counter();
            Msg_GW_28C.GW_MFS_RollingCounter_28C= GW_28C_GW_MFS_RollingCounter_28C_counter;
        }
        else if(GW_28C_GW_MFS_RollingCounter_28C_wrongvalctr > 0)
        {
			GW_28C_GW_MFS_RollingCounter_28C_counter=GW_28C_GW_MFS_RollingCounter_28C_counter + GW_28C_GW_MFS_RollingCounter_28C_wrongvalctr;
			 Msg_GW_28C.GW_MFS_RollingCounter_28C= GW_28C_GW_MFS_RollingCounter_28C_counter;
             /* GW_28C_GW_MFS_RollingCounter_28C_wrongvalctr--;
              // if counter becomes zero, update panel controller to zero
             if(GW_28C_GW_MFS_RollingCounter_28C_wrongvalctr == 0)
             {
                 putValue(E_pubc_GW_GW_28C_GW_MFS_RollingCounter_28C_wrongvalctr,0);
             } */
        }
        else
        {
            //do nothing
        }        
        //calculate the CRC CheckSum
        update_GW_28C_CRC_CheckSum();

        output(Msg_GW_28C);        
    }
}

on envVar E_pubc_GW_GW_28C_Range
{
    qword rawstatus = 0ll;
    qword rawValue = 0ll;    
    
    rawstatus = getvalue(this);    
    // set all the signals with min raw /max raw /init raw
    switch (rawstatus) 
    {
     case(0) :
        rawValue= 0;
        putValue(E_pubc_GW_GW_28C_GW_MFS_IACCenable_switch_signal_Rv, rawValue);
        break;
     case(1) :
        rawValue= 3;
        putValue(E_pubc_GW_GW_28C_GW_MFS_IACCenable_switch_signal_Rv, rawValue);
        break;
     default :
        rawValue= 0;
        putValue(E_pubc_GW_GW_28C_GW_MFS_IACCenable_switch_signal_Rv, rawValue);
      break;
   }
}

on envVar E_pubc_GW_GW_28C_Dlc
{
    if(getValue(E_pubc_GW_GW_28C_enDlc))
    {
        Msg_GW_28C.dlc =getValue(this);
    }
    else
    {
        Msg_GW_28C.dlc =8;
    }
}

on envVar E_pubc_GW_GW_28C_enDlc
{
    //For Messages with DLC = 8, set wrong DLC to smaller than defined DLC
    //For Messages with DLC < 8 set wrong DLC to smaller/longer than defined DLC
    if(getValue(this))
    {
        Msg_GW_28C.dlc =getValue(E_pubc_GW_GW_28C_Dlc);
    }
    else
    {
        Msg_GW_28C.dlc =8;
    }
}

on envVar E_pubc_GW_GW_28C_GW_MFS_CRCCheck_28C_wrongvalctr
{
    //update disturb count
    //disturb value range:(-1 = always send wrong value),( X>0 ,x is the number of Messages with wrong CHK sent)
    GW_28C_GW_MFS_CRCCheck_28C_wrongvalctr =getValue(this);    
}
on envVar E_pubc_GW_GW_28C_GW_MFS_RollingCounter_28C_wrongvalctr
{
    //update disturb count
    //disturb value range:(-1 = always send wrong value),( X>0 ,x is the number of Messages with wrong CHK sent)
    GW_28C_GW_MFS_RollingCounter_28C_wrongvalctr =getValue(this);    
}

on envVar E_pubc_GW_GW_28C_GW_MFS_IACCenable_switch_signal_Rv
{
    int64 rawValue = 0ll;
    float rawValue_float = 0.0;
    float phyValue = 0.0;        

    //set the signal with updated raw value
    if(getValue(E_pubc_GW_GW_28C_GW_MFS_IACCenable_switch_signal_SetVt)==0)
    {
        rawValue = getvalue(this);
        if(chgEv_GW_28C_GW_MFS_IACCenable_switch_signal == 0)
        {
            //type conversion to float
            rawValue_float = rawValue;        
            // raw to physical conversion
            phyValue = ((rawValue_float *1)+(0));
            putValue(E_pubc_GW_GW_28C_GW_MFS_IACCenable_switch_signal_Pv, phyValue);
            chgEv_GW_28C_GW_MFS_IACCenable_switch_signal = 1;
        }
        else
        {
            chgEv_GW_28C_GW_MFS_IACCenable_switch_signal = 0;
        }    
        //update the signal value
        Msg_GW_28C.GW_MFS_IACCenable_switch_signal=rawValue;        
    }                                                                           
}

on envVar E_pubc_GW_GW_28C_GW_MFS_IACCenable_switch_signal_Pv
{
    int64 rawValue = 0ll;
    float phyValue = 0.0;
    
    //update the raw value with physical value 
    if(getValue(E_pubc_GW_GW_28C_GW_MFS_IACCenable_switch_signal_SetVt)==0)
    {
        if(chgEv_GW_28C_GW_MFS_IACCenable_switch_signal == 0)
        {
            phyValue = getvalue(this);
            // physical to raw conversion
            rawValue = ((phyValue -(0))/1);
            putValue(E_pubc_GW_GW_28C_GW_MFS_IACCenable_switch_signal_Rv, rawValue);
            chgEv_GW_28C_GW_MFS_IACCenable_switch_signal = 1;  
        }
        else
        {
            chgEv_GW_28C_GW_MFS_IACCenable_switch_signal = 0;
        }
    }
}

on envVar E_pubc_GW_GW_28C_GW_MFS_IACCenable_switch_signal_Vt
{
    qword rawValue = 0ll;
    if(getValue(E_pubc_GW_GW_28C_GW_MFS_IACCenable_switch_signal_SetVt))
    {
        //update the signal value
        Msg_GW_28C.GW_MFS_IACCenable_switch_signal=getValue(this);
    }
}

on envVar E_pubc_GW_GW_28C_GW_MFS_IACCenable_switch_signal_SetVt
{
    if(getValue(E_pubc_GW_GW_28C_GW_MFS_IACCenable_switch_signal_SetVt))
    {
        //update the signal value
        Msg_GW_28C.GW_MFS_IACCenable_switch_signal=getvalue(E_pubc_GW_GW_28C_GW_MFS_IACCenable_switch_signal_Vt);
    }
    else
    {
        Msg_GW_28C.GW_MFS_IACCenable_switch_signal=getValue(E_pubc_GW_GW_28C_GW_MFS_IACCenable_switch_signal_Rv);
    }
}
 
on envVar E_pubc_GW_GW_366_tx
{
    if(getValue(this))
    {       
        

        output(Msg_GW_366);        
    }
}

on envVar E_pubc_GW_GW_366_Range
{
    qword rawstatus = 0ll;
    qword rawValue = 0ll;    
    
    rawstatus = getvalue(this);    
    // set all the signals with min raw /max raw /init raw
    switch (rawstatus) 
    {
     case(0) :
        rawValue= 0;
        putValue(E_pubc_GW_GW_366_AC_EnvironmentalTemp_Rv, rawValue);
        rawValue= 0;
        putValue(E_pubc_GW_GW_366_AC_EnvironmentalTempVD_Rv, rawValue);
        break;
     case(1) :
        rawValue= 254;
        putValue(E_pubc_GW_GW_366_AC_EnvironmentalTemp_Rv, rawValue);
        rawValue= 1;
        putValue(E_pubc_GW_GW_366_AC_EnvironmentalTempVD_Rv, rawValue);
        break;
     default :
        rawValue= 0;
        putValue(E_pubc_GW_GW_366_AC_EnvironmentalTemp_Rv, rawValue);
        rawValue= 0;
        putValue(E_pubc_GW_GW_366_AC_EnvironmentalTempVD_Rv, rawValue);
      break;
   }
}

on envVar E_pubc_GW_GW_366_Dlc
{
    if(getValue(E_pubc_GW_GW_366_enDlc))
    {
        Msg_GW_366.dlc =getValue(this);
    }
    else
    {
        Msg_GW_366.dlc =8;
    }
}

on envVar E_pubc_GW_GW_366_enDlc
{
    //For Messages with DLC = 8, set wrong DLC to smaller than defined DLC
    //For Messages with DLC < 8 set wrong DLC to smaller/longer than defined DLC
    if(getValue(this))
    {
        Msg_GW_366.dlc =getValue(E_pubc_GW_GW_366_Dlc);
    }
    else
    {
        Msg_GW_366.dlc =8;
    }
}


on envVar E_pubc_GW_GW_366_AC_EnvironmentalTemp_Rv
{
    int64 rawValue = 0ll;
    float rawValue_float = 0.0;
    float phyValue = 0.0;        

    //set the signal with updated raw value
    if(getValue(E_pubc_GW_GW_366_AC_EnvironmentalTemp_SetVt)==0)
    {
        rawValue = getvalue(this);
        if(chgEv_GW_366_AC_EnvironmentalTemp == 0)
        {
            //type conversion to float
            rawValue_float = rawValue;        
            // raw to physical conversion
            phyValue = ((rawValue_float *0.5)+(-40));
            putValue(E_pubc_GW_GW_366_AC_EnvironmentalTemp_Pv, phyValue);
            chgEv_GW_366_AC_EnvironmentalTemp = 1;
        }
        else
        {
            chgEv_GW_366_AC_EnvironmentalTemp = 0;
        }    
        //update the signal value
        Msg_GW_366.AC_EnvironmentalTemp=rawValue;        
    }                                                                           
}

on envVar E_pubc_GW_GW_366_AC_EnvironmentalTemp_Pv
{
    int64 rawValue = 0ll;
    float phyValue = 0.0;
    
    //update the raw value with physical value 
    if(getValue(E_pubc_GW_GW_366_AC_EnvironmentalTemp_SetVt)==0)
    {
        if(chgEv_GW_366_AC_EnvironmentalTemp == 0)
        {
            phyValue = getvalue(this);
            // physical to raw conversion
            rawValue = ((phyValue -(-40))/0.5);
            putValue(E_pubc_GW_GW_366_AC_EnvironmentalTemp_Rv, rawValue);
            chgEv_GW_366_AC_EnvironmentalTemp = 1;  
        }
        else
        {
            chgEv_GW_366_AC_EnvironmentalTemp = 0;
        }
    }
}

on envVar E_pubc_GW_GW_366_AC_EnvironmentalTemp_Vt
{
    qword rawValue = 0ll;
    if(getValue(E_pubc_GW_GW_366_AC_EnvironmentalTemp_SetVt))
    {
        //update the signal value
        Msg_GW_366.AC_EnvironmentalTemp=getValue(this);
    }
}

on envVar E_pubc_GW_GW_366_AC_EnvironmentalTemp_SetVt
{
    if(getValue(E_pubc_GW_GW_366_AC_EnvironmentalTemp_SetVt))
    {
        //update the signal value
        Msg_GW_366.AC_EnvironmentalTemp=getvalue(E_pubc_GW_GW_366_AC_EnvironmentalTemp_Vt);
    }
    else
    {
        Msg_GW_366.AC_EnvironmentalTemp=getValue(E_pubc_GW_GW_366_AC_EnvironmentalTemp_Rv);
    }
}
 
on envVar E_pubc_GW_GW_366_AC_EnvironmentalTempVD_Rv
{
    int64 rawValue = 0ll;
    float rawValue_float = 0.0;
    float phyValue = 0.0;        

    //set the signal with updated raw value
    if(getValue(E_pubc_GW_GW_366_AC_EnvironmentalTempVD_SetVt)==0)
    {
        rawValue = getvalue(this);
        if(chgEv_GW_366_AC_EnvironmentalTempVD == 0)
        {
            //type conversion to float
            rawValue_float = rawValue;        
            // raw to physical conversion
            phyValue = ((rawValue_float *1)+(0));
            putValue(E_pubc_GW_GW_366_AC_EnvironmentalTempVD_Pv, phyValue);
            chgEv_GW_366_AC_EnvironmentalTempVD = 1;
        }
        else
        {
            chgEv_GW_366_AC_EnvironmentalTempVD = 0;
        }    
        //update the signal value
        Msg_GW_366.AC_EnvironmentalTempVD=rawValue;        
    }                                                                           
}

on envVar E_pubc_GW_GW_366_AC_EnvironmentalTempVD_Pv
{
    int64 rawValue = 0ll;
    float phyValue = 0.0;
    
    //update the raw value with physical value 
    if(getValue(E_pubc_GW_GW_366_AC_EnvironmentalTempVD_SetVt)==0)
    {
        if(chgEv_GW_366_AC_EnvironmentalTempVD == 0)
        {
            phyValue = getvalue(this);
            // physical to raw conversion
            rawValue = ((phyValue -(0))/1);
            putValue(E_pubc_GW_GW_366_AC_EnvironmentalTempVD_Rv, rawValue);
            chgEv_GW_366_AC_EnvironmentalTempVD = 1;  
        }
        else
        {
            chgEv_GW_366_AC_EnvironmentalTempVD = 0;
        }
    }
}

on envVar E_pubc_GW_GW_366_AC_EnvironmentalTempVD_Vt
{
    qword rawValue = 0ll;
    if(getValue(E_pubc_GW_GW_366_AC_EnvironmentalTempVD_SetVt))
    {
        //update the signal value
        Msg_GW_366.AC_EnvironmentalTempVD=getValue(this);
    }
}

on envVar E_pubc_GW_GW_366_AC_EnvironmentalTempVD_SetVt
{
    if(getValue(E_pubc_GW_GW_366_AC_EnvironmentalTempVD_SetVt))
    {
        //update the signal value
        Msg_GW_366.AC_EnvironmentalTempVD=getvalue(E_pubc_GW_GW_366_AC_EnvironmentalTempVD_Vt);
    }
    else
    {
        Msg_GW_366.AC_EnvironmentalTempVD=getValue(E_pubc_GW_GW_366_AC_EnvironmentalTempVD_Rv);
    }
}
 
on envVar E_pubc_GW_GW_530_tx
{
    if(getValue(this))
    {       
        

        output(Msg_GW_530);        
    }
}

on envVar E_pubc_GW_GW_530_Range
{
    qword rawstatus = 0ll;
    qword rawValue = 0ll;    
    
    rawstatus = getvalue(this);    
    // set all the signals with min raw /max raw /init raw
    switch (rawstatus) 
    {
     case(0) :
        rawValue= 0;
        putValue(E_pubc_GW_GW_530_IP_TotalOdometer_Rv, rawValue);
        break;
     case(1) :
        rawValue= 9999990;
        putValue(E_pubc_GW_GW_530_IP_TotalOdometer_Rv, rawValue);
        break;
     default :
        rawValue= 0;
        putValue(E_pubc_GW_GW_530_IP_TotalOdometer_Rv, rawValue);
      break;
   }
}

on envVar E_pubc_GW_GW_530_Dlc
{
    if(getValue(E_pubc_GW_GW_530_enDlc))
    {
        Msg_GW_530.dlc =getValue(this);
    }
    else
    {
        Msg_GW_530.dlc =8;
    }
}

on envVar E_pubc_GW_GW_530_enDlc
{
    //For Messages with DLC = 8, set wrong DLC to smaller than defined DLC
    //For Messages with DLC < 8 set wrong DLC to smaller/longer than defined DLC
    if(getValue(this))
    {
        Msg_GW_530.dlc =getValue(E_pubc_GW_GW_530_Dlc);
    }
    else
    {
        Msg_GW_530.dlc =8;
    }
}


on envVar E_pubc_GW_GW_530_IP_TotalOdometer_Rv
{
    int64 rawValue = 0ll;
    float rawValue_float = 0.0;
    float phyValue = 0.0;        

    //set the signal with updated raw value
    {
        rawValue = getvalue(this);
        if(chgEv_GW_530_IP_TotalOdometer == 0)
        {
            //type conversion to float
            rawValue_float = rawValue;        
            // raw to physical conversion
            phyValue = ((rawValue_float *0.1)+(0));
            putValue(E_pubc_GW_GW_530_IP_TotalOdometer_Pv, phyValue);
            chgEv_GW_530_IP_TotalOdometer = 1;
        }
        else
        {
            chgEv_GW_530_IP_TotalOdometer = 0;
        }    
        //update the signal value
        Msg_GW_530.IP_TotalOdometer=rawValue;        
    }                                                                           
}

on envVar E_pubc_GW_GW_530_IP_TotalOdometer_Pv
{
    int64 rawValue = 0ll;
    float phyValue = 0.0;
    
    //update the raw value with physical value 
    {
        if(chgEv_GW_530_IP_TotalOdometer == 0)
        {
            phyValue = getvalue(this);
            // physical to raw conversion
            rawValue = ((phyValue -(0))/0.1);
            putValue(E_pubc_GW_GW_530_IP_TotalOdometer_Rv, rawValue);
            chgEv_GW_530_IP_TotalOdometer = 1;  
        }
        else
        {
            chgEv_GW_530_IP_TotalOdometer = 0;
        }
    }
}


 

update_GW_170_EPS_RollingCounter_170_counter()
{
    //update the signal value
    Msg_GW_170.EPS_RollingCounter_170=GW_170_EPS_RollingCounter_170_counter;
    
    if(GW_170_EPS_RollingCounter_170_counter == 15)
    {
        GW_170_EPS_RollingCounter_170_counter =0;
    }
    else
    {
        GW_170_EPS_RollingCounter_170_counter =GW_170_EPS_RollingCounter_170_counter+1;
    }    
    
}
 
 
on envVar E_pubc_GW_GW_180_tx
{
    if(getValue(this))
    {       
        
        //update the BZ Signal
        if(GW_180_SAS_RollingCounter_wrongvalctr == 0)
        {
            update_GW_180_SAS_RollingCounter_counter();
            Msg_GW_180.SAS_RollingCounter= GW_180_SAS_RollingCounter_counter;
        }
        else if(GW_180_SAS_RollingCounter_wrongvalctr > 0)
        {
			GW_180_SAS_RollingCounter_counter=GW_180_SAS_RollingCounter_counter + GW_180_SAS_RollingCounter_wrongvalctr;
			 Msg_GW_180.SAS_RollingCounter= GW_180_SAS_RollingCounter_counter;
             /* GW_180_SAS_RollingCounter_wrongvalctr--;
              // if counter becomes zero, update panel controller to zero
             if(GW_180_SAS_RollingCounter_wrongvalctr == 0)
             {
                 putValue(E_pubc_GW_GW_180_SAS_RollingCounter_wrongvalctr,0);
             } */
        }
        else
        {
            //do nothing
        }        
        //calculate the CRC CheckSum
        update_GW_180_CRC_CheckSum();

        output(Msg_GW_180);        
    }
}

on envVar E_pubc_GW_GW_180_Range
{
    qword rawstatus = 0ll;
    qword rawValue = 0ll;    
    
    rawstatus = getvalue(this);    
    // set all the signals with min raw /max raw /init raw
    switch (rawstatus) 
    {
     case(0) :
        rawValue= 0;
        putValue(E_pubc_GW_GW_180_SAS_SteeringAngleValid_Rv, rawValue);
        rawValue= 0;
        putValue(E_pubc_GW_GW_180_SAS_Calibrated_Rv, rawValue);
        rawValue= 0;
        putValue(E_pubc_GW_GW_180_SAS_TrimmingSts_Rv, rawValue);
        rawValue= -7800;
        putValue(E_pubc_GW_GW_180_SAS_SteeringAngle_Rv, rawValue);
        rawValue= 0;
        putValue(E_pubc_GW_GW_180_SAS_SteeringAngleSpeed_Rv, rawValue);
        rawValue= 0;
        putValue(E_pubc_GW_GW_180_SAS_SASFailure_Rv, rawValue);
        break;
     case(1) :
        rawValue= 1;
        putValue(E_pubc_GW_GW_180_SAS_SteeringAngleValid_Rv, rawValue);
        rawValue= 1;
        putValue(E_pubc_GW_GW_180_SAS_Calibrated_Rv, rawValue);
        rawValue= 1;
        putValue(E_pubc_GW_GW_180_SAS_TrimmingSts_Rv, rawValue);
        rawValue= 7800;
        putValue(E_pubc_GW_GW_180_SAS_SteeringAngle_Rv, rawValue);
        rawValue= 254;
        putValue(E_pubc_GW_GW_180_SAS_SteeringAngleSpeed_Rv, rawValue);
        rawValue= 1;
        putValue(E_pubc_GW_GW_180_SAS_SASFailure_Rv, rawValue);
        break;
     default :
        rawValue= 0;
        putValue(E_pubc_GW_GW_180_SAS_SteeringAngleValid_Rv, rawValue);
        rawValue= 0;
        putValue(E_pubc_GW_GW_180_SAS_Calibrated_Rv, rawValue);
        rawValue= 0;
        putValue(E_pubc_GW_GW_180_SAS_TrimmingSts_Rv, rawValue);
        rawValue= -7800;
        putValue(E_pubc_GW_GW_180_SAS_SteeringAngle_Rv, rawValue);
        rawValue= 0;
        putValue(E_pubc_GW_GW_180_SAS_SteeringAngleSpeed_Rv, rawValue);
        rawValue= 0;
        putValue(E_pubc_GW_GW_180_SAS_SASFailure_Rv, rawValue);
      break;
   }
}

on envVar E_pubc_GW_GW_180_Dlc
{
    if(getValue(E_pubc_GW_GW_180_enDlc))
    {
        Msg_GW_180.dlc =getValue(this);
    }
    else
    {
        Msg_GW_180.dlc =8;
    }
}

on envVar E_pubc_GW_GW_180_enDlc
{
    //For Messages with DLC = 8, set wrong DLC to smaller than defined DLC
    //For Messages with DLC < 8 set wrong DLC to smaller/longer than defined DLC
    if(getValue(this))
    {
        Msg_GW_180.dlc =getValue(E_pubc_GW_GW_180_Dlc);
    }
    else
    {
        Msg_GW_180.dlc =8;
    }
}

on envVar E_pubc_GW_GW_180_SAS_CRCCheck_wrongvalctr
{
    //update disturb count
    //disturb value range:(-1 = always send wrong value),( X>0 ,x is the number of Messages with wrong CHK sent)
    GW_180_SAS_CRCCheck_wrongvalctr =getValue(this);    
}
on envVar E_pubc_GW_GW_180_SAS_RollingCounter_wrongvalctr
{
    //update disturb count
    //disturb value range:(-1 = always send wrong value),( X>0 ,x is the number of Messages with wrong CHK sent)
    GW_180_SAS_RollingCounter_wrongvalctr =getValue(this);    
}

on envVar E_pubc_GW_GW_180_SAS_SteeringAngleValid_Rv
{
    int64 rawValue = 0ll;
    float rawValue_float = 0.0;
    float phyValue = 0.0;        

    //set the signal with updated raw value
    if(getValue(E_pubc_GW_GW_180_SAS_SteeringAngleValid_SetVt)==0)
    {
        rawValue = getvalue(this);
        if(chgEv_GW_180_SAS_SteeringAngleValid == 0)
        {
            //type conversion to float
            rawValue_float = rawValue;        
            // raw to physical conversion
            phyValue = ((rawValue_float *1)+(0));
            putValue(E_pubc_GW_GW_180_SAS_SteeringAngleValid_Pv, phyValue);
            chgEv_GW_180_SAS_SteeringAngleValid = 1;
        }
        else
        {
            chgEv_GW_180_SAS_SteeringAngleValid = 0;
        }    
        //update the signal value
        Msg_GW_180.SAS_SteeringAngleValid=rawValue;        
    }                                                                           
}

on envVar E_pubc_GW_GW_180_SAS_SteeringAngleValid_Pv
{
    int64 rawValue = 0ll;
    float phyValue = 0.0;
    
    //update the raw value with physical value 
    if(getValue(E_pubc_GW_GW_180_SAS_SteeringAngleValid_SetVt)==0)
    {
        if(chgEv_GW_180_SAS_SteeringAngleValid == 0)
        {
            phyValue = getvalue(this);
            // physical to raw conversion
            rawValue = ((phyValue -(0))/1);
            putValue(E_pubc_GW_GW_180_SAS_SteeringAngleValid_Rv, rawValue);
            chgEv_GW_180_SAS_SteeringAngleValid = 1;  
        }
        else
        {
            chgEv_GW_180_SAS_SteeringAngleValid = 0;
        }
    }
}

on envVar E_pubc_GW_GW_180_SAS_SteeringAngleValid_Vt
{
    qword rawValue = 0ll;
    if(getValue(E_pubc_GW_GW_180_SAS_SteeringAngleValid_SetVt))
    {
        //update the signal value
        Msg_GW_180.SAS_SteeringAngleValid=getValue(this);
    }
}

on envVar E_pubc_GW_GW_180_SAS_SteeringAngleValid_SetVt
{
    if(getValue(E_pubc_GW_GW_180_SAS_SteeringAngleValid_SetVt))
    {
        //update the signal value
        Msg_GW_180.SAS_SteeringAngleValid=getvalue(E_pubc_GW_GW_180_SAS_SteeringAngleValid_Vt);
    }
    else
    {
        Msg_GW_180.SAS_SteeringAngleValid=getValue(E_pubc_GW_GW_180_SAS_SteeringAngleValid_Rv);
    }
}
 
on envVar E_pubc_GW_GW_180_SAS_Calibrated_Rv
{
    int64 rawValue = 0ll;
    float rawValue_float = 0.0;
    float phyValue = 0.0;        

    //set the signal with updated raw value
    if(getValue(E_pubc_GW_GW_180_SAS_Calibrated_SetVt)==0)
    {
        rawValue = getvalue(this);
        if(chgEv_GW_180_SAS_Calibrated == 0)
        {
            //type conversion to float
            rawValue_float = rawValue;        
            // raw to physical conversion
            phyValue = ((rawValue_float *1)+(0));
            putValue(E_pubc_GW_GW_180_SAS_Calibrated_Pv, phyValue);
            chgEv_GW_180_SAS_Calibrated = 1;
        }
        else
        {
            chgEv_GW_180_SAS_Calibrated = 0;
        }    
        //update the signal value
        Msg_GW_180.SAS_Calibrated=rawValue;        
    }                                                                           
}

on envVar E_pubc_GW_GW_180_SAS_Calibrated_Pv
{
    int64 rawValue = 0ll;
    float phyValue = 0.0;
    
    //update the raw value with physical value 
    if(getValue(E_pubc_GW_GW_180_SAS_Calibrated_SetVt)==0)
    {
        if(chgEv_GW_180_SAS_Calibrated == 0)
        {
            phyValue = getvalue(this);
            // physical to raw conversion
            rawValue = ((phyValue -(0))/1);
            putValue(E_pubc_GW_GW_180_SAS_Calibrated_Rv, rawValue);
            chgEv_GW_180_SAS_Calibrated = 1;  
        }
        else
        {
            chgEv_GW_180_SAS_Calibrated = 0;
        }
    }
}

on envVar E_pubc_GW_GW_180_SAS_Calibrated_Vt
{
    qword rawValue = 0ll;
    if(getValue(E_pubc_GW_GW_180_SAS_Calibrated_SetVt))
    {
        //update the signal value
        Msg_GW_180.SAS_Calibrated=getValue(this);
    }
}

on envVar E_pubc_GW_GW_180_SAS_Calibrated_SetVt
{
    if(getValue(E_pubc_GW_GW_180_SAS_Calibrated_SetVt))
    {
        //update the signal value
        Msg_GW_180.SAS_Calibrated=getvalue(E_pubc_GW_GW_180_SAS_Calibrated_Vt);
    }
    else
    {
        Msg_GW_180.SAS_Calibrated=getValue(E_pubc_GW_GW_180_SAS_Calibrated_Rv);
    }
}
 
on envVar E_pubc_GW_GW_180_SAS_TrimmingSts_Rv
{
    int64 rawValue = 0ll;
    float rawValue_float = 0.0;
    float phyValue = 0.0;        

    //set the signal with updated raw value
    if(getValue(E_pubc_GW_GW_180_SAS_TrimmingSts_SetVt)==0)
    {
        rawValue = getvalue(this);
        if(chgEv_GW_180_SAS_TrimmingSts == 0)
        {
            //type conversion to float
            rawValue_float = rawValue;        
            // raw to physical conversion
            phyValue = ((rawValue_float *1)+(0));
            putValue(E_pubc_GW_GW_180_SAS_TrimmingSts_Pv, phyValue);
            chgEv_GW_180_SAS_TrimmingSts = 1;
        }
        else
        {
            chgEv_GW_180_SAS_TrimmingSts = 0;
        }    
        //update the signal value
        Msg_GW_180.SAS_TrimmingSts=rawValue;        
    }                                                                           
}

on envVar E_pubc_GW_GW_180_SAS_TrimmingSts_Pv
{
    int64 rawValue = 0ll;
    float phyValue = 0.0;
    
    //update the raw value with physical value 
    if(getValue(E_pubc_GW_GW_180_SAS_TrimmingSts_SetVt)==0)
    {
        if(chgEv_GW_180_SAS_TrimmingSts == 0)
        {
            phyValue = getvalue(this);
            // physical to raw conversion
            rawValue = ((phyValue -(0))/1);
            putValue(E_pubc_GW_GW_180_SAS_TrimmingSts_Rv, rawValue);
            chgEv_GW_180_SAS_TrimmingSts = 1;  
        }
        else
        {
            chgEv_GW_180_SAS_TrimmingSts = 0;
        }
    }
}

on envVar E_pubc_GW_GW_180_SAS_TrimmingSts_Vt
{
    qword rawValue = 0ll;
    if(getValue(E_pubc_GW_GW_180_SAS_TrimmingSts_SetVt))
    {
        //update the signal value
        Msg_GW_180.SAS_TrimmingSts=getValue(this);
    }
}

on envVar E_pubc_GW_GW_180_SAS_TrimmingSts_SetVt
{
    if(getValue(E_pubc_GW_GW_180_SAS_TrimmingSts_SetVt))
    {
        //update the signal value
        Msg_GW_180.SAS_TrimmingSts=getvalue(E_pubc_GW_GW_180_SAS_TrimmingSts_Vt);
    }
    else
    {
        Msg_GW_180.SAS_TrimmingSts=getValue(E_pubc_GW_GW_180_SAS_TrimmingSts_Rv);
    }
}
 
on envVar E_pubc_GW_GW_180_SAS_SteeringAngle_Rv
{
    int64 rawValue = 0ll;
    float rawValue_float = 0.0;
    float phyValue = 0.0;        

    //set the signal with updated raw value
    {
        rawValue = getvalue(this);
        if(chgEv_GW_180_SAS_SteeringAngle == 0)
        {
            //type conversion to float
            rawValue_float = rawValue;        
            // raw to physical conversion
            phyValue = ((rawValue_float *0.1)+(0));
            putValue(E_pubc_GW_GW_180_SAS_SteeringAngle_Pv, phyValue);
            chgEv_GW_180_SAS_SteeringAngle = 1;
        }
        else
        {
            chgEv_GW_180_SAS_SteeringAngle = 0;
        }    
        //update the signal value
        Msg_GW_180.SAS_SteeringAngle=rawValue;        
    }                                                                           
}

on envVar E_pubc_GW_GW_180_SAS_SteeringAngle_Pv
{
    int64 rawValue = 0ll;
    float phyValue = 0.0;
    
    //update the raw value with physical value 
    {
        if(chgEv_GW_180_SAS_SteeringAngle == 0)
        {
            phyValue = getvalue(this);
            // physical to raw conversion
            rawValue = ((phyValue -(0))/0.1);
            putValue(E_pubc_GW_GW_180_SAS_SteeringAngle_Rv, rawValue);
            chgEv_GW_180_SAS_SteeringAngle = 1;  
        }
        else
        {
            chgEv_GW_180_SAS_SteeringAngle = 0;
        }
    }
}


 
on envVar E_pubc_GW_GW_180_SAS_SteeringAngleSpeed_Rv
{
    int64 rawValue = 0ll;
    float rawValue_float = 0.0;
    float phyValue = 0.0;        

    //set the signal with updated raw value
    {
        rawValue = getvalue(this);
        if(chgEv_GW_180_SAS_SteeringAngleSpeed == 0)
        {
            //type conversion to float
            rawValue_float = rawValue;        
            // raw to physical conversion
            phyValue = ((rawValue_float *4)+(0));
            putValue(E_pubc_GW_GW_180_SAS_SteeringAngleSpeed_Pv, phyValue);
            chgEv_GW_180_SAS_SteeringAngleSpeed = 1;
        }
        else
        {
            chgEv_GW_180_SAS_SteeringAngleSpeed = 0;
        }    
        //update the signal value
        Msg_GW_180.SAS_SteeringAngleSpeed=rawValue;        
    }                                                                           
}

on envVar E_pubc_GW_GW_180_SAS_SteeringAngleSpeed_Pv
{
    int64 rawValue = 0ll;
    float phyValue = 0.0;
    
    //update the raw value with physical value 
    {
        if(chgEv_GW_180_SAS_SteeringAngleSpeed == 0)
        {
            phyValue = getvalue(this);
            // physical to raw conversion
            rawValue = ((phyValue -(0))/4);
            putValue(E_pubc_GW_GW_180_SAS_SteeringAngleSpeed_Rv, rawValue);
            chgEv_GW_180_SAS_SteeringAngleSpeed = 1;  
        }
        else
        {
            chgEv_GW_180_SAS_SteeringAngleSpeed = 0;
        }
    }
}


 
on envVar E_pubc_GW_GW_180_SAS_SASFailure_Rv
{
    int64 rawValue = 0ll;
    float rawValue_float = 0.0;
    float phyValue = 0.0;        

    //set the signal with updated raw value
    if(getValue(E_pubc_GW_GW_180_SAS_SASFailure_SetVt)==0)
    {
        rawValue = getvalue(this);
        if(chgEv_GW_180_SAS_SASFailure == 0)
        {
            //type conversion to float
            rawValue_float = rawValue;        
            // raw to physical conversion
            phyValue = ((rawValue_float *1)+(0));
            putValue(E_pubc_GW_GW_180_SAS_SASFailure_Pv, phyValue);
            chgEv_GW_180_SAS_SASFailure = 1;
        }
        else
        {
            chgEv_GW_180_SAS_SASFailure = 0;
        }    
        //update the signal value
        Msg_GW_180.SAS_SASFailure=rawValue;        
    }                                                                           
}

on envVar E_pubc_GW_GW_180_SAS_SASFailure_Pv
{
    int64 rawValue = 0ll;
    float phyValue = 0.0;
    
    //update the raw value with physical value 
    if(getValue(E_pubc_GW_GW_180_SAS_SASFailure_SetVt)==0)
    {
        if(chgEv_GW_180_SAS_SASFailure == 0)
        {
            phyValue = getvalue(this);
            // physical to raw conversion
            rawValue = ((phyValue -(0))/1);
            putValue(E_pubc_GW_GW_180_SAS_SASFailure_Rv, rawValue);
            chgEv_GW_180_SAS_SASFailure = 1;  
        }
        else
        {
            chgEv_GW_180_SAS_SASFailure = 0;
        }
    }
}

on envVar E_pubc_GW_GW_180_SAS_SASFailure_Vt
{
    qword rawValue = 0ll;
    if(getValue(E_pubc_GW_GW_180_SAS_SASFailure_SetVt))
    {
        //update the signal value
        Msg_GW_180.SAS_SASFailure=getValue(this);
    }
}

on envVar E_pubc_GW_GW_180_SAS_SASFailure_SetVt
{
    if(getValue(E_pubc_GW_GW_180_SAS_SASFailure_SetVt))
    {
        //update the signal value
        Msg_GW_180.SAS_SASFailure=getvalue(E_pubc_GW_GW_180_SAS_SASFailure_Vt);
    }
    else
    {
        Msg_GW_180.SAS_SASFailure=getValue(E_pubc_GW_GW_180_SAS_SASFailure_Rv);
    }
}
 
on envVar E_pubc_GW_GW_3BB_tx
{
    if(getValue(this))
    {       
        

        output(Msg_GW_3BB);        
    }
}

on envVar E_pubc_GW_GW_3BB_Range
{
    qword rawstatus = 0ll;
    qword rawValue = 0ll;    
    
    rawstatus = getvalue(this);    
    // set all the signals with min raw /max raw /init raw
    switch (rawstatus) 
    {
     case(0) :
        rawValue= 0;
        putValue(E_pubc_GW_GW_3BB_HU_SpeedLimitDistance_Rv, rawValue);
        break;
     case(1) :
        rawValue= 60;
        putValue(E_pubc_GW_GW_3BB_HU_SpeedLimitDistance_Rv, rawValue);
        break;
     default :
        rawValue= 0;
        putValue(E_pubc_GW_GW_3BB_HU_SpeedLimitDistance_Rv, rawValue);
      break;
   }
}

on envVar E_pubc_GW_GW_3BB_Dlc
{
    if(getValue(E_pubc_GW_GW_3BB_enDlc))
    {
        Msg_GW_3BB.dlc =getValue(this);
    }
    else
    {   
	   Msg_GW_3BB.dlc = 8;
	   	
  }
}

on envVar E_pubc_GW_GW_3BB_enDlc
{
    //For Messages with DLC = 8, set wrong DLC to smaller than defined DLC
    //For Messages with DLC < 8 set wrong DLC to smaller/longer than defined DLC
    if(getValue(this))
    {
        Msg_GW_3BB.dlc =getValue(E_pubc_GW_GW_3BB_Dlc);
    }
    else
    {
	   Msg_GW_3BB.dlc = 8;
			
    }
}


on envVar E_pubc_GW_GW_3BB_HU_SpeedLimitDistance_Rv
{
    int64 rawValue = 0ll;
    float rawValue_float = 0.0;
    float phyValue = 0.0;        

    //set the signal with updated raw value
    if(getValue(E_pubc_GW_GW_3BB_HU_SpeedLimitDistance_SetVt)==0)
    {
        rawValue = getvalue(this);
        if(chgEv_GW_3BB_HU_SpeedLimitDistance == 0)
        {
            //type conversion to float
            rawValue_float = rawValue;        
            // raw to physical conversion
            phyValue = ((rawValue_float *10)+(0));
            putValue(E_pubc_GW_GW_3BB_HU_SpeedLimitDistance_Pv, phyValue);
            chgEv_GW_3BB_HU_SpeedLimitDistance = 1;
        }
        else
        {
            chgEv_GW_3BB_HU_SpeedLimitDistance = 0;
        }    
        //update the signal value
        Msg_GW_3BB.HU_SpeedLimitDistance=rawValue;        
    }                                                                           
}

on envVar E_pubc_GW_GW_3BB_HU_SpeedLimitDistance_Pv
{
    int64 rawValue = 0ll;
    float phyValue = 0.0;
    
    //update the raw value with physical value 
    if(getValue(E_pubc_GW_GW_3BB_HU_SpeedLimitDistance_SetVt)==0)
    {
        if(chgEv_GW_3BB_HU_SpeedLimitDistance == 0)
        {
            phyValue = getvalue(this);
            // physical to raw conversion
            rawValue = ((phyValue -(0))/10);
            putValue(E_pubc_GW_GW_3BB_HU_SpeedLimitDistance_Rv, rawValue);
            chgEv_GW_3BB_HU_SpeedLimitDistance = 1;  
        }
        else
        {
            chgEv_GW_3BB_HU_SpeedLimitDistance = 0;
        }
    }
}

on envVar E_pubc_GW_GW_3BB_HU_SpeedLimitDistance_Vt
{
    qword rawValue = 0ll;
    if(getValue(E_pubc_GW_GW_3BB_HU_SpeedLimitDistance_SetVt))
    {
        //update the signal value
        Msg_GW_3BB.HU_SpeedLimitDistance=getValue(this);
    }
}

on envVar E_pubc_GW_GW_3BB_HU_SpeedLimitDistance_SetVt
{
    if(getValue(E_pubc_GW_GW_3BB_HU_SpeedLimitDistance_SetVt))
    {
        //update the signal value
        Msg_GW_3BB.HU_SpeedLimitDistance=getvalue(E_pubc_GW_GW_3BB_HU_SpeedLimitDistance_Vt);
    }
    else
    {
        Msg_GW_3BB.HU_SpeedLimitDistance=getValue(E_pubc_GW_GW_3BB_HU_SpeedLimitDistance_Rv);
    }
}
 

update_GW_3B8_HU_RollingCounter_3B8_counter()
{
    //update the signal value
    Msg_GW_3B8.HU_RollingCounter_3B8=GW_3B8_HU_RollingCounter_3B8_counter;
    
    if(GW_3B8_HU_RollingCounter_3B8_counter == 15)
    {
        GW_3B8_HU_RollingCounter_3B8_counter =0;
    }
    else
    {
        GW_3B8_HU_RollingCounter_3B8_counter =GW_3B8_HU_RollingCounter_3B8_counter+1;
    }    
    
}
update_GW_3C4_HU_RollingCounter_3C4_counter()
{
    //update the signal value
    Msg_GW_3C4.HU_RollingCounter_3C4=GW_3C4_HU_RollingCounter_3C4_counter;
    
    if(GW_3C4_HU_RollingCounter_3C4_counter == 15)
    {
        GW_3C4_HU_RollingCounter_3C4_counter =0;
    }
    else
    {
        GW_3C4_HU_RollingCounter_3C4_counter =GW_3C4_HU_RollingCounter_3C4_counter+1;
    }    
    
}
update_GW_50_SRS_RollingCounter_id050_counter()
{
    //update the signal value
    Msg_GW_50.SRS_RollingCounter_id050=GW_50_SRS_RollingCounter_id050_counter;
    
    if(GW_50_SRS_RollingCounter_id050_counter == 15)
    {
        GW_50_SRS_RollingCounter_id050_counter =0;
    }
    else
    {
        GW_50_SRS_RollingCounter_id050_counter =GW_50_SRS_RollingCounter_id050_counter+1;
    }    
    
}
update_GW_24F_EPS_RollingCounter_24F_counter()
{
    //update the signal value
    Msg_GW_24F.EPS_RollingCounter_24F=GW_24F_EPS_RollingCounter_24F_counter;
    
    if(GW_24F_EPS_RollingCounter_24F_counter == 15)
    {
        GW_24F_EPS_RollingCounter_24F_counter =0;
    }
    else
    {
        GW_24F_EPS_RollingCounter_24F_counter =GW_24F_EPS_RollingCounter_24F_counter+1;
    }    
    
}
update_GW_3C7_HU_RollingCounter_3C7_counter()
{
    //update the signal value
    Msg_GW_3C7.HU_RollingCounter_3C7=GW_3C7_HU_RollingCounter_3C7_counter;
    
    if(GW_3C7_HU_RollingCounter_3C7_counter == 15)
    {
        GW_3C7_HU_RollingCounter_3C7_counter =0;
    }
    else
    {
        GW_3C7_HU_RollingCounter_3C7_counter =GW_3C7_HU_RollingCounter_3C7_counter+1;
    }    
    
}
update_GW_3C6_HU_RollingCounter_3C6_counter()
{
    //update the signal value
    Msg_GW_3C6.HU_RollingCounter_3C6=GW_3C6_HU_RollingCounter_3C6_counter;
    
    if(GW_3C6_HU_RollingCounter_3C6_counter == 15)
    {
        GW_3C6_HU_RollingCounter_3C6_counter =0;
    }
    else
    {
        GW_3C6_HU_RollingCounter_3C6_counter =GW_3C6_HU_RollingCounter_3C6_counter+1;
    }    
    
}
update_GW_1A8_TCU_RollingCounter_1A8_counter()
{
    //update the signal value
    Msg_GW_1A8.TCU_RollingCounter_1A8=GW_1A8_TCU_RollingCounter_1A8_counter;
    
    if(GW_1A8_TCU_RollingCounter_1A8_counter == 15)
    {
        GW_1A8_TCU_RollingCounter_1A8_counter =0;
    }
    else
    {
        GW_1A8_TCU_RollingCounter_1A8_counter =GW_1A8_TCU_RollingCounter_1A8_counter+1;
    }    
    
}
update_GW_3C2_HU_RollingCounter_3C2_counter()
{
    //update the signal value
    Msg_GW_3C2.HU_RollingCounter_3C2=GW_3C2_HU_RollingCounter_3C2_counter;
    
    if(GW_3C2_HU_RollingCounter_3C2_counter == 15)
    {
        GW_3C2_HU_RollingCounter_3C2_counter =0;
    }
    else
    {
        GW_3C2_HU_RollingCounter_3C2_counter =GW_3C2_HU_RollingCounter_3C2_counter+1;
    }    
    
}
update_GW_3AF_HU_RollingCounter_3AF_counter()
{
    //update the signal value
    Msg_GW_3AF.HU_RollingCounter_3AF=GW_3AF_HU_RollingCounter_3AF_counter;
    
    if(GW_3AF_HU_RollingCounter_3AF_counter == 15)
    {
        GW_3AF_HU_RollingCounter_3AF_counter =0;
    }
    else
    {
        GW_3AF_HU_RollingCounter_3AF_counter =GW_3AF_HU_RollingCounter_3AF_counter+1;
    }    
    
}
update_GW_17E_EPS_RollingCounter_17E_counter()
{
    //update the signal value
    Msg_GW_17E.EPS_RollingCounter_17E=GW_17E_EPS_RollingCounter_17E_counter;
    
    if(GW_17E_EPS_RollingCounter_17E_counter == 15)
    {
        GW_17E_EPS_RollingCounter_17E_counter =0;
    }
    else
    {
        GW_17E_EPS_RollingCounter_17E_counter =GW_17E_EPS_RollingCounter_17E_counter+1;
    }    
    
}

update_GW_28C_GW_MFS_RollingCounter_28C_counter()
{
    //update the signal value
    Msg_GW_28C.GW_MFS_RollingCounter_28C=GW_28C_GW_MFS_RollingCounter_28C_counter;
    
    if(GW_28C_GW_MFS_RollingCounter_28C_counter == 15)
    {
        GW_28C_GW_MFS_RollingCounter_28C_counter =0;
    }
    else
    {
        GW_28C_GW_MFS_RollingCounter_28C_counter =GW_28C_GW_MFS_RollingCounter_28C_counter+1;
    }    
    
}

update_GW_180_SAS_RollingCounter_counter()
{
    //update the signal value
    Msg_GW_180.SAS_RollingCounter=GW_180_SAS_RollingCounter_counter;
    
    if(GW_180_SAS_RollingCounter_counter == 15)
    {
        GW_180_SAS_RollingCounter_counter =0;
    }
    else
    {
        GW_180_SAS_RollingCounter_counter =GW_180_SAS_RollingCounter_counter+1;
    }    
    
}


update_GW_3B8_CRC_CheckSum()
{
  int l_Crc_Len=0,l_count=0;
  int l_data[64];
 
  l_Crc_Len = 8-1;
  for (l_count=0;l_count<l_Crc_Len;l_count++)
    {
      l_data[l_count] = Msg_GW_3B8.BYTE(l_count);    
    }
       
	Msg_GW_3B8.BYTE(l_Crc_Len) = calc_SAE_J1850(l_data,l_Crc_Len); 

	
	if(GW_3B8_HU_CRCCheck_3B8_wrongvalctr != 0)
    {
		Msg_GW_3B8.HU_CRCCheck_3B8+=1; 
        //update signal with wrong CRC value
		if(GW_3B8_HU_CRCCheck_3B8_wrongvalctr > 0)
        {
             GW_3B8_HU_CRCCheck_3B8_wrongvalctr--;
              // if counter becomes zero, update panel controller to zero
             if(GW_3B8_HU_CRCCheck_3B8_wrongvalctr == 0)
             {
                 putValue(E_pubc_GW_GW_3B8_HU_CRCCheck_3B8_wrongvalctr,0);
             }
        }
	}
	
}
update_GW_3C4_CRC_CheckSum()
{
  int l_Crc_Len=0,l_count=0;
  int l_data[64];
 
  l_Crc_Len = 8-1;
  for (l_count=0;l_count<l_Crc_Len;l_count++)
    {
      l_data[l_count] = Msg_GW_3C4.BYTE(l_count);    
    }
       
	Msg_GW_3C4.BYTE(l_Crc_Len) = calc_SAE_J1850(l_data,l_Crc_Len); 

	
	if(GW_3C4_HU_CRCCheck_3C4_wrongvalctr != 0)
    {
		Msg_GW_3C4.HU_CRCCheck_3C4+=1; 
        //update signal with wrong CRC value
		if(GW_3C4_HU_CRCCheck_3C4_wrongvalctr > 0)
        {
             GW_3C4_HU_CRCCheck_3C4_wrongvalctr--;
              // if counter becomes zero, update panel controller to zero
             if(GW_3C4_HU_CRCCheck_3C4_wrongvalctr == 0)
             {
                 putValue(E_pubc_GW_GW_3C4_HU_CRCCheck_3C4_wrongvalctr,0);
             }
        }
	}
}
update_GW_50_CRC_CheckSum()
{
  int l_Crc_Len=0,l_count=0;
  int l_data[64];
 
  l_Crc_Len = 4-1;
  for (l_count=0;l_count<l_Crc_Len;l_count++)
    {
      l_data[l_count] = Msg_GW_50.BYTE(l_count);    
    }
       
	Msg_GW_50.BYTE(l_Crc_Len) = calc_SAE_J1850(l_data,l_Crc_Len); 

	
	if(GW_50_SRS_CrashOutputStatusCheckSum_wrongvalctr != 0)
    {
		Msg_GW_50.SRS_CrashOutputStatusCheckSum+=1; 
        //update signal with wrong CRC value
		if(GW_50_SRS_CrashOutputStatusCheckSum_wrongvalctr > 0)
        {
             GW_50_SRS_CrashOutputStatusCheckSum_wrongvalctr--;
              // if counter becomes zero, update panel controller to zero
             if(GW_50_SRS_CrashOutputStatusCheckSum_wrongvalctr == 0)
             {
                 putValue(E_pubc_GW_GW_50_SRS_CrashOutputStatusCheckSum_wrongvalctr,0);
             }
        }
	}
}
update_GW_24F_CRC_CheckSum()
{
  int l_Crc_Len=0,l_count=0;
  int l_data[64];
 
  l_Crc_Len = 8-1;
  for (l_count=0;l_count<l_Crc_Len;l_count++)
    {
      l_data[l_count] = Msg_GW_24F.BYTE(l_count);    
    }
       
	Msg_GW_24F.BYTE(l_Crc_Len) = calc_SAE_J1850(l_data,l_Crc_Len); 

	
	if(GW_24F_EPS_CRCCheck_24F_wrongvalctr != 0)
    {
		Msg_GW_24F.EPS_CRCCheck_24F+=1; 
        //update signal with wrong CRC value
		if(GW_24F_EPS_CRCCheck_24F_wrongvalctr > 0)
        {
             GW_24F_EPS_CRCCheck_24F_wrongvalctr--;
              // if counter becomes zero, update panel controller to zero
             if(GW_24F_EPS_CRCCheck_24F_wrongvalctr == 0)
             {
                 putValue(E_pubc_GW_GW_24F_EPS_CRCCheck_24F_wrongvalctr,0);
             }
        }
	}
	
}
update_GW_3C7_CRC_CheckSum()
{
  int l_Crc_Len=0,l_count=0;
  int l_data[64];
 
  l_Crc_Len = 8-1;
  for (l_count=0;l_count<l_Crc_Len;l_count++)
    {
      l_data[l_count] = Msg_GW_3C7.BYTE(l_count);    
    }
       
	Msg_GW_3C7.BYTE(l_Crc_Len) = calc_SAE_J1850(l_data,l_Crc_Len); 

	
	if(GW_3C7_HU_CRCCheck_3C7_wrongvalctr != 0)
    {
		Msg_GW_3C7.HU_CRCCheck_3C7+=1; 
        //update signal with wrong CRC value
		if(GW_3C7_HU_CRCCheck_3C7_wrongvalctr > 0)
        {
             GW_3C7_HU_CRCCheck_3C7_wrongvalctr--;
              // if counter becomes zero, update panel controller to zero
             if(GW_3C7_HU_CRCCheck_3C7_wrongvalctr == 0)
             {
                 putValue(E_pubc_GW_GW_3C7_HU_CRCCheck_3C7_wrongvalctr,0);
             }
        }
	}
	
}
update_GW_3C6_CRC_CheckSum()
{
  int l_Crc_Len=0,l_count=0;
  int l_data[64];
 
  l_Crc_Len = 8-1;
  for (l_count=0;l_count<l_Crc_Len;l_count++)
    {
      l_data[l_count] = Msg_GW_3C6.BYTE(l_count);    
    }
       
	Msg_GW_3C6.BYTE(l_Crc_Len) = calc_SAE_J1850(l_data,l_Crc_Len); 

	
	if(GW_3C6_HU_CRCCheck_3C6_wrongvalctr != 0)
    {
		Msg_GW_3C6.HU_CRCCheck_3C6+=1; 
        //update signal with wrong CRC value
		if(GW_3C6_HU_CRCCheck_3C6_wrongvalctr > 0)
        {
             GW_3C6_HU_CRCCheck_3C6_wrongvalctr--;
              // if counter becomes zero, update panel controller to zero
             if(GW_3C6_HU_CRCCheck_3C6_wrongvalctr == 0)
             {
                 putValue(E_pubc_GW_GW_3C6_HU_CRCCheck_3C6_wrongvalctr,0);
             }
        }
	}
	
}
update_GW_1A8_CRC_CheckSum()
{
  int l_Crc_Len=0,l_count=0;
  int l_data[64];
 
  l_Crc_Len = 8-1;
  for (l_count=0;l_count<l_Crc_Len;l_count++)
    {
      l_data[l_count] = Msg_GW_1A8.BYTE(l_count);    
    }
       
	Msg_GW_1A8.BYTE(l_Crc_Len) = calc_SAE_J1850(l_data,l_Crc_Len); 

	
	if(GW_1A8_TCU_CRCCheck_1A8_wrongvalctr != 0)
    {
		Msg_GW_1A8.TCU_CRCCheck_1A8+=1; 
        //update signal with wrong CRC value
		if(GW_1A8_TCU_CRCCheck_1A8_wrongvalctr > 0)
        {
             GW_1A8_TCU_CRCCheck_1A8_wrongvalctr--;
              // if counter becomes zero, update panel controller to zero
             if(GW_1A8_TCU_CRCCheck_1A8_wrongvalctr == 0)
             {
                 putValue(E_pubc_GW_GW_1A8_TCU_CRCCheck_1A8_wrongvalctr,0);
             }
        }
	}
	
}
update_GW_3C2_CRC_CheckSum()
{
  int l_Crc_Len=0,l_count=0;
  int l_data[64];
 
  l_Crc_Len = 8-1;
  for (l_count=0;l_count<l_Crc_Len;l_count++)
    {
      l_data[l_count] = Msg_GW_3C2.BYTE(l_count);    
    }
       
	Msg_GW_3C2.BYTE(l_Crc_Len) = calc_SAE_J1850(l_data,l_Crc_Len); 

	
	if(GW_3C2_HU_CRCCheck_3C2_wrongvalctr != 0)
    {
		Msg_GW_3C2.HU_CRCCheck_3C2+=1; 
        //update signal with wrong CRC value
		if(GW_3C2_HU_CRCCheck_3C2_wrongvalctr > 0)
        {
             GW_3C2_HU_CRCCheck_3C2_wrongvalctr--;
              // if counter becomes zero, update panel controller to zero
             if(GW_3C2_HU_CRCCheck_3C2_wrongvalctr == 0)
             {
                 putValue(E_pubc_GW_GW_3C2_HU_CRCCheck_3C2_wrongvalctr,0);
             }
        }
	}
	
}
update_GW_3AF_CRC_CheckSum()
{
  int l_Crc_Len=0,l_count=0;
  int l_data[64];
 
  l_Crc_Len = 8-1;
  for (l_count=0;l_count<l_Crc_Len;l_count++)
    {
      l_data[l_count] = Msg_GW_3AF.BYTE(l_count);    
    }
       
	Msg_GW_3AF.BYTE(l_Crc_Len) = calc_SAE_J1850(l_data,l_Crc_Len); 

	
	if(GW_3AF_HU_CRCCheck_3AF_wrongvalctr != 0)
    {
		Msg_GW_3AF.HU_CRCCheck_3AF+=1; 
        //update signal with wrong CRC value
		if(GW_3AF_HU_CRCCheck_3AF_wrongvalctr > 0)
        {
             GW_3AF_HU_CRCCheck_3AF_wrongvalctr--;
              // if counter becomes zero, update panel controller to zero
             if(GW_3AF_HU_CRCCheck_3AF_wrongvalctr == 0)
             {
                 putValue(E_pubc_GW_GW_3AF_HU_CRCCheck_3AF_wrongvalctr,0);
             }
        }
	}
	
}
update_GW_17E_CRC_CheckSum()
{
  int l_Crc_Len=0,l_count=0;
  int l_data[64];
 
  l_Crc_Len = 8-1;
  for (l_count=0;l_count<l_Crc_Len;l_count++)
    {
      l_data[l_count] = Msg_GW_17E.BYTE(l_count);    
    }
       
	Msg_GW_17E.BYTE(l_Crc_Len) = calc_SAE_J1850(l_data,l_Crc_Len); 

	
	if(GW_17E_EPS_CRCCheck_17E_wrongvalctr != 0)
    {
		Msg_GW_17E.EPS_CRCCheck_17E+=1; 
        //update signal with wrong CRC value
		if(GW_17E_EPS_CRCCheck_17E_wrongvalctr > 0)
        {
             GW_17E_EPS_CRCCheck_17E_wrongvalctr--;
              // if counter becomes zero, update panel controller to zero
             if(GW_17E_EPS_CRCCheck_17E_wrongvalctr == 0)
             {
                 putValue(E_pubc_GW_GW_17E_EPS_CRCCheck_17E_wrongvalctr,0);
             }
        }
	}
	
}

update_GW_170_CRC_CheckSum()
{
  int l_Crc_Len=0,l_count=0;
  int l_data[64];
 
  l_Crc_Len = 8-1;
  for (l_count=0;l_count<l_Crc_Len;l_count++)
    {
      l_data[l_count] = Msg_GW_170.BYTE(l_count);    
    }
       
	Msg_GW_170.BYTE(l_Crc_Len) = calc_SAE_J1850(l_data,l_Crc_Len); 

	
	if(GW_170_EPS_CRCCheck_170_wrongvalctr != 0)
    {
		Msg_GW_170.EPS_CRCCheck_170+=1; 
        //update signal with wrong CRC value
		if(GW_170_EPS_CRCCheck_170_wrongvalctr > 0)
        {
             GW_170_EPS_CRCCheck_170_wrongvalctr--;
              // if counter becomes zero, update panel controller to zero
             if(GW_170_EPS_CRCCheck_170_wrongvalctr == 0)
             {
                 putValue(E_pubc_GW_GW_170_EPS_CRCCheck_170_wrongvalctr,0);
             }
        }
	}
}

update_GW_28C_CRC_CheckSum()
{
  int l_Crc_Len=0,l_count=0;
  int l_data[64];
 
  l_Crc_Len = 8-1;
  for (l_count=0;l_count<l_Crc_Len;l_count++)
    {
      l_data[l_count] = Msg_GW_28C.BYTE(l_count);    
    }
       
	Msg_GW_28C.BYTE(l_Crc_Len) = calc_SAE_J1850(l_data,l_Crc_Len); 

	
	if(GW_28C_GW_MFS_CRCCheck_28C_wrongvalctr != 0)
    {
		Msg_GW_28C.GW_MFS_CRCCheck_28C+=1; 
        //update signal with wrong CRC value
		if(GW_28C_GW_MFS_CRCCheck_28C_wrongvalctr > 0)
        {
             GW_28C_GW_MFS_CRCCheck_28C_wrongvalctr--;
              // if counter becomes zero, update panel controller to zero
             if(GW_28C_GW_MFS_CRCCheck_28C_wrongvalctr == 0)
             {
                 putValue(E_pubc_GW_GW_28C_GW_MFS_CRCCheck_28C_wrongvalctr,0);
             }
        }
	}
	
}
//update_GW_24F_CRC_CheckSum()
//{
//  int l_Crc_Len=0,l_count=0;
//  int l_data[64];
// 
//  l_Crc_Len = 8-1;
//  for (l_count=0;l_count<l_Crc_Len;l_count++)
//    {
//      l_data[l_count] = Msg_GW_24F.BYTE(l_count);    
//    }
//       
//	Msg_GW_24F.BYTE(l_Crc_Len) = calc_SAE_J1850(l_data,l_Crc_Len); 
//
//	
//	if(GW_24F_EPS_CRCCheck_24F_wrongvalctr != 0)
//    {
//		Msg_GW_24F.EPS_CRCCheck_24F+=1; 
//        //update signal with wrong CRC value
//		if(GW_24F_EPS_CRCCheck_24F_wrongvalctr > 0)
//        {
//             GW_24F_EPS_CRCCheck_24F_wrongvalctr--;
//              // if counter becomes zero, update panel controller to zero
//             if(GW_24F_EPS_CRCCheck_24F_wrongvalctr == 0)
//             {
//                 putValue(E_pubc_GW_GW_24F_EPS_CRCCheck_24F_wrongvalctr,0);
//             }
//        }
//	}
//	
//}
//update_GW_258_CRC_CheckSum()
//{
//  int l_Crc_Len=0,l_count=0;
//  int l_data[64];
// 
//  l_Crc_Len = 8-1;
//  for (l_count=0;l_count<l_Crc_Len;l_count++)
//    {
//      l_data[l_count] = Msg_GW_258.BYTE(l_count);    
//    }
//       
//	Msg_GW_258.BYTE(l_Crc_Len) = calc_SAE_J1850(l_data,l_Crc_Len); 
//
//	
//	if(GW_258_ESP_CRCCheck_258_wrongvalctr != 0)
//    {
//		Msg_GW_258.ESP_CRCCheck_258+=1; 
//        //update signal with wrong CRC value
//		if(GW_258_ESP_CRCCheck_258_wrongvalctr > 0)
//        {
//             GW_258_ESP_CRCCheck_258_wrongvalctr--;
//              // if counter becomes zero, update panel controller to zero
//             if(GW_258_ESP_CRCCheck_258_wrongvalctr == 0)
//             {
//                 putValue(E_pubc_GW_GW_258_ESP_CRCCheck_258_wrongvalctr,0);
//             }
//        }
//	}
//	
//}
//update_GW_277_CRC_CheckSum()
//{
//  int l_Crc_Len=0,l_count=0;
//  int l_data[64];
// 
//  l_Crc_Len = 8-1;
//  for (l_count=0;l_count<l_Crc_Len;l_count++)
//    {
//      l_data[l_count] = Msg_GW_277.BYTE(l_count);    
//    }
//       
//	Msg_GW_277.BYTE(l_Crc_Len) = calc_SAE_J1850(l_data,l_Crc_Len); 
//
//	
//	if(GW_277_ESP_CRCCheck_277_wrongvalctr != 0)
//    {
//		Msg_GW_277.ESP_CRCCheck_277+=1; 
//        //update signal with wrong CRC value
//		if(GW_277_ESP_CRCCheck_277_wrongvalctr > 0)
//        {
//             GW_277_ESP_CRCCheck_277_wrongvalctr--;
//              // if counter becomes zero, update panel controller to zero
//             if(GW_277_ESP_CRCCheck_277_wrongvalctr == 0)
//             {
//                 putValue(E_pubc_GW_GW_277_ESP_CRCCheck_277_wrongvalctr,0);
//             }
//        }
//	}
//	
//}

//update_GW_278_CRC_CheckSum()
//{
//  int l_Crc_Len=0,l_count=0;
//  int l_data[64];
// 
//  l_Crc_Len = 8-1;
//  for (l_count=0;l_count<l_Crc_Len;l_count++)
//    {
//      l_data[l_count] = Msg_GW_278.BYTE(l_count);    
//    }
//       
//	Msg_GW_278.BYTE(l_Crc_Len) = calc_SAE_J1850(l_data,l_Crc_Len); 
//
//	
//	if(GW_278_ESP_CRCCheck_278_wrongvalctr != 0)
//    {
//		Msg_GW_278.ESP_CRCCheck_278+=1; 
//        //update signal with wrong CRC value
//		if(GW_278_ESP_CRCCheck_278_wrongvalctr > 0)
//        {
//             GW_278_ESP_CRCCheck_278_wrongvalctr--;
//              // if counter becomes zero, update panel controller to zero
//             if(GW_278_ESP_CRCCheck_278_wrongvalctr == 0)
//             {
//                 putValue(E_pubc_GW_GW_278_ESP_CRCCheck_278_wrongvalctr,0);
//             }
//        }
//	}
//	
//}
//update_GW_3C7_CRC_CheckSum()
//{
//  int l_Crc_Len=0,l_count=0;
//  int l_data[64];
// 
//  l_Crc_Len = 8-1;
//  for (l_count=0;l_count<l_Crc_Len;l_count++)
//    {
//      l_data[l_count] = Msg_GW_3C7.BYTE(l_count);    
//    }
//       
//	Msg_GW_3C7.BYTE(l_Crc_Len) = calc_SAE_J1850(l_data,l_Crc_Len); 
//
//	
//	if(GW_3C7_HU_CRCCheck_3C7_wrongvalctr != 0)
//    {
//		Msg_GW_3C7.HU_CRCCheck_3C7+=1; 
//        //update signal with wrong CRC value
//		if(GW_3C7_HU_CRCCheck_3C7_wrongvalctr > 0)
//        {
//             GW_3C7_HU_CRCCheck_3C7_wrongvalctr--;
//              // if counter becomes zero, update panel controller to zero
//             if(GW_3C7_HU_CRCCheck_3C7_wrongvalctr == 0)
//             {
//                 putValue(E_pubc_GW_GW_3C7_HU_CRCCheck_3C7_wrongvalctr,0);
//             }
//        }
//	}
//	
//}
//update_GW_3C6_CRC_CheckSum()
//{
//  int l_Crc_Len=0,l_count=0;
//  int l_data[64];
// 
//  l_Crc_Len = 8-1;
//  for (l_count=0;l_count<l_Crc_Len;l_count++)
//    {
//      l_data[l_count] = Msg_GW_3C6.BYTE(l_count);    
//    }
//       
//	Msg_GW_3C6.BYTE(l_Crc_Len) = calc_SAE_J1850(l_data,l_Crc_Len); 
//
//	
//	if(GW_3C6_HU_CRCCheck_3C6_wrongvalctr != 0)
//    {
//		Msg_GW_3C6.HU_CRCCheck_3C6+=1; 
//        //update signal with wrong CRC value
//		if(GW_3C6_HU_CRCCheck_3C6_wrongvalctr > 0)
//        {
//             GW_3C6_HU_CRCCheck_3C6_wrongvalctr--;
//              // if counter becomes zero, update panel controller to zero
//             if(GW_3C6_HU_CRCCheck_3C6_wrongvalctr == 0)
//             {
//                 putValue(E_pubc_GW_GW_3C6_HU_CRCCheck_3C6_wrongvalctr,0);
//             }
//        }
//	}
//	
//}
//update_GW_1A8_CRC_CheckSum()
//{
//  int l_Crc_Len=0,l_count=0;
//  int l_data[64];
// 
//  l_Crc_Len = 8-1;
//  for (l_count=0;l_count<l_Crc_Len;l_count++)
//    {
//      l_data[l_count] = Msg_GW_1A8.BYTE(l_count);    
//    }
//       
//	Msg_GW_1A8.BYTE(l_Crc_Len) = calc_SAE_J1850(l_data,l_Crc_Len); 
//
//	
//	if(GW_1A8_TCU_CRCCheck_1A8_wrongvalctr != 0)
//    {
//		Msg_GW_1A8.TCU_CRCCheck_1A8+=1; 
//        //update signal with wrong CRC value
//		if(GW_1A8_TCU_CRCCheck_1A8_wrongvalctr > 0)
//        {
//             GW_1A8_TCU_CRCCheck_1A8_wrongvalctr--;
//              // if counter becomes zero, update panel controller to zero
//             if(GW_1A8_TCU_CRCCheck_1A8_wrongvalctr == 0)
//             {
//                 putValue(E_pubc_GW_GW_1A8_TCU_CRCCheck_1A8_wrongvalctr,0);
//             }
//        }
//	}
//	
//}
//update_GW_3C2_CRC_CheckSum()
//{
//  int l_Crc_Len=0,l_count=0;
//  int l_data[64];
// 
//  l_Crc_Len = 8-1;
//  for (l_count=0;l_count<l_Crc_Len;l_count++)
//    {
//      l_data[l_count] = Msg_GW_3C2.BYTE(l_count);    
//    }
//       
//	Msg_GW_3C2.BYTE(l_Crc_Len) = calc_SAE_J1850(l_data,l_Crc_Len); 
//
//	
//	if(GW_3C2_HU_CRCCheck_3C2_wrongvalctr != 0)
//    {
//		Msg_GW_3C2.HU_CRCCheck_3C2+=1; 
//        //update signal with wrong CRC value
//		if(GW_3C2_HU_CRCCheck_3C2_wrongvalctr > 0)
//        {
//             GW_3C2_HU_CRCCheck_3C2_wrongvalctr--;
//              // if counter becomes zero, update panel controller to zero
//             if(GW_3C2_HU_CRCCheck_3C2_wrongvalctr == 0)
//             {
//                 putValue(E_pubc_GW_GW_3C2_HU_CRCCheck_3C2_wrongvalctr,0);
//             }
//        }
//	}
//	
//}
//update_GW_3AF_CRC_CheckSum()
//{
//  int l_Crc_Len=0,l_count=0;
//  int l_data[64];
// 
//  l_Crc_Len = 8-1;
//  for (l_count=0;l_count<l_Crc_Len;l_count++)
//    {
//      l_data[l_count] = Msg_GW_3AF.BYTE(l_count);    
//    }
//       
//	Msg_GW_3AF.BYTE(l_Crc_Len) = calc_SAE_J1850(l_data,l_Crc_Len); 
//
//	
//	if(GW_3AF_HU_CRCCheck_3AF_wrongvalctr != 0)
//    {
//		Msg_GW_3AF.HU_CRCCheck_3AF+=1; 
//        //update signal with wrong CRC value
//		if(GW_3AF_HU_CRCCheck_3AF_wrongvalctr > 0)
//        {
//             GW_3AF_HU_CRCCheck_3AF_wrongvalctr--;
//              // if counter becomes zero, update panel controller to zero
//             if(GW_3AF_HU_CRCCheck_3AF_wrongvalctr == 0)
//             {
//                 putValue(E_pubc_GW_GW_3AF_HU_CRCCheck_3AF_wrongvalctr,0);
//             }
//        }
//	}
//	
//}
//update_GW_1A6_CRC_CheckSum()
//{
//  int l_Crc_Len=0,l_count=0;
//  int l_data[64];
// 
//  l_Crc_Len = 8-1;
//  for (l_count=0;l_count<l_Crc_Len;l_count++)
//    {
//      l_data[l_count] = Msg_GW_1A6.BYTE(l_count);    
//    }
//       
//	Msg_GW_1A6.BYTE(l_Crc_Len) = calc_SAE_J1850(l_data,l_Crc_Len); 
//
//	
//	if(GW_1A6_EMS_CRCCheck_1A6_wrongvalctr != 0)
//    {
//		Msg_GW_1A6.EMS_CRCCheck_1A6+=1; 
//        //update signal with wrong CRC value
//		if(GW_1A6_EMS_CRCCheck_1A6_wrongvalctr > 0)
//        {
//             GW_1A6_EMS_CRCCheck_1A6_wrongvalctr--;
//              // if counter becomes zero, update panel controller to zero
//             if(GW_1A6_EMS_CRCCheck_1A6_wrongvalctr == 0)
//             {
//                 putValue(E_pubc_GW_GW_1A6_EMS_CRCCheck_1A6_wrongvalctr,0);
//             }
//        }
//	}
//	
//}
//update_GW_196_CRC_CheckSum()
//{
//  int l_Crc_Len=0,l_count=0;
//  int l_data[64];
// 
//  l_Crc_Len = 8-1;
//  for (l_count=0;l_count<l_Crc_Len;l_count++)
//    {
//      l_data[l_count] = Msg_GW_196.BYTE(l_count);    
//    }
//       
//	Msg_GW_196.BYTE(l_Crc_Len) = calc_SAE_J1850(l_data,l_Crc_Len); 
//
//	
//	if(GW_196_EMS_CRCCheck_196_wrongvalctr != 0)
//    {
//		Msg_GW_196.EMS_CRCCheck_196+=1; 
//        //update signal with wrong CRC value
//		if(GW_196_EMS_CRCCheck_196_wrongvalctr > 0)
//        {
//             GW_196_EMS_CRCCheck_196_wrongvalctr--;
//              // if counter becomes zero, update panel controller to zero
//             if(GW_196_EMS_CRCCheck_196_wrongvalctr == 0)
//             {
//                 putValue(E_pubc_GW_GW_196_EMS_CRCCheck_196_wrongvalctr,0);
//             }
//        }
//	}
//	
//}
//update_GW_17E_CRC_CheckSum()
//{
//  int l_Crc_Len=0,l_count=0;
//  int l_data[64];
// 
//  l_Crc_Len = 8-1;
//  for (l_count=0;l_count<l_Crc_Len;l_count++)
//    {
//      l_data[l_count] = Msg_GW_17E.BYTE(l_count);    
//    }
//       
//	Msg_GW_17E.BYTE(l_Crc_Len) = calc_SAE_J1850(l_data,l_Crc_Len); 
//
//	
//	if(GW_17E_EPS_CRCCheck_17E_wrongvalctr != 0)
//    {
//		Msg_GW_17E.EPS_CRCCheck_17E+=1; 
//        //update signal with wrong CRC value
//		if(GW_17E_EPS_CRCCheck_17E_wrongvalctr > 0)
//        {
//             GW_17E_EPS_CRCCheck_17E_wrongvalctr--;
//              // if counter becomes zero, update panel controller to zero
//             if(GW_17E_EPS_CRCCheck_17E_wrongvalctr == 0)
//             {
//                 putValue(E_pubc_GW_GW_17E_EPS_CRCCheck_17E_wrongvalctr,0);
//             }
//        }
//	}
//	
//}
//update_GW_206_CRC_CheckSum()
//{
//  int l_Crc_Len=0,l_count=0;
//  int l_data[64];
// 
//  l_Crc_Len = 8-1;
//  for (l_count=0;l_count<l_Crc_Len;l_count++)
//    {
//      l_data[l_count] = Msg_GW_206.BYTE(l_count);    
//    }
//       
//	Msg_GW_206.BYTE(l_Crc_Len) = calc_SAE_J1850(l_data,l_Crc_Len); 
//
//	
//	if(GW_206_ESP_CRCCheck_206_wrongvalctr != 0)
//    {
//		Msg_GW_206.ESP_CRCCheck_206+=1; 
//        //update signal with wrong CRC value
//		if(GW_206_ESP_CRCCheck_206_wrongvalctr > 0)
//        {
//             GW_206_ESP_CRCCheck_206_wrongvalctr--;
//              // if counter becomes zero, update panel controller to zero
//             if(GW_206_ESP_CRCCheck_206_wrongvalctr == 0)
//             {
//                 putValue(E_pubc_GW_GW_206_ESP_CRCCheck_206_wrongvalctr,0);
//             }
//        }
//	}
//	
//}
//update_GW_28C_CRC_CheckSum()
//{
//  int l_Crc_Len=0,l_count=0;
//  int l_data[64];
// 
//  l_Crc_Len = 8-1;
//  for (l_count=0;l_count<l_Crc_Len;l_count++)
//    {
//      l_data[l_count] = Msg_GW_28C.BYTE(l_count);    
//    }
//       
//	Msg_GW_28C.BYTE(l_Crc_Len) = calc_SAE_J1850(l_data,l_Crc_Len); 
//
//	
//	if(GW_28C_GW_MFS_CRCCheck_28C_wrongvalctr != 0)
//    {
//		Msg_GW_28C.GW_MFS_CRCCheck_28C+=1; 
//        //update signal with wrong CRC value
//		if(GW_28C_GW_MFS_CRCCheck_28C_wrongvalctr > 0)
//        {
//             GW_28C_GW_MFS_CRCCheck_28C_wrongvalctr--;
//              // if counter becomes zero, update panel controller to zero
//             if(GW_28C_GW_MFS_CRCCheck_28C_wrongvalctr == 0)
//             {
//                 putValue(E_pubc_GW_GW_28C_GW_MFS_CRCCheck_28C_wrongvalctr,0);
//             }
//        }
//	}
//	
//}


update_GW_180_CRC_CheckSum()
{
  int l_Crc_Len=0,l_count=0;
  int l_data[64];
 
  l_Crc_Len = 8-1;
  for (l_count=0;l_count<l_Crc_Len;l_count++)
    {
      l_data[l_count] = Msg_GW_180.BYTE(l_count);    
    }
       
	Msg_GW_180.BYTE(l_Crc_Len) = calc_SAE_J1850(l_data,l_Crc_Len); 

	
	if(GW_180_SAS_CRCCheck_wrongvalctr != 0)
    {
		Msg_GW_180.SAS_CRCCheck+=1; 
        //update signal with wrong CRC value
		if(GW_180_SAS_CRCCheck_wrongvalctr > 0)
        {
             GW_180_SAS_CRCCheck_wrongvalctr--;
              // if counter becomes zero, update panel controller to zero
             if(GW_180_SAS_CRCCheck_wrongvalctr == 0)
             {
                 putValue(E_pubc_GW_GW_180_SAS_CRCCheck_wrongvalctr,0);
             }
        }
	}
	
}




int calc_SAE_J1850(int data[], int Crc_len)
	{
		int idx,crc,temp,temp1;
		crc = 0xFF;
        idx = 0;
        temp = 0;
        temp1 = 0;
	
        for(idx=0;idx < Crc_len;idx++)
        {
         temp1 = data[idx];
         temp = (crc^temp1);
         crc = CRC_J1850_Table[temp];
       }
		crc ^= 0xFF;
		return crc;
	}

//GW_50_Checksum
int GW_50_Checksum(int data)
	{
		int idx,crc;
		   crc = 0;
        idx = 0;
	      crc = data ^ 0xF;
//        for(idx=1;idx < Crc_len;idx++)
//        {
//         crc=crc^data[idx];
//       }
		//crc ^= 0xF0;
		return crc;
	}




	/*	int calc_SAE_J1851(int data[], int Crc_len)
	{
		int crc;
		
        crc = (data[0]+data[1]+data[2]+data[3]+data[4]+data[5]+data[6]) ;
          
		crc ^= 255;
		return crc;
	}*/

	

/* 	int calc_SAE_J1850(int data, int Crc_len)
	{
		int idx,crc,temp,temp1,temp2,idy;
		crc = 0xFF;
        idx = 0;
        idy = 0;
        temp = 0;
        temp1 = 0;
        temp2 = 0;
	
        for(idx=0;idx < Crc_len;idx++)
        {
         temp1 = data[idx];
         crc = (crc^temp1);
          for (idy=8; idy>0; idy--)
          {
              // Save the value before the top bit is shifted out.
              temp2 = crc;
              crc <<= 1;
              if (0 != (temp2 & 128))
              {
                  crc ^= 0x2f;
              }
          } 
          
         //crc = CRC_J1850_Table[temp];
        }
		crc ^= 0xFF;
		return crc;
	} */

