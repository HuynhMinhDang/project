
/*@@var:*/
variables
{
    //Used interact between raw and the physical environment variables
    byte chgEv_IBCMR_366_AC_EnvironmentalTempVD = 0;
    byte chgEv_IBCMR_366_AC_EnvironmentalTemp = 0;
    byte chgEv_IBCMR_3B3_BCM_RearFoglampStatus = 0;
    byte chgEv_IBCMR_2D1_BCM_PassengerDoorStatus = 0;
    byte chgEv_IBCMR_2D1_BCM_TrunkDoorStatus = 0;
    byte chgEv_IBCMR_2D1_BCM_RightRearDoorStatus = 0;
    byte chgEv_IBCMR_340_AC_FrBlowType = 0;
    
    message IBCMR_366        Msg_IBCMR_366;
    msTimer Tm_IBCMR_366;
    int Cycle_IBCMR_366 = 100;
    message IBCMR_3B3        Msg_IBCMR_3B3;
    msTimer Tm_IBCMR_3B3;
    int Cycle_IBCMR_3B3 = 100;
    message IBCMR_2D1        Msg_IBCMR_2D1;
    msTimer Tm_IBCMR_2D1;
    int Cycle_IBCMR_2D1 = 40;
    message IBCMR_340        Msg_IBCMR_340;
    msTimer Tm_IBCMR_340;
    int Cycle_IBCMR_340 = 100;
    
    
    //CRC Polynomial for MQB     
    byte cb_ChkSum_POLY_MQB =0x2F;
	// CANFD DLC
	byte Dbc_dlc;
	int i=0;
	char CAN_DLC[7]={9,10,11,12,13,14,15};
	char CANFD_DLC[7]={12,16,20,24,32,48,64};
    

    
        byte CRC_J1850_Table[256] = {
 /*0 - 7*/  0x00, 0x1D, 0x3A, 0x27, 0x74, 0x69, 0x4E, 0x53,
 /*8 - 15*/ 0xE8, 0xF5, 0xD2, 0xCF, 0x9C, 0x81, 0xA6, 0xBB,
 /*16 - 23*/ 0xCD, 0xD0, 0xF7, 0xEA, 0xB9, 0xA4, 0x83, 0x9E,
 /*24 - 31*/ 0x25, 0x38, 0x1F, 0x02, 0x51, 0x4C, 0x6B, 0x76,
 /*32 - 39*/ 0x87, 0x9A, 0xBD, 0xA0, 0xF3, 0xEE, 0xC9, 0xD4,
 /*40 - 47*/ 0x6F, 0x72, 0x55, 0x48, 0x1B, 0x06, 0x21, 0x3C,
 /*48 - 55*/ 0x4A, 0x57, 0x70, 0x6D, 0x3E, 0x23, 0x04, 0x19,
 /*56 - 63*/ 0xA2, 0xBF, 0x98, 0x85, 0xD6, 0xCB, 0xEC, 0xF1,
 /*64 - 71*/  0x13, 0x0E, 0x29, 0x34, 0x67, 0x7A, 0x5D, 0x40,
 /*72 - 79*/ 0xFB, 0xE6, 0xC1, 0xDC, 0x8F, 0x92, 0xB5, 0xA8,
 /*80 - 87*/ 0xDE, 0xC3, 0xE4, 0xF9, 0xAA, 0xB7, 0x90, 0x8D,
 /*88 - 95*/ 0x36, 0x2B, 0x0C, 0x11, 0x42, 0x5F, 0x78, 0x65,
 /*96 - 103*/ 0x94, 0x89, 0xAE, 0xB3, 0xE0, 0xFD, 0xDA, 0xC7,
 /*104 - 111*/ 0x7C, 0x61, 0x46, 0x5B, 0x08, 0x15, 0x32, 0x2F,
 /*112 - 119*/ 0x59, 0x44, 0x63, 0x7E, 0x2D, 0x30, 0x17, 0x0A,
 /*120 - 127*/ 0xB1, 0xAC, 0x8B, 0x96, 0xC5, 0xD8, 0xFF, 0xE2,
 /*128 - 135*/ 0x26, 0x3B, 0x1C, 0x01, 0x52, 0x4F, 0x68, 0x75,
 /*136 - 143*/ 0xCE, 0xD3, 0xF4, 0xE9, 0xBA, 0xA7, 0x80, 0x9D,
 /*144 - 151*/ 0xEB, 0xF6, 0xD1, 0xCC, 0x9F, 0x82, 0xA5, 0xB8,
 /*152 - 159*/ 0x03, 0x1E, 0x39, 0x24, 0x77, 0x6A, 0x4D, 0x50,
 /*160 - 167*/ 0xA1, 0xBC, 0x9B, 0x86, 0xD5, 0xC8, 0xEF, 0xF2,
 /*168 - 175*/ 0x49, 0x54, 0x73, 0x6E, 0x3D, 0x20, 0x07, 0x1A,
 /*176 - 183*/ 0x6C, 0x71, 0x56, 0x4B, 0x18, 0x05, 0x22, 0x3F,
 /*184 - 191*/ 0x84, 0x99, 0xBE, 0xA3, 0xF0, 0xED, 0xCA, 0xD7,
 /*192 - 199*/ 0x35, 0x28, 0x0F, 0x12, 0x41, 0x5C, 0x7B, 0x66,
 /*200 - 207*/ 0xDD, 0xC0, 0xE7, 0xFA, 0xA9, 0xB4, 0x93, 0x8E,
 /*208 - 215*/ 0xF8, 0xE5, 0xC2, 0xDF, 0x8C, 0x91, 0xB6, 0xAB,
 /*216 - 223*/ 0x10, 0x0D, 0x2A, 0x37, 0x64, 0x79, 0x5E, 0x43,
 /*224 - 231*/ 0xB2, 0xAF, 0x88, 0x95, 0xC6, 0xDB, 0xFC, 0xE1,
 /*232 - 239*/ 0x5A, 0x47, 0x60, 0x7D, 0x2E, 0x33, 0x14, 0x09,
 /*240 - 247*/ 0x7F, 0x62, 0x45, 0x58, 0x0B, 0x16, 0x31, 0x2C,
 /*248 - 255*/ 0x97, 0x8A, 0xAD, 0xB0, 0xE3, 0xFE, 0xD9, 0xC4
};

         
}
/*@@end*/


/*@@startStart:Start:*/
on start
{
    //Initialise cycle time and message timer 
    putValue(E_pubc_IBCMR_IBCMR_366_cycleTm,Cycle_IBCMR_366);
    SetTimer( Tm_IBCMR_366,100);
    putValue(E_pubc_IBCMR_IBCMR_366_Tm,1);
    putValue(E_pubc_IBCMR_IBCMR_3B3_cycleTm,Cycle_IBCMR_3B3);
    SetTimer( Tm_IBCMR_3B3,101);
    putValue(E_pubc_IBCMR_IBCMR_3B3_Tm,1);
    putValue(E_pubc_IBCMR_IBCMR_2D1_cycleTm,Cycle_IBCMR_2D1);
    SetTimer( Tm_IBCMR_2D1,102);
    putValue(E_pubc_IBCMR_IBCMR_2D1_Tm,1);
    putValue(E_pubc_IBCMR_IBCMR_340_cycleTm,Cycle_IBCMR_340);
    SetTimer( Tm_IBCMR_340,103);
    putValue(E_pubc_IBCMR_IBCMR_340_Tm,1);
    
    //Initialise signals with init raw value
    Msg_IBCMR_366.AC_EnvironmentalTempVD   =getvalue(E_pubc_IBCMR_IBCMR_366_AC_EnvironmentalTempVD_Rv);
    Msg_IBCMR_366.AC_EnvironmentalTemp   =getvalue(E_pubc_IBCMR_IBCMR_366_AC_EnvironmentalTemp_Rv);
    Msg_IBCMR_3B3.BCM_RearFoglampStatus   =getvalue(E_pubc_IBCMR_IBCMR_3B3_BCM_RearFoglampStatus_Rv);
    Msg_IBCMR_2D1.BCM_PassengerDoorStatus   =getvalue(E_pubc_IBCMR_IBCMR_2D1_BCM_PassengerDoorStatus_Rv);
    Msg_IBCMR_2D1.BCM_TrunkDoorStatus   =getvalue(E_pubc_IBCMR_IBCMR_2D1_BCM_TrunkDoorStatus_Rv);
    Msg_IBCMR_2D1.BCM_RightRearDoorStatus   =getvalue(E_pubc_IBCMR_IBCMR_2D1_BCM_RightRearDoorStatus_Rv);
    Msg_IBCMR_340.AC_FrBlowType   =getvalue(E_pubc_IBCMR_IBCMR_340_AC_FrBlowType_Rv);
}
/*@@end*/

/*@@envVar:E_pubc_IBCMR_CycMsgsON:*/
on envVar E_pubc_IBCMR_CycMsgsON
{
    // enable all the cyclic messages 
    putValue(E_pubc_IBCMR_IBCMR_366_Tm,1);
    putValue(E_pubc_IBCMR_IBCMR_3B3_Tm,1);
    putValue(E_pubc_IBCMR_IBCMR_2D1_Tm,1);
    putValue(E_pubc_IBCMR_IBCMR_340_Tm,1);
}
/*@@end*/

/*@@envVar:E_pubc_IBCMR_CycMsgsOFF:*/
on envVar E_pubc_IBCMR_CycMsgsOFF
{
    // disable all the cyclic messages
    putValue(E_pubc_IBCMR_IBCMR_366_Tm,0);
    putValue(E_pubc_IBCMR_IBCMR_3B3_Tm,0);
    putValue(E_pubc_IBCMR_IBCMR_2D1_Tm,0);
    putValue(E_pubc_IBCMR_IBCMR_340_Tm,0);
    
}
/*@@end*/
/*@@timer:Tm_IBCMR_366:*/
on timer Tm_IBCMR_366
{
    //cyclic message timer 
    if(getValue(E_pubc_IBCMR_IBCMR_366_Tm) == 1)
    {
        
		//update the BZ Signal
	
        output(Msg_IBCMR_366);
        
    }
    //Reset Timer
    SetTimer(Tm_IBCMR_366,Cycle_IBCMR_366);
}
/*@@end*/

/*@@envVar:E_pubc_IBCMR_IBCMR_366_cycleTm:*/
on envVar E_pubc_IBCMR_IBCMR_366_cycleTm
{
    // update the cycle time 
    Cycle_IBCMR_366=getvalue(this);
}
/*@@end*/
/*@@timer:Tm_IBCMR_3B3:*/
on timer Tm_IBCMR_3B3
{
    //cyclic message timer 
    if(getValue(E_pubc_IBCMR_IBCMR_3B3_Tm) == 1)
    {
        
		//update the BZ Signal
	
        output(Msg_IBCMR_3B3);
        
    }
    //Reset Timer
    SetTimer(Tm_IBCMR_3B3,Cycle_IBCMR_3B3);
}
/*@@end*/

/*@@envVar:E_pubc_IBCMR_IBCMR_3B3_cycleTm:*/
on envVar E_pubc_IBCMR_IBCMR_3B3_cycleTm
{
    // update the cycle time 
    Cycle_IBCMR_3B3=getvalue(this);
}
/*@@end*/
/*@@timer:Tm_IBCMR_2D1:*/
on timer Tm_IBCMR_2D1
{
    //cyclic message timer 
    if(getValue(E_pubc_IBCMR_IBCMR_2D1_Tm) == 1)
    {
        
		//update the BZ Signal
	
        output(Msg_IBCMR_2D1);
        
    }
    //Reset Timer
    SetTimer(Tm_IBCMR_2D1,Cycle_IBCMR_2D1);
}
/*@@end*/

/*@@envVar:E_pubc_IBCMR_IBCMR_2D1_cycleTm:*/
on envVar E_pubc_IBCMR_IBCMR_2D1_cycleTm
{
    // update the cycle time 
    Cycle_IBCMR_2D1=getvalue(this);
}
/*@@end*/
/*@@timer:Tm_IBCMR_340:*/
on timer Tm_IBCMR_340
{
    //cyclic message timer 
    if(getValue(E_pubc_IBCMR_IBCMR_340_Tm) == 1)
    {
        
		//update the BZ Signal
	
        output(Msg_IBCMR_340);
        
    }
    //Reset Timer
    SetTimer(Tm_IBCMR_340,Cycle_IBCMR_340);
}
/*@@end*/

/*@@envVar:E_pubc_IBCMR_IBCMR_340_cycleTm:*/
on envVar E_pubc_IBCMR_IBCMR_340_cycleTm
{
    // update the cycle time 
    Cycle_IBCMR_340=getvalue(this);
}
/*@@end*/

/*@@envVar:E_pubc_IBCMR_IBCMR_366_tx:*/
on envVar E_pubc_IBCMR_IBCMR_366_tx
{
    if(getValue(this))
    {       
        

        output(Msg_IBCMR_366);        
    }
}
/*@@end*/

/*@@envVar:E_pubc_IBCMR_IBCMR_366_Range:*/
on envVar E_pubc_IBCMR_IBCMR_366_Range
{
    qword rawstatus = 0ll;
    qword rawValue = 0ll;    
    
    rawstatus = getvalue(this);    
    // set all the signals with min raw /max raw /init raw
    switch (rawstatus) 
    {
     case(0) :
        rawValue= 0;
        putValue(E_pubc_IBCMR_IBCMR_366_AC_EnvironmentalTempVD_Rv, rawValue);
        rawValue= 0;
        putValue(E_pubc_IBCMR_IBCMR_366_AC_EnvironmentalTemp_Rv, rawValue);
        break;
     case(1) :
        rawValue= 1;
        putValue(E_pubc_IBCMR_IBCMR_366_AC_EnvironmentalTempVD_Rv, rawValue);
        rawValue= 254;
        putValue(E_pubc_IBCMR_IBCMR_366_AC_EnvironmentalTemp_Rv, rawValue);
        break;
     default :
        rawValue= 0;
        putValue(E_pubc_IBCMR_IBCMR_366_AC_EnvironmentalTempVD_Rv, rawValue);
        rawValue= 0;
        putValue(E_pubc_IBCMR_IBCMR_366_AC_EnvironmentalTemp_Rv, rawValue);
      break;
   }
}
/*@@end*/

/*@@envVar:E_pubc_IBCMR_IBCMR_366_Dlc:*/
on envVar E_pubc_IBCMR_IBCMR_366_Dlc
{
    if(getValue(E_pubc_IBCMR_IBCMR_366_enDlc))
    {
        Msg_IBCMR_366.dlc =getValue(this);
    }
    else
    {   
	   Msg_IBCMR_366.dlc = 8;
	   	
  }
}
/*@@end*/

/*@@envVar:E_pubc_IBCMR_IBCMR_366_enDlc:*/
on envVar E_pubc_IBCMR_IBCMR_366_enDlc
{
    //For Messages with DLC = 8, set wrong DLC to smaller than defined DLC
    //For Messages with DLC < 8 set wrong DLC to smaller/longer than defined DLC
    if(getValue(this))
    {
        Msg_IBCMR_366.dlc =getValue(E_pubc_IBCMR_IBCMR_366_Dlc);
    }
    else
    {
	   Msg_IBCMR_366.dlc = 8;
			
    }
}
/*@@end*/


/*@@envVar:E_pubc_IBCMR_IBCMR_366_AC_EnvironmentalTempVD_Rv:*/
on envVar E_pubc_IBCMR_IBCMR_366_AC_EnvironmentalTempVD_Rv
{
    int64 rawValue = 0ll;
    float rawValue_float = 0.0;
    float phyValue = 0.0;        

    //set the signal with updated raw value
    if(getValue(E_pubc_IBCMR_IBCMR_366_AC_EnvironmentalTempVD_SetVt)==0)
    {
        rawValue = getvalue(this);
        if(chgEv_IBCMR_366_AC_EnvironmentalTempVD == 0)
        {
            //type conversion to float
            rawValue_float = rawValue;        
            // raw to physical conversion
            phyValue = ((rawValue_float *1)+(0));
            putValue(E_pubc_IBCMR_IBCMR_366_AC_EnvironmentalTempVD_Pv, phyValue);
            chgEv_IBCMR_366_AC_EnvironmentalTempVD = 1;
        }
        else
        {
            chgEv_IBCMR_366_AC_EnvironmentalTempVD = 0;
        }    
        //update the signal value
        Msg_IBCMR_366.AC_EnvironmentalTempVD=rawValue;        
    }                                                                           
}
/*@@end*/

/*@@envVar:E_pubc_IBCMR_IBCMR_366_AC_EnvironmentalTempVD_Pv:*/
on envVar E_pubc_IBCMR_IBCMR_366_AC_EnvironmentalTempVD_Pv
{
    int64 rawValue = 0ll;
    float phyValue = 0.0;
    
    //update the raw value with physical value 
    if(getValue(E_pubc_IBCMR_IBCMR_366_AC_EnvironmentalTempVD_SetVt)==0)
    {
        if(chgEv_IBCMR_366_AC_EnvironmentalTempVD == 0)
        {
            phyValue = getvalue(this);
            // physical to raw conversion
            rawValue = ((phyValue -(0))/1);
            putValue(E_pubc_IBCMR_IBCMR_366_AC_EnvironmentalTempVD_Rv, rawValue);
            chgEv_IBCMR_366_AC_EnvironmentalTempVD = 1;  
        }
        else
        {
            chgEv_IBCMR_366_AC_EnvironmentalTempVD = 0;
        }
    }
}
/*@@end*/

/*@@envVar:E_pubc_IBCMR_IBCMR_366_AC_EnvironmentalTempVD_Vt:*/
on envVar E_pubc_IBCMR_IBCMR_366_AC_EnvironmentalTempVD_Vt
{
    qword rawValue = 0ll;
    if(getValue(E_pubc_IBCMR_IBCMR_366_AC_EnvironmentalTempVD_SetVt))
    {
        //update the signal value
        Msg_IBCMR_366.AC_EnvironmentalTempVD=getValue(this);
    }
}
/*@@end*/

/*@@envVar:E_pubc_IBCMR_IBCMR_366_AC_EnvironmentalTempVD_SetVt:*/
on envVar E_pubc_IBCMR_IBCMR_366_AC_EnvironmentalTempVD_SetVt
{
    if(getValue(E_pubc_IBCMR_IBCMR_366_AC_EnvironmentalTempVD_SetVt))
    {
        //update the signal value
        Msg_IBCMR_366.AC_EnvironmentalTempVD=getvalue(E_pubc_IBCMR_IBCMR_366_AC_EnvironmentalTempVD_Vt);
    }
    else
    {
        Msg_IBCMR_366.AC_EnvironmentalTempVD=getValue(E_pubc_IBCMR_IBCMR_366_AC_EnvironmentalTempVD_Rv);
    }
}
/*@@end*/
 
/*@@envVar:E_pubc_IBCMR_IBCMR_366_AC_EnvironmentalTemp_Rv:*/
on envVar E_pubc_IBCMR_IBCMR_366_AC_EnvironmentalTemp_Rv
{
    int64 rawValue = 0ll;
    float rawValue_float = 0.0;
    float phyValue = 0.0;        

    //set the signal with updated raw value
    if(getValue(E_pubc_IBCMR_IBCMR_366_AC_EnvironmentalTemp_SetVt)==0)
    {
        rawValue = getvalue(this);
        if(chgEv_IBCMR_366_AC_EnvironmentalTemp == 0)
        {
            //type conversion to float
            rawValue_float = rawValue;        
            // raw to physical conversion
            phyValue = ((rawValue_float *0.5)+(-40));
            putValue(E_pubc_IBCMR_IBCMR_366_AC_EnvironmentalTemp_Pv, phyValue);
            chgEv_IBCMR_366_AC_EnvironmentalTemp = 1;
        }
        else
        {
            chgEv_IBCMR_366_AC_EnvironmentalTemp = 0;
        }    
        //update the signal value
        Msg_IBCMR_366.AC_EnvironmentalTemp=rawValue;        
    }                                                                           
}
/*@@end*/

/*@@envVar:E_pubc_IBCMR_IBCMR_366_AC_EnvironmentalTemp_Pv:*/
on envVar E_pubc_IBCMR_IBCMR_366_AC_EnvironmentalTemp_Pv
{
    int64 rawValue = 0ll;
    float phyValue = 0.0;
    
    //update the raw value with physical value 
    if(getValue(E_pubc_IBCMR_IBCMR_366_AC_EnvironmentalTemp_SetVt)==0)
    {
        if(chgEv_IBCMR_366_AC_EnvironmentalTemp == 0)
        {
            phyValue = getvalue(this);
            // physical to raw conversion
            rawValue = ((phyValue -(-40))/0.5);
            putValue(E_pubc_IBCMR_IBCMR_366_AC_EnvironmentalTemp_Rv, rawValue);
            chgEv_IBCMR_366_AC_EnvironmentalTemp = 1;  
        }
        else
        {
            chgEv_IBCMR_366_AC_EnvironmentalTemp = 0;
        }
    }
}
/*@@end*/

/*@@envVar:E_pubc_IBCMR_IBCMR_366_AC_EnvironmentalTemp_Vt:*/
on envVar E_pubc_IBCMR_IBCMR_366_AC_EnvironmentalTemp_Vt
{
    qword rawValue = 0ll;
    if(getValue(E_pubc_IBCMR_IBCMR_366_AC_EnvironmentalTemp_SetVt))
    {
        //update the signal value
        Msg_IBCMR_366.AC_EnvironmentalTemp=getValue(this);
    }
}
/*@@end*/

/*@@envVar:E_pubc_IBCMR_IBCMR_366_AC_EnvironmentalTemp_SetVt:*/
on envVar E_pubc_IBCMR_IBCMR_366_AC_EnvironmentalTemp_SetVt
{
    if(getValue(E_pubc_IBCMR_IBCMR_366_AC_EnvironmentalTemp_SetVt))
    {
        //update the signal value
        Msg_IBCMR_366.AC_EnvironmentalTemp=getvalue(E_pubc_IBCMR_IBCMR_366_AC_EnvironmentalTemp_Vt);
    }
    else
    {
        Msg_IBCMR_366.AC_EnvironmentalTemp=getValue(E_pubc_IBCMR_IBCMR_366_AC_EnvironmentalTemp_Rv);
    }
}
/*@@end*/
 
/*@@envVar:E_pubc_IBCMR_IBCMR_3B3_tx:*/
on envVar E_pubc_IBCMR_IBCMR_3B3_tx
{
    if(getValue(this))
    {       
        

        output(Msg_IBCMR_3B3);        
    }
}
/*@@end*/

/*@@envVar:E_pubc_IBCMR_IBCMR_3B3_Range:*/
on envVar E_pubc_IBCMR_IBCMR_3B3_Range
{
    qword rawstatus = 0ll;
    qword rawValue = 0ll;    
    
    rawstatus = getvalue(this);    
    // set all the signals with min raw /max raw /init raw
    switch (rawstatus) 
    {
     case(0) :
        rawValue= 0;
        putValue(E_pubc_IBCMR_IBCMR_3B3_BCM_RearFoglampStatus_Rv, rawValue);
        break;
     case(1) :
        rawValue= 3;
        putValue(E_pubc_IBCMR_IBCMR_3B3_BCM_RearFoglampStatus_Rv, rawValue);
        break;
     default :
        rawValue= 0;
        putValue(E_pubc_IBCMR_IBCMR_3B3_BCM_RearFoglampStatus_Rv, rawValue);
      break;
   }
}
/*@@end*/

/*@@envVar:E_pubc_IBCMR_IBCMR_3B3_Dlc:*/
on envVar E_pubc_IBCMR_IBCMR_3B3_Dlc
{
    if(getValue(E_pubc_IBCMR_IBCMR_3B3_enDlc))
    {
        Msg_IBCMR_3B3.dlc =getValue(this);
    }
    else
    {   
	   Msg_IBCMR_3B3.dlc = 8;
	   	
  }
}
/*@@end*/

/*@@envVar:E_pubc_IBCMR_IBCMR_3B3_enDlc:*/
on envVar E_pubc_IBCMR_IBCMR_3B3_enDlc
{
    //For Messages with DLC = 8, set wrong DLC to smaller than defined DLC
    //For Messages with DLC < 8 set wrong DLC to smaller/longer than defined DLC
    if(getValue(this))
    {
        Msg_IBCMR_3B3.dlc =getValue(E_pubc_IBCMR_IBCMR_3B3_Dlc);
    }
    else
    {
	   Msg_IBCMR_3B3.dlc = 8;
			
    }
}
/*@@end*/


/*@@envVar:E_pubc_IBCMR_IBCMR_3B3_BCM_RearFoglampStatus_Rv:*/
on envVar E_pubc_IBCMR_IBCMR_3B3_BCM_RearFoglampStatus_Rv
{
    int64 rawValue = 0ll;
    float rawValue_float = 0.0;
    float phyValue = 0.0;        

    //set the signal with updated raw value
    if(getValue(E_pubc_IBCMR_IBCMR_3B3_BCM_RearFoglampStatus_SetVt)==0)
    {
        rawValue = getvalue(this);
        if(chgEv_IBCMR_3B3_BCM_RearFoglampStatus == 0)
        {
            //type conversion to float
            rawValue_float = rawValue;        
            // raw to physical conversion
            phyValue = ((rawValue_float *1)+(0));
            putValue(E_pubc_IBCMR_IBCMR_3B3_BCM_RearFoglampStatus_Pv, phyValue);
            chgEv_IBCMR_3B3_BCM_RearFoglampStatus = 1;
        }
        else
        {
            chgEv_IBCMR_3B3_BCM_RearFoglampStatus = 0;
        }    
        //update the signal value
        Msg_IBCMR_3B3.BCM_RearFoglampStatus=rawValue;        
    }                                                                           
}
/*@@end*/

/*@@envVar:E_pubc_IBCMR_IBCMR_3B3_BCM_RearFoglampStatus_Pv:*/
on envVar E_pubc_IBCMR_IBCMR_3B3_BCM_RearFoglampStatus_Pv
{
    int64 rawValue = 0ll;
    float phyValue = 0.0;
    
    //update the raw value with physical value 
    if(getValue(E_pubc_IBCMR_IBCMR_3B3_BCM_RearFoglampStatus_SetVt)==0)
    {
        if(chgEv_IBCMR_3B3_BCM_RearFoglampStatus == 0)
        {
            phyValue = getvalue(this);
            // physical to raw conversion
            rawValue = ((phyValue -(0))/1);
            putValue(E_pubc_IBCMR_IBCMR_3B3_BCM_RearFoglampStatus_Rv, rawValue);
            chgEv_IBCMR_3B3_BCM_RearFoglampStatus = 1;  
        }
        else
        {
            chgEv_IBCMR_3B3_BCM_RearFoglampStatus = 0;
        }
    }
}
/*@@end*/

/*@@envVar:E_pubc_IBCMR_IBCMR_3B3_BCM_RearFoglampStatus_Vt:*/
on envVar E_pubc_IBCMR_IBCMR_3B3_BCM_RearFoglampStatus_Vt
{
    qword rawValue = 0ll;
    if(getValue(E_pubc_IBCMR_IBCMR_3B3_BCM_RearFoglampStatus_SetVt))
    {
        //update the signal value
        Msg_IBCMR_3B3.BCM_RearFoglampStatus=getValue(this);
    }
}
/*@@end*/

/*@@envVar:E_pubc_IBCMR_IBCMR_3B3_BCM_RearFoglampStatus_SetVt:*/
on envVar E_pubc_IBCMR_IBCMR_3B3_BCM_RearFoglampStatus_SetVt
{
    if(getValue(E_pubc_IBCMR_IBCMR_3B3_BCM_RearFoglampStatus_SetVt))
    {
        //update the signal value
        Msg_IBCMR_3B3.BCM_RearFoglampStatus=getvalue(E_pubc_IBCMR_IBCMR_3B3_BCM_RearFoglampStatus_Vt);
    }
    else
    {
        Msg_IBCMR_3B3.BCM_RearFoglampStatus=getValue(E_pubc_IBCMR_IBCMR_3B3_BCM_RearFoglampStatus_Rv);
    }
}
/*@@end*/
 
/*@@envVar:E_pubc_IBCMR_IBCMR_2D1_tx:*/
on envVar E_pubc_IBCMR_IBCMR_2D1_tx
{
    if(getValue(this))
    {       
        

        output(Msg_IBCMR_2D1);        
    }
}
/*@@end*/

/*@@envVar:E_pubc_IBCMR_IBCMR_2D1_Range:*/
on envVar E_pubc_IBCMR_IBCMR_2D1_Range
{
    qword rawstatus = 0ll;
    qword rawValue = 0ll;    
    
    rawstatus = getvalue(this);    
    // set all the signals with min raw /max raw /init raw
    switch (rawstatus) 
    {
     case(0) :
        rawValue= 0;
        putValue(E_pubc_IBCMR_IBCMR_2D1_BCM_PassengerDoorStatus_Rv, rawValue);
        rawValue= 0;
        putValue(E_pubc_IBCMR_IBCMR_2D1_BCM_TrunkDoorStatus_Rv, rawValue);
        rawValue= 0;
        putValue(E_pubc_IBCMR_IBCMR_2D1_BCM_RightRearDoorStatus_Rv, rawValue);
        break;
     case(1) :
        rawValue= 1;
        putValue(E_pubc_IBCMR_IBCMR_2D1_BCM_PassengerDoorStatus_Rv, rawValue);
        rawValue= 1;
        putValue(E_pubc_IBCMR_IBCMR_2D1_BCM_TrunkDoorStatus_Rv, rawValue);
        rawValue= 1;
        putValue(E_pubc_IBCMR_IBCMR_2D1_BCM_RightRearDoorStatus_Rv, rawValue);
        break;
     default :
        rawValue= 0;
        putValue(E_pubc_IBCMR_IBCMR_2D1_BCM_PassengerDoorStatus_Rv, rawValue);
        rawValue= 0;
        putValue(E_pubc_IBCMR_IBCMR_2D1_BCM_TrunkDoorStatus_Rv, rawValue);
        rawValue= 0;
        putValue(E_pubc_IBCMR_IBCMR_2D1_BCM_RightRearDoorStatus_Rv, rawValue);
      break;
   }
}
/*@@end*/

/*@@envVar:E_pubc_IBCMR_IBCMR_2D1_Dlc:*/
on envVar E_pubc_IBCMR_IBCMR_2D1_Dlc
{
    if(getValue(E_pubc_IBCMR_IBCMR_2D1_enDlc))
    {
        Msg_IBCMR_2D1.dlc =getValue(this);
    }
    else
    {   
	   Msg_IBCMR_2D1.dlc = 8;
	   	
  }
}
/*@@end*/

/*@@envVar:E_pubc_IBCMR_IBCMR_2D1_enDlc:*/
on envVar E_pubc_IBCMR_IBCMR_2D1_enDlc
{
    //For Messages with DLC = 8, set wrong DLC to smaller than defined DLC
    //For Messages with DLC < 8 set wrong DLC to smaller/longer than defined DLC
    if(getValue(this))
    {
        Msg_IBCMR_2D1.dlc =getValue(E_pubc_IBCMR_IBCMR_2D1_Dlc);
    }
    else
    {
	   Msg_IBCMR_2D1.dlc = 8;
			
    }
}
/*@@end*/


/*@@envVar:E_pubc_IBCMR_IBCMR_2D1_BCM_PassengerDoorStatus_Rv:*/
on envVar E_pubc_IBCMR_IBCMR_2D1_BCM_PassengerDoorStatus_Rv
{
    int64 rawValue = 0ll;
    float rawValue_float = 0.0;
    float phyValue = 0.0;        

    //set the signal with updated raw value
    if(getValue(E_pubc_IBCMR_IBCMR_2D1_BCM_PassengerDoorStatus_SetVt)==0)
    {
        rawValue = getvalue(this);
        if(chgEv_IBCMR_2D1_BCM_PassengerDoorStatus == 0)
        {
            //type conversion to float
            rawValue_float = rawValue;        
            // raw to physical conversion
            phyValue = ((rawValue_float *1)+(0));
            putValue(E_pubc_IBCMR_IBCMR_2D1_BCM_PassengerDoorStatus_Pv, phyValue);
            chgEv_IBCMR_2D1_BCM_PassengerDoorStatus = 1;
        }
        else
        {
            chgEv_IBCMR_2D1_BCM_PassengerDoorStatus = 0;
        }    
        //update the signal value
        Msg_IBCMR_2D1.BCM_PassengerDoorStatus=rawValue;        
    }                                                                           
}
/*@@end*/

/*@@envVar:E_pubc_IBCMR_IBCMR_2D1_BCM_PassengerDoorStatus_Pv:*/
on envVar E_pubc_IBCMR_IBCMR_2D1_BCM_PassengerDoorStatus_Pv
{
    int64 rawValue = 0ll;
    float phyValue = 0.0;
    
    //update the raw value with physical value 
    if(getValue(E_pubc_IBCMR_IBCMR_2D1_BCM_PassengerDoorStatus_SetVt)==0)
    {
        if(chgEv_IBCMR_2D1_BCM_PassengerDoorStatus == 0)
        {
            phyValue = getvalue(this);
            // physical to raw conversion
            rawValue = ((phyValue -(0))/1);
            putValue(E_pubc_IBCMR_IBCMR_2D1_BCM_PassengerDoorStatus_Rv, rawValue);
            chgEv_IBCMR_2D1_BCM_PassengerDoorStatus = 1;  
        }
        else
        {
            chgEv_IBCMR_2D1_BCM_PassengerDoorStatus = 0;
        }
    }
}
/*@@end*/

/*@@envVar:E_pubc_IBCMR_IBCMR_2D1_BCM_PassengerDoorStatus_Vt:*/
on envVar E_pubc_IBCMR_IBCMR_2D1_BCM_PassengerDoorStatus_Vt
{
    qword rawValue = 0ll;
    if(getValue(E_pubc_IBCMR_IBCMR_2D1_BCM_PassengerDoorStatus_SetVt))
    {
        //update the signal value
        Msg_IBCMR_2D1.BCM_PassengerDoorStatus=getValue(this);
    }
}
/*@@end*/

/*@@envVar:E_pubc_IBCMR_IBCMR_2D1_BCM_PassengerDoorStatus_SetVt:*/
on envVar E_pubc_IBCMR_IBCMR_2D1_BCM_PassengerDoorStatus_SetVt
{
    if(getValue(E_pubc_IBCMR_IBCMR_2D1_BCM_PassengerDoorStatus_SetVt))
    {
        //update the signal value
        Msg_IBCMR_2D1.BCM_PassengerDoorStatus=getvalue(E_pubc_IBCMR_IBCMR_2D1_BCM_PassengerDoorStatus_Vt);
    }
    else
    {
        Msg_IBCMR_2D1.BCM_PassengerDoorStatus=getValue(E_pubc_IBCMR_IBCMR_2D1_BCM_PassengerDoorStatus_Rv);
    }
}
/*@@end*/
 
/*@@envVar:E_pubc_IBCMR_IBCMR_2D1_BCM_TrunkDoorStatus_Rv:*/
on envVar E_pubc_IBCMR_IBCMR_2D1_BCM_TrunkDoorStatus_Rv
{
    int64 rawValue = 0ll;
    float rawValue_float = 0.0;
    float phyValue = 0.0;        

    //set the signal with updated raw value
    if(getValue(E_pubc_IBCMR_IBCMR_2D1_BCM_TrunkDoorStatus_SetVt)==0)
    {
        rawValue = getvalue(this);
        if(chgEv_IBCMR_2D1_BCM_TrunkDoorStatus == 0)
        {
            //type conversion to float
            rawValue_float = rawValue;        
            // raw to physical conversion
            phyValue = ((rawValue_float *1)+(0));
            putValue(E_pubc_IBCMR_IBCMR_2D1_BCM_TrunkDoorStatus_Pv, phyValue);
            chgEv_IBCMR_2D1_BCM_TrunkDoorStatus = 1;
        }
        else
        {
            chgEv_IBCMR_2D1_BCM_TrunkDoorStatus = 0;
        }    
        //update the signal value
        Msg_IBCMR_2D1.BCM_TrunkDoorStatus=rawValue;        
    }                                                                           
}
/*@@end*/

/*@@envVar:E_pubc_IBCMR_IBCMR_2D1_BCM_TrunkDoorStatus_Pv:*/
on envVar E_pubc_IBCMR_IBCMR_2D1_BCM_TrunkDoorStatus_Pv
{
    int64 rawValue = 0ll;
    float phyValue = 0.0;
    
    //update the raw value with physical value 
    if(getValue(E_pubc_IBCMR_IBCMR_2D1_BCM_TrunkDoorStatus_SetVt)==0)
    {
        if(chgEv_IBCMR_2D1_BCM_TrunkDoorStatus == 0)
        {
            phyValue = getvalue(this);
            // physical to raw conversion
            rawValue = ((phyValue -(0))/1);
            putValue(E_pubc_IBCMR_IBCMR_2D1_BCM_TrunkDoorStatus_Rv, rawValue);
            chgEv_IBCMR_2D1_BCM_TrunkDoorStatus = 1;  
        }
        else
        {
            chgEv_IBCMR_2D1_BCM_TrunkDoorStatus = 0;
        }
    }
}
/*@@end*/

/*@@envVar:E_pubc_IBCMR_IBCMR_2D1_BCM_TrunkDoorStatus_Vt:*/
on envVar E_pubc_IBCMR_IBCMR_2D1_BCM_TrunkDoorStatus_Vt
{
    qword rawValue = 0ll;
    if(getValue(E_pubc_IBCMR_IBCMR_2D1_BCM_TrunkDoorStatus_SetVt))
    {
        //update the signal value
        Msg_IBCMR_2D1.BCM_TrunkDoorStatus=getValue(this);
    }
}
/*@@end*/

/*@@envVar:E_pubc_IBCMR_IBCMR_2D1_BCM_TrunkDoorStatus_SetVt:*/
on envVar E_pubc_IBCMR_IBCMR_2D1_BCM_TrunkDoorStatus_SetVt
{
    if(getValue(E_pubc_IBCMR_IBCMR_2D1_BCM_TrunkDoorStatus_SetVt))
    {
        //update the signal value
        Msg_IBCMR_2D1.BCM_TrunkDoorStatus=getvalue(E_pubc_IBCMR_IBCMR_2D1_BCM_TrunkDoorStatus_Vt);
    }
    else
    {
        Msg_IBCMR_2D1.BCM_TrunkDoorStatus=getValue(E_pubc_IBCMR_IBCMR_2D1_BCM_TrunkDoorStatus_Rv);
    }
}
/*@@end*/
 
/*@@envVar:E_pubc_IBCMR_IBCMR_2D1_BCM_RightRearDoorStatus_Rv:*/
on envVar E_pubc_IBCMR_IBCMR_2D1_BCM_RightRearDoorStatus_Rv
{
    int64 rawValue = 0ll;
    float rawValue_float = 0.0;
    float phyValue = 0.0;        

    //set the signal with updated raw value
    if(getValue(E_pubc_IBCMR_IBCMR_2D1_BCM_RightRearDoorStatus_SetVt)==0)
    {
        rawValue = getvalue(this);
        if(chgEv_IBCMR_2D1_BCM_RightRearDoorStatus == 0)
        {
            //type conversion to float
            rawValue_float = rawValue;        
            // raw to physical conversion
            phyValue = ((rawValue_float *1)+(0));
            putValue(E_pubc_IBCMR_IBCMR_2D1_BCM_RightRearDoorStatus_Pv, phyValue);
            chgEv_IBCMR_2D1_BCM_RightRearDoorStatus = 1;
        }
        else
        {
            chgEv_IBCMR_2D1_BCM_RightRearDoorStatus = 0;
        }    
        //update the signal value
        Msg_IBCMR_2D1.BCM_RightRearDoorStatus=rawValue;        
    }                                                                           
}
/*@@end*/

/*@@envVar:E_pubc_IBCMR_IBCMR_2D1_BCM_RightRearDoorStatus_Pv:*/
on envVar E_pubc_IBCMR_IBCMR_2D1_BCM_RightRearDoorStatus_Pv
{
    int64 rawValue = 0ll;
    float phyValue = 0.0;
    
    //update the raw value with physical value 
    if(getValue(E_pubc_IBCMR_IBCMR_2D1_BCM_RightRearDoorStatus_SetVt)==0)
    {
        if(chgEv_IBCMR_2D1_BCM_RightRearDoorStatus == 0)
        {
            phyValue = getvalue(this);
            // physical to raw conversion
            rawValue = ((phyValue -(0))/1);
            putValue(E_pubc_IBCMR_IBCMR_2D1_BCM_RightRearDoorStatus_Rv, rawValue);
            chgEv_IBCMR_2D1_BCM_RightRearDoorStatus = 1;  
        }
        else
        {
            chgEv_IBCMR_2D1_BCM_RightRearDoorStatus = 0;
        }
    }
}
/*@@end*/

/*@@envVar:E_pubc_IBCMR_IBCMR_2D1_BCM_RightRearDoorStatus_Vt:*/
on envVar E_pubc_IBCMR_IBCMR_2D1_BCM_RightRearDoorStatus_Vt
{
    qword rawValue = 0ll;
    if(getValue(E_pubc_IBCMR_IBCMR_2D1_BCM_RightRearDoorStatus_SetVt))
    {
        //update the signal value
        Msg_IBCMR_2D1.BCM_RightRearDoorStatus=getValue(this);
    }
}
/*@@end*/

/*@@envVar:E_pubc_IBCMR_IBCMR_2D1_BCM_RightRearDoorStatus_SetVt:*/
on envVar E_pubc_IBCMR_IBCMR_2D1_BCM_RightRearDoorStatus_SetVt
{
    if(getValue(E_pubc_IBCMR_IBCMR_2D1_BCM_RightRearDoorStatus_SetVt))
    {
        //update the signal value
        Msg_IBCMR_2D1.BCM_RightRearDoorStatus=getvalue(E_pubc_IBCMR_IBCMR_2D1_BCM_RightRearDoorStatus_Vt);
    }
    else
    {
        Msg_IBCMR_2D1.BCM_RightRearDoorStatus=getValue(E_pubc_IBCMR_IBCMR_2D1_BCM_RightRearDoorStatus_Rv);
    }
}
/*@@end*/
 
/*@@envVar:E_pubc_IBCMR_IBCMR_340_tx:*/
on envVar E_pubc_IBCMR_IBCMR_340_tx
{
    if(getValue(this))
    {       
        

        output(Msg_IBCMR_340);        
    }
}
/*@@end*/

/*@@envVar:E_pubc_IBCMR_IBCMR_340_Range:*/
on envVar E_pubc_IBCMR_IBCMR_340_Range
{
    qword rawstatus = 0ll;
    qword rawValue = 0ll;    
    
    rawstatus = getvalue(this);    
    // set all the signals with min raw /max raw /init raw
    switch (rawstatus) 
    {
     case(0) :
        rawValue= 0;
        putValue(E_pubc_IBCMR_IBCMR_340_AC_FrBlowType_Rv, rawValue);
        break;
     case(1) :
        rawValue= 7;
        putValue(E_pubc_IBCMR_IBCMR_340_AC_FrBlowType_Rv, rawValue);
        break;
     default :
        rawValue= 0;
        putValue(E_pubc_IBCMR_IBCMR_340_AC_FrBlowType_Rv, rawValue);
      break;
   }
}
/*@@end*/

/*@@envVar:E_pubc_IBCMR_IBCMR_340_Dlc:*/
on envVar E_pubc_IBCMR_IBCMR_340_Dlc
{
    if(getValue(E_pubc_IBCMR_IBCMR_340_enDlc))
    {
        Msg_IBCMR_340.dlc =getValue(this);
    }
    else
    {   
	   Msg_IBCMR_340.dlc = 8;
	   	
  }
}
/*@@end*/

/*@@envVar:E_pubc_IBCMR_IBCMR_340_enDlc:*/
on envVar E_pubc_IBCMR_IBCMR_340_enDlc
{
    //For Messages with DLC = 8, set wrong DLC to smaller than defined DLC
    //For Messages with DLC < 8 set wrong DLC to smaller/longer than defined DLC
    if(getValue(this))
    {
        Msg_IBCMR_340.dlc =getValue(E_pubc_IBCMR_IBCMR_340_Dlc);
    }
    else
    {
	   Msg_IBCMR_340.dlc = 8;
			
    }
}
/*@@end*/


/*@@envVar:E_pubc_IBCMR_IBCMR_340_AC_FrBlowType_Rv:*/
on envVar E_pubc_IBCMR_IBCMR_340_AC_FrBlowType_Rv
{
    int64 rawValue = 0ll;
    float rawValue_float = 0.0;
    float phyValue = 0.0;        

    //set the signal with updated raw value
    if(getValue(E_pubc_IBCMR_IBCMR_340_AC_FrBlowType_SetVt)==0)
    {
        rawValue = getvalue(this);
        if(chgEv_IBCMR_340_AC_FrBlowType == 0)
        {
            //type conversion to float
            rawValue_float = rawValue;        
            // raw to physical conversion
            phyValue = ((rawValue_float *1)+(0));
            putValue(E_pubc_IBCMR_IBCMR_340_AC_FrBlowType_Pv, phyValue);
            chgEv_IBCMR_340_AC_FrBlowType = 1;
        }
        else
        {
            chgEv_IBCMR_340_AC_FrBlowType = 0;
        }    
        //update the signal value
        Msg_IBCMR_340.AC_FrBlowType=rawValue;        
    }                                                                           
}
/*@@end*/

/*@@envVar:E_pubc_IBCMR_IBCMR_340_AC_FrBlowType_Pv:*/
on envVar E_pubc_IBCMR_IBCMR_340_AC_FrBlowType_Pv
{
    int64 rawValue = 0ll;
    float phyValue = 0.0;
    
    //update the raw value with physical value 
    if(getValue(E_pubc_IBCMR_IBCMR_340_AC_FrBlowType_SetVt)==0)
    {
        if(chgEv_IBCMR_340_AC_FrBlowType == 0)
        {
            phyValue = getvalue(this);
            // physical to raw conversion
            rawValue = ((phyValue -(0))/1);
            putValue(E_pubc_IBCMR_IBCMR_340_AC_FrBlowType_Rv, rawValue);
            chgEv_IBCMR_340_AC_FrBlowType = 1;  
        }
        else
        {
            chgEv_IBCMR_340_AC_FrBlowType = 0;
        }
    }
}
/*@@end*/

/*@@envVar:E_pubc_IBCMR_IBCMR_340_AC_FrBlowType_Vt:*/
on envVar E_pubc_IBCMR_IBCMR_340_AC_FrBlowType_Vt
{
    qword rawValue = 0ll;
    if(getValue(E_pubc_IBCMR_IBCMR_340_AC_FrBlowType_SetVt))
    {
        //update the signal value
        Msg_IBCMR_340.AC_FrBlowType=getValue(this);
    }
}
/*@@end*/

/*@@envVar:E_pubc_IBCMR_IBCMR_340_AC_FrBlowType_SetVt:*/
on envVar E_pubc_IBCMR_IBCMR_340_AC_FrBlowType_SetVt
{
    if(getValue(E_pubc_IBCMR_IBCMR_340_AC_FrBlowType_SetVt))
    {
        //update the signal value
        Msg_IBCMR_340.AC_FrBlowType=getvalue(E_pubc_IBCMR_IBCMR_340_AC_FrBlowType_Vt);
    }
    else
    {
        Msg_IBCMR_340.AC_FrBlowType=getValue(E_pubc_IBCMR_IBCMR_340_AC_FrBlowType_Rv);
    }
}
/*@@end*/
 






/*@@caplFunc:calc_SAE_J1850(int[],int):*/
int calc_SAE_J1850(int data[], int Crc_len)
	{
		int idx,crc,temp,temp1;
		crc = 0x00;
        idx = 0;
        temp = 0;
        temp1 = 0;
	
        for(idx=0;idx <= Crc_len;idx++)
        {
			temp1 = data[idx];
			temp = (crc^temp1);
			crc = CRC_J1850_Table[temp];
        }
		crc ^= 0x00;
		return crc;
	}


/*	int calc_SAE_J1851(int data[], int Crc_len)
	{
		int crc;
		
        crc = (data[0]+data[1]+data[2]+data[3]+data[4]+data[5]+data[6]) ;
          
		crc ^= 255;
		return crc;
	}*/

	

/* 	int calc_SAE_J1850(int data[], int Crc_len)
	{
		int idx,crc,temp,temp1,temp2,idy;
		crc = 0xFF;
        idx = 0;
        idy = 0;
        temp = 0;
        temp1 = 0;
        temp2 = 0;
	
        for(idx=0;idx < Crc_len;idx++)
        {
         temp1 = data[idx];
         crc = (crc^temp1);
          for (idy=8; idy>0; idy--)
          {
              // Save the value before the top bit is shifted out.
              temp2 = crc;
              crc <<= 1;
              if (0 != (temp2 & 128))
              {
                  crc ^= 0x2f;
              }
          } 
          
         //crc = CRC_J1850_Table[temp];
        }
		crc ^= 0xFF;
		return crc;
	} */
/*@@end*/

/*@@Capl function to calculate CANFD Dlc*/
int Calc_Canfd_dlc(byte Dbc_dlc1)
	{
		if(Dbc_dlc > 8)
		    {
			 while (i<=7)
			  {
				if (CANFD_DLC[i]==Dbc_dlc)
				{
				return CAN_DLC[i];
				 break;
				}
				i++ ;
			}
		}
    else
	
	return Dbc_dlc1 ;
	
		
	}
	
	int calc_Checksum(int data[], int Crc_len)
 {
	int crc;
	crc=0x00;
	
    crc = (data[0]+data[1]+data[2]+data[3]+data[4]+data[5]+data[6]) ;
      
	crc ^= 255;
	return crc;
 }
	//For Messages with DLC = 8, CAN FD data length =8
	//For Messages with DLC = 9, CAN FD data length =12
	//For Messages with DLC = 10, CAN FD data length =16
	//For Messages with DLC = 11, CAN FD data length =20
	//For Messages with DLC = 12, CAN FD data length =24
	//For Messages with DLC = 13, CAN FD data length =32
	//For Messages with DLC = 14, CAN FD data length =48
	//For Messages with DLC = 15, CAN FD data length =64
/*@@end*/
	

