/*@!Encoding:1252*/
variables
{
        
    byte TextoutByte[100];
    byte TextinByte[100];
    char TextoutChar[100];      
	char TextinChar[100];
	char TextinCharTmp[100];
	//dword receiveBufferLength = 100;

	dword receiveBufferCounter = 0;
	dword receiveMessageCounter = 0;
	int receiveKind = 0;
	
	mstimer measActualValues;
	      

 //RS-232 variables

    long rs232Init;     
    
    long comPort = 14;
     long comPort1;
  	long baudRate = 9600;
  	long length = 8;
  	long stopBit = 0;
  	long useParity = 0; 	
    
}

on envVar Env_VoltBKSet
{
    
    if(getvalue(Env_VoltBKSet))
    {        
        //SelectCh(getvalue(Env_VoltBKChannel));
        SetVoltage(getvalue(Env_VoltBKValue));
        putvalue(Env_VoltBKSet,0);
    }    
        
}

on envVar Env_VoltBKRelease
{
if(getvalue(Env_VoltBKRelease))
{
  SetVoltage(12);
}
else{
   //RelaseControl();
    SendToCOM("EX OFF");  //abschalten 
}
    
        
}

on preStart
{
    comPort1=getvalue(EnvVoltComPort);
    if(comPort1==comPort)
    {
    write("defaultcomport=%x",comPort);
    RS232Open(comPort);
    rs232Init=RS232Configure(comPort, baudRate, length, stopBit, useParity);
    }
    else
    {
    write("defaultcomport=%x",comPort);
    putvalue(EnvVoltComPort,comPort);
    RS232Open(comPort);
    rs232Init=RS232Configure(comPort, baudRate, length, stopBit, useParity);
    }  
  

}

On envVar EnvVoltComPort
 {
  comPort=getvalue(this);
  write("givencomport=%x",comPort);
  RS232Open(comPort);
  rs232Init=RS232Configure(comPort, baudRate, length, stopBit, useParity);
  
 }

on envVar Env_VoltBKChannel
{
    
    SelectCh(getvalue(this));

}

SelectCh (int channel)
{
    int mysize = 20;
	    
	// channel 1 activate
    if (0==channel)
    SendToCOM("SEL 1");

    // channel 2 activate
    if (1==channel)
    SendToCOM("SEL 2");
	
	//read out on/off state	
	receiveKind=1;
	SendToCOM("EX?");


	if ( 1==RS232Receive(comPort,TextinByte,10 ) ) 
	{	
	}
//	write("Receive function ended, received up to now: %s", TextinChar);

}

SetVoltage (float voltage)
{
    int i;
    char string[15];
    
    //creating command
    i=snprintf(string, 15, "V %.3f",voltage);
             
    SendToCOM("SYST:REM");
    SendToCOM(string);
    SendToCOM("C 5");
    SendToCOM("EX ON");
    
}

SetCurrent (float current)
{
   
  
    //no implementation for current recently
   
}

ChannelOnOff (int onoff)
{
    if (onoff)
    SendToCOM("OUTP 1");
    

    if (!onoff)
    SendToCOM("OUTP 0");
   
}

SendToCOM (char f_message[])
{
    int j, result;
    
    //convert command string to byte[]
    for(j=0;f_message[j]>0;j++)            
    {
        TextoutByte[j]=f_message[j];
    }

    //end character 0x0a
    TextoutByte[j]=10;
    
    //send to COM port        
    result = Rs232WriteBlock(comPort,TextoutByte,strlen(f_message)+1);
      
    
    //write report to write window
    if (1==result)
    {   
        write("Message %s sent to COM %d",f_message, comPort);
    }
    else
    {
        write("Message %s not sent, error code> %d",f_message,result);
    }    
}

RelaseControl ()
{

    SendToCOM("SYST:LOC");  
      
}

on envVar Env_VoltBKValue
{

     putValue(Env_VoltBKSet,1);

}

on envVar Env_VoltBKStat
{

    ChannelOnOff(getvalue(this));
    
        
}

on envVar Env_VoltBKValue_mV
{

    int i;
    float b;
    char string[30];
    
    //creating command
    i=snprintf(string, 30, "VOLT %dmV",getvalue(this));
                   
    SendToCOM(string);

    b=getvalue(this);
    b=b/1000;
    putValue(Env_VoltBKValue,b);

}

on start
{

	//putValue(Env_VoltBKChannel,1);
    //ChannelOnOff(1);
    
// setTimer(measActualValues,1000);
}

on stopMeasurement
{

    //SelectCh(1);
    //ChannelOnOff(0);

}

RS232OnReceive( dword port, byte buffer[],  dword receiveBufferLength )

{
	int i;
	int j=0;
	float measValue_f;	
  
	
		receiveBufferCounter = 0;
		//write("Received: %s", TextinCharTmp);
		write("receiveKind: %d", receiveKind);
		
		for (i=0; i<elcount(buffer); i++)
		{
			TextinChar[i] = buffer[i];
			TextinCharTmp[i] = 0;
		}
		
		switch (receiveKind)
		{
			// '1'= on/off state
			case 1:
			
				putvalue(Env_VoltBKStat,TextinChar[0]-48);						
				
				break;

			// '2'= read out actual current
			case 2:
				
				measValue_f = atodbl(TextinChar);		
				write("Received: %.3f A", measValue_f);
				putvalue(Env_VoltBKCurrValue, measValue_f);

				break;

			// '3'= read out actual voltage
			case 3:
				
				measValue_f = atodbl(TextinChar);		
				write("Received: %.3f V", measValue_f);
				putvalue(Env_VoltBKValue, measValue_f);

				break;
		}

		for (i=0; i<100; i++)
		{
			TextinChar[i] = 0;
		}
	
			
}

on envVar Env_VoltBKGetCurr
{
	if(getvalue(Env_VoltBKGetCurr))
    {        
        SendToCOM("MC?");
		receiveKind=2;
		
		if ( 1==RS232Receive(comPort,TextinByte,10 ) ) 
		{	
	
		}	

		putvalue(Env_VoltBKGetCurr,0);
    }    
    
}
/*
on timer measActualValues
{
	   SendToCOM("MC?");
		receiveKind=2;
		
		if ( 1==RS232Receive(comPort,TextinByte,10 ) ) 
		{	
	
		}	
    	
    setTimer(measActualValues,2000);
}
*/
on timer measActualValues
{
	   SendToCOM("MV?");
		receiveKind=3;
		
		if ( 1==RS232Receive(comPort,TextinByte,10 ) ) 
		{	
	
		}	
    	    //setTimer(measActualValues,2000);
}
on envVar Env_VoltBKGetVolt
{
	if(getvalue(Env_VoltBKGetVolt))
    {
		SendToCOM("MV?");
      
		receiveKind=3;
		
		if ( 1==RS232Receive(comPort,TextinByte,10 ) ) 
		{	
	   
		}		

		putvalue(Env_VoltBKGetVolt,0);
    }  
}

