/*@@includes:*/
includes
{
	#include "cs_gac_common_functions.can"
}
/*@@end*/

/*@@var:*/
variables
{    
    /*Debug*/
    int g_DSDL_debug = 0;

    /* Globals */
    char nameOfFile[255];

    /* Buffer for reading from file */
    char    g_DataBufferRaw[200000];    //includes the whole parameters from the 'Datensatz' incl. spaces (0x20)
    char    g_DataBuffer[200000];    //includes the whole parameters from the 'Datensatz' excl. spaces (0x20)
    long    g_Datalenght = 0;
    const   int coursorOffset = 13;
     
    /* Blockbuffer's filled with prepared data for writing to flash*/
    byte    g_WriteBuffer[5000][256]; //each buffer "row" element contains a prepared datablock
    int     g_CurrentBlockIndex = 1; //
    int     g_MaxBlockNr = 0;   // Number of blocks that is required to transfer all parameters
    int     g_bytecounter[5000];  // Contains the datalengt of each sendblock
    const   int hexCharSize = 4;        // 4 = amount of characters used to identify one hex value in "Datensatz".xml
    double  datablockSize = 256;    // 256 = amount of bytes transmitted per datablock

    /* Tx Data */
    Byte g_RqTxData[258];	// 2 Byte SID and block counter + 258 Byte data per each datablock
}
/*@@end*/

/*@@testcase:ReadFile(int,int):*/
testcase ReadFile (int caseHandle, int interactive)
{
    dword fileHandle = 0;
    char  buffer[200000];
    char  FileBuffer[200000];
	long  bytePos = 0;
    long  resultGetString = 1;
    long  coursorPosStart = 0;
    long  coursorPosEnd = 0;
    long  Datalenght = 0;
	long   i, j = 0;

    long filestate = 0;

    //Get file path
    switch(caseHandle)
    {
        case 0: //Get filepath from dialogbox
            getValue(EnvFilePath,nameOfFile);
            fileHandle =  openFileRead (nameOfFile,0);
        break;

        case 1: //Static filepath for DPC with bad CRC
            fileHandle =  openFileRead ("BAD_CRC_PRG_85_D4-AU641_SERIE_XX_VAS5163.xml",0);
            fileRewind (fileHandle);       
        break;

        case 2: //Static filepath for BVS with bad CRC
            fileHandle =  openFileRead ("BAD_CRC_PRG_8E_D4-AU641_SERIE_XX_VAS5163.xml",0);
        break;

        case 3: //Get filepath from dialogbox
            fileHandle = openFileRead (nameOfFile,0);
        break;
                
        default:
        break;
    }

    snprintf(FileBuffer, elcount(FileBuffer), "0"); //Clear FileBuffer for rewrite

    if (1 == g_DSDL_debug) write("Dateipfad: %s ",nameOfFile);
    
    if (0 == fileHandle)
    {
        Write("Error at Fileopen"); //Errormessage if no file is found or selected
        Write("No file found. Please select parameter file!");
        stop(); //Stop measurement
    }
    else
    {
        //Get data from file
        while (fileGetStringSZ(buffer,elcount(buffer),fileHandle)!=0) 
        {
            strncat(FileBuffer, buffer, elcount(FileBuffer));
        }

        filestate = fileClose (fileHandle);

        //Copy param values from file for dataset download    
        coursorPosStart =  strstr(FileBuffer,"LOGIN_IND=") + coursorOffset; //Offset = +13 zum ersten Hexwert, da vorbereitung für spätere Einleseschleife
        coursorPosEnd =  strstr(FileBuffer,"</PARAMETER");
        g_Datalenght = coursorPosEnd - coursorPosStart;
    }
    //if (1 == g_DSDL_debug)
    //{
        write("coursorPosStart: %d",coursorPosStart);
        write("coursorPosEnd: %d",coursorPosEnd);
        write("g_Datalenght: %d",g_Datalenght);
    //}

	
    /* Copy local data buffer to global data buffer */
    substr_cpy(g_DataBufferRaw, FileBuffer, coursorPosStart,g_Datalenght,elcount(g_DataBufferRaw));
	
	//write("RawBufferSize: %d", strlen(g_DataBufferRaw));
	/* Copy only the legal values to another global buffer in a hex array format*/
	for(i=1;i<g_Datalenght;i++)
	{
		if((0x78 == g_DataBufferRaw[i]) && (0x30 == g_DataBufferRaw[i-1]))//itt
		{
			g_DataBuffer[j]=g_DataBufferRaw[i-1];
			g_DataBuffer[j+1]=g_DataBufferRaw[i];
			g_DataBuffer[j+2]=g_DataBufferRaw[i+1];
			g_DataBuffer[j+3]=g_DataBufferRaw[i+2];
			j+=4;
		}
	}
	
	write("g_DataBuffer: %d", strlen(g_DataBuffer));
	
	if (1 == g_DSDL_debug)
    {
		/* Write out the first 64 elements of the two buffers */
	    write("Raw Buffer:");
		for(i=0;i<64;i+=8)
		{
		write("%2X %2X %2X %2X %2X %2X %2X %2X",
				g_DataBufferRaw[0+i],g_DataBufferRaw[1+i],g_DataBufferRaw[2+i],g_DataBufferRaw[3+i],
				g_DataBufferRaw[4+i],g_DataBufferRaw[5+i],g_DataBufferRaw[6+i],g_DataBufferRaw[7+i]);	
		}
		
		write("Clear Buffer:");
		for(i=0;i<64;i+=8)
		{
		write("%2X %2X %2X %2X %2X %2X %2X %2X",
				g_DataBuffer[0+i],g_DataBuffer[1+i],g_DataBuffer[2+i],g_DataBuffer[3+i],
				g_DataBuffer[4+i],g_DataBuffer[5+i],g_DataBuffer[6+i],g_DataBuffer[7+i]);	
		}
	}	

	g_MaxBlockNr = mkDataString(interactive);
}
/*@@end*/

/*@@testcase:TransmitData(long):*/
testcase TransmitData (long f_timeOutValue)
{
    int  idx = 0; //Pointer @ data element coursor
    int  blockIndex = 0; //Pointer at "row" dimension from g_WriteBuffer array
    int  datalenght = 0;
    char tempString[255];
	int  i = 0;
    
    while (blockIndex <= g_MaxBlockNr)
    {
        blockIndex = g_CurrentBlockIndex -1;
        
        g_RqTxData[0] = 0x36;            
        g_RqTxData[1] = g_CurrentBlockIndex % 256;

        /* Copy data from global data buffer to global write buffer */
        for(idx=0; idx < elcount(g_WriteBuffer[blockIndex]) ;idx++)
        {
            g_RqTxData[idx+2] = g_WriteBuffer[blockIndex][idx];
        }
    
        write("Send data block %d",g_CurrentBlockIndex);
        write("***********************************************************");  

        /* Check datalenght */
        if( g_bytecounter[blockIndex] < elcount(g_WriteBuffer[blockIndex]))
        {
            datalenght = g_bytecounter[blockIndex];
        }
        else
        {
            datalenght = elcount(g_WriteBuffer[blockIndex]);
        }

		write("data block length = %d",datalenght);         
		
		CreateByteString(g_RqTxData, 0, datalenght+2);
		RequestResponseCompareLogic(byteString, "76..", "Regexp"); 

        g_CurrentBlockIndex++;
         
        if (g_CurrentBlockIndex > g_MaxBlockNr) 
        {
            g_CurrentBlockIndex = 1; //Reset g_CurrentBlockIndex to start value
            break;  
        }
    }
}
/*@@end*/

/*@@caplFunc:mkDataString(int):*/
int mkDataString (int interactive)
{
    /* Variablendeklaration */
    char    charbuff[4] = "";
    double  input;
    long    coursorPos = 0;
    int     blockIndex,g,bytecounter,i;  //blockIndex = Arrayzähler. g = Byteposition in aktuellem Array

    coursorPos = 0;
    input = 0;
    blockIndex = 0;
    datablockSize = 256;

    /* Handling the case when the size of the transferred blocks is added manually */
    if (interactive)
    {
        TestWaitForValueInput("Enter the required block size!\nMaximum is 256!\nFor incrementing block size, type: 789!");
        input = TestGetValueInput();
        write("input %lf",input);

        if ((input != 0) && (input <= 256) && (input != 789))
        {
            datablockSize = input;
            write("datablockSize %lf",datablockSize);
        }
        else if (input == 789)
        {
            datablockSize = 1;
            write("datablockSize %lf",datablockSize);
        }
        else
        {
            write("NO OR INVALID VALUE ADDED FOR BLOCK SIZE!!!");
            stop();
        }
    }
	
	/* Make the 256 byte or manually given long blocks */
    for (blockIndex=0; blockIndex<5000; blockIndex++)
    {
        for (g=0; g<(datablockSize*4); g+=hexCharSize)
    	{   
            bytecounter = bytecounter; //Dont touch!!
            coursorPos = coursorPos; //Dont touch!!
            substr_cpy(charbuff,g_DataBuffer,coursorPos, 4,elcount(g_DataBuffer));
            g_WriteBuffer[blockIndex][g/4] = atol(charbuff);
            coursorPos +=4;
            bytecounter = ((g/4)+1);
            if (coursorPos >= strlen(g_DataBuffer)) break;
    	}

        
        g_bytecounter[blockIndex] = bytecounter;

        if (1 == g_DSDL_debug)
        {            
			write("coursorPos = %ld",coursorPos);
            write("g_DataBuffer = %d",strlen(g_DataBuffer));
            write("g_WriteBuffer = %x %x %x %x    %x %x",g_WriteBuffer[blockIndex][0],g_WriteBuffer[blockIndex][1],g_WriteBuffer[blockIndex][2],g_WriteBuffer[blockIndex][3],g_WriteBuffer[blockIndex][252],g_WriteBuffer[blockIndex][14]);
            write("blockIndex = %d",blockIndex);
            write("bytecounter = %d",bytecounter);

			for(i=0;i<256;i+=245)
			{
				if (0 == i)
				{
					write("block start");
				}
				else
				{
					write("block ending");
				}
				write("%2x %2x %2x %2x %x %2x %2x %2x",
					g_WriteBuffer[blockIndex][0+i],g_WriteBuffer[blockIndex][1+i],g_WriteBuffer[blockIndex][2+i],g_WriteBuffer[blockIndex][3+i],
					g_WriteBuffer[blockIndex][4+i],g_WriteBuffer[blockIndex][5+i],g_WriteBuffer[blockIndex][6+i],g_WriteBuffer[blockIndex][7+i]);	
			}
        }

        /* Handling the case when the block size should be incremented: 1,10,15,20,25, ... */
        if (interactive && (input == 789))
        {
            if (datablockSize == 1)
            {
                datablockSize += 9;
            }
            else
            {
                datablockSize += 5;

                if (datablockSize > 256)
                {
                    datablockSize = 255;
                }
            }
        }

        if (coursorPos >= strlen(g_DataBuffer)) break;        
    }	
    
    /*"write" is commented because of invalid array range in case of 1 or 2 bytes long datablocks!*/
	//write("Last three bytes:");
	//write("%d %d %d bytecounter",bytecounter-3,bytecounter-2,bytecounter-1);
	//write("%2x %2x %2x value",g_WriteBuffer[blockIndex][bytecounter-3],g_WriteBuffer[blockIndex][bytecounter-2],g_WriteBuffer[blockIndex][bytecounter-1]);

    blockIndex++;
    write("DataBlock value = %d",blockIndex);
    
    return blockIndex;
}
/*@@end*/

/*@@envVar:EnvFilePath:*/
on envVar EnvFilePath
{
    getValue(this,nameOfFile);
}
/*@@end*/

/*@@testcase:RequestDownload():*/
testcase RequestDownload ()
{
	// This test step automatically initializes the proper data length parameter of
	// Service 0x34 according to the length of the raw data in the dataset .xml to be downloaded.

	char s_RequestDownloadBuffer [21]="34003400000000______"; // the fixed part of the service RequestDownload
	char s_substring [7]; // string for the remaining part, the size actually
	long dataLength; // No. bytes to be transmitted

	// calculate the number of bytes to be transmitted
	dataLength = strlen(g_DataBuffer)/4;
	ltoa(dataLength, s_substring, 16);
  
	write("ltoa conversion value: %s", s_substring);

    if(strlen(s_substring) == 1)
    {
    	s_RequestDownloadBuffer[19] = s_substring[0];
		s_RequestDownloadBuffer[18] = 0x30;
		s_RequestDownloadBuffer[17] = 0x30;
    	s_RequestDownloadBuffer[16] = 0x30;
    	s_RequestDownloadBuffer[15] = 0x30;
        s_RequestDownloadBuffer[14] = 0x30;
    }
    else if(strlen(s_substring) == 2)
    {
    	s_RequestDownloadBuffer[19] = s_substring[1];
		s_RequestDownloadBuffer[18] = s_substring[0];
		s_RequestDownloadBuffer[17] = 0x30;
    	s_RequestDownloadBuffer[16] = 0x30;
    	s_RequestDownloadBuffer[15] = 0x30;
        s_RequestDownloadBuffer[14] = 0x30;
    }
    else if(strlen(s_substring) == 3)
    {
    	s_RequestDownloadBuffer[19] = s_substring[2];
		s_RequestDownloadBuffer[18] = s_substring[1];
		s_RequestDownloadBuffer[17] = s_substring[0];
    	s_RequestDownloadBuffer[16] = 0x30;
    	s_RequestDownloadBuffer[15] = 0x30;
        s_RequestDownloadBuffer[14] = 0x30;
    }
	else if(strlen(s_substring) == 4)
    {
    	s_RequestDownloadBuffer[19] = s_substring[3];
		s_RequestDownloadBuffer[18] = s_substring[2];
		s_RequestDownloadBuffer[17] = s_substring[1];
    	s_RequestDownloadBuffer[16] = s_substring[0];
    	s_RequestDownloadBuffer[15] = 0x30;
        s_RequestDownloadBuffer[14] = 0x30;
    }
	else if(strlen(s_substring) == 5)
    {
    	s_RequestDownloadBuffer[19] = s_substring[4];
		s_RequestDownloadBuffer[18] = s_substring[3];
		s_RequestDownloadBuffer[17] = s_substring[2];
    	s_RequestDownloadBuffer[16] = s_substring[1];
    	s_RequestDownloadBuffer[15] = s_substring[0];
        s_RequestDownloadBuffer[14] = 0x30;
    }
    else
    {
    	s_RequestDownloadBuffer[19] = s_substring[5];
		s_RequestDownloadBuffer[18] = s_substring[4];
		s_RequestDownloadBuffer[17] = s_substring[3];
    	s_RequestDownloadBuffer[16] = s_substring[2];
    	s_RequestDownloadBuffer[15] = s_substring[1];
        s_RequestDownloadBuffer[14] = s_substring[0];
    }
	RequestResponseCompareLogic(s_RequestDownloadBuffer, "74200102", "Equal"); 
	//write(s_RequestDownloadBuffer);
}
/*@@end*/

