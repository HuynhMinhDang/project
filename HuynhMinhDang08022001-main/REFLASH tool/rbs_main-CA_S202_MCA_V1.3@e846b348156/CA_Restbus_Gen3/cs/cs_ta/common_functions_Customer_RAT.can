//- -----------------------------------------------------------------------------------------------
//! \teststep Check for $1 Message.
//! \testresponse $1 message is not received. 
//- -----------------------------------------------------------------------------------------------
testcase WaitForNoMessage (char MessageName[], long Timeout)
{
    dword MessageID;
    MessageID = GetMessageID(MessageName);

	write("ID= %x", MessageID);
    
    WaitForNoMessageFunction(MessageID, Timeout);
}
//- -----------------------------------------------------------------------------------------------
//! \teststep Check for Camera Transmitting Messages.
//! \testresponse Camera Transmitting Messages received. 
//- -----------------------------------------------------------------------------------------------
testcase WaitForAlltxMessage ()
{
    
  WaitForMessageFunction(0x214, 5000);
  WaitForMessageFunction(0x109, 5000);
  WaitForMessageFunction(0x260, 5000);
  WaitForMessageFunction(0x261, 5000);
  WaitForMessageFunction(0x27C, 5000);
  WaitForMessageFunction(0x27D, 5000);
}
//- -----------------------------------------------------------------------------------------------
//! \teststep Check for Camera Transmitting Messages.
//! \testresponse Camera Transmitting Messages are not received. 
//- -----------------------------------------------------------------------------------------------
testcase WaitForNoAlltxMessage ()
{
  WaitForNoMessageFunction(0x214, 5000);
  WaitForNoMessageFunction(0x109, 5000);
  WaitForNoMessageFunction(0x260, 5000);
  WaitForNoMessageFunction(0x261, 5000);
  WaitForNoMessageFunction(0x27C, 5000);
  WaitForNoMessageFunction(0x27D, 5000);

}
//- -----------------------------------------------------------------------------------------------
//! \teststep check Cycle time and DLC of $1 message with min cycletime=$2,max cycletime=$3
//! \testresponse Cycle time and DLC of $1 message is in the expected Range
//- -----------------------------------------------------------------------------------------------
testcase CheckMessageCycletime(int64 id, double aMinRelCycleTime,double aMaxRelCycleTime)//testing extended Id make int64 id
{
 
  double checkId ;
  double checkId1 ;
  
  switch(id)
  {
    case 0x7FE7A00:
    checkId = ChkStart_MsgRelCycleTimeViolation(Dev_Video_SyncVisor_TX,aMinRelCycleTime,aMaxRelCycleTime); // cycle time check
    checkId1=ChkStart_InconsistentDLC(Dev_Video_SyncVisor_TX); // DLC check
    break;
    case 0x3A3:
    checkId = ChkStart_MsgRelCycleTimeViolation(VFC_MapInfo,aMinRelCycleTime,aMaxRelCycleTime); // cycle time check
    checkId1=ChkStart_InconsistentDLC(VFC_MapInfo); // DLC check
    break;
	
  }
TestAddCondition(checkId); 
TestAddCondition(checkId1);
TestWaitForTimeout(180000);//3 minutes
TestRemoveCondition(checkId);
TestRemoveCondition(checkId1);
}
/- -----------------------------------------------------------------------------------------------
//! \brief  Testcase to enter into the chosen session.
//!
//! \param  char sessionName is the name of the session we want to enter into.
//!
//! \note	Available sessions are: \n
//!     Default\n
//!     Extended\n
//!     EOL\n
//!     Development\n
//!     Programming
//! \teststep Change to $1 Session  
//! \testresponse Positive response is received 
//- -----------------------------------------------------------------------------------------------
testcase DiagSessionCtrl (char sessionName[])
{
	if(0 == strncmp("Default", sessionName, strlen(sessionName)))
	{
		TestStep("INFO","The sessionName is: %s", sessionName);
		RequestResponseCompareLogic("1001", "5001.{8}", "Regexp");  
    }
    else if(0 == strncmp("Extended", sessionName, strlen(sessionName)))
    {
		TestStep("INFO","The sessionName is: %s", sessionName);
		RequestResponseCompareLogic("1003", "5003.{8}", "Regexp");   
    }
    else if(0 == strncmp("EOL", sessionName, strlen(sessionName)))
    {
		TestStep("INFO","The sessionName is: %s", sessionName);
		RequestResponseCompareLogic("1040", "5040.{8}", "Regexp");
    }
    else if(0 == strncmp("Development", sessionName, strlen(sessionName)))
    {
		TestStep("INFO","The sessionName is: %s", sessionName);
		RequestResponseCompareLogic("104f", "504f.{8}", "Regexp");
    }
    else if(0 == strncmp("Programming", sessionName, strlen(sessionName)))
    {
		TestStep("INFO","The sessionName is: %s", sessionName);
		RequestResponseCompareLogic("1002", "5002.{8}", "Regexp");
    }
    else
    {
		TestStepFail("INFO","The sessionName is not valid!");
		TestStepFail("INFO","Please choose from the following sessionName types: Default, Extended, EOL, Development, Programming!");
    }
    putvalue(EnvTesterPresentOnOff,1);
}
//- -----------------------------------------------------------------------------------------------
//! \brief  Testcase to send message using functional addressing
//!
//! \note	Set the CANIDs to the functional addresses, after the request was sent, function set back the CANIDs to the physical addresses. \n
//! 		VW uses CanID 0x740 for the transmit messages. \n
//! 		VW uses CanID 0x7B6 for the receive messages. \n
//!
//! \param  char Request is the request should be sent.
//! \param  char Response is the expected response should be awaited.
//! \param  char CompareMode is the compare mode should be used to check the response.
//! \teststep Send $1 Using Functional addressing
//! \testresponse Expected Response is 0x$2
//- -----------------------------------------------------------------------------------------------
testcase FunctionalMessage(char Request[], char Response[], char CompareMode[])
{
	setType (0x7B1,0x7DF);
	RequestResponseCompareLogic(Request, Response, CompareMode);
    //Reset the default CAN message IDs
    //setType (0x7C0,0x740);
}
//- -----------------------------------------------------------------------------------------------
//! \teststep Send $1 Using Functional addressing
//! \testresponse NO response is received 
//- -----------------------------------------------------------------------------------------------
testcase FunctionalMessage_SPRB(char Request[])
{
	setType (0x7B1,0x7DF);
	RequestResponseCompareLogic(Request," ", "None");
    //Reset the default CAN message IDs
    //setType (0x7C0,0x740);
}
//- -----------------------------------------------------------------------------------------------
//! \teststep Send $1 Using physical addressing
//! \testresponse NO response is received 
//- -----------------------------------------------------------------------------------------------
testcase RequestResponse_SPRB(char Request[])
{
     setType (0x7B1,0x731);
	RequestResponseCompareLogic(Request," ", "None");
}

//- -----------------------------------------------------------------------------------------------
// /*@@testcase:ResetCamera(dword):*/
//! \teststep Rerest the Camera.
//! \testresponse Positive response is received 
//- -----------------------------------------------------------------------------------------------
testcase ResetCamera(dword WaitTime)
{

    long result;
  RequestResponseCompareLogic("1003", "5003.*", "Regexp");
  RequestResponseCompareLogic("1101", "5101", "Equal");
  result = testWaitForTimeout(WaitTime);
  if (-1 == result)
  {
//    write ("General error with the testWaitForTimeout function, for example, functionality is not available!");
    TestStepFail("INFO","General error with the testWaitForTimeout function, for example, functionality is not available!");
  } else if (-2 == result)
  {
//    write ("Resume due to constraint violation in the testWaitForTimeout function!");
    TestStepFail("INFO","Resume due to constraint violation in the testWaitForTimeout function!");
  }
}
/*@@end*/
//- -----------------------------------------------------------------------------------------------
// /*@@to set invalid CRC and BZ value*/
//! \teststep Set $1 to $2.
//! \testresponse - 
//- -----------------------------------------------------------------------------------------------
testcase setenv_CRC_BZ (char Name[] ,int Value , int WaitTime )
{
 putValue(Name, Value);
} 
/*@@end*/

void occurance_counter_function(char Env_Variable[],char Counter_Req[], char Counter_resp[], char compareMode[])
{

 putValue(Env_Variable, 1);
 testWaitForTimeout(500);
 RequestResponseCompareLogic("190209","5902.*","Regexp");
 RequestResponseCompareLogic(Counter_Req,Counter_resp,compareMode);
 testWaitForTimeout(500);
 putValue(Env_Variable, 0);
 testWaitForTimeout(500);
 RequestResponseCompareLogic("190209","5902.*","Regexp");
 RequestResponseCompareLogic(Counter_Req,Counter_resp,compareMode);
}
//- -----------------------------------------------------------------------------------------------
//! \teststep Occurance_Counter_100 .
//! \testresponse - 
//- -----------------------------------------------------------------------------------------------
testcase Occurance_Counter_100 (char Env_Variable[],char Counter_Req[], char Counter_resp[], char compareMode[])
{
int s;
for(s=0;s<100;s++)
{
occurance_counter_function(Env_Variable,Counter_Req,Counter_resp,compareMode);
}
 putValue(Env_Variable,1);
 testWaitForTimeout(500);
} 
//- -----------------------------------------------------------------------------------------------
//! \teststep Occurance_Counter_4.
//! \testresponse - 
//- -----------------------------------------------------------------------------------------------
testcase Occurance_Counter_4 (char Env_Variable[],char Counter_Req[], char Counter_resp[], char compareMode[])
{
  int s;
for(s=0;s<4;s++)
{
occurance_counter_function(Env_Variable,Counter_Req,Counter_resp,compareMode);
}
 putValue(Env_Variable, 1);
 testWaitForTimeout(500);
} 
//- -----------------------------------------------------------------------------------------------
//! \teststep Occurance_Counter_50.
//! \testresponse - 
//- -----------------------------------------------------------------------------------------------
testcase Occurance_Counter_50 (char Env_Variable[],char Counter_Req[], char Counter_resp[], char compareMode[])
{
	int s;
for(s=0;s<50;s++)
{
occurance_counter_function(Env_Variable,Counter_Req,Counter_resp,compareMode);
}
 putValue(Env_Variable, 1);
 testWaitForTimeout(500);
}
void Aging_counter_function(char Recordrequest[], char RecordResponse[],char dtcResponse[], char RecordcompareMode[])
{

	putvalue(EnvTesterPresentOnOff, 1);
	RequestResponseCompareLogic("1003", "5003.*", "Regexp");
  testwaitfortimeout(1000);
	RequestResponseCompareLogic("1101", "5101", "Equal");
	testwaitfortimeout(7000);
	RequestResponseCompareLogic("190209", dtcResponse, "Regexp");
	RequestResponseCompareLogic(Recordrequest, RecordResponse, RecordcompareMode);
  testwaitfortimeout(100);
	putvalue(EnvTesterPresentOnOff, 0);
}
//- -----------------------------------------------------------------------------------------------
//! \teststep Check for Aging Counter(ignition_cycles_10).
//! \testresponse Aging Counter value is Updated. 
//- -----------------------------------------------------------------------------------------------
testcase ignition_cycles_10(char Recordrequest[], char RecordResponse[],char dtcResponse[], char RecordcompareMode[])
{
int i=0;
for(i=0;i<10;i++)
{
Aging_counter_function(Recordrequest,RecordResponse,dtcResponse,RecordcompareMode);
}
}

//- -----------------------------------------------------------------------------------------------
//! \teststep Check for Aging Counter(ignition_cycles_9).
//! \testresponse Aging Counter value is Updated. 
//- -----------------------------------------------------------------------------------------------
testcase ignition_cycles_9(char Recordrequest[], char RecordResponse[],char dtcResponse[], char RecordcompareMode[])
{
int i=0;
for(i=0;i<9;i++)
{
Aging_counter_function(Recordrequest,RecordResponse,dtcResponse,RecordcompareMode);
}
}



//- -----------------------------------------------------------------------------------------------
//! \teststep Send $2 Events.
//! \testresponse - . 
//- -----------------------------------------------------------------------------------------------
testcase Check_Eventmessage_failure(char MsgEnvVar[],int Nrofevents)
{
  int i=0;
for(i=0;i<Nrofevents;i++)
{
putValue(MsgEnvVar, 1);
testwaitfortimeout(10);
putValue(MsgEnvVar, 0);
}
}

//- -----------------------------------------------------------------------------------------------
//! \teststep check initial values of $1 message signals.
//! \testresponse received Signal Init values are as expected values. 
//- -----------------------------------------------------------------------------------------------
testcase CheckInitalSignalValue(char MessageName[], char Signals[], char ExpectedResults[])
{
}
//- -----------------------------------------------------------------------------------------------
//! \teststep check Counter value of $1 message .
//! \testresponse received Counter value is as expected. 
//- -----------------------------------------------------------------------------------------------
testcase CheckAliveCounter(char CanName[], char NodeName[],char MessageName[], char SignalName[])
{
}
/*@!Encoding:1252*/

//- -----------------------------------------------------------------------------------------------
//! \teststep check BlockCounter value of $1 message .
//! \testresponse received Counter value is as expected. 
//- -----------------------------------------------------------------------------------------------
testcase CheckBlockCounter(char CanName[], char NodeName[],char MessageName[], char SignalName[])
{
}
//- -----------------------------------------------------------------------------------------------
//! \teststep check CRC and Alive counter of $1 message 
//! \testresponse received CRC and Alive counter values as expected .
//- -----------------------------------------------------------------------------------------------
testcase CalculateCRCForMessage(char MessageName[], int NrOfExecution)
{
}
//- -----------------------------------------------------------------------------------------------
//! \teststep Unlcok Security level 1 and wait for $1ms
//! \testresponse -.
//- -----------------------------------------------------------------------------------------------
testcase SecurityunlockLevel1(int waitTime)
{
  putValue(EnvLogInLevel1_1,1);
  testWaitForTimeout(waitTime);
   putValue(EnvLogInLevel1_1,0);
  testWaitForTimeout(1000);
  if (RsRxIntData[0]==0x67 && RsRxIntData[1]==0x02)
  {
    TestStepPass("INFO","Security unlock Level1 is successfull!:%x %x", RsRxIntData[0],RsRxIntData[1]);
  }
  else if(RsRxIntData[0]==0x7f && RsRxIntData[1]==0x27)
  {
   TestStepFail("INFO","Security unlock Level1 is not successfull!:%x %x %x", RsRxIntData[0],RsRxIntData[1],RsRxIntData[2]); 
  }
  else{
    TestStepFail("INFO","Security unlock Level1 is not successfull for unknown Reason"); 
  }
}
//- -----------------------------------------------------------------------------------------------
//! \teststep Unlcok bootloader security and wait for $1ms
//! \testresponse -.
//- -----------------------------------------------------------------------------------------------
testcase SecurityunlockBoot(int waitTime)
{
  putValue(EnvLogInLevel2,1);
  testWaitForTimeout(waitTime);
   putValue(EnvLogInLevel2,0);
  testWaitForTimeout(1000);
  if (RsRxIntData[0]==0x67 && RsRxIntData[1]==0x12)
  {
    TestStepPass("INFO","Security unlock Boot is successfull!:%x %x", RsRxIntData[0],RsRxIntData[1]);
  }
  else if(RsRxIntData[0]==0x7f && RsRxIntData[1]==0x27)
  {
   TestStepFail("INFO","Security unlock Boot is not successfull!:%x %x %x", RsRxIntData[0],RsRxIntData[1],RsRxIntData[2]); 
  }
  else{
    TestStepFail("INFO","Security unlock Boot is not successfull for unknown Reason"); 
  }
}
//- -----------------------------------------------------------------------------------------------
//! \brief  The testcase will transit CAN frame on the bus
//!
//! \param  char frame will can frame to be transmitted 
//! 
//! \teststep Send 0x$3 on CAN ID=$1 with DLC=$2,deltaTime=$4ms
//! \testresponse -
//- -----------------------------------------------------------------------------------------------
testcase SendDiagFrame(char messageID[], int DLC, char frame[], int deltaT)
{
     long convertedmessageID;
     convertedmessageID=atol(messageID);
 // write("messageID= %s",messageID);
  //write("convertedmessageID=%x",convertedmessageID);
    SendFrame(convertedmessageID, DLC, frame);
    TestWaitForTextEvent("pause", deltaT);
}
//- -----------------------------------------------------------------------------------------------
//! \brief  The testcase will bring up a Popup window where the tester confirmation is necessary to continue the testcase
//!
//! \param  char Text The text what the Popup window will contains
//! 
//! \teststep Check Diagnosis Trace
//! \testresponse $1
//- -----------------------------------------------------------------------------------------------
Testcase TesterConfirmation_CanTp(char ExpectedResponse[])
{
long result;
TestStep("Tester","%s", ExpectedResponse);
result=TestWaitForTesterConfirmation (ExpectedResponse);

if (result==1)
  testStepPass("INFO","ExpectedResponse Received!");
else if(result==2)
  testStepFail("INFO","UnExpectedResponse Received!");
else if(result==-1)
  testStepFail("INFO","General error");
else if(result==-2)
  testStepFail("INFO","Constraint occurred");
else if(result==0)
  testStepFail("INFO","Timeout occurred");
else
 testStepFail("INFO","Unknown error"); 
}
//- -----------------------------------------------------------------------------------------------
//! \brief  The testcase will control tester flow control Tester flowcontrol
//!
//! \teststep Set Tester flow control to $1(0-OFF or 1-ON)  
//! \testresponse -
//- -----------------------------------------------------------------------------------------------
testcase SetUseFC(long value)
{
    OSEKTL_SetUseFC(value);
	putvalue (EnvUseFC,value);
}
//- -----------------------------------------------------------------------------------------------
//! \brief  The testcase will control tester flow control Tester flowcontrol
//!
//! \teststep Set OSEKTL_SetUseFC to $1(0-OFF or 1-ON)  
//! \testresponse -
//- -----------------------------------------------------------------------------------------------
testcase SetUseFC1(long value)
{
  OSEKTL_SetUseFC(value);
}
//- -----------------------------------------------------------------------------------------------
//! \brief  The testcase will be verify timing parameters
//!
//! \teststep Test Timing Parameters  
//! \testresponse -
//- -----------------------------------------------------------------------------------------------
testcase StartPerformanceTest()
{
}
//- -----------------------------------------------------------------------------------------------
//! \brief  The testcase will be verify timing parameters
//!
//! \teststep Test Timing Parameters  
//! \testresponse -
//- -----------------------------------------------------------------------------------------------
testcase StartPerformanceTest1()
{
}
//- -----------------------------------------------------------------------------------------------
//! \brief  The testcase will be verify timing parameters
//!
//! \teststep Test Timing Parameters  
//! \testresponse -
//- -----------------------------------------------------------------------------------------------
testcase StartPerformanceTest2()
{
}
//- -----------------------------------------------------------------------------------------------
//! \brief  The testcase will be verify timing parameters
//!
//! \teststep Verify Timing Parameters  
//! \testresponse -
//- -----------------------------------------------------------------------------------------------
testcase CheckStatisticData()
{
}
//- -----------------------------------------------------------------------------------------------
//! \brief  The testcase will be verify timing parameters
//!
//! \teststep Verify ECU Timing Parameters  
//! \testresponse -
//- -----------------------------------------------------------------------------------------------
testcase CheckStatisticData1()
{
}
//- -----------------------------------------------------------------------------------------------
//! \brief  The testcase will be verify timing parameters
//!
//! \teststep Verify Timing Parameters  
//! \testresponse -
//- -----------------------------------------------------------------------------------------------
testcase CheckStatisticData2()
{
}
//- -----------------------------------------------------------------------------------------------
//! \teststep Create Failures in the camera  
//! \testresponse -
//- -----------------------------------------------------------------------------------------------
testcase Createfailure()
{
}
//- -----------------------------------------------------------------------------------------------
//! \brief  The testcase will be verify timing parameters
//!
//! \teststep Clear Failures in the camera   
//! \testresponse -
//- -----------------------------------------------------------------------------------------------
testcase clearfailure()
{
}
//- -----------------------------------------------------------------------------------------------
//! \brief  The testcase will be verify timing parameters
//!
//! \teststep Check for max data length supported in CAN   
//! \testresponse -
//- -----------------------------------------------------------------------------------------------
testcase MaxLengthcheck()
{
}
//- -----------------------------------------------------------------------------------------------
//! \teststep 0-Create/1-Heal($1) Global Timeout Failure.
//! \testresponse -. 
//- -----------------------------------------------------------------------------------------------
Testcase Global_timeout (int value,int wait)
{
	if (value==0)
	{
	Putvalue(E_pubc_BCS_CycMsgsOFF,1);
	Putvalue(E_pubc_EBB_CycMsgsOFF,1);
	Putvalue(E_pubc_EPS_CycMsgsOFF,1);
	Putvalue(E_pubc_SAS_CycMsgsOFF,1);
	Putvalue(E_pubc_VCU_CycMsgsOFF,1);
	Putvalue(E_pubc_GWM_CycMsgsOFF,1);
	Putvalue(E_pubc_MLM_CycMsgsOFF,1);
	}
	else if(value==1)
	{
	Putvalue(E_pubc_BCS_CycMsgsON,1);
	Putvalue(E_pubc_EBB_CycMsgsON,1);
	Putvalue(E_pubc_EPS_CycMsgsON,1);
	Putvalue(E_pubc_SAS_CycMsgsON,1);
	Putvalue(E_pubc_VCU_CycMsgsON,1);
	Putvalue(E_pubc_GWM_CycMsgsON,1);
	Putvalue(E_pubc_MLM_CycMsgsON,1);
	}
	else{
	//Nothing
	}
	TestWaitForTimeout(wait);
}
