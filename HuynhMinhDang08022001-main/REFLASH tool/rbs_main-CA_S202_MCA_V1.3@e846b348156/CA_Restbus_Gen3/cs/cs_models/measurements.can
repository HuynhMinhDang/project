/*@@includes:*/
includes
{
    //#include "..\TestNodes\Diagnosis_Bib.cin"
}
/*@@end*/

/*@@var:*/
variables
{
    int     TransceiverID = 0x7E2;      //Msg ID Request (from CANoe)
    int     ReceiverID = 0x7EA;         //Msg ID Response (MPC)    
    //int     FuncTransceiverID = 0x700;  //Msg ID Request Func (from CANoe)
    int     FuncReceiverID = 0x7EA;     //Msg ID Response (MPC, same as phys ID)

    const word  BL = 2000;                //Puffergröße
    byte     rqBuf[1024];                //Sende-Buffer (1024 Byte)
    byte     rsBuf[1024];                //Empfangs-Buffer (1024 Byte)
    byte    ResultBuffer[BL];           //Eingangspuffer nur für interne Verwendung bestimmt
    byte    ResultBuffer_Length = 0;
    
    char    toText[BL];                 //Ergebnis-Buffer für die Umwandlung in String
    byte    toByte[BL];                 //Ergebnis-Buffer für die Umwandlung in Byte

  //int     ReadyFlag = 1;              //indicates if bus is ready to send
    int     waitingForResponse = 0;     //0:no response expected;  1:response expected;  -1:Timeout

    // to store the strings of every EnvMess_0X in a char[]
    char    Rq_01[BL], Rq_02[BL], Rq_03[BL], Rq_04[BL], Rq_05[BL], Rq_06[BL];

    msTimer TimeOutTimer;
    msTimer timerReqInterval_01;
    msTimer timerReqInterval_02;
    msTimer timerReqInterval_03;
    msTimer timerReqInterval_04;
    msTimer timerReqInterval_05;
    msTimer timerReqInterval_06;
}
/*@@end*/

/*@@envVar:EnvMess_01_Actv:*/
on envVar EnvMess_01_Actv
{
    switch(getValue(this)){
        case 1:     setTimer(timerReqInterval_01, getvalue(EnvMess_01_ReqInterval)); 
                    break;
        
        case 0:     cancelTimer(timerReqInterval_01); 
                    break;
        
        default:    break;
    }
}
/*@@end*/

/*@@timer:timerReqInterval_01:*/
on timer timerReqInterval_01
{
    // do the Diag Request and get the Response

    int i;

    getValue(EnvMess_01_ReqId, Rq_01);
    toUpper(Rq_01, Rq_01, elcount(Rq_01));  // to make the request case-insensitive (always Uppper)
    String2Byte(Rq_01);

    // rqBuf befüllen
    rqBuf[0] = 0x22;
    rqBuf[1] = toByte[0];
    rqBuf[2] = toByte[1];

    // Request abschicken
    Diagnosis_Send(3);  //since a measurement Identifier has always 2 Bytes, we can hard-code this '3' here
    //waitingForResponse = 1;
    

    // set the timer again
    setTimer(this, getValue(EnvMess_01_ReqInterval));
}
/*@@end*/

/*@@caplFunc:Diagnosis_Send(int,int):*///function
void Diagnosis_Send (int rqLength, int mode)
{
    int count_si16;

    //Steuergerät setzen
    switch(mode)
    {
        case 0: // 0 = physikalische Adressierung
            //Steuergeräte IDs für physikalische Adressierung setzen
            OSEKTL_SetTxId (TransceiverID); //Sender
            OSEKTL_SetRxId (ReceiverID);    //Empfänger
            break;
        case 1: // 1 = funktionale Adressierung
            //Steuergeräte IDs für funktionale Adressierung setzen
           // OSEKTL_SetTxId (FuncTransceiverID);//Sender
           // OSEKTL_SetRxId (FuncReceiverID);//Empfänger
            break;
        default: // default = physikalische Adressierung
            //Steuergeräte IDs für physikalische Adressierung setzen
            OSEKTL_SetTxId (TransceiverID); //Sender
            OSEKTL_SetRxId (ReceiverID);    //Empfänger
            break;
    }

    if(waitingForResponse == 0)
    {
        OSEKTL_DataReq(rqBuf, rqLength);
        waitingForResponse = 1;
        cancelTimer(TimeOutTimer);
    }
    else
    {
        // start TimeOutTimer
        setTimer(TimeOutTimer, 3000);
    }
}
/*@@end*/

/*@@caplFunc:OSEKTL_DataInd(long):*///callback
OSEKTL_DataInd (long rxCount)
{
    int i;
    long src; // Output of Source Address
    
    OSEKTL_GetRxData(rsBuf, rxCount);
    ResultBuffer_Length = rxCount;

    //Prüfe auf Response Pending:
    if (rsBuf[0]==0x7F && rsBuf[2]==0x78 /* || rsBuf[0]==0x08 && rsBuf[1]==0x14 */)
    {
        //Response Pending - setze TimeOutTimer erneut mit TimeOut_P2Extended
        cancelTimer(TimeOutTimer);
        setTimer(TimeOutTimer, 2000);
        //write("Response pending ...");
    }
    //any other NRC arrived 
    else if(rsBuf[0]==0x7F){
        // stop Timer and don't wait for a response any longer
        cancelTimer(TimeOutTimer);
        waitingForResponse = 0;
    }

    //positive Response arrived
    else if (rsBuf[0] == (rqBuf[0]+0x40)){
        // stop Timer and don't wait for a response any longer
        cancelTimer(TimeOutTimer);
        waitingForResponse = 0;
        analyzePosResp();
        //write("Response received - stop Timer");
    }
    
    //response of TesterPresent arrived
    else if (rsBuf[0] == 0x7E && rsBuf[1] == 0x00){
        //write("TesterPresent");
    }

    //Undefinierte Antwort
    else{
        waitingForResponse = 0;
    } 
    

}
/*@@end*/

/*@@timer:TimeOutTimer:*/
on timer TimeOutTimer
{
    //Wenn Timer abläuft wurde keine Antwort empfangen --> Timeout
    waitingForResponse = 0;
    //ReadyFlag = 1;
}
/*@@end*/

/*@@caplFunc:Byte2String(byte[],int):*///function
Byte2String (byte Buffer[], int el)
{
    // Ergebnis wird in (char) "toText" geschrieben

    char Temp2[4];
    int i;

    for (i=0;i<elcount(toText);i++)
    toText[i]=0;

    for (i=0;i<el;i++)
    {
        if (i<elcount(Buffer))
        {
            if (Buffer[i]<0x10)
            {
                snprintf(Temp2,4,"0%lX ",Buffer[i]);
            }
            else
            {
                snprintf(Temp2,4,"%lX ",Buffer[i]);
            }
            strncat(toText, Temp2, 2000);
        }
    }
}
/*@@end*/

/*@@caplFunc:String2Byte(char[]):*///function
String2Byte(char String[])
{
    // Ergebnis wird in (byte) "toByte" geschrieben
    
    int i,e,p,t;
    byte temp;
    
    temp=0;
    e=0;
    p=0x10;
    t=0;

    for (i=0;i<elcount(toByte);i++)
        toByte[i]=0;

    for (i=0;i<strlen(String);i++){
        //Wenn ein Leerzeichen gefunden wird, soll das nächste Byte beschrieben werden
        if (String[i]==' '){
            toByte[e]=temp;
            temp=0;
            e++;
            t=0;
        }else{
            if (t==0)
                p=0x10;
            else
                p=0x1;

                t++;
        }
        if (t>3)    
            write("String_HexBuffer (String-bytes sperated with a ' 'space?","Formatfehler");

        switch(String[i])
        {
            case '0':
            {
                temp+=0*p;
                break;
            }
            case '1':
            {
                temp+=(1*p);
                break;
            }
            case '2':
            {
                temp+=(2*p);
                break;
            }
            case '3':
            {
                temp+=3*p;    
                break;
            }
            case '4':
            {
                temp+=4*p;
                break;
            }
            case '5':
            {
                temp+=5*p;
                break;
            }
            case '6':
            {
                temp+=6*p;
                break;
            }
            case '7':
            {
                temp+=7*p;
                break;
            }
            case '8':
            {
                temp+=8*p;
                break;
            }
            case '9':
            {
                temp+=9*p;
                break;
            }
            case 'a':
            {
                temp+=0xA*p;
                break;
            }
            case 'A':
            {
                temp+=0xA*p;
                break;
            }
            case 'b':
            {
                temp+=0xB*p;
                break;
            }
            case 'B':
            {
                temp+=0xB*p;
                break;
            }
            case 'c':
            {
                temp+=0xC*p;
                break;
            }
            case 'C':
            {
                temp+=0xC*p;
                break;
            }
            case 'd':
            {
                temp+=0xD*p;
                break;
            }
            case 'D':
            {
                temp+=0xD*p;
                break;
            }
            case 'e':
            {
                temp+=0xE*p;
                break;
            }
            case 'E':
            {
                temp+=0xE*p;
                break;
            }
            case 'f':
            {
                temp+=0xF*p;
                break;
            }
            case 'F':
            {
                temp+=0xF*p;
                break;
            }
            default:
            {    
                //write("unbekanntes Zeichen %c", String[i]);
            }
        }
    }
    toByte[e]=temp;
}
/*@@end*/

/*@@key:'z':*/
on key 'z'
{
    /********* this stuff here is olnly for DEBUGGING *******************/

    char tempString[BL];
    int i;

    // rqBuf leeren
/*  for (i=0; i<elCount(rqBuf); i++)
    {
        rqBuf[i] = 0x00;
    }*/


    getValue(EnvMess_01_ReqId, tempString);
    String2Byte(tempString);

    // rqBuf befüllen
    rqBuf[0] = 0x22;
    rqBuf[1] = toByte[0];
    rqBuf[2] = toByte[1];


    // Request abschicken
    Diagnosis_Send(3, 0);
    //waitingForResponse = 1;
    
    // so schnell wird der rsBuf nicht befüllt!
    //write("rsBuf [0]:%2X, [1]:%2X, [2]:%2X, [3]:%2X, [4]:%2X", rsBuf[0], rsBuf[1], rsBuf[2], rsBuf[3], rsBuf[4]);
    
    //setTimer(lookForResponse, 10);
}
/*@@end*/

/*@@startStart:Start:*/
on start
{
    int defaultInterval = 500;

    putValue(EnvMess_01_ReqId, "02 85");
    putValue(EnvMess_01_ReqInterval, defaultInterval);
    
    putValue(EnvMess_02_ReqId, "18 0C");
    putValue(EnvMess_02_ReqInterval, defaultInterval);

    putValue(EnvMess_03_ReqId, "15 18");
    putValue(EnvMess_03_ReqInterval, defaultInterval);

    putValue(EnvMess_04_ReqId, "15 08");
    putValue(EnvMess_04_ReqInterval, defaultInterval);

    putValue(EnvMess_05_ReqId, "25 B4");
    putValue(EnvMess_05_ReqInterval, defaultInterval);

    putValue(EnvMess_06_ReqId, "15 1A");
    putValue(EnvMess_06_ReqInterval, defaultInterval);

    //setTimer(lookForResponse, 10);
}
/*@@end*/

/*@@caplFunc:OSEKTL_DataCon(long):*///callback
OSEKTL_DataCon(long txLength)
{
    //Funktion nicht löschen, da von OSEK_TP.dll verlangt
}
/*@@end*/

/*@@caplFunc:OSEKTL_ErrorInd(int):*///callback
OSEKTL_ErrorInd(int error)
{
    //Funktion nicht löschen, da von OSEK_TP.dll verlangt
}
/*@@end*/

/*@@caplFunc:OSEKTL_FirstFrameIndication(long,long,long):*///callback
OSEKTL_FirstFrameIndication (long sourceAdr, long destAdr, long rxCount)
{
    //Funktion nicht löschen, da von OSEK_TP.dll verlangt
}
/*@@end*/

/*@@caplFunc:Diagnosis_Send(int):*///function
void Diagnosis_Send (int rqLength)
{
    // this is just the same function like 'Diagnosis_Send (int[],int[])'
    // but without the need pass the Diagmode for phys. or func. addressing

    // here it will just do the physical addressmode (=0)
    Diagnosis_Send(rqLength, 0);
}
/*@@end*/

/*@@timer:timerReqInterval_02:*/
on timer timerReqInterval_02
{
    // do the Diag Request and get the Response

    int i;

    getValue(EnvMess_02_ReqId, Rq_02);
    toUpper(Rq_02, Rq_02, elcount(Rq_02));  // to make the request case-insensitive (always Uppper)
    String2Byte(Rq_02);

    // rqBuf befüllen
    rqBuf[0] = 0x22;
    rqBuf[1] = toByte[0];
    rqBuf[2] = toByte[1];

    // Request abschicken
    Diagnosis_Send(3);  //since a measurement Identifier has always 2 Bytes, we can hard-code this '3' here
    //waitingForResponse = 1;
    

    // set the timer again
    setTimer(this, getValue(EnvMess_02_ReqInterval));
}
/*@@end*/

/*@@envVar:EnvMess_02_Actv:*/
on envVar EnvMess_02_Actv
{
    switch(getValue(this)){
        case 1:     setTimer(timerReqInterval_02, getvalue(EnvMess_02_ReqInterval)); 
                    break;
        
        case 0:     cancelTimer(timerReqInterval_02); 
                    break;
        
        default:    break;
    }
}
/*@@end*/

/*@@timer:timerReqInterval_03:*/
on timer timerReqInterval_03
{
    // do the Diag Request and get the Response

    int i;

    getValue(EnvMess_03_ReqId, Rq_03);
    toUpper(Rq_03, Rq_03, elcount(Rq_03));  // to make the request case-insensitive (always Uppper)
    String2Byte(Rq_03);

    // rqBuf befüllen
    rqBuf[0] = 0x22;
    rqBuf[1] = toByte[0];
    rqBuf[2] = toByte[1];

    // Request abschicken
    Diagnosis_Send(3);  //since a measurement Identifier has always 2 Bytes, we can hard-code this '3' here
    //waitingForResponse = 1;
    

    // set the timer again
    setTimer(this, getValue(EnvMess_03_ReqInterval));
}
/*@@end*/

/*@@envVar:EnvMess_03_Actv:*/
on envVar EnvMess_03_Actv
{
    switch(getValue(this)){
        case 1:     setTimer(timerReqInterval_03, getvalue(EnvMess_03_ReqInterval)); 
                    break;
        
        case 0:     cancelTimer(timerReqInterval_03); 
                    break;
        
        default:    break;
    }
}
/*@@end*/

/*@@timer:timerReqInterval_04:*/
on timer timerReqInterval_04
{
    // do the Diag Request and get the Response

    int i;

    getValue(EnvMess_04_ReqId, Rq_04);
    toUpper(Rq_04, Rq_04, elcount(Rq_04));  // to make the request case-insensitive (always Uppper)
    String2Byte(Rq_04);

    // rqBuf befüllen
    rqBuf[0] = 0x22;
    rqBuf[1] = toByte[0];
    rqBuf[2] = toByte[1];

    // Request abschicken
    Diagnosis_Send(3);  //since a measurement Identifier has always 2 Bytes, we can hard-code this '3' here
    //waitingForResponse = 1;
    

    // set the timer again
    setTimer(this, getValue(EnvMess_04_ReqInterval));
}
/*@@end*/

/*@@timer:timerReqInterval_05:*/
on timer timerReqInterval_05
{
    // do the Diag Request and get the Response

    int i;

    getValue(EnvMess_05_ReqId, Rq_05);
    toUpper(Rq_05, Rq_05, elcount(Rq_05));  // to make the request case-insensitive (always Uppper)
    String2Byte(Rq_05);

    // rqBuf befüllen
    rqBuf[0] = 0x22;
    rqBuf[1] = toByte[0];
    rqBuf[2] = toByte[1];

    // Request abschicken
    Diagnosis_Send(3);  //since a measurement Identifier has always 2 Bytes, we can hard-code this '3' here
    //waitingForResponse = 1;
    

    // set the timer again
    setTimer(this, getValue(EnvMess_05_ReqInterval));
}
/*@@end*/

/*@@timer:timerReqInterval_06:*/
on timer timerReqInterval_06
{
    // do the Diag Request and get the Response

    int i;

    getValue(EnvMess_06_ReqId, Rq_06);
    toUpper(Rq_06, Rq_06, elcount(Rq_06));  // to make the request case-insensitive (always Uppper)
    String2Byte(Rq_06);

    // rqBuf befüllen
    rqBuf[0] = 0x22;
    rqBuf[1] = toByte[0];
    rqBuf[2] = toByte[1];

    // Request abschicken
    Diagnosis_Send(3);  //since a measurement Identifier has always 2 Bytes, we can hard-code this '3' here
    //waitingForResponse = 1;
    

    // set the timer again
    setTimer(this, getValue(EnvMess_06_ReqInterval));
}
/*@@end*/

/*@@envVar:EnvMess_04_Actv:*/
on envVar EnvMess_04_Actv
{
    switch(getValue(this)){
        case 1:     setTimer(timerReqInterval_04, getvalue(EnvMess_04_ReqInterval)); 
                    break;
        
        case 0:     cancelTimer(timerReqInterval_04); 
                    break;
        
        default:    break;
    }
}
/*@@end*/

/*@@envVar:EnvMess_05_Actv:*/
on envVar EnvMess_05_Actv
{
    switch(getValue(this)){
        case 1:     setTimer(timerReqInterval_05, getvalue(EnvMess_05_ReqInterval)); 
                    break;
        
        case 0:     cancelTimer(timerReqInterval_05); 
                    break;
        
        default:    break;
    }
}
/*@@end*/

/*@@envVar:EnvMess_06_Actv:*/
on envVar EnvMess_06_Actv
{
    switch(getValue(this)){
        case 1:     setTimer(timerReqInterval_06, getvalue(EnvMess_06_ReqInterval)); 
                    break;
        
        case 0:     cancelTimer(timerReqInterval_06); 
                    break;
        
        default:    break;
    }
}
/*@@end*/

/*@@caplFunc:analyzePosResp():*///function
analyzePosResp ()
{
    //write("analyzePosResp() called!");

    Byte2String(rsBuf, ResultBuffer_Length);
    // toText contains the response now
    if(strlen(toText)>3){
        //write("strlen(toText): %d", strlen(toText));
        //write("toText %s || Rq_01 %s", toText, Rq_01);
        // which Response is it?
        if(0 == strncmp_off(toText, 3, Rq_01, 0, 5)){       // matches Identifier 01
            putValue(EnvMess_01_RespId_raw, toText);
            putValue(EnvMess_01_Indicator, (getValue(EnvMess_01_Indicator)+1)%6);   // rotate the Ball one step
        }
        else if(0 == strncmp_off(toText, 3, Rq_02, 0, 5)){  // matches Identifier 02
            putValue(EnvMess_02_RespId_raw, toText);
            putValue(EnvMess_02_Indicator, (getValue(EnvMess_02_Indicator)+1)%6);   // rotate the Ball one step
        }
        else if(0 == strncmp_off(toText, 3, Rq_03, 0, 5)){  // matches Identifier 03
            putValue(EnvMess_03_RespId_raw, toText);
            putValue(EnvMess_03_Indicator, (getValue(EnvMess_03_Indicator)+1)%6);   // rotate the Ball one step
        }
        else if(0 == strncmp_off(toText, 3, Rq_04, 0, 5)){  // matches Identifier 04
            putValue(EnvMess_04_RespId_raw, toText);
            putValue(EnvMess_04_Indicator, (getValue(EnvMess_04_Indicator)+1)%6);   // rotate the Ball one step
        }
        else if(0 == strncmp_off(toText, 3, Rq_05, 0, 5)){  // matches Identifier 05
            putValue(EnvMess_05_RespId_raw, toText);
            putValue(EnvMess_05_Indicator, (getValue(EnvMess_05_Indicator)+1)%6);   // rotate the Ball one step
        }
        else if(0 == strncmp_off(toText, 3, Rq_06, 0, 5)){  // matches Identifier 06
            putValue(EnvMess_06_RespId_raw, toText);
            putValue(EnvMess_06_Indicator, (getValue(EnvMess_06_Indicator)+1)%6);   // rotate the Ball one step
        }

    }
    else{   // 'toText' is too short to be analyzed
        // ignore
    }

}
/*@@end*/

