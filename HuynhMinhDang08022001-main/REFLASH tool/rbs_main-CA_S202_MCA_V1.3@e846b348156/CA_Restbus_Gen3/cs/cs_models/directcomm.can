/*@!Encoding:1252*/
variables
{
	int 	NrNeededRespBytes = 0;
	int 	SendBufferSize;
	int 	ReceiveBufferLength;
	int 	DirectCounter;

	char	MVbuffer[4096] = "";
	char	MVbuffer2[4096] = "0x";   

	byte 	TransmitBuffer[4096];
	byte 	ReceiveBuffer[4096];	

}

on start
{
	putValue (EnvDirectSend, "");
  putValue(EnvDirectReceive,"");
	DirectCounter = 0;
}

MyEvaluateResponse ()
{
	int i;
	int RespLength;

	char buffer[500];
	char buffer2[500]="0";

 
	strncpy(buffer2, "0", 6);
	strncpy(MVbuffer2, "",6);
	strncpy(MVbuffer, "",6);


	if( ReceiveBufferLength > 4095 )
	{
		strncpy(buffer, "Antwortlaenge zu gross!",99);
		ErrorMessage(buffer);
	}

	if( NrNeededRespBytes != 0 )
	{
		RespLength = NrNeededRespBytes;
	}
	else
	{
		RespLength = ReceiveBufferLength;
	}

	for(i=0; i < RespLength; i++)
	{
		ltoa(ReceiveBuffer[i], MVbuffer2, 16);
		if( strlen( MVbuffer2 ) == 1 )
		{
			strncat(buffer2, MVbuffer2, 4095);
			strncat(MVbuffer, buffer2, 4095);
			strncpy(buffer2, "0", 6);
		}
		else
		{
			strncat(MVbuffer, MVbuffer2, 4095);
		}
	}
	putValue(EnvDirectReceive,  MVbuffer);
}

on envVar EnvDirectSend
{
	int i,length;

	DirectCounter = 1;
	SendBufferSize = getValueSize(EnvDirectSend);
  write("SendBufferSize=%x",SendBufferSize);
	getValue(EnvDirectSend,MVbuffer);
	if( !strncmp(MVbuffer,"Idle",strlen(MVbuffer)) )
	{
		//write("Variable neu initialisiert");
		putValue(EnvSendBuffer_1,0);
	}
	else
	{
		strncpy(MVbuffer2, "0x",3);

		for(i=0; i<= SendBufferSize-3; i+=2)
		{
			MVbuffer2[2] = MVbuffer[i];
			MVbuffer2[3] = MVbuffer[i+1];
			MVbuffer2[4] = 0;
			TransmitBuffer[i/2] = atol( MVbuffer2 );
		}
		length = (SendBufferSize - 1)/2;
		putValue(EnvTxData_1, TransmitBuffer, length);
		putValue(EnvTransfer, length);
		putValue(EnvSendBuffer_1,1);
		putValue(EnvDirectSend, "Idle");
    write("data successfully sent");
	}
}

on envVar EnvNrNeededRespBytes
{
	NrNeededRespBytes = getValue( EnvNrNeededRespBytes );
}

on envVar EnvRxData_CAN
{
	//if( DirectCounter == 1 )
	//{
		getValue(this, ReceiveBuffer);
		ReceiveBufferLength = getValue(EnvRxDataLen_CAN);
		MyEvaluateResponse();
		DirectCounter = 0;
	//}
}

void ErrorMessage (char Errmsg[])
{
  putValue(EnvDirectReceive,  MVbuffer);
	write("Fehler '%s' ist aufgetreten!", Errmsg);
}

