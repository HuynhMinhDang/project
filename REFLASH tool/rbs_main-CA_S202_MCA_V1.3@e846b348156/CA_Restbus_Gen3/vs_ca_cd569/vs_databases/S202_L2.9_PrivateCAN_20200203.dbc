VERSION ""

NS_ :

BS_:

BU_: FC FR ADS HPP ACC GW BDC HU IP

BO_ 427 FR_1AB: 64 FR
 SG_ FC_RollingCounter_1AB : 491|4@0+ (1,0) [0|15] ""  FR,ADS
 SG_ FC_CRCCheck_1AB : 503|16@0+ (1,0) [0|65535] ""  FR,ADS
 SG_ LeFr_AccOBJ_Track_Age : 479|8@0+ (1,0) [0|255] ""  FR,ADS
 SG_ LeFr_AccOBJ_Track_ID : 460|8@0+ (1,0) [0|255] ""  FR,ADS
 SG_ LeFr_AccOBJ_FusionedFC_Track_ID : 487|8@0+ (1,0) [0|255] ""  FR,ADS
 SG_ LeFr_AccOBJ_fusion_Sts : 463|2@0+ (1,0) [0|3] ""  FR,ADS
 SG_ LeFr_AccOBJ_ObstacleProb : 453|6@0+ (2,0) [0|100] "%"  FR,ADS
 SG_ LeFr_AccOBJ_ExistProb : 445|6@0+ (2,0) [0|100] "%"  FR,ADS
 SG_ LeFr_AccOBJ_Brakelight_Info : 447|1@0+ (1,0) [0|1] ""  FR,ADS
 SG_ LeFr_AccOBJ_Taillight_Info : 434|3@0+ (1,0) [0|7] ""  FR,ADS
 SG_ LeFr_AccOBJ_Dis_to_R_LaneMark : 428|9@0+ (0.01,0) [0|5] "m"  FR,ADS
 SG_ LeFr_AccOBJ_Dis_to_L_LaneMark : 422|9@0+ (0.01,0) [0|5] "m"  FR,ADS
 SG_ LeFr_AccOBJ_Ax : 401|10@0+ (0.03125,-16) [-16|15.96875] "m/s2"  FR,ADS
 SG_ LeFr_AccOBJ_Ay : 394|9@0+ (0.0625,-16) [-16|15.9375] "m/s2"  FR,ADS
 SG_ LeFr_AccOBJ_Vx_std : 391|12@0+ (0.0625,-128) [-128|127.9375] "m/s"  FR,ADS
 SG_ LeFr_AccOBJ_Vx : 372|12@0+ (0.0625,-128) [-128|127.9375] "m/s"  FR,ADS
 SG_ LeFr_AccOBJ_Vy_std : 367|10@0+ (0.125,-64) [-64|63.875] "m/s"  FR,ADS
 SG_ LeFr_AccOBJ_Vy : 345|10@0+ (0.125,-64) [-64|63.875] "m/s"  FR,ADS
 SG_ LeFr_AccOBJ_Dx_Vnce : 329|14@0+ (0.05,0) [0|50] ""  FR,ADS
 SG_ LeFr_AccOBJ_Dx : 327|13@0+ (0.0625,-256) [-256|255.9375] "m"  FR,ADS
 SG_ LeFr_AccOBJ_Dy_Vnce : 305|10@0+ (0.02,0) [0|20] "m2"  FR,ADS
 SG_ LeFr_AccOBJ_Dy : 301|11@0+ (0.125,-128) [-128|127.875] "m"  FR,ADS
 SG_ LeFr_AccOBJ_HeadingAngle : 294|9@0+ (0.01,-1.57) [-1.57|1.57] "rad"  FR,ADS
 SG_ LeFr_AccOBJ_Length : 287|9@0+ (0.05,0) [0|25.5] "m"  FR,ADS
 SG_ LeFr_AccOBJ_Height : 264|9@0+ (0.01,0) [0|5.11] "m"  FR,ADS
 SG_ LeFr_AccOBJ_Width : 259|11@0+ (0.01,0) [0|12] "m"  FR,ADS
 SG_ LeFr_AccOBJ_Class : 263|3@0+ (1,0) [0|7] ""  FR,ADS
 SG_ Le_AccOBJ_Track_Age : 223|8@0+ (1,0) [0|255] ""  FR,ADS
 SG_ Le_AccOBJ_Track_ID : 204|8@0+ (1,0) [0|255] ""  FR,ADS
 SG_ Le_AccOBJ_FusionedFC_Track_ID : 231|8@0+ (1,0) [0|255] ""  FR,ADS
 SG_ Le_AccOBJ_fusion_Sts : 207|2@0+ (1,0) [0|3] ""  FR,ADS
 SG_ Le_AccOBJ_ObstacleProb : 197|6@0+ (2,0) [0|100] "%"  FR,ADS
 SG_ Le_AccOBJ_ExistProb : 189|6@0+ (2,0) [0|100] "%"  FR,ADS
 SG_ Le_AccOBJ_Brakelight_Info : 191|1@0+ (1,0) [0|1] ""  FR,ADS
 SG_ Le_AccOBJ_Taillight_Info : 178|3@0+ (1,0) [0|7] ""  FR,ADS
 SG_ Le_AccOBJ_Dis_to_R_LaneMark : 172|9@0+ (0.01,0) [0|5] "m"  FR,ADS
 SG_ Le_AccOBJ_Dis_to_L_LaneMark : 166|9@0+ (0.01,0) [0|5] "m"  FR,ADS
 SG_ Le_AccOBJ_Ax : 145|10@0+ (0.03125,-16) [-16|15.96875] "m/s2"  FR,ADS
 SG_ Le_AccOBJ_Ay : 138|9@0+ (0.0625,-16) [-16|15.9375] "m/s2"  FR,ADS
 SG_ Le_AccOBJ_Vx_std : 135|12@0+ (0.0625,-128) [-128|127.9375] "m/s"  FR,ADS
 SG_ Le_AccOBJ_Vx : 116|12@0+ (0.0625,-128) [-128|127.9375] "m/s"  FR,ADS
 SG_ Le_AccOBJ_Vy_std : 111|10@0+ (0.125,-64) [-64|63.875] "m/s"  FR,ADS
 SG_ Le_AccOBJ_Vy : 89|10@0+ (0.125,-64) [-64|63.875] "m/s"  FR,ADS
 SG_ Le_AccOBJ_Dx_Vnce : 73|14@0+ (0.05,0) [0|50] ""  FR,ADS
 SG_ Le_AccOBJ_Dx : 71|13@0+ (0.0625,-256) [-256|255.9375] "m"  FR,ADS
 SG_ Le_AccOBJ_Dy_Vnce : 49|10@0+ (0.02,0) [0|20] "m2"  FR,ADS
 SG_ Le_AccOBJ_Dy : 45|11@0+ (0.125,-128) [-128|127.875] "m"  FR,ADS
 SG_ Le_AccOBJ_HeadingAngle : 38|9@0+ (0.01,-1.57) [-1.57|1.57] "rad"  FR,ADS
 SG_ Le_AccOBJ_Length : 31|9@0+ (0.05,0) [0|25.5] "m"  FR,ADS
 SG_ Le_AccOBJ_Height : 8|9@0+ (0.01,0) [0|5.11] "m"  FR,ADS
 SG_ Le_AccOBJ_Width : 3|11@0+ (0.01,0) [0|12] "m"  FR,ADS
 SG_ Le_AccOBJ_Class : 7|3@0+ (1,0) [0|7] ""  FR,ADS

BO_ 428 FR_1AC: 64 FR
 SG_ FC_RollingCounter_1AC : 491|4@0+ (1,0) [0|15] ""  FR,ADS
 SG_ FC_CRCCheck_1AC : 503|16@0+ (1,0) [0|65535] ""  FR,ADS
 SG_ RiFr_AccOBJ_Track_Age : 479|8@0+ (1,0) [0|255] ""  FR,ADS
 SG_ RiFr_AccOBJ_Track_ID : 460|8@0+ (1,0) [0|255] ""  FR,ADS
 SG_ RiFr_AccOBJ_FusionedFC_Track_ID : 487|8@0+ (1,0) [0|255] ""  FR,ADS
 SG_ RiFr_AccOBJ_fusion_Sts : 463|2@0+ (1,0) [0|3] ""  FR,ADS
 SG_ RiFr_AccOBJ_ObstacleProb : 453|6@0+ (2,0) [0|100] "%"  FR,ADS
 SG_ RiFr_AccOBJ_ExistProb : 445|6@0+ (2,0) [0|100] "%"  FR,ADS
 SG_ RiFr_AccOBJ_Brakelight_Info : 447|1@0+ (1,0) [0|1] ""  FR,ADS
 SG_ RiFr_AccOBJ_Taillight_Info : 434|3@0+ (1,0) [0|7] ""  FR,ADS
 SG_ RiFr_AccOBJ_Dis_to_R_LaneMark : 428|9@0+ (0.01,0) [0|5] "m"  FR,ADS
 SG_ RiFr_AccOBJ_Dis_to_L_LaneMark : 422|9@0+ (0.01,0) [0|5] "m"  FR,ADS
 SG_ RiFr_AccOBJ_Ax : 401|10@0+ (0.03125,-16) [-16|15.96875] "m/s2"  FR,ADS
 SG_ RiFr_AccOBJ_Ay : 394|9@0+ (0.0625,-16) [-16|15.9375] "m/s2"  FR,ADS
 SG_ RiFr_AccOBJ_Vx_std : 391|12@0+ (0.0625,-128) [-128|127.9375] "m/s"  FR,ADS
 SG_ RiFr_AccOBJ_Vx : 372|12@0+ (0.0625,-128) [-128|127.9375] "m/s"  FR,ADS
 SG_ RiFr_AccOBJ_Vy_std : 367|10@0+ (0.125,-64) [-64|63.875] "m/s"  FR,ADS
 SG_ RiFr_AccOBJ_Vy : 345|10@0+ (0.125,-64) [-64|63.875] "m/s"  FR,ADS
 SG_ RiFr_AccOBJ_Dx_Vnce : 329|14@0+ (0.05,0) [0|50] ""  FR,ADS
 SG_ RiFr_AccOBJ_Dx : 327|13@0+ (0.0625,-256) [-256|255.9375] "m"  FR,ADS
 SG_ RiFr_AccOBJ_Dy_Vnce : 305|10@0+ (0.02,0) [0|20] "m2"  FR,ADS
 SG_ RiFr_AccOBJ_Dy : 301|11@0+ (0.125,-128) [-128|127.875] "m"  FR,ADS
 SG_ RiFr_AccOBJ_HeadingAngle : 294|9@0+ (0.01,-1.57) [-1.57|1.57] "rad"  FR,ADS
 SG_ RiFr_AccOBJ_Length : 287|9@0+ (0.05,0) [0|25.5] "m"  FR,ADS
 SG_ RiFr_AccOBJ_Height : 264|9@0+ (0.01,0) [0|5.11] "m"  FR,ADS
 SG_ RiFr_AccOBJ_Width : 259|11@0+ (0.01,0) [0|12] "m"  FR,ADS
 SG_ RiFr_AccOBJ_Class : 263|3@0+ (1,0) [0|7] ""  FR,ADS
 SG_ Ri_AccOBJ_Track_Age : 223|8@0+ (1,0) [0|255] ""  FR,ADS
 SG_ Ri_AccOBJ_Track_ID : 204|8@0+ (1,0) [0|255] ""  FR,ADS
 SG_ Ri_AccOBJ_FusionedFC_Track_ID : 231|8@0+ (1,0) [0|255] ""  FR,ADS
 SG_ Ri_AccOBJ_fusion_Sts : 207|2@0+ (1,0) [0|3] ""  FR,ADS
 SG_ Ri_AccOBJ_ObstacleProb : 197|6@0+ (2,0) [0|100] "%"  FR,ADS
 SG_ Ri_AccOBJ_ExistProb : 189|6@0+ (2,0) [0|100] "%"  FR,ADS
 SG_ Ri_AccOBJ_Brakelight_Info : 191|1@0+ (1,0) [0|1] ""  FR,ADS
 SG_ Ri_AccOBJ_Taillight_Info : 178|3@0+ (1,0) [0|7] ""  FR,ADS
 SG_ Ri_AccOBJ_Dis_to_R_LaneMark : 172|9@0+ (0.01,0) [0|5] "m"  FR,ADS
 SG_ Ri_AccOBJ_Dis_to_L_LaneMark : 166|9@0+ (0.01,0) [0|5] "m"  FR,ADS
 SG_ Ri_AccOBJ_Ax : 145|10@0+ (0.03125,-16) [-16|15.96875] "m/s2"  FR,ADS
 SG_ Ri_AccOBJ_Ay : 138|9@0+ (0.0625,-16) [-16|15.9375] "m/s2"  FR,ADS
 SG_ Ri_AccOBJ_Vx_std : 135|12@0+ (0.0625,-128) [-128|127.9375] "m/s"  FR,ADS
 SG_ Ri_AccOBJ_Vx : 116|12@0+ (0.0625,-128) [-128|127.9375] "m/s"  FR,ADS
 SG_ Ri_AccOBJ_Vy_std : 111|10@0+ (0.125,-64) [-64|63.875] "m/s"  FR,ADS
 SG_ Ri_AccOBJ_Vy : 89|10@0+ (0.125,-64) [-64|63.875] "m/s"  FR,ADS
 SG_ Ri_AccOBJ_Dx_Vnce : 73|14@0+ (0.05,0) [0|50] ""  FR,ADS
 SG_ Ri_AccOBJ_Dx : 71|13@0+ (0.0625,-256) [-256|255.9375] "m"  FR,ADS
 SG_ Ri_AccOBJ_Dy_Vnce : 49|10@0+ (0.02,0) [0|20] "m2"  FR,ADS
 SG_ Ri_AccOBJ_Dy : 45|11@0+ (0.125,-128) [-128|127.875] "m"  FR,ADS
 SG_ Ri_AccOBJ_HeadingAngle : 38|9@0+ (0.01,-1.57) [-1.57|1.57] "rad"  FR,ADS
 SG_ Ri_AccOBJ_Length : 31|9@0+ (0.05,0) [0|25.5] "m"  FR,ADS
 SG_ Ri_AccOBJ_Height : 8|9@0+ (0.01,0) [0|5.11] "m"  FR,ADS
 SG_ Ri_AccOBJ_Width : 3|11@0+ (0.01,0) [0|12] "m"  FR,ADS
 SG_ Ri_AccOBJ_Class : 7|3@0+ (1,0) [0|7] ""  FR,ADS

BO_ 429 FR_1AD: 64 FR
 SG_ FC_RollingCounter_1AD : 491|4@0+ (1,0) [0|15] ""  FR,ADS
 SG_ FC_CRCCheck_1AD : 503|16@0+ (1,0) [0|65535] ""  FR,ADS
 SG_ FR_OBJ8_Track_Age : 479|8@0+ (1,0) [0|255] ""  FR,ADS
 SG_ FR_OBJ8_Track_ID : 460|8@0+ (1,0) [0|255] ""  FR,ADS
 SG_ FR_OBJ8_FusionedFC_Track_ID : 487|8@0+ (1,0) [0|255] ""  FR,ADS
 SG_ FR_OBJ8_fusion_Sts : 463|2@0+ (1,0) [0|3] ""  FR,ADS
 SG_ FR_OBJ8_ObstacleProb : 453|6@0+ (2,0) [0|100] "%"  FR,ADS
 SG_ FR_OBJ8_ExistProb : 445|6@0+ (2,0) [0|100] "%"  FR,ADS
 SG_ FR_OBJ8_Brakelight_Info : 447|1@0+ (1,0) [0|1] ""  FR,ADS
 SG_ FR_OBJ8_Taillight_Info : 434|3@0+ (1,0) [0|7] ""  FR,ADS
 SG_ FR_OBJ8_Dis_to_R_LaneMark : 428|9@0+ (0.01,0) [0|5] "m"  FR,ADS
 SG_ FR_OBJ8_Dis_to_L_LaneMark : 422|9@0+ (0.01,0) [0|5] "m"  FR,ADS
 SG_ FR_OBJ8_Ax : 401|10@0+ (0.03125,-16) [-16|15.96875] "m/s2"  FR,ADS
 SG_ FR_OBJ8_Ay : 394|9@0+ (0.0625,-16) [-16|15.9375] "m/s2"  FR,ADS
 SG_ FR_OBJ8_Vx_std : 391|12@0+ (0.0625,-128) [-128|127.9375] "m/s"  FR,ADS
 SG_ FR_OBJ8_Vx : 372|12@0+ (0.0625,-128) [-128|127.9375] "m/s"  FR,ADS
 SG_ FR_OBJ8_Vy_std : 367|10@0+ (0.125,-64) [-64|63.875] "m/s"  FR,ADS
 SG_ FR_OBJ8_Vy : 345|10@0+ (0.125,-64) [-64|63.875] "m/s"  FR,ADS
 SG_ FR_OBJ8_Dx_Vnce : 329|14@0+ (0.05,0) [0|50] ""  FR,ADS
 SG_ FR_OBJ8_Dx : 327|13@0+ (0.0625,-256) [-256|255.9375] "m"  FR,ADS
 SG_ FR_OBJ8_Dy_Vnce : 305|10@0+ (0.02,0) [0|20] "m2"  FR,ADS
 SG_ FR_OBJ8_Dy : 301|11@0+ (0.125,-128) [-128|127.875] "m"  FR,ADS
 SG_ FR_OBJ8_HeadingAngle : 294|9@0+ (0.01,-1.57) [-1.57|1.57] "rad"  FR,ADS
 SG_ FR_OBJ8_Length : 287|9@0+ (0.05,0) [0|25.5] "m"  FR,ADS
 SG_ FR_OBJ8_Height : 264|9@0+ (0.01,0) [0|5.11] "m"  FR,ADS
 SG_ FR_OBJ8_Width : 259|11@0+ (0.01,0) [0|12] "m"  FR,ADS
 SG_ FR_OBJ8_Class : 263|3@0+ (1,0) [0|7] ""  FR,ADS
 SG_ FR_OBJ7_Track_Age : 223|8@0+ (1,0) [0|255] ""  FR,ADS
 SG_ FR_OBJ7_Track_ID : 204|8@0+ (1,0) [0|255] ""  FR,ADS
 SG_ FR_OBJ7_FusionedFC_Track_ID : 231|8@0+ (1,0) [0|255] ""  FR,ADS
 SG_ FR_OBJ7_fusion_Sts : 207|2@0+ (1,0) [0|3] ""  FR,ADS
 SG_ FR_OBJ7_ObstacleProb : 197|6@0+ (2,0) [0|100] "%"  FR,ADS
 SG_ FR_OBJ7_ExistProb : 189|6@0+ (2,0) [0|100] "%"  FR,ADS
 SG_ FR_OBJ7_Brakelight_Info : 191|1@0+ (1,0) [0|1] ""  FR,ADS
 SG_ FR_OBJ7_Taillight_Info : 178|3@0+ (1,0) [0|7] ""  FR,ADS
 SG_ FR_OBJ7_Dis_to_R_LaneMark : 172|9@0+ (0.01,0) [0|5] "m"  FR,ADS
 SG_ FR_OBJ7_Dis_to_L_LaneMark : 166|9@0+ (0.01,0) [0|5] "m"  FR,ADS
 SG_ FR_OBJ7_Ax : 145|10@0+ (0.03125,-16) [-16|15.96875] "m/s2"  FR,ADS
 SG_ FR_OBJ7_Ay : 138|9@0+ (0.0625,-16) [-16|15.9375] "m/s2"  FR,ADS
 SG_ FR_OBJ7_Vx_std : 135|12@0+ (0.0625,-128) [-128|127.9375] "m/s"  FR,ADS
 SG_ FR_OBJ7_Vx : 116|12@0+ (0.0625,-128) [-128|127.9375] "m/s"  FR,ADS
 SG_ FR_OBJ7_Vy_std : 111|10@0+ (0.125,-64) [-64|63.875] "m/s"  FR,ADS
 SG_ FR_OBJ7_Vy : 89|10@0+ (0.125,-64) [-64|63.875] "m/s"  FR,ADS
 SG_ FR_OBJ7_Dx_Vnce : 73|14@0+ (0.05,0) [0|50] ""  FR,ADS
 SG_ FR_OBJ7_Dx : 71|13@0+ (0.0625,-256) [-256|255.9375] "m"  FR,ADS
 SG_ FR_OBJ7_Dy_Vnce : 49|10@0+ (0.02,0) [0|20] "m2"  FR,ADS
 SG_ FR_OBJ7_Dy : 45|11@0+ (0.125,-128) [-128|127.875] "m"  FR,ADS
 SG_ FR_OBJ7_HeadingAngle : 38|9@0+ (0.01,-1.57) [-1.57|1.57] "rad"  FR,ADS
 SG_ FR_OBJ7_Length : 31|9@0+ (0.05,0) [0|25.5] "m"  FR,ADS
 SG_ FR_OBJ7_Height : 8|9@0+ (0.01,0) [0|5.11] "m"  FR,ADS
 SG_ FR_OBJ7_Width : 3|11@0+ (0.01,0) [0|12] "m"  FR,ADS
 SG_ FR_OBJ7_Class : 7|3@0+ (1,0) [0|7] ""  FR,ADS

BO_ 430 FR_1AE: 64 FR
 SG_ FC_RollingCounter_1AE : 491|4@0+ (1,0) [0|15] ""  FR,ADS
 SG_ FC_CRCCheck_1AE : 503|16@0+ (1,0) [0|65535] ""  FR,ADS
 SG_ FR_OBJ10_Track_Age : 479|8@0+ (1,0) [0|255] ""  FR,ADS
 SG_ FR_OBJ10_Track_ID : 460|8@0+ (1,0) [0|255] ""  FR,ADS
 SG_ FR_OBJ10_FusionedFC_Track_ID : 487|8@0+ (1,0) [0|255] ""  FR,ADS
 SG_ FR_OBJ10_fusion_Sts : 463|2@0+ (1,0) [0|3] ""  FR,ADS
 SG_ FR_OBJ10_ObstacleProb : 453|6@0+ (2,0) [0|100] "%"  FR,ADS
 SG_ FR_OBJ10_ExistProb : 445|6@0+ (2,0) [0|100] "%"  FR,ADS
 SG_ FR_OBJ10_Brakelight_Info : 447|1@0+ (1,0) [0|1] ""  FR,ADS
 SG_ FR_OBJ10_Taillight_Info : 434|3@0+ (1,0) [0|7] ""  FR,ADS
 SG_ FR_OBJ10_Dis_to_R_LaneMark : 428|9@0+ (0.01,0) [0|5] "m"  FR,ADS
 SG_ FR_OBJ10_Dis_to_L_LaneMark : 422|9@0+ (0.01,0) [0|5] "m"  FR,ADS
 SG_ FR_OBJ10_Ax : 401|10@0+ (0.03125,-16) [-16|15.96875] "m/s2"  FR,ADS
 SG_ FR_OBJ10_Ay : 394|9@0+ (0.0625,-16) [-16|15.9375] "m/s2"  FR,ADS
 SG_ FR_OBJ10_Vx_std : 391|12@0+ (0.0625,-128) [-128|127.9375] "m/s"  FR,ADS
 SG_ FR_OBJ10_Vx : 372|12@0+ (0.0625,-128) [-128|127.9375] "m/s"  FR,ADS
 SG_ FR_OBJ10_Vy_std : 367|10@0+ (0.125,-64) [-64|63.875] "m/s"  FR,ADS
 SG_ FR_OBJ10_Vy : 345|10@0+ (0.125,-64) [-64|63.875] "m/s"  FR,ADS
 SG_ FR_OBJ10_Dx_Vnce : 329|14@0+ (0.05,0) [0|50] ""  FR,ADS
 SG_ FR_OBJ10_Dx : 327|13@0+ (0.0625,-256) [-256|255.9375] "m"  FR,ADS
 SG_ FR_OBJ10_Dy_Vnce : 305|10@0+ (0.02,0) [0|20] "m2"  FR,ADS
 SG_ FR_OBJ10_Dy : 301|11@0+ (0.125,-128) [-128|127.875] "m"  FR,ADS
 SG_ FR_OBJ10_HeadingAngle : 294|9@0+ (0.01,-1.57) [-1.57|1.57] "rad"  FR,ADS
 SG_ FR_OBJ10_Length : 287|9@0+ (0.05,0) [0|25.5] "m"  FR,ADS
 SG_ FR_OBJ10_Height : 264|9@0+ (0.01,0) [0|5.11] "m"  FR,ADS
 SG_ FR_OBJ10_Width : 259|11@0+ (0.01,0) [0|12] "m"  FR,ADS
 SG_ FR_OBJ10_Class : 263|3@0+ (1,0) [0|7] ""  FR,ADS
 SG_ FR_OBJ9_Track_Age : 223|8@0+ (1,0) [0|255] ""  FR,ADS
 SG_ FR_OBJ9_Track_ID : 204|8@0+ (1,0) [0|255] ""  FR,ADS
 SG_ FR_OBJ9_FusionedFC_Track_ID : 231|8@0+ (1,0) [0|255] ""  FR,ADS
 SG_ FR_OBJ9_fusion_Sts : 207|2@0+ (1,0) [0|3] ""  FR,ADS
 SG_ FR_OBJ9_ObstacleProb : 197|6@0+ (2,0) [0|100] "%"  FR,ADS
 SG_ FR_OBJ9_ExistProb : 189|6@0+ (2,0) [0|100] "%"  FR,ADS
 SG_ FR_OBJ9_Brakelight_Info : 191|1@0+ (1,0) [0|1] ""  FR,ADS
 SG_ FR_OBJ9_Taillight_Info : 178|3@0+ (1,0) [0|7] ""  FR,ADS
 SG_ FR_OBJ9_Dis_to_R_LaneMark : 172|9@0+ (0.01,0) [0|5] "m"  FR,ADS
 SG_ FR_OBJ9_Dis_to_L_LaneMark : 166|9@0+ (0.01,0) [0|5] "m"  FR,ADS
 SG_ FR_OBJ9_Ax : 145|10@0+ (0.03125,-16) [-16|15.96875] "m/s2"  FR,ADS
 SG_ FR_OBJ9_Ay : 138|9@0+ (0.0625,-16) [-16|15.9375] "m/s2"  FR,ADS
 SG_ FR_OBJ9_Vx_std : 135|12@0+ (0.0625,-128) [-128|127.9375] "m/s"  FR,ADS
 SG_ FR_OBJ9_Vx : 116|12@0+ (0.0625,-128) [-128|127.9375] "m/s"  FR,ADS
 SG_ FR_OBJ9_Vy_std : 111|10@0+ (0.125,-64) [-64|63.875] "m/s"  FR,ADS
 SG_ FR_OBJ9_Vy : 89|10@0+ (0.125,-64) [-64|63.875] "m/s"  FR,ADS
 SG_ FR_OBJ9_Dx_Vnce : 73|14@0+ (0.05,0) [0|50] ""  FR,ADS
 SG_ FR_OBJ9_Dx : 71|13@0+ (0.0625,-256) [-256|255.9375] "m"  FR,ADS
 SG_ FR_OBJ9_Dy_Vnce : 49|10@0+ (0.02,0) [0|20] "m2"  FR,ADS
 SG_ FR_OBJ9_Dy : 45|11@0+ (0.125,-128) [-128|127.875] "m"  FR,ADS
 SG_ FR_OBJ9_HeadingAngle : 38|9@0+ (0.01,-1.57) [-1.57|1.57] "rad"  FR,ADS
 SG_ FR_OBJ9_Length : 31|9@0+ (0.05,0) [0|25.5] "m"  FR,ADS
 SG_ FR_OBJ9_Height : 8|9@0+ (0.01,0) [0|5.11] "m"  FR,ADS
 SG_ FR_OBJ9_Width : 3|11@0+ (0.01,0) [0|12] "m"  FR,ADS
 SG_ FR_OBJ9_Class : 7|3@0+ (1,0) [0|7] ""  FR,ADS

BO_ 431 FR_1AF: 64 FR
 SG_ FC_RollingCounter_1AF : 491|4@0+ (1,0) [0|15] ""  FR,ADS
 SG_ FC_CRCCheck_1AF : 503|16@0+ (1,0) [0|65535] ""  FR,ADS
 SG_ FR_OBJ12_Track_Age : 479|8@0+ (1,0) [0|255] ""  FR,ADS
 SG_ FR_OBJ12_Track_ID : 460|8@0+ (1,0) [0|255] ""  FR,ADS
 SG_ FR_OBJ12_FusionedFC_Track_ID : 487|8@0+ (1,0) [0|255] ""  FR,ADS
 SG_ FR_OBJ12_fusion_Sts : 463|2@0+ (1,0) [0|3] ""  FR,ADS
 SG_ FR_OBJ12_ObstacleProb : 453|6@0+ (2,0) [0|100] "%"  FR,ADS
 SG_ FR_OBJ12_ExistProb : 445|6@0+ (2,0) [0|100] "%"  FR,ADS
 SG_ FR_OBJ12_Brakelight_Info : 447|1@0+ (1,0) [0|1] ""  FR,ADS
 SG_ FR_OBJ12_Taillight_Info : 434|3@0+ (1,0) [0|7] ""  FR,ADS
 SG_ FR_OBJ12_Dis_to_R_LaneMark : 428|9@0+ (0.01,0) [0|5] "m"  FR,ADS
 SG_ FR_OBJ12_Dis_to_L_LaneMark : 422|9@0+ (0.01,0) [0|5] "m"  FR,ADS
 SG_ FR_OBJ12_Ax : 401|10@0+ (0.03125,-16) [-16|15.96875] "m/s2"  FR,ADS
 SG_ FR_OBJ12_Ay : 394|9@0+ (0.0625,-16) [-16|15.9375] "m/s2"  FR,ADS
 SG_ FR_OBJ12_Vx_std : 391|12@0+ (0.0625,-128) [-128|127.9375] "m/s"  FR,ADS
 SG_ FR_OBJ12_Vx : 372|12@0+ (0.0625,-128) [-128|127.9375] "m/s"  FR,ADS
 SG_ FR_OBJ12_Vy_std : 367|10@0+ (0.125,-64) [-64|63.875] "m/s"  FR,ADS
 SG_ FR_OBJ12_Vy : 345|10@0+ (0.125,-64) [-64|63.875] "m/s"  FR,ADS
 SG_ FR_OBJ12_Dx_Vnce : 329|14@0+ (0.05,0) [0|50] ""  FR,ADS
 SG_ FR_OBJ12_Dx : 327|13@0+ (0.0625,-256) [-256|255.9375] "m"  FR,ADS
 SG_ FR_OBJ12_Dy_Vnce : 305|10@0+ (0.02,0) [0|20] "m2"  FR,ADS
 SG_ FR_OBJ12_Dy : 301|11@0+ (0.125,-128) [-128|127.875] "m"  FR,ADS
 SG_ FR_OBJ12_HeadingAngle : 294|9@0+ (0.01,-1.57) [-1.57|1.57] "rad"  FR,ADS
 SG_ FR_OBJ12_Length : 287|9@0+ (0.05,0) [0|25.5] "m"  FR,ADS
 SG_ FR_OBJ12_Height : 264|9@0+ (0.01,0) [0|5.11] "m"  FR,ADS
 SG_ FR_OBJ12_Width : 259|11@0+ (0.01,0) [0|12] "m"  FR,ADS
 SG_ FR_OBJ12_Class : 263|3@0+ (1,0) [0|7] ""  FR,ADS
 SG_ FR_OBJ11_Track_Age : 223|8@0+ (1,0) [0|255] ""  FR,ADS
 SG_ FR_OBJ11_Track_ID : 204|8@0+ (1,0) [0|255] ""  FR,ADS
 SG_ FR_OBJ11_FusionedFC_Track_ID : 231|8@0+ (1,0) [0|255] ""  FR,ADS
 SG_ FR_OBJ11_fusion_Sts : 207|2@0+ (1,0) [0|3] ""  FR,ADS
 SG_ FR_OBJ11_ObstacleProb : 197|6@0+ (2,0) [0|100] "%"  FR,ADS
 SG_ FR_OBJ11_ExistProb : 189|6@0+ (2,0) [0|100] "%"  FR,ADS
 SG_ FR_OBJ11_Brakelight_Info : 191|1@0+ (1,0) [0|1] ""  FR,ADS
 SG_ FR_OBJ11_Taillight_Info : 178|3@0+ (1,0) [0|7] ""  FR,ADS
 SG_ FR_OBJ11_Dis_to_R_LaneMark : 172|9@0+ (0.01,0) [0|5] "m"  FR,ADS
 SG_ FR_OBJ11_Dis_to_L_LaneMark : 166|9@0+ (0.01,0) [0|5] "m"  FR,ADS
 SG_ FR_OBJ11_Ax : 145|10@0+ (0.03125,-16) [-16|15.96875] "m/s2"  FR,ADS
 SG_ FR_OBJ11_Ay : 138|9@0+ (0.0625,-16) [-16|15.9375] "m/s2"  FR,ADS
 SG_ FR_OBJ11_Vx_std : 135|12@0+ (0.0625,-128) [-128|127.9375] "m/s"  FR,ADS
 SG_ FR_OBJ11_Vx : 116|12@0+ (0.0625,-128) [-128|127.9375] "m/s"  FR,ADS
 SG_ FR_OBJ11_Vy_std : 111|10@0+ (0.125,-64) [-64|63.875] "m/s"  FR,ADS
 SG_ FR_OBJ11_Vy : 89|10@0+ (0.125,-64) [-64|63.875] "m/s"  FR,ADS
 SG_ FR_OBJ11_Dx_Vnce : 73|14@0+ (0.05,0) [0|50] ""  FR,ADS
 SG_ FR_OBJ11_Dx : 71|13@0+ (0.0625,-256) [-256|255.9375] "m"  FR,ADS
 SG_ FR_OBJ11_Dy_Vnce : 49|10@0+ (0.02,0) [0|20] "m2"  FR,ADS
 SG_ FR_OBJ11_Dy : 45|11@0+ (0.125,-128) [-128|127.875] "m"  FR,ADS
 SG_ FR_OBJ11_HeadingAngle : 38|9@0+ (0.01,-1.57) [-1.57|1.57] "rad"  FR,ADS
 SG_ FR_OBJ11_Length : 31|9@0+ (0.05,0) [0|25.5] "m"  FR,ADS
 SG_ FR_OBJ11_Height : 8|9@0+ (0.01,0) [0|5.11] "m"  FR,ADS
 SG_ FR_OBJ11_Width : 3|11@0+ (0.01,0) [0|12] "m"  FR,ADS
 SG_ FR_OBJ11_Class : 7|3@0+ (1,0) [0|7] ""  FR,ADS

BO_ 432 FR_1B0: 64 FR
 SG_ FC_RollingCounter_1B0 : 491|4@0+ (1,0) [0|15] ""  FR,ADS
 SG_ FC_CRCCheck_1B0 : 503|16@0+ (1,0) [0|65535] ""  FR,ADS
 SG_ FR_OBJ14_Track_Age : 479|8@0+ (1,0) [0|255] ""  FR,ADS
 SG_ FR_OBJ14_Track_ID : 460|8@0+ (1,0) [0|255] ""  FR,ADS
 SG_ FR_OBJ14_FusionedFC_Track_ID : 487|8@0+ (1,0) [0|255] ""  FR,ADS
 SG_ FR_OBJ14_fusion_Sts : 463|2@0+ (1,0) [0|3] ""  FR,ADS
 SG_ FR_OBJ14_ObstacleProb : 453|6@0+ (2,0) [0|100] "%"  FR,ADS
 SG_ FR_OBJ14_ExistProb : 445|6@0+ (2,0) [0|100] "%"  FR,ADS
 SG_ FR_OBJ14_Brakelight_Info : 447|1@0+ (1,0) [0|1] ""  FR,ADS
 SG_ FR_OBJ14_Taillight_Info : 434|3@0+ (1,0) [0|7] ""  FR,ADS
 SG_ FR_OBJ14_Dis_to_R_LaneMark : 428|9@0+ (0.01,0) [0|5] "m"  FR,ADS
 SG_ FR_OBJ14_Dis_to_L_LaneMark : 422|9@0+ (0.01,0) [0|5] "m"  FR,ADS
 SG_ FR_OBJ14_Ax : 401|10@0+ (0.03125,-16) [-16|15.96875] "m/s2"  FR,ADS
 SG_ FR_OBJ14_Ay : 394|9@0+ (0.0625,-16) [-16|15.9375] "m/s2"  FR,ADS
 SG_ FR_OBJ14_Vx_std : 391|12@0+ (0.0625,-128) [-128|127.9375] "m/s"  FR,ADS
 SG_ FR_OBJ14_Vx : 372|12@0+ (0.0625,-128) [-128|127.9375] "m/s"  FR,ADS
 SG_ FR_OBJ14_Vy_std : 367|10@0+ (0.125,-64) [-64|63.875] "m/s"  FR,ADS
 SG_ FR_OBJ14_Vy : 345|10@0+ (0.125,-64) [-64|63.875] "m/s"  FR,ADS
 SG_ FR_OBJ14_Dx_Vnce : 329|14@0+ (0.05,0) [0|50] ""  FR,ADS
 SG_ FR_OBJ14_Dx : 327|13@0+ (0.0625,-256) [-256|255.9375] "m"  FR,ADS
 SG_ FR_OBJ14_Dy_Vnce : 305|10@0+ (0.02,0) [0|20] "m2"  FR,ADS
 SG_ FR_OBJ14_Dy : 301|11@0+ (0.125,-128) [-128|127.875] "m"  FR,ADS
 SG_ FR_OBJ14_HeadingAngle : 294|9@0+ (0.01,-1.57) [-1.57|1.57] "rad"  FR,ADS
 SG_ FR_OBJ14_Length : 287|9@0+ (0.05,0) [0|25.5] "m"  FR,ADS
 SG_ FR_OBJ14_Height : 264|9@0+ (0.01,0) [0|5.11] "m"  FR,ADS
 SG_ FR_OBJ14_Width : 259|11@0+ (0.01,0) [0|12] "m"  FR,ADS
 SG_ FR_OBJ14_Class : 263|3@0+ (1,0) [0|7] ""  FR,ADS
 SG_ FR_OBJ13_Track_Age : 223|8@0+ (1,0) [0|255] ""  FR,ADS
 SG_ FR_OBJ13_Track_ID : 204|8@0+ (1,0) [0|255] ""  FR,ADS
 SG_ FR_OBJ13_FusionedFC_Track_ID : 231|8@0+ (1,0) [0|255] ""  FR,ADS
 SG_ FR_OBJ13_fusion_Sts : 207|2@0+ (1,0) [0|3] ""  FR,ADS
 SG_ FR_OBJ13_ObstacleProb : 197|6@0+ (2,0) [0|100] "%"  FR,ADS
 SG_ FR_OBJ13_ExistProb : 189|6@0+ (2,0) [0|100] "%"  FR,ADS
 SG_ FR_OBJ13_Brakelight_Info : 191|1@0+ (1,0) [0|1] ""  FR,ADS
 SG_ FR_OBJ13_Taillight_Info : 178|3@0+ (1,0) [0|7] ""  FR,ADS
 SG_ FR_OBJ13_Dis_to_R_LaneMark : 172|9@0+ (0.01,0) [0|5] "m"  FR,ADS
 SG_ FR_OBJ13_Dis_to_L_LaneMark : 166|9@0+ (0.01,0) [0|5] "m"  FR,ADS
 SG_ FR_OBJ13_Ax : 145|10@0+ (0.03125,-16) [-16|15.96875] "m/s2"  FR,ADS
 SG_ FR_OBJ13_Ay : 138|9@0+ (0.0625,-16) [-16|15.9375] "m/s2"  FR,ADS
 SG_ FR_OBJ13_Vx_std : 135|12@0+ (0.0625,-128) [-128|127.9375] "m/s"  FR,ADS
 SG_ FR_OBJ13_Vx : 116|12@0+ (0.0625,-128) [-128|127.9375] "m/s"  FR,ADS
 SG_ FR_OBJ13_Vy_std : 111|10@0+ (0.125,-64) [-64|63.875] "m/s"  FR,ADS
 SG_ FR_OBJ13_Vy : 89|10@0+ (0.125,-64) [-64|63.875] "m/s"  FR,ADS
 SG_ FR_OBJ13_Dx_Vnce : 73|14@0+ (0.05,0) [0|50] ""  FR,ADS
 SG_ FR_OBJ13_Dx : 71|13@0+ (0.0625,-256) [-256|255.9375] "m"  FR,ADS
 SG_ FR_OBJ13_Dy_Vnce : 49|10@0+ (0.02,0) [0|20] "m2"  FR,ADS
 SG_ FR_OBJ13_Dy : 45|11@0+ (0.125,-128) [-128|127.875] "m"  FR,ADS
 SG_ FR_OBJ13_HeadingAngle : 38|9@0+ (0.01,-1.57) [-1.57|1.57] "rad"  FR,ADS
 SG_ FR_OBJ13_Length : 31|9@0+ (0.05,0) [0|25.5] "m"  FR,ADS
 SG_ FR_OBJ13_Height : 8|9@0+ (0.01,0) [0|5.11] "m"  FR,ADS
 SG_ FR_OBJ13_Width : 3|11@0+ (0.01,0) [0|12] "m"  FR,ADS
 SG_ FR_OBJ13_Class : 7|3@0+ (1,0) [0|7] ""  FR,ADS

BO_ 433 FR_1B1: 64 FR
 SG_ FC_RollingCounter_1B1 : 491|4@0+ (1,0) [0|15] ""  FR,ADS
 SG_ FC_CRCCheck_1B1 : 503|16@0+ (1,0) [0|65535] ""  FR,ADS
 SG_ FR_OBJ16_Track_Age : 479|8@0+ (1,0) [0|255] ""  FR,ADS
 SG_ FR_OBJ16_Track_ID : 460|8@0+ (1,0) [0|255] ""  FR,ADS
 SG_ FR_OBJ16_FusionedFC_Track_ID : 487|8@0+ (1,0) [0|255] ""  FR,ADS
 SG_ FR_OBJ16_fusion_Sts : 463|2@0+ (1,0) [0|3] ""  FR,ADS
 SG_ FR_OBJ16_ObstacleProb : 453|6@0+ (2,0) [0|100] "%"  FR,ADS
 SG_ FR_OBJ16_ExistProb : 445|6@0+ (2,0) [0|100] "%"  FR,ADS
 SG_ FR_OBJ16_Brakelight_Info : 447|1@0+ (1,0) [0|1] ""  FR,ADS
 SG_ FR_OBJ16_Taillight_Info : 434|3@0+ (1,0) [0|7] ""  FR,ADS
 SG_ FR_OBJ16_Dis_to_R_LaneMark : 428|9@0+ (0.01,0) [0|5] "m"  FR,ADS
 SG_ FR_OBJ16_Dis_to_L_LaneMark : 422|9@0+ (0.01,0) [0|5] "m"  FR,ADS
 SG_ FR_OBJ16_Ax : 401|10@0+ (0.03125,-16) [-16|15.96875] "m/s2"  FR,ADS
 SG_ FR_OBJ16_Ay : 394|9@0+ (0.0625,-16) [-16|15.9375] "m/s2"  FR,ADS
 SG_ FR_OBJ16_Vx_std : 391|12@0+ (0.0625,-128) [-128|127.9375] "m/s"  FR,ADS
 SG_ FR_OBJ16_Vx : 372|12@0+ (0.0625,-128) [-128|127.9375] "m/s"  FR,ADS
 SG_ FR_OBJ16_Vy_std : 367|10@0+ (0.125,-64) [-64|63.875] "m/s"  FR,ADS
 SG_ FR_OBJ16_Vy : 345|10@0+ (0.125,-64) [-64|63.875] "m/s"  FR,ADS
 SG_ FR_OBJ16_Dx_Vnce : 329|14@0+ (0.05,0) [0|50] ""  FR,ADS
 SG_ FR_OBJ16_Dx : 327|13@0+ (0.0625,-256) [-256|255.9375] "m"  FR,ADS
 SG_ FR_OBJ16_Dy_Vnce : 305|10@0+ (0.02,0) [0|20] "m2"  FR,ADS
 SG_ FR_OBJ16_Dy : 301|11@0+ (0.125,-128) [-128|127.875] "m"  FR,ADS
 SG_ FR_OBJ16_HeadingAngle : 294|9@0+ (0.01,-1.57) [-1.57|1.57] "rad"  FR,ADS
 SG_ FR_OBJ16_Length : 287|9@0+ (0.05,0) [0|25.5] "m"  FR,ADS
 SG_ FR_OBJ16_Height : 264|9@0+ (0.01,0) [0|5.11] "m"  FR,ADS
 SG_ FR_OBJ16_Width : 259|11@0+ (0.01,0) [0|12] "m"  FR,ADS
 SG_ FR_OBJ16_Class : 263|3@0+ (1,0) [0|7] ""  FR,ADS
 SG_ FR_OBJ15_Track_Age : 223|8@0+ (1,0) [0|255] ""  FR,ADS
 SG_ FR_OBJ15_Track_ID : 204|8@0+ (1,0) [0|255] ""  FR,ADS
 SG_ FR_OBJ15_FusionedFC_Track_ID : 231|8@0+ (1,0) [0|255] ""  FR,ADS
 SG_ FR_OBJ15_fusion_Sts : 207|2@0+ (1,0) [0|3] ""  FR,ADS
 SG_ FR_OBJ15_ObstacleProb : 197|6@0+ (2,0) [0|100] "%"  FR,ADS
 SG_ FR_OBJ15_ExistProb : 189|6@0+ (2,0) [0|100] "%"  FR,ADS
 SG_ FR_OBJ15_Brakelight_Info : 191|1@0+ (1,0) [0|1] ""  FR,ADS
 SG_ FR_OBJ15_Taillight_Info : 178|3@0+ (1,0) [0|7] ""  FR,ADS
 SG_ FR_OBJ15_Dis_to_R_LaneMark : 172|9@0+ (0.01,0) [0|5] "m"  FR,ADS
 SG_ FR_OBJ15_Dis_to_L_LaneMark : 166|9@0+ (0.01,0) [0|5] "m"  FR,ADS
 SG_ FR_OBJ15_Ax : 145|10@0+ (0.03125,-16) [-16|15.96875] "m/s2"  FR,ADS
 SG_ FR_OBJ15_Ay : 138|9@0+ (0.0625,-16) [-16|15.9375] "m/s2"  FR,ADS
 SG_ FR_OBJ15_Vx_std : 135|12@0+ (0.0625,-128) [-128|127.9375] "m/s"  FR,ADS
 SG_ FR_OBJ15_Vx : 116|12@0+ (0.0625,-128) [-128|127.9375] "m/s"  FR,ADS
 SG_ FR_OBJ15_Vy_std : 111|10@0+ (0.125,-64) [-64|63.875] "m/s"  FR,ADS
 SG_ FR_OBJ15_Vy : 89|10@0+ (0.125,-64) [-64|63.875] "m/s"  FR,ADS
 SG_ FR_OBJ15_Dx_Vnce : 73|14@0+ (0.05,0) [0|50] ""  FR,ADS
 SG_ FR_OBJ15_Dx : 71|13@0+ (0.0625,-256) [-256|255.9375] "m"  FR,ADS
 SG_ FR_OBJ15_Dy_Vnce : 49|10@0+ (0.02,0) [0|20] "m2"  FR,ADS
 SG_ FR_OBJ15_Dy : 45|11@0+ (0.125,-128) [-128|127.875] "m"  FR,ADS
 SG_ FR_OBJ15_HeadingAngle : 38|9@0+ (0.01,-1.57) [-1.57|1.57] "rad"  FR,ADS
 SG_ FR_OBJ15_Length : 31|9@0+ (0.05,0) [0|25.5] "m"  FR,ADS
 SG_ FR_OBJ15_Height : 8|9@0+ (0.01,0) [0|5.11] "m"  FR,ADS
 SG_ FR_OBJ15_Width : 3|11@0+ (0.01,0) [0|12] "m"  FR,ADS
 SG_ FR_OBJ15_Class : 7|3@0+ (1,0) [0|7] ""  FR,ADS

BO_ 434 FR_1B2: 64 FR
 SG_ FC_RollingCounter_1B2 : 491|4@0+ (1,0) [0|15] ""  FR,ADS
 SG_ FC_CRCCheck_1B2 : 503|16@0+ (1,0) [0|65535] ""  FR,ADS
 SG_ FR_OBJ18_Track_Age : 479|8@0+ (1,0) [0|255] ""  FR,ADS
 SG_ FR_OBJ18_Track_ID : 460|8@0+ (1,0) [0|255] ""  FR,ADS
 SG_ FR_OBJ18_FusionedFC_Track_ID : 487|8@0+ (1,0) [0|255] ""  FR,ADS
 SG_ FR_OBJ18_fusion_Sts : 463|2@0+ (1,0) [0|3] ""  FR,ADS
 SG_ FR_OBJ18_ObstacleProb : 453|6@0+ (2,0) [0|100] "%"  FR,ADS
 SG_ FR_OBJ18_ExistProb : 445|6@0+ (2,0) [0|100] "%"  FR,ADS
 SG_ FR_OBJ18_Brakelight_Info : 447|1@0+ (1,0) [0|1] ""  FR,ADS
 SG_ FR_OBJ18_Taillight_Info : 434|3@0+ (1,0) [0|7] ""  FR,ADS
 SG_ FR_OBJ18_Dis_to_R_LaneMark : 428|9@0+ (0.01,0) [0|5] "m"  FR,ADS
 SG_ FR_OBJ18_Dis_to_L_LaneMark : 422|9@0+ (0.01,0) [0|5] "m"  FR,ADS
 SG_ FR_OBJ18_Ax : 401|10@0+ (0.03125,-16) [-16|15.96875] "m/s2"  FR,ADS
 SG_ FR_OBJ18_Ay : 394|9@0+ (0.0625,-16) [-16|15.9375] "m/s2"  FR,ADS
 SG_ FR_OBJ18_Vx_std : 391|12@0+ (0.0625,-128) [-128|127.9375] "m/s"  FR,ADS
 SG_ FR_OBJ18_Vx : 372|12@0+ (0.0625,-128) [-128|127.9375] "m/s"  FR,ADS
 SG_ FR_OBJ18_Vy_std : 367|10@0+ (0.125,-64) [-64|63.875] "m/s"  FR,ADS
 SG_ FR_OBJ18_Vy : 345|10@0+ (0.125,-64) [-64|63.875] "m/s"  FR,ADS
 SG_ FR_OBJ18_Dx_Vnce : 329|14@0+ (0.05,0) [0|50] ""  FR,ADS
 SG_ FR_OBJ18_Dx : 327|13@0+ (0.0625,-256) [-256|255.9375] "m"  FR,ADS
 SG_ FR_OBJ18_Dy_Vnce : 305|10@0+ (0.02,0) [0|20] "m2"  FR,ADS
 SG_ FR_OBJ18_Dy : 301|11@0+ (0.125,-128) [-128|127.875] "m"  FR,ADS
 SG_ FR_OBJ18_HeadingAngle : 294|9@0+ (0.01,-1.57) [-1.57|1.57] "rad"  FR,ADS
 SG_ FR_OBJ18_Length : 287|9@0+ (0.05,0) [0|25.5] "m"  FR,ADS
 SG_ FR_OBJ18_Height : 264|9@0+ (0.01,0) [0|5.11] "m"  FR,ADS
 SG_ FR_OBJ18_Width : 259|11@0+ (0.01,0) [0|12] "m"  FR,ADS
 SG_ FR_OBJ18_Class : 263|3@0+ (1,0) [0|7] ""  FR,ADS
 SG_ FR_OBJ17_Track_Age : 223|8@0+ (1,0) [0|255] ""  FR,ADS
 SG_ FR_OBJ17_Track_ID : 204|8@0+ (1,0) [0|255] ""  FR,ADS
 SG_ FR_OBJ17_FusionedFC_Track_ID : 231|8@0+ (1,0) [0|255] ""  FR,ADS
 SG_ FR_OBJ17_fusion_Sts : 207|2@0+ (1,0) [0|3] ""  FR,ADS
 SG_ FR_OBJ17_ObstacleProb : 197|6@0+ (2,0) [0|100] "%"  FR,ADS
 SG_ FR_OBJ17_ExistProb : 189|6@0+ (2,0) [0|100] "%"  FR,ADS
 SG_ FR_OBJ17_Brakelight_Info : 191|1@0+ (1,0) [0|1] ""  FR,ADS
 SG_ FR_OBJ17_Taillight_Info : 178|3@0+ (1,0) [0|7] ""  FR,ADS
 SG_ FR_OBJ17_Dis_to_R_LaneMark : 172|9@0+ (0.01,0) [0|5] "m"  FR,ADS
 SG_ FR_OBJ17_Dis_to_L_LaneMark : 166|9@0+ (0.01,0) [0|5] "m"  FR,ADS
 SG_ FR_OBJ17_Ax : 145|10@0+ (0.03125,-16) [-16|15.96875] "m/s2"  FR,ADS
 SG_ FR_OBJ17_Ay : 138|9@0+ (0.0625,-16) [-16|15.9375] "m/s2"  FR,ADS
 SG_ FR_OBJ17_Vx_std : 135|12@0+ (0.0625,-128) [-128|127.9375] "m/s"  FR,ADS
 SG_ FR_OBJ17_Vx : 116|12@0+ (0.0625,-128) [-128|127.9375] "m/s"  FR,ADS
 SG_ FR_OBJ17_Vy_std : 111|10@0+ (0.125,-64) [-64|63.875] "m/s"  FR,ADS
 SG_ FR_OBJ17_Vy : 89|10@0+ (0.125,-64) [-64|63.875] "m/s"  FR,ADS
 SG_ FR_OBJ17_Dx_Vnce : 73|14@0+ (0.05,0) [0|50] ""  FR,ADS
 SG_ FR_OBJ17_Dx : 71|13@0+ (0.0625,-256) [-256|255.9375] "m"  FR,ADS
 SG_ FR_OBJ17_Dy_Vnce : 49|10@0+ (0.02,0) [0|20] "m2"  FR,ADS
 SG_ FR_OBJ17_Dy : 45|11@0+ (0.125,-128) [-128|127.875] "m"  FR,ADS
 SG_ FR_OBJ17_HeadingAngle : 38|9@0+ (0.01,-1.57) [-1.57|1.57] "rad"  FR,ADS
 SG_ FR_OBJ17_Length : 31|9@0+ (0.05,0) [0|25.5] "m"  FR,ADS
 SG_ FR_OBJ17_Height : 8|9@0+ (0.01,0) [0|5.11] "m"  FR,ADS
 SG_ FR_OBJ17_Width : 3|11@0+ (0.01,0) [0|12] "m"  FR,ADS
 SG_ FR_OBJ17_Class : 7|3@0+ (1,0) [0|7] ""  FR,ADS

BO_ 435 FR_1B3: 64 FR
 SG_ FC_RollingCounter_1B3 : 491|4@0+ (1,0) [0|15] ""  FR,ADS
 SG_ FC_CRCCheck_1B3 : 503|16@0+ (1,0) [0|65535] ""  FR,ADS
 SG_ FR_OBJ20_Track_Age : 479|8@0+ (1,0) [0|255] ""  FR,ADS
 SG_ FR_OBJ20_Track_ID : 460|8@0+ (1,0) [0|255] ""  FR,ADS
 SG_ FR_OBJ20_FusionedFC_Track_ID : 487|8@0+ (1,0) [0|255] ""  FR,ADS
 SG_ FR_OBJ20_fusion_Sts : 463|2@0+ (1,0) [0|3] ""  FR,ADS
 SG_ FR_OBJ20_ObstacleProb : 453|6@0+ (2,0) [0|100] "%"  FR,ADS
 SG_ FR_OBJ20_ExistProb : 445|6@0+ (2,0) [0|100] "%"  FR,ADS
 SG_ FR_OBJ20_Brakelight_Info : 447|1@0+ (1,0) [0|1] ""  FR,ADS
 SG_ FR_OBJ20_Taillight_Info : 434|3@0+ (1,0) [0|7] ""  FR,ADS
 SG_ FR_OBJ20_Dis_to_R_LaneMark : 428|9@0+ (0.01,0) [0|5] "m"  FR,ADS
 SG_ FR_OBJ20_Dis_to_L_LaneMark : 422|9@0+ (0.01,0) [0|5] "m"  FR,ADS
 SG_ FR_OBJ20_Ax : 401|10@0+ (0.03125,-16) [-16|15.96875] "m/s2"  FR,ADS
 SG_ FR_OBJ20_Ay : 394|9@0+ (0.0625,-16) [-16|15.9375] "m/s2"  FR,ADS
 SG_ FR_OBJ20_Vx_std : 391|12@0+ (0.0625,-128) [-128|127.9375] "m/s"  FR,ADS
 SG_ FR_OBJ20_Vx : 372|12@0+ (0.0625,-128) [-128|127.9375] "m/s"  FR,ADS
 SG_ FR_OBJ20_Vy_std : 367|10@0+ (0.125,-64) [-64|63.875] "m/s"  FR,ADS
 SG_ FR_OBJ20_Vy : 345|10@0+ (0.125,-64) [-64|63.875] "m/s"  FR,ADS
 SG_ FR_OBJ20_Dx_Vnce : 329|14@0+ (0.05,0) [0|50] ""  FR,ADS
 SG_ FR_OBJ20_Dx : 327|13@0+ (0.0625,-256) [-256|255.9375] "m"  FR,ADS
 SG_ FR_OBJ20_Dy_Vnce : 305|10@0+ (0.02,0) [0|20] "m2"  FR,ADS
 SG_ FR_OBJ20_Dy : 301|11@0+ (0.125,-128) [-128|127.875] "m"  FR,ADS
 SG_ FR_OBJ20_HeadingAngle : 294|9@0+ (0.01,-1.57) [-1.57|1.57] "rad"  FR,ADS
 SG_ FR_OBJ20_Length : 287|9@0+ (0.05,0) [0|25.5] "m"  FR,ADS
 SG_ FR_OBJ20_Height : 264|9@0+ (0.01,0) [0|5.11] "m"  FR,ADS
 SG_ FR_OBJ20_Width : 259|11@0+ (0.01,0) [0|12] "m"  FR,ADS
 SG_ FR_OBJ20_Class : 263|3@0+ (1,0) [0|7] ""  FR,ADS
 SG_ FR_OBJ19_Track_Age : 223|8@0+ (1,0) [0|255] ""  FR,ADS
 SG_ FR_OBJ19_Track_ID : 204|8@0+ (1,0) [0|255] ""  FR,ADS
 SG_ FR_OBJ19_FusionedFC_Track_ID : 231|8@0+ (1,0) [0|255] ""  FR,ADS
 SG_ FR_OBJ19_fusion_Sts : 207|2@0+ (1,0) [0|3] ""  FR,ADS
 SG_ FR_OBJ19_ObstacleProb : 197|6@0+ (2,0) [0|100] "%"  FR,ADS
 SG_ FR_OBJ19_ExistProb : 189|6@0+ (2,0) [0|100] "%"  FR,ADS
 SG_ FR_OBJ19_Brakelight_Info : 191|1@0+ (1,0) [0|1] ""  FR,ADS
 SG_ FR_OBJ19_Taillight_Info : 178|3@0+ (1,0) [0|7] ""  FR,ADS
 SG_ FR_OBJ19_Dis_to_R_LaneMark : 172|9@0+ (0.01,0) [0|5] "m"  FR,ADS
 SG_ FR_OBJ19_Dis_to_L_LaneMark : 166|9@0+ (0.01,0) [0|5] "m"  FR,ADS
 SG_ FR_OBJ19_Ax : 145|10@0+ (0.03125,-16) [-16|15.96875] "m/s2"  FR,ADS
 SG_ FR_OBJ19_Ay : 138|9@0+ (0.0625,-16) [-16|15.9375] "m/s2"  FR,ADS
 SG_ FR_OBJ19_Vx_std : 135|12@0+ (0.0625,-128) [-128|127.9375] "m/s"  FR,ADS
 SG_ FR_OBJ19_Vx : 116|12@0+ (0.0625,-128) [-128|127.9375] "m/s"  FR,ADS
 SG_ FR_OBJ19_Vy_std : 111|10@0+ (0.125,-64) [-64|63.875] "m/s"  FR,ADS
 SG_ FR_OBJ19_Vy : 89|10@0+ (0.125,-64) [-64|63.875] "m/s"  FR,ADS
 SG_ FR_OBJ19_Dx_Vnce : 73|14@0+ (0.05,0) [0|50] ""  FR,ADS
 SG_ FR_OBJ19_Dx : 71|13@0+ (0.0625,-256) [-256|255.9375] "m"  FR,ADS
 SG_ FR_OBJ19_Dy_Vnce : 49|10@0+ (0.02,0) [0|20] "m2"  FR,ADS
 SG_ FR_OBJ19_Dy : 45|11@0+ (0.125,-128) [-128|127.875] "m"  FR,ADS
 SG_ FR_OBJ19_HeadingAngle : 38|9@0+ (0.01,-1.57) [-1.57|1.57] "rad"  FR,ADS
 SG_ FR_OBJ19_Length : 31|9@0+ (0.05,0) [0|25.5] "m"  FR,ADS
 SG_ FR_OBJ19_Height : 8|9@0+ (0.01,0) [0|5.11] "m"  FR,ADS
 SG_ FR_OBJ19_Width : 3|11@0+ (0.01,0) [0|12] "m"  FR,ADS
 SG_ FR_OBJ19_Class : 7|3@0+ (1,0) [0|7] ""  FR,ADS

BO_ 436 FR_1B4: 64 FR
 SG_ FC_RollingCounter_1B4 : 491|4@0+ (1,0) [0|15] ""  FR,ADS
 SG_ FC_CRCCheck_1B4 : 503|16@0+ (1,0) [0|65535] ""  FR,ADS
 SG_ FR_OBJ22_Track_Age : 479|8@0+ (1,0) [0|255] ""  FR,ADS
 SG_ FR_OBJ22_Track_ID : 460|8@0+ (1,0) [0|255] ""  FR,ADS
 SG_ FR_OBJ22_FusionedFC_Track_ID : 487|8@0+ (1,0) [0|255] ""  FR,ADS
 SG_ FR_OBJ22_fusion_Sts : 463|2@0+ (1,0) [0|3] ""  FR,ADS
 SG_ FR_OBJ22_ObstacleProb : 453|6@0+ (2,0) [0|100] "%"  FR,ADS
 SG_ FR_OBJ22_ExistProb : 445|6@0+ (2,0) [0|100] "%"  FR,ADS
 SG_ FR_OBJ22_Brakelight_Info : 447|1@0+ (1,0) [0|1] ""  FR,ADS
 SG_ FR_OBJ22_Taillight_Info : 434|3@0+ (1,0) [0|7] ""  FR,ADS
 SG_ FR_OBJ22_Dis_to_R_LaneMark : 428|9@0+ (0.01,0) [0|5] "m"  FR,ADS
 SG_ FR_OBJ22_Dis_to_L_LaneMark : 422|9@0+ (0.01,0) [0|5] "m"  FR,ADS
 SG_ FR_OBJ22_Ax : 401|10@0+ (0.03125,-16) [-16|15.96875] "m/s2"  FR,ADS
 SG_ FR_OBJ22_Ay : 394|9@0+ (0.0625,-16) [-16|15.9375] "m/s2"  FR,ADS
 SG_ FR_OBJ22_Vx_std : 391|12@0+ (0.0625,-128) [-128|127.9375] "m/s"  FR,ADS
 SG_ FR_OBJ22_Vx : 372|12@0+ (0.0625,-128) [-128|127.9375] "m/s"  FR,ADS
 SG_ FR_OBJ22_Vy_std : 367|10@0+ (0.125,-64) [-64|63.875] "m/s"  FR,ADS
 SG_ FR_OBJ22_Vy : 345|10@0+ (0.125,-64) [-64|63.875] "m/s"  FR,ADS
 SG_ FR_OBJ22_Dx_Vnce : 329|14@0+ (0.05,0) [0|50] ""  FR,ADS
 SG_ FR_OBJ22_Dx : 327|13@0+ (0.0625,-256) [-256|255.9375] "m"  FR,ADS
 SG_ FR_OBJ22_Dy_Vnce : 305|10@0+ (0.02,0) [0|20] "m2"  FR,ADS
 SG_ FR_OBJ22_Dy : 301|11@0+ (0.125,-128) [-128|127.875] "m"  FR,ADS
 SG_ FR_OBJ22_HeadingAngle : 294|9@0+ (0.01,-1.57) [-1.57|1.57] "rad"  FR,ADS
 SG_ FR_OBJ22_Length : 287|9@0+ (0.05,0) [0|25.5] "m"  FR,ADS
 SG_ FR_OBJ22_Height : 264|9@0+ (0.01,0) [0|5.11] "m"  FR,ADS
 SG_ FR_OBJ22_Width : 259|11@0+ (0.01,0) [0|12] "m"  FR,ADS
 SG_ FR_OBJ22_Class : 263|3@0+ (1,0) [0|7] ""  FR,ADS
 SG_ FR_OBJ21_Track_Age : 223|8@0+ (1,0) [0|255] ""  FR,ADS
 SG_ FR_OBJ21_Track_ID : 204|8@0+ (1,0) [0|255] ""  FR,ADS
 SG_ FR_OBJ21_FusionedFC_Track_ID : 231|8@0+ (1,0) [0|255] ""  FR,ADS
 SG_ FR_OBJ21_fusion_Sts : 207|2@0+ (1,0) [0|3] ""  FR,ADS
 SG_ FR_OBJ21_ObstacleProb : 197|6@0+ (2,0) [0|100] "%"  FR,ADS
 SG_ FR_OBJ21_ExistProb : 189|6@0+ (2,0) [0|100] "%"  FR,ADS
 SG_ FR_OBJ21_Brakelight_Info : 191|1@0+ (1,0) [0|1] ""  FR,ADS
 SG_ FR_OBJ21_Taillight_Info : 178|3@0+ (1,0) [0|7] ""  FR,ADS
 SG_ FR_OBJ21_Dis_to_R_LaneMark : 172|9@0+ (0.01,0) [0|5] "m"  FR,ADS
 SG_ FR_OBJ21_Dis_to_L_LaneMark : 166|9@0+ (0.01,0) [0|5] "m"  FR,ADS
 SG_ FR_OBJ21_Ax : 145|10@0+ (0.03125,-16) [-16|15.96875] "m/s2"  FR,ADS
 SG_ FR_OBJ21_Ay : 138|9@0+ (0.0625,-16) [-16|15.9375] "m/s2"  FR,ADS
 SG_ FR_OBJ21_Vx_std : 135|12@0+ (0.0625,-128) [-128|127.9375] "m/s"  FR,ADS
 SG_ FR_OBJ21_Vx : 116|12@0+ (0.0625,-128) [-128|127.9375] "m/s"  FR,ADS
 SG_ FR_OBJ21_Vy_std : 111|10@0+ (0.125,-64) [-64|63.875] "m/s"  FR,ADS
 SG_ FR_OBJ21_Vy : 89|10@0+ (0.125,-64) [-64|63.875] "m/s"  FR,ADS
 SG_ FR_OBJ21_Dx_Vnce : 73|14@0+ (0.05,0) [0|50] ""  FR,ADS
 SG_ FR_OBJ21_Dx : 71|13@0+ (0.0625,-256) [-256|255.9375] "m"  FR,ADS
 SG_ FR_OBJ21_Dy_Vnce : 49|10@0+ (0.02,0) [0|20] "m2"  FR,ADS
 SG_ FR_OBJ21_Dy : 45|11@0+ (0.125,-128) [-128|127.875] "m"  FR,ADS
 SG_ FR_OBJ21_HeadingAngle : 38|9@0+ (0.01,-1.57) [-1.57|1.57] "rad"  FR,ADS
 SG_ FR_OBJ21_Length : 31|9@0+ (0.05,0) [0|25.5] "m"  FR,ADS
 SG_ FR_OBJ21_Height : 8|9@0+ (0.01,0) [0|5.11] "m"  FR,ADS
 SG_ FR_OBJ21_Width : 3|11@0+ (0.01,0) [0|12] "m"  FR,ADS
 SG_ FR_OBJ21_Class : 7|3@0+ (1,0) [0|7] ""  FR,ADS

BO_ 437 FR_1B5: 64 FR
 SG_ FC_RollingCounter_1B5 : 491|4@0+ (1,0) [0|15] ""  FR,ADS
 SG_ FC_CRCCheck_1B5 : 503|16@0+ (1,0) [0|65535] ""  FR,ADS
 SG_ FR_OBJ24_Track_Age : 479|8@0+ (1,0) [0|255] ""  FR,ADS
 SG_ FR_OBJ24_Track_ID : 460|8@0+ (1,0) [0|255] ""  FR,ADS
 SG_ FR_OBJ24_FusionedFC_Track_ID : 487|8@0+ (1,0) [0|255] ""  FR,ADS
 SG_ FR_OBJ24_fusion_Sts : 463|2@0+ (1,0) [0|3] ""  FR,ADS
 SG_ FR_OBJ24_ObstacleProb : 453|6@0+ (2,0) [0|100] "%"  FR,ADS
 SG_ FR_OBJ24_ExistProb : 445|6@0+ (2,0) [0|100] "%"  FR,ADS
 SG_ FR_OBJ24_Brakelight_Info : 447|1@0+ (1,0) [0|1] ""  FR,ADS
 SG_ FR_OBJ24_Taillight_Info : 434|3@0+ (1,0) [0|7] ""  FR,ADS
 SG_ FR_OBJ24_Dis_to_R_LaneMark : 428|9@0+ (0.01,0) [0|5] "m"  FR,ADS
 SG_ FR_OBJ24_Dis_to_L_LaneMark : 422|9@0+ (0.01,0) [0|5] "m"  FR,ADS
 SG_ FR_OBJ24_Ax : 401|10@0+ (0.03125,-16) [-16|15.96875] "m/s2"  FR,ADS
 SG_ FR_OBJ24_Ay : 394|9@0+ (0.0625,-16) [-16|15.9375] "m/s2"  FR,ADS
 SG_ FR_OBJ24_Vx_std : 391|12@0+ (0.0625,-128) [-128|127.9375] "m/s"  FR,ADS
 SG_ FR_OBJ24_Vx : 372|12@0+ (0.0625,-128) [-128|127.9375] "m/s"  FR,ADS
 SG_ FR_OBJ24_Vy_std : 367|10@0+ (0.125,-64) [-64|63.875] "m/s"  FR,ADS
 SG_ FR_OBJ24_Vy : 345|10@0+ (0.125,-64) [-64|63.875] "m/s"  FR,ADS
 SG_ FR_OBJ24_Dx_Vnce : 329|14@0+ (0.05,0) [0|50] ""  FR,ADS
 SG_ FR_OBJ24_Dx : 327|13@0+ (0.0625,-256) [-256|255.9375] "m"  FR,ADS
 SG_ FR_OBJ24_Dy_Vnce : 305|10@0+ (0.02,0) [0|20] "m2"  FR,ADS
 SG_ FR_OBJ24_Dy : 301|11@0+ (0.125,-128) [-128|127.875] "m"  FR,ADS
 SG_ FR_OBJ24_HeadingAngle : 294|9@0+ (0.01,-1.57) [-1.57|1.57] "rad"  FR,ADS
 SG_ FR_OBJ24_Length : 287|9@0+ (0.05,0) [0|25.5] "m"  FR,ADS
 SG_ FR_OBJ24_Height : 264|9@0+ (0.01,0) [0|5.11] "m"  FR,ADS
 SG_ FR_OBJ24_Width : 259|11@0+ (0.01,0) [0|12] "m"  FR,ADS
 SG_ FR_OBJ24_Class : 263|3@0+ (1,0) [0|7] ""  FR,ADS
 SG_ FR_OBJ23_Track_Age : 223|8@0+ (1,0) [0|255] ""  FR,ADS
 SG_ FR_OBJ23_Track_ID : 204|8@0+ (1,0) [0|255] ""  FR,ADS
 SG_ FR_OBJ23_FusionedFC_Track_ID : 231|8@0+ (1,0) [0|255] ""  FR,ADS
 SG_ FR_OBJ23_fusion_Sts : 207|2@0+ (1,0) [0|3] ""  FR,ADS
 SG_ FR_OBJ23_ObstacleProb : 197|6@0+ (2,0) [0|100] "%"  FR,ADS
 SG_ FR_OBJ23_ExistProb : 189|6@0+ (2,0) [0|100] "%"  FR,ADS
 SG_ FR_OBJ23_Brakelight_Info : 191|1@0+ (1,0) [0|1] ""  FR,ADS
 SG_ FR_OBJ23_Taillight_Info : 178|3@0+ (1,0) [0|7] ""  FR,ADS
 SG_ FR_OBJ23_Dis_to_R_LaneMark : 172|9@0+ (0.01,0) [0|5] "m"  FR,ADS
 SG_ FR_OBJ23_Dis_to_L_LaneMark : 166|9@0+ (0.01,0) [0|5] "m"  FR,ADS
 SG_ FR_OBJ23_Ax : 145|10@0+ (0.03125,-16) [-16|15.96875] "m/s2"  FR,ADS
 SG_ FR_OBJ23_Ay : 138|9@0+ (0.0625,-16) [-16|15.9375] "m/s2"  FR,ADS
 SG_ FR_OBJ23_Vx_std : 135|12@0+ (0.0625,-128) [-128|127.9375] "m/s"  FR,ADS
 SG_ FR_OBJ23_Vx : 116|12@0+ (0.0625,-128) [-128|127.9375] "m/s"  FR,ADS
 SG_ FR_OBJ23_Vy_std : 111|10@0+ (0.125,-64) [-64|63.875] "m/s"  FR,ADS
 SG_ FR_OBJ23_Vy : 89|10@0+ (0.125,-64) [-64|63.875] "m/s"  FR,ADS
 SG_ FR_OBJ23_Dx_Vnce : 73|14@0+ (0.05,0) [0|50] ""  FR,ADS
 SG_ FR_OBJ23_Dx : 71|13@0+ (0.0625,-256) [-256|255.9375] "m"  FR,ADS
 SG_ FR_OBJ23_Dy_Vnce : 49|10@0+ (0.02,0) [0|20] "m2"  FR,ADS
 SG_ FR_OBJ23_Dy : 45|11@0+ (0.125,-128) [-128|127.875] "m"  FR,ADS
 SG_ FR_OBJ23_HeadingAngle : 38|9@0+ (0.01,-1.57) [-1.57|1.57] "rad"  FR,ADS
 SG_ FR_OBJ23_Length : 31|9@0+ (0.05,0) [0|25.5] "m"  FR,ADS
 SG_ FR_OBJ23_Height : 8|9@0+ (0.01,0) [0|5.11] "m"  FR,ADS
 SG_ FR_OBJ23_Width : 3|11@0+ (0.01,0) [0|12] "m"  FR,ADS
 SG_ FR_OBJ23_Class : 7|3@0+ (1,0) [0|7] ""  FR,ADS

BO_ 438 FR_1B6: 64 FR
 SG_ FC_RollingCounter_1B6 : 491|4@0+ (1,0) [0|15] ""  FR,ADS
 SG_ FC_CRCCheck_1B6 : 503|16@0+ (1,0) [0|65535] ""  FR,ADS
 SG_ FR_OBJ26_Track_Age : 479|8@0+ (1,0) [0|255] ""  FR,ADS
 SG_ FR_OBJ26_Track_ID : 460|8@0+ (1,0) [0|255] ""  FR,ADS
 SG_ FR_OBJ26_FusionedFC_Track_ID : 487|8@0+ (1,0) [0|255] ""  FR,ADS
 SG_ FR_OBJ26_fusion_Sts : 463|2@0+ (1,0) [0|3] ""  FR,ADS
 SG_ FR_OBJ26_ObstacleProb : 453|6@0+ (2,0) [0|100] "%"  FR,ADS
 SG_ FR_OBJ26_ExistProb : 445|6@0+ (2,0) [0|100] "%"  FR,ADS
 SG_ FR_OBJ26_Brakelight_Info : 447|1@0+ (1,0) [0|1] ""  FR,ADS
 SG_ FR_OBJ26_Taillight_Info : 434|3@0+ (1,0) [0|7] ""  FR,ADS
 SG_ FR_OBJ26_Dis_to_R_LaneMark : 428|9@0+ (0.01,0) [0|5] "m"  FR,ADS
 SG_ FR_OBJ26_Dis_to_L_LaneMark : 422|9@0+ (0.01,0) [0|5] "m"  FR,ADS
 SG_ FR_OBJ26_Ax : 401|10@0+ (0.03125,-16) [-16|15.96875] "m/s2"  FR,ADS
 SG_ FR_OBJ26_Ay : 394|9@0+ (0.0625,-16) [-16|15.9375] "m/s2"  FR,ADS
 SG_ FR_OBJ26_Vx_std : 391|12@0+ (0.0625,-128) [-128|127.9375] "m/s"  FR,ADS
 SG_ FR_OBJ26_Vx : 372|12@0+ (0.0625,-128) [-128|127.9375] "m/s"  FR,ADS
 SG_ FR_OBJ26_Vy_std : 367|10@0+ (0.125,-64) [-64|63.875] "m/s"  FR,ADS
 SG_ FR_OBJ26_Vy : 345|10@0+ (0.125,-64) [-64|63.875] "m/s"  FR,ADS
 SG_ FR_OBJ26_Dx_Vnce : 329|14@0+ (0.05,0) [0|50] ""  FR,ADS
 SG_ FR_OBJ26_Dx : 327|13@0+ (0.0625,-256) [-256|255.9375] "m"  FR,ADS
 SG_ FR_OBJ26_Dy_Vnce : 305|10@0+ (0.02,0) [0|20] "m2"  FR,ADS
 SG_ FR_OBJ26_Dy : 301|11@0+ (0.125,-128) [-128|127.875] "m"  FR,ADS
 SG_ FR_OBJ26_HeadingAngle : 294|9@0+ (0.01,-1.57) [-1.57|1.57] "rad"  FR,ADS
 SG_ FR_OBJ26_Length : 287|9@0+ (0.05,0) [0|25.5] "m"  FR,ADS
 SG_ FR_OBJ26_Height : 264|9@0+ (0.01,0) [0|5.11] "m"  FR,ADS
 SG_ FR_OBJ26_Width : 259|11@0+ (0.01,0) [0|12] "m"  FR,ADS
 SG_ FR_OBJ26_Class : 263|3@0+ (1,0) [0|7] ""  FR,ADS
 SG_ FR_OBJ25_Track_Age : 223|8@0+ (1,0) [0|255] ""  FR,ADS
 SG_ FR_OBJ25_Track_ID : 204|8@0+ (1,0) [0|255] ""  FR,ADS
 SG_ FR_OBJ25_FusionedFC_Track_ID : 231|8@0+ (1,0) [0|255] ""  FR,ADS
 SG_ FR_OBJ25_fusion_Sts : 207|2@0+ (1,0) [0|3] ""  FR,ADS
 SG_ FR_OBJ25_ObstacleProb : 197|6@0+ (2,0) [0|100] "%"  FR,ADS
 SG_ FR_OBJ25_ExistProb : 189|6@0+ (2,0) [0|100] "%"  FR,ADS
 SG_ FR_OBJ25_Brakelight_Info : 191|1@0+ (1,0) [0|1] ""  FR,ADS
 SG_ FR_OBJ25_Taillight_Info : 178|3@0+ (1,0) [0|7] ""  FR,ADS
 SG_ FR_OBJ25_Dis_to_R_LaneMark : 172|9@0+ (0.01,0) [0|5] "m"  FR,ADS
 SG_ FR_OBJ25_Dis_to_L_LaneMark : 166|9@0+ (0.01,0) [0|5] "m"  FR,ADS
 SG_ FR_OBJ25_Ax : 145|10@0+ (0.03125,-16) [-16|15.96875] "m/s2"  FR,ADS
 SG_ FR_OBJ25_Ay : 138|9@0+ (0.0625,-16) [-16|15.9375] "m/s2"  FR,ADS
 SG_ FR_OBJ25_Vx_std : 135|12@0+ (0.0625,-128) [-128|127.9375] "m/s"  FR,ADS
 SG_ FR_OBJ25_Vx : 116|12@0+ (0.0625,-128) [-128|127.9375] "m/s"  FR,ADS
 SG_ FR_OBJ25_Vy_std : 111|10@0+ (0.125,-64) [-64|63.875] "m/s"  FR,ADS
 SG_ FR_OBJ25_Vy : 89|10@0+ (0.125,-64) [-64|63.875] "m/s"  FR,ADS
 SG_ FR_OBJ25_Dx_Vnce : 73|14@0+ (0.05,0) [0|50] ""  FR,ADS
 SG_ FR_OBJ25_Dx : 71|13@0+ (0.0625,-256) [-256|255.9375] "m"  FR,ADS
 SG_ FR_OBJ25_Dy_Vnce : 49|10@0+ (0.02,0) [0|20] "m2"  FR,ADS
 SG_ FR_OBJ25_Dy : 45|11@0+ (0.125,-128) [-128|127.875] "m"  FR,ADS
 SG_ FR_OBJ25_HeadingAngle : 38|9@0+ (0.01,-1.57) [-1.57|1.57] "rad"  FR,ADS
 SG_ FR_OBJ25_Length : 31|9@0+ (0.05,0) [0|25.5] "m"  FR,ADS
 SG_ FR_OBJ25_Height : 8|9@0+ (0.01,0) [0|5.11] "m"  FR,ADS
 SG_ FR_OBJ25_Width : 3|11@0+ (0.01,0) [0|12] "m"  FR,ADS
 SG_ FR_OBJ25_Class : 7|3@0+ (1,0) [0|7] ""  FR,ADS

BO_ 439 FR_1B7: 64 FR
 SG_ FC_RollingCounter_1B7 : 491|4@0+ (1,0) [0|15] ""  FR,ADS
 SG_ FC_CRCCheck_1B7 : 503|16@0+ (1,0) [0|65535] ""  FR,ADS
 SG_ FR_OBJ28_Track_Age : 479|8@0+ (1,0) [0|255] ""  FR,ADS
 SG_ FR_OBJ28_Track_ID : 460|8@0+ (1,0) [0|255] ""  FR,ADS
 SG_ FR_OBJ28_FusionedFC_Track_ID : 487|8@0+ (1,0) [0|255] ""  FR,ADS
 SG_ FR_OBJ28_fusion_Sts : 463|2@0+ (1,0) [0|3] ""  FR,ADS
 SG_ FR_OBJ28_ObstacleProb : 453|6@0+ (2,0) [0|100] "%"  FR,ADS
 SG_ FR_OBJ28_ExistProb : 445|6@0+ (2,0) [0|100] "%"  FR,ADS
 SG_ FR_OBJ28_Brakelight_Info : 447|1@0+ (1,0) [0|1] ""  FR,ADS
 SG_ FR_OBJ28_Taillight_Info : 434|3@0+ (1,0) [0|7] ""  FR,ADS
 SG_ FR_OBJ28_Dis_to_R_LaneMark : 428|9@0+ (0.01,0) [0|5] "m"  FR,ADS
 SG_ FR_OBJ28_Dis_to_L_LaneMark : 422|9@0+ (0.01,0) [0|5] "m"  FR,ADS
 SG_ FR_OBJ28_Ax : 401|10@0+ (0.03125,-16) [-16|15.96875] "m/s2"  FR,ADS
 SG_ FR_OBJ28_Ay : 394|9@0+ (0.0625,-16) [-16|15.9375] "m/s2"  FR,ADS
 SG_ FR_OBJ28_Vx_std : 391|12@0+ (0.0625,-128) [-128|127.9375] "m/s"  FR,ADS
 SG_ FR_OBJ28_Vx : 372|12@0+ (0.0625,-128) [-128|127.9375] "m/s"  FR,ADS
 SG_ FR_OBJ28_Vy_std : 367|10@0+ (0.125,-64) [-64|63.875] "m/s"  FR,ADS
 SG_ FR_OBJ28_Vy : 345|10@0+ (0.125,-64) [-64|63.875] "m/s"  FR,ADS
 SG_ FR_OBJ28_Dx_Vnce : 329|14@0+ (0.05,0) [0|50] ""  FR,ADS
 SG_ FR_OBJ28_Dx : 327|13@0+ (0.0625,-256) [-256|255.9375] "m"  FR,ADS
 SG_ FR_OBJ28_Dy_Vnce : 305|10@0+ (0.02,0) [0|20] "m2"  FR,ADS
 SG_ FR_OBJ28_Dy : 301|11@0+ (0.125,-128) [-128|127.875] "m"  FR,ADS
 SG_ FR_OBJ28_HeadingAngle : 294|9@0+ (0.01,-1.57) [-1.57|1.57] "rad"  FR,ADS
 SG_ FR_OBJ28_Length : 287|9@0+ (0.05,0) [0|25.5] "m"  FR,ADS
 SG_ FR_OBJ28_Height : 264|9@0+ (0.01,0) [0|5.11] "m"  FR,ADS
 SG_ FR_OBJ28_Width : 259|11@0+ (0.01,0) [0|12] "m"  FR,ADS
 SG_ FR_OBJ28_Class : 263|3@0+ (1,0) [0|7] ""  FR,ADS
 SG_ FR_OBJ27_Track_Age : 223|8@0+ (1,0) [0|255] ""  FR,ADS
 SG_ FR_OBJ27_Track_ID : 204|8@0+ (1,0) [0|255] ""  FR,ADS
 SG_ FR_OBJ27_FusionedFC_Track_ID : 231|8@0+ (1,0) [0|255] ""  FR,ADS
 SG_ FR_OBJ27_fusion_Sts : 207|2@0+ (1,0) [0|3] ""  FR,ADS
 SG_ FR_OBJ27_ObstacleProb : 197|6@0+ (2,0) [0|100] "%"  FR,ADS
 SG_ FR_OBJ27_ExistProb : 189|6@0+ (2,0) [0|100] "%"  FR,ADS
 SG_ FR_OBJ27_Brakelight_Info : 191|1@0+ (1,0) [0|1] ""  FR,ADS
 SG_ FR_OBJ27_Taillight_Info : 178|3@0+ (1,0) [0|7] ""  FR,ADS
 SG_ FR_OBJ27_Dis_to_R_LaneMark : 172|9@0+ (0.01,0) [0|5] "m"  FR,ADS
 SG_ FR_OBJ27_Dis_to_L_LaneMark : 166|9@0+ (0.01,0) [0|5] "m"  FR,ADS
 SG_ FR_OBJ27_Ax : 145|10@0+ (0.03125,-16) [-16|15.96875] "m/s2"  FR,ADS
 SG_ FR_OBJ27_Ay : 138|9@0+ (0.0625,-16) [-16|15.9375] "m/s2"  FR,ADS
 SG_ FR_OBJ27_Vx_std : 135|12@0+ (0.0625,-128) [-128|127.9375] "m/s"  FR,ADS
 SG_ FR_OBJ27_Vx : 116|12@0+ (0.0625,-128) [-128|127.9375] "m/s"  FR,ADS
 SG_ FR_OBJ27_Vy_std : 111|10@0+ (0.125,-64) [-64|63.875] "m/s"  FR,ADS
 SG_ FR_OBJ27_Vy : 89|10@0+ (0.125,-64) [-64|63.875] "m/s"  FR,ADS
 SG_ FR_OBJ27_Dx_Vnce : 73|14@0+ (0.05,0) [0|50] ""  FR,ADS
 SG_ FR_OBJ27_Dx : 71|13@0+ (0.0625,-256) [-256|255.9375] "m"  FR,ADS
 SG_ FR_OBJ27_Dy_Vnce : 49|10@0+ (0.02,0) [0|20] "m2"  FR,ADS
 SG_ FR_OBJ27_Dy : 45|11@0+ (0.125,-128) [-128|127.875] "m"  FR,ADS
 SG_ FR_OBJ27_HeadingAngle : 38|9@0+ (0.01,-1.57) [-1.57|1.57] "rad"  FR,ADS
 SG_ FR_OBJ27_Length : 31|9@0+ (0.05,0) [0|25.5] "m"  FR,ADS
 SG_ FR_OBJ27_Height : 8|9@0+ (0.01,0) [0|5.11] "m"  FR,ADS
 SG_ FR_OBJ27_Width : 3|11@0+ (0.01,0) [0|12] "m"  FR,ADS
 SG_ FR_OBJ27_Class : 7|3@0+ (1,0) [0|7] ""  FR,ADS

BO_ 440 FR_1B8: 64 FR
 SG_ FC_RollingCounter_1B8 : 491|4@0+ (1,0) [0|15] ""  FR,ADS
 SG_ FC_CRCCheck_1B8 : 503|16@0+ (1,0) [0|65535] ""  FR,ADS
 SG_ FR_OBJ30_Track_Age : 479|8@0+ (1,0) [0|255] ""  FR,ADS
 SG_ FR_OBJ30_Track_ID : 460|8@0+ (1,0) [0|255] ""  FR,ADS
 SG_ FR_OBJ30_FusionedFC_Track_ID : 487|8@0+ (1,0) [0|255] ""  FR,ADS
 SG_ FR_OBJ30_fusion_Sts : 463|2@0+ (1,0) [0|3] ""  FR,ADS
 SG_ FR_OBJ30_ObstacleProb : 453|6@0+ (2,0) [0|100] "%"  FR,ADS
 SG_ FR_OBJ30_ExistProb : 445|6@0+ (2,0) [0|100] "%"  FR,ADS
 SG_ FR_OBJ30_Brakelight_Info : 447|1@0+ (1,0) [0|1] ""  FR,ADS
 SG_ FR_OBJ30_Taillight_Info : 434|3@0+ (1,0) [0|7] ""  FR,ADS
 SG_ FR_OBJ30_Dis_to_R_LaneMark : 428|9@0+ (0.01,0) [0|5] "m"  FR,ADS
 SG_ FR_OBJ30_Dis_to_L_LaneMark : 422|9@0+ (0.01,0) [0|5] "m"  FR,ADS
 SG_ FR_OBJ30_Ax : 401|10@0+ (0.03125,-16) [-16|15.96875] "m/s2"  FR,ADS
 SG_ FR_OBJ30_Ay : 394|9@0+ (0.0625,-16) [-16|15.9375] "m/s2"  FR,ADS
 SG_ FR_OBJ30_Vx_std : 391|12@0+ (0.0625,-128) [-128|127.9375] "m/s"  FR,ADS
 SG_ FR_OBJ30_Vx : 372|12@0+ (0.0625,-128) [-128|127.9375] "m/s"  FR,ADS
 SG_ FR_OBJ30_Vy_std : 367|10@0+ (0.125,-64) [-64|63.875] "m/s"  FR,ADS
 SG_ FR_OBJ30_Vy : 345|10@0+ (0.125,-64) [-64|63.875] "m/s"  FR,ADS
 SG_ FR_OBJ30_Dx_Vnce : 329|14@0+ (0.05,0) [0|50] ""  FR,ADS
 SG_ FR_OBJ30_Dx : 327|13@0+ (0.0625,-256) [-256|255.9375] "m"  FR,ADS
 SG_ FR_OBJ30_Dy_Vnce : 305|10@0+ (0.02,0) [0|20] "m2"  FR,ADS
 SG_ FR_OBJ30_Dy : 301|11@0+ (0.125,-128) [-128|127.875] "m"  FR,ADS
 SG_ FR_OBJ30_HeadingAngle : 294|9@0+ (0.01,-1.57) [-1.57|1.57] "rad"  FR,ADS
 SG_ FR_OBJ30_Length : 287|9@0+ (0.05,0) [0|25.5] "m"  FR,ADS
 SG_ FR_OBJ30_Height : 264|9@0+ (0.01,0) [0|5.11] "m"  FR,ADS
 SG_ FR_OBJ30_Width : 259|11@0+ (0.01,0) [0|12] "m"  FR,ADS
 SG_ FR_OBJ30_Class : 263|3@0+ (1,0) [0|7] ""  FR,ADS
 SG_ FR_OBJ29_Track_Age : 223|8@0+ (1,0) [0|255] ""  FR,ADS
 SG_ FR_OBJ29_Track_ID : 204|8@0+ (1,0) [0|255] ""  FR,ADS
 SG_ FR_OBJ29_FusionedFC_Track_ID : 231|8@0+ (1,0) [0|255] ""  FR,ADS
 SG_ FR_OBJ29_fusion_Sts : 207|2@0+ (1,0) [0|3] ""  FR,ADS
 SG_ FR_OBJ29_ObstacleProb : 197|6@0+ (2,0) [0|100] "%"  FR,ADS
 SG_ FR_OBJ29_ExistProb : 189|6@0+ (2,0) [0|100] "%"  FR,ADS
 SG_ FR_OBJ29_Brakelight_Info : 191|1@0+ (1,0) [0|1] ""  FR,ADS
 SG_ FR_OBJ29_Taillight_Info : 178|3@0+ (1,0) [0|7] ""  FR,ADS
 SG_ FR_OBJ29_Dis_to_R_LaneMark : 172|9@0+ (0.01,0) [0|5] "m"  FR,ADS
 SG_ FR_OBJ29_Dis_to_L_LaneMark : 166|9@0+ (0.01,0) [0|5] "m"  FR,ADS
 SG_ FR_OBJ29_Ax : 145|10@0+ (0.03125,-16) [-16|15.96875] "m/s2"  FR,ADS
 SG_ FR_OBJ29_Ay : 138|9@0+ (0.0625,-16) [-16|15.9375] "m/s2"  FR,ADS
 SG_ FR_OBJ29_Vx_std : 135|12@0+ (0.0625,-128) [-128|127.9375] "m/s"  FR,ADS
 SG_ FR_OBJ29_Vx : 116|12@0+ (0.0625,-128) [-128|127.9375] "m/s"  FR,ADS
 SG_ FR_OBJ29_Vy_std : 111|10@0+ (0.125,-64) [-64|63.875] "m/s"  FR,ADS
 SG_ FR_OBJ29_Vy : 89|10@0+ (0.125,-64) [-64|63.875] "m/s"  FR,ADS
 SG_ FR_OBJ29_Dx_Vnce : 73|14@0+ (0.05,0) [0|50] ""  FR,ADS
 SG_ FR_OBJ29_Dx : 71|13@0+ (0.0625,-256) [-256|255.9375] "m"  FR,ADS
 SG_ FR_OBJ29_Dy_Vnce : 49|10@0+ (0.02,0) [0|20] "m2"  FR,ADS
 SG_ FR_OBJ29_Dy : 45|11@0+ (0.125,-128) [-128|127.875] "m"  FR,ADS
 SG_ FR_OBJ29_HeadingAngle : 38|9@0+ (0.01,-1.57) [-1.57|1.57] "rad"  FR,ADS
 SG_ FR_OBJ29_Length : 31|9@0+ (0.05,0) [0|25.5] "m"  FR,ADS
 SG_ FR_OBJ29_Height : 8|9@0+ (0.01,0) [0|5.11] "m"  FR,ADS
 SG_ FR_OBJ29_Width : 3|11@0+ (0.01,0) [0|12] "m"  FR,ADS
 SG_ FR_OBJ29_Class : 7|3@0+ (1,0) [0|7] ""  FR,ADS

BO_ 441 FR_1B9: 64 FR
 SG_ FC_RollingCounter_1B9 : 491|4@0+ (1,0) [0|15] ""  FR,ADS
 SG_ FC_CRCCheck_1B9 : 503|16@0+ (1,0) [0|65535] ""  FR,ADS
 SG_ FR_OBJ32_Track_Age : 479|8@0+ (1,0) [0|255] ""  FR,ADS
 SG_ FR_OBJ32_Track_ID : 460|8@0+ (1,0) [0|255] ""  FR,ADS
 SG_ FR_OBJ32_FusionedFC_Track_ID : 487|8@0+ (1,0) [0|255] ""  FR,ADS
 SG_ FR_OBJ32_fusion_Sts : 463|2@0+ (1,0) [0|3] ""  FR,ADS
 SG_ FR_OBJ32_ObstacleProb : 453|6@0+ (2,0) [0|100] "%"  FR,ADS
 SG_ FR_OBJ32_ExistProb : 445|6@0+ (2,0) [0|100] "%"  FR,ADS
 SG_ FR_OBJ32_Brakelight_Info : 447|1@0+ (1,0) [0|1] ""  FR,ADS
 SG_ FR_OBJ32_Taillight_Info : 434|3@0+ (1,0) [0|7] ""  FR,ADS
 SG_ FR_OBJ32_Dis_to_R_LaneMark : 428|9@0+ (0.01,0) [0|5] "m"  FR,ADS
 SG_ FR_OBJ32_Dis_to_L_LaneMark : 422|9@0+ (0.01,0) [0|5] "m"  FR,ADS
 SG_ FR_OBJ32_Ax : 401|10@0+ (0.03125,-16) [-16|15.96875] "m/s2"  FR,ADS
 SG_ FR_OBJ32_Ay : 394|9@0+ (0.0625,-16) [-16|15.9375] "m/s2"  FR,ADS
 SG_ FR_OBJ32_Vx_std : 391|12@0+ (0.0625,-128) [-128|127.9375] "m/s"  FR,ADS
 SG_ FR_OBJ32_Vx : 372|12@0+ (0.0625,-128) [-128|127.9375] "m/s"  FR,ADS
 SG_ FR_OBJ32_Vy_std : 367|10@0+ (0.125,-64) [-64|63.875] "m/s"  FR,ADS
 SG_ FR_OBJ32_Vy : 345|10@0+ (0.125,-64) [-64|63.875] "m/s"  FR,ADS
 SG_ FR_OBJ32_Dx_Vnce : 329|14@0+ (0.05,0) [0|50] ""  FR,ADS
 SG_ FR_OBJ32_Dx : 327|13@0+ (0.0625,-256) [-256|255.9375] "m"  FR,ADS
 SG_ FR_OBJ32_Dy_Vnce : 305|10@0+ (0.02,0) [0|20] "m2"  FR,ADS
 SG_ FR_OBJ32_Dy : 301|11@0+ (0.125,-128) [-128|127.875] "m"  FR,ADS
 SG_ FR_OBJ32_HeadingAngle : 294|9@0+ (0.01,-1.57) [-1.57|1.57] "rad"  FR,ADS
 SG_ FR_OBJ32_Length : 287|9@0+ (0.05,0) [0|25.5] "m"  FR,ADS
 SG_ FR_OBJ32_Height : 264|9@0+ (0.01,0) [0|5.11] "m"  FR,ADS
 SG_ FR_OBJ32_Width : 259|11@0+ (0.01,0) [0|12] "m"  FR,ADS
 SG_ FR_OBJ32_Class : 263|3@0+ (1,0) [0|7] ""  FR,ADS
 SG_ FR_OBJ31_Track_Age : 223|8@0+ (1,0) [0|255] ""  FR,ADS
 SG_ FR_OBJ31_Track_ID : 204|8@0+ (1,0) [0|255] ""  FR,ADS
 SG_ FR_OBJ31_FusionedFC_Track_ID : 231|8@0+ (1,0) [0|255] ""  FR,ADS
 SG_ FR_OBJ31_fusion_Sts : 207|2@0+ (1,0) [0|3] ""  FR,ADS
 SG_ FR_OBJ31_ObstacleProb : 197|6@0+ (2,0) [0|100] "%"  FR,ADS
 SG_ FR_OBJ31_ExistProb : 189|6@0+ (2,0) [0|100] "%"  FR,ADS
 SG_ FR_OBJ31_Brakelight_Info : 191|1@0+ (1,0) [0|1] ""  FR,ADS
 SG_ FR_OBJ31_Taillight_Info : 178|3@0+ (1,0) [0|7] ""  FR,ADS
 SG_ FR_OBJ31_Dis_to_R_LaneMark : 172|9@0+ (0.01,0) [0|5] "m"  FR,ADS
 SG_ FR_OBJ31_Dis_to_L_LaneMark : 166|9@0+ (0.01,0) [0|5] "m"  FR,ADS
 SG_ FR_OBJ31_Ax : 145|10@0+ (0.03125,-16) [-16|15.96875] "m/s2"  FR,ADS
 SG_ FR_OBJ31_Ay : 138|9@0+ (0.0625,-16) [-16|15.9375] "m/s2"  FR,ADS
 SG_ FR_OBJ31_Vx_std : 135|12@0+ (0.0625,-128) [-128|127.9375] "m/s"  FR,ADS
 SG_ FR_OBJ31_Vx : 116|12@0+ (0.0625,-128) [-128|127.9375] "m/s"  FR,ADS
 SG_ FR_OBJ31_Vy_std : 111|10@0+ (0.125,-64) [-64|63.875] "m/s"  FR,ADS
 SG_ FR_OBJ31_Vy : 89|10@0+ (0.125,-64) [-64|63.875] "m/s"  FR,ADS
 SG_ FR_OBJ31_Dx_Vnce : 73|14@0+ (0.05,0) [0|50] ""  FR,ADS
 SG_ FR_OBJ31_Dx : 71|13@0+ (0.0625,-256) [-256|255.9375] "m"  FR,ADS
 SG_ FR_OBJ31_Dy_Vnce : 49|10@0+ (0.02,0) [0|20] "m2"  FR,ADS
 SG_ FR_OBJ31_Dy : 45|11@0+ (0.125,-128) [-128|127.875] "m"  FR,ADS
 SG_ FR_OBJ31_HeadingAngle : 38|9@0+ (0.01,-1.57) [-1.57|1.57] "rad"  FR,ADS
 SG_ FR_OBJ31_Length : 31|9@0+ (0.05,0) [0|25.5] "m"  FR,ADS
 SG_ FR_OBJ31_Height : 8|9@0+ (0.01,0) [0|5.11] "m"  FR,ADS
 SG_ FR_OBJ31_Width : 3|11@0+ (0.01,0) [0|12] "m"  FR,ADS
 SG_ FR_OBJ31_Class : 7|3@0+ (1,0) [0|7] ""  FR,ADS

BO_ 442 FR_1BA: 64 FR
 SG_ FC_RollingCounter_1BA : 491|4@0+ (1,0) [0|15] ""  FR,ADS
 SG_ FC_CRCCheck_1BA : 503|16@0+ (1,0) [0|65535] ""  FR,ADS
 SG_ FR_RightGuardrail_dy : 39|12@0+ (0.015625,-32) [-32|31.984375] "m"  FR,ADS
 SG_ FR_RightGuardrailConfidence : 31|6@0+ (2,0) [0|100] "%"  FR,ADS
 SG_ FR_LeftGuardrail_dy : 15|12@0+ (0.015625,-32) [-32|31.984375] "m"  FR,ADS
 SG_ FR_LeftGuardrailConfidence : 7|6@0+ (2,0) [0|100] "%"  FR,ADS

BO_ 443 FR_1BB: 64 FR
 SG_ FC_RollingCounter_1BB : 491|4@0+ (1,0) [0|15] ""  FR,ADS
 SG_ FC_CRCCheck_1BB : 503|16@0+ (1,0) [0|65535] ""  FR,ADS
 SG_ FR_AEBEnable : 124|1@0+ (1,0) [0|1] ""  FR,ADS
 SG_ FR_FCWSettingStatus : 122|3@0+ (1,0) [0|7] ""  FR,ADS
 SG_ FR_FCWPreWarning : 111|1@0+ (1,0) [0|1] ""  FR,ADS
 SG_ FR_FCWLatentWarning : 96|1@0+ (1,0) [0|1] ""  FR,ADS
 SG_ FR_FCWActive : 97|1@0+ (1,0) [0|1] ""  FR,ADS
 SG_ FR_FCWStatus : 99|2@0+ (1,0) [0|3] ""  FR,ADS
 SG_ FR_AEBTargetLatRange : 94|10@0+ (0.1,-50) [-50|50] "m"  FR,ADS
 SG_ FR_AEBTargetLngRange : 72|9@0+ (0.5,-70) [-70|180] "m"  FR,ADS
 SG_ FR_AEBTargetDetection : 73|1@0+ (1,0) [0|1] ""  FR,ADS
 SG_ FR_AEBTargetType : 78|4@0+ (1,0) [0|15] ""  FR,ADS
 SG_ FR_AEBTargetRelSpeed : 71|9@0+ (1,-250) [-250|250] "km/h"  FR,ADS
 SG_ FR_AEBTextInfo : 59|4@0+ (1,0) [0|15] ""  FR,ADS
 SG_ FR_AEBStatus : 62|2@0+ (1,0) [0|3] ""  FR,ADS
 SG_ FR_ABAActive : 48|1@0+ (1,0) [0|1] ""  FR,ADS
 SG_ FR_ABAlevel : 50|2@0+ (1,0) [0|3] ""  FR,ADS
 SG_ FR_AWBActive : 51|1@0+ (1,0) [0|1] ""  FR,ADS
 SG_ FR_AWBlevel : 55|4@0+ (1,0) [0|15] ""  FR,ADS
 SG_ FR_PrefillActive : 40|1@0+ (1,0) [0|1] ""  FR,ADS
 SG_ FR_AEBVehilceHoldReq : 42|1@0+ (1,0) [0|1] ""  FR,ADS
 SG_ FR_AEBCtrlType : 47|4@0+ (1,0) [0|15] ""  FR,ADS
 SG_ FR_AEBTargetDeceleration : 31|16@0+ (0.0005,-16) [-16|16] "m/s2"  FR,ADS
 SG_ FR_AEBActive : 16|1@0+ (1,0) [0|1] ""  FR,ADS
 SG_ FR_AEBTargetmode : 19|2@0+ (1,0) [0|3] ""  FR,ADS
 SG_ FR_OBJ_TTC : 15|11@0+ (0.008,-8) [-8|8] "s"  FR,ADS
 SG_ FR_OBJ_AEB_ID : 7|8@0+ (1,0) [0|255] ""  FR,ADS

BO_ 444 FR_1BC: 64 FR
 SG_ FC_RollingCounter_1BC : 491|4@0+ (1,0) [0|15] ""  FR,ADS
 SG_ FC_CRCCheck_1BC : 503|16@0+ (1,0) [0|65535] ""  FR,ADS
 SG_ FR_LKATakeoverReq : 0|1@0+ (1,0) [0|1] ""  FR,ADS
 SG_ FR_LKAStatus : 7|2@0+ (1,0) [0|3] ""  FR,ADS
 SG_ FR_LDWVibrationWarningReq : 11|2@0+ (1,0) [0|3] ""  FR,ADS
 SG_ FR_LDWStatus : 13|2@0+ (1,0) [0|3] ""  FR,ADS

BO_ 445 FR_1BD: 64 FR
 SG_ FC_RollingCounter_1BD : 491|4@0+ (1,0) [0|15] ""  FR,ADS
 SG_ FC_CRCCheck_1BD : 503|16@0+ (1,0) [0|65535] ""  FR,ADS
 SG_ FR_LatAngReqActive : 31|1@0+ (1,0) [0|1] ""  FR,ADS
 SG_ FR_LatAngReq : 29|14@0+ (0.1,-720) [-720|720] "degree"  FR,ADS
 SG_ FR_MotorTorqueMinLimitRequest : 10|11@0+ (0.02,-20.48) [-20.48|20.46] "Nm"  FR,ADS
 SG_ FR_MotorTorqueMaxLimitRequest : 7|11@0+ (0.02,-20.48) [-20.48|20.46] "Nm"  FR,ADS

BO_ 446 FR_1BE: 64 FR
 SG_ FC_RollingCounter_1BE : 491|4@0+ (1,0) [0|15] ""  FR,ADS
 SG_ FC_CRCCheck_1BE : 503|16@0+ (1,0) [0|65535] ""  FR,ADS
 SG_ FR_ELKEnableStatus : 12|1@0+ (1,0) [0|1] ""  ADS,ACC,GW,BDC,HU,IP
 SG_ FR_RadarFailureStatus : 4|2@0+ (1,0) [0|3] ""  ADS,ACC,GW,BDC,IP
 SG_ FR_FRadarCalibrationStatus : 7|2@0+ (1,0) [0|3] ""  FR,ADS
 SG_ FR_HostLaneLeftStatus : 27|4@0+ (1,0) [15|15] ""  FR,ADS
 SG_ FR_HostLaneRightStatus : 31|4@0+ (1,0) [0|15] ""  FR,ADS
 SG_ FR_Voiceinfo : 23|5@0+ (1,0) [0|31] ""  FR,ADS
 SG_ FR_ELKInterventionMode : 10|2@0+ (1,0) [0|3] ""  FR,ADS
 SG_ FR_ELKMode : 15|3@0+ (1,0) [0|7] ""  FR,ADS
 SG_ FR_LDWShakeLevStatus : 47|2@0+ (1,0) [0|3] ""  FR,ADS
 SG_ FR_LASWarningModeSelectionSts : 34|3@0+ (1,0) [0|7] ""  FR,ADS
 SG_ FR_LASModeSelectionStatus : 38|3@0+ (1,0) [0|7] ""  FR,ADS

BO_ 448 ADS_1C0: 64 ADS
 SG_ ADS_UDLCStatus : 15|4@0+ (1,0) [0|15] ""  FC,FR,ADS
 SG_ ADS_IACCHWAMode : 6|3@0+ (1,0) [0|7] ""  FC,FR,ADS

BO_ 449 FR_1C1: 64 FR
 SG_ FC_RollingCounter_1C1 : 491|4@0+ (1,0) [0|15] ""  FR,ADS
 SG_ FC_CRCCheck_1C1 : 503|16@0+ (1,0) [0|65535] ""  FR,ADS
 SG_ FR_OBJ2_Track_Age : 479|8@0+ (1,0) [0|255] ""  FR,ADS
 SG_ FR_OBJ2_Track_ID : 460|8@0+ (1,0) [0|255] ""  FR,ADS
 SG_ FR_OBJ2_FusionedFC_Track_ID : 487|8@0+ (1,0) [0|255] ""  FR,ADS
 SG_ FR_OBJ2_fusion_Sts : 463|2@0+ (1,0) [0|3] ""  FR,ADS
 SG_ FR_OBJ2_ObstacleProb : 453|6@0+ (2,0) [0|100] "%"  FR,ADS
 SG_ FR_OBJ2_ExistProb : 445|6@0+ (2,0) [0|100] "%"  FR,ADS
 SG_ FR_OBJ2_Brakelight_Info : 447|1@0+ (1,0) [0|1] ""  FR,ADS
 SG_ FR_OBJ2_Taillight_Info : 434|3@0+ (1,0) [0|7] ""  FR,ADS
 SG_ FR_OBJ2_Dis_to_R_LaneMark : 428|9@0+ (0.01,0) [0|5] "m"  FR,ADS
 SG_ FR_OBJ2_Dis_to_L_LaneMark : 422|9@0+ (0.01,0) [0|5] "m"  FR,ADS
 SG_ FR_OBJ2_Ax : 401|10@0+ (0.03125,-16) [-16|15.96875] "m/s2"  FR,ADS
 SG_ FR_OBJ2_Ay : 394|9@0+ (0.0625,-16) [-16|15.9375] "m/s2"  FR,ADS
 SG_ FR_OBJ2_Vx_std : 391|12@0+ (0.0625,-128) [-128|127.9375] "m/s"  FR,ADS
 SG_ FR_OBJ2_Vx : 372|12@0+ (0.0625,-128) [-128|127.9375] "m/s"  FR,ADS
 SG_ FR_OBJ2_Vy_std : 367|10@0+ (0.125,-64) [-64|63.875] "m/s"  FR,ADS
 SG_ FR_OBJ2_Vy : 345|10@0+ (0.125,-64) [-64|63.875] "m/s"  FR,ADS
 SG_ FR_OBJ2_Dx_Vnce : 329|14@0+ (0.05,0) [0|50] ""  FR,ADS
 SG_ FR_OBJ2_Dx : 327|13@0+ (0.0625,-256) [-256|255.9375] "m"  FR,ADS
 SG_ FR_OBJ2_Dy_Vnce : 305|10@0+ (0.02,0) [0|20] "m2"  FR,ADS
 SG_ FR_OBJ2_Dy : 301|11@0+ (0.125,-128) [-128|127.875] "m"  FR,ADS
 SG_ FR_OBJ2_HeadingAngle : 294|9@0+ (0.01,-1.57) [-1.57|1.57] "rad"  FR,ADS
 SG_ FR_OBJ2_Length : 287|9@0+ (0.05,0) [0|25.5] "m"  FR,ADS
 SG_ FR_OBJ2_Height : 264|9@0+ (0.01,0) [0|5.11] "m"  FR,ADS
 SG_ FR_OBJ2_Width : 259|11@0+ (0.01,0) [0|12] "m"  FR,ADS
 SG_ FR_OBJ2_Class : 263|3@0+ (1,0) [0|7] ""  FR,ADS
 SG_ FR_OBJ1_Track_Age : 223|8@0+ (1,0) [0|255] ""  FR,ADS
 SG_ FR_OBJ1_Track_ID : 204|8@0+ (1,0) [0|255] ""  FR,ADS
 SG_ FR_OBJ1_FusionedFC_Track_ID : 231|8@0+ (1,0) [0|255] ""  FR,ADS
 SG_ FR_OBJ1_fusion_Sts : 207|2@0+ (1,0) [0|3] ""  FR,ADS
 SG_ FR_OBJ1_ObstacleProb : 197|6@0+ (2,0) [0|100] "%"  FR,ADS
 SG_ FR_OBJ1_ExistProb : 189|6@0+ (2,0) [0|100] "%"  FR,ADS
 SG_ FR_OBJ1_Brakelight_Info : 191|1@0+ (1,0) [0|1] ""  FR,ADS
 SG_ FR_OBJ1_Taillight_Info : 178|3@0+ (1,0) [0|7] ""  FR,ADS
 SG_ FR_OBJ1_Dis_to_R_LaneMark : 172|9@0+ (0.01,0) [0|5] "m"  FR,ADS
 SG_ FR_OBJ1_Dis_to_L_LaneMark : 166|9@0+ (0.01,0) [0|5] "m"  FR,ADS
 SG_ FR_OBJ1_Ax : 145|10@0+ (0.03125,-16) [-16|15.96875] "m/s2"  FR,ADS
 SG_ FR_OBJ1_Ay : 138|9@0+ (0.0625,-16) [-16|15.9375] "m/s2"  FR,ADS
 SG_ FR_OBJ1_Vx_std : 135|12@0+ (0.0625,-128) [-128|127.9375] "m/s"  FR,ADS
 SG_ FR_OBJ1_Vx : 116|12@0+ (0.0625,-128) [-128|127.9375] "m/s"  FR,ADS
 SG_ FR_OBJ1_Vy_std : 111|10@0+ (0.125,-64) [-64|63.875] "m/s"  FR,ADS
 SG_ FR_OBJ1_Vy : 89|10@0+ (0.125,-64) [-64|63.875] "m/s"  FR,ADS
 SG_ FR_OBJ1_Dx_Vnce : 73|14@0+ (0.05,0) [0|50] "m2"  FR,ADS
 SG_ FR_OBJ1_Dx : 71|13@0+ (0.0625,-256) [-256|255.9375] "m"  FR,ADS
 SG_ FR_OBJ1_Dy_Vnce : 49|10@0+ (0.02,0) [0|20] "m2"  FR,ADS
 SG_ FR_OBJ1_Dy : 45|11@0+ (0.125,-128) [-128|127.875] "m"  FR,ADS
 SG_ FR_OBJ1_HeadingAngle : 38|9@0+ (0.01,-1.57) [-1.57|1.57] "rad"  FR,ADS
 SG_ FR_OBJ1_Length : 31|9@0+ (0.05,0) [0|25.5] "m"  FR,ADS
 SG_ FR_OBJ1_Height : 8|9@0+ (0.01,0) [0|5.11] "m"  FR,ADS
 SG_ FR_OBJ1_Width : 3|11@0+ (0.01,0) [0|12] "m"  FR,ADS
 SG_ FR_OBJ1_Class : 7|3@0+ (1,0) [0|7] ""  FR,ADS

BO_ 450 FR_1C2: 64 FR
 SG_ FC_RollingCounter_1C2 : 491|4@0+ (1,0) [0|15] ""  FR,ADS
 SG_ FC_CRCCheck_1C2 : 503|16@0+ (1,0) [0|65535] ""  FR,ADS
 SG_ FR_OBJ4_Track_Age : 479|8@0+ (1,0) [0|255] ""  FR,ADS
 SG_ FR_OBJ4_Track_ID : 460|8@0+ (1,0) [0|255] ""  FR,ADS
 SG_ FR_OBJ4_FusionedFC_Track_ID : 487|8@0+ (1,0) [0|255] ""  FR,ADS
 SG_ FR_OBJ4_fusion_Sts : 463|2@0+ (1,0) [0|3] ""  FR,ADS
 SG_ FR_OBJ4_ObstacleProb : 453|6@0+ (2,0) [0|100] "%"  FR,ADS
 SG_ FR_OBJ4_ExistProb : 445|6@0+ (2,0) [0|100] "%"  FR,ADS
 SG_ FR_OBJ4_Brakelight_Info : 447|1@0+ (1,0) [0|1] ""  FR,ADS
 SG_ FR_OBJ4_Taillight_Info : 434|3@0+ (1,0) [0|7] ""  FR,ADS
 SG_ FR_OBJ4_Dis_to_R_LaneMark : 428|9@0+ (0.01,0) [0|5] "m"  FR,ADS
 SG_ FR_OBJ4_Dis_to_L_LaneMark : 422|9@0+ (0.01,0) [0|5] "m"  FR,ADS
 SG_ FR_OBJ4_Ax : 401|10@0+ (0.03125,-16) [-16|15.96875] "m/s2"  FR,ADS
 SG_ FR_OBJ4_Ay : 394|9@0+ (0.0625,-16) [-16|15.9375] "m/s2"  FR,ADS
 SG_ FR_OBJ4_Vx_std : 391|12@0+ (0.0625,-128) [-128|127.9375] "m/s"  FR,ADS
 SG_ FR_OBJ4_Vx : 372|12@0+ (0.0625,-128) [-128|127.9375] "m/s"  FR,ADS
 SG_ FR_OBJ4_Vy_std : 367|10@0+ (0.125,-64) [-64|63.875] "m/s"  FR,ADS
 SG_ FR_OBJ4_Vy : 345|10@0+ (0.125,-64) [-64|63.875] "m/s"  FR,ADS
 SG_ FR_OBJ4_Dx_Vnce : 329|14@0+ (0.05,0) [0|50] ""  FR,ADS
 SG_ FR_OBJ4_Dx : 327|13@0+ (0.0625,-256) [-256|255.9375] "m"  FR,ADS
 SG_ FR_OBJ4_Dy_Vnce : 305|10@0+ (0.02,0) [0|20] "m2"  FR,ADS
 SG_ FR_OBJ4_Dy : 301|11@0+ (0.125,-128) [-128|127.875] "m"  FR,ADS
 SG_ FR_OBJ4_HeadingAngle : 294|9@0+ (0.01,-1.57) [-1.57|1.57] "rad"  FR,ADS
 SG_ FR_OBJ4_Length : 287|9@0+ (0.05,0) [0|25.5] "m"  FR,ADS
 SG_ FR_OBJ4_Height : 264|9@0+ (0.01,0) [0|5.11] "m"  FR,ADS
 SG_ FR_OBJ4_Width : 259|11@0+ (0.01,0) [0|12] "m"  FR,ADS
 SG_ FR_OBJ4_Class : 263|3@0+ (1,0) [0|7] ""  FR,ADS
 SG_ FR_OBJ3_Track_Age : 223|8@0+ (1,0) [0|255] ""  FR,ADS
 SG_ FR_OBJ3_Track_ID : 204|8@0+ (1,0) [0|255] ""  FR,ADS
 SG_ FR_OBJ3_FusionedFC_Track_ID : 231|8@0+ (1,0) [0|255] ""  FR,ADS
 SG_ FR_OBJ3_fusion_Sts : 207|2@0+ (1,0) [0|3] ""  FR,ADS
 SG_ FR_OBJ3_ObstacleProb : 197|6@0+ (2,0) [0|100] "%"  FR,ADS
 SG_ FR_OBJ3_ExistProb : 189|6@0+ (2,0) [0|100] "%"  FR,ADS
 SG_ FR_OBJ3_Brakelight_Info : 191|1@0+ (1,0) [0|1] ""  FR,ADS
 SG_ FR_OBJ3_Taillight_Info : 178|3@0+ (1,0) [0|7] ""  FR,ADS
 SG_ FR_OBJ3_Dis_to_R_LaneMark : 172|9@0+ (0.01,0) [0|5] "m"  FR,ADS
 SG_ FR_OBJ3_Dis_to_L_LaneMark : 166|9@0+ (0.01,0) [0|5] "m"  FR,ADS
 SG_ FR_OBJ3_Ax : 145|10@0+ (0.03125,-16) [-16|15.96875] "m/s2"  FR,ADS
 SG_ FR_OBJ3_Ay : 138|9@0+ (0.0625,-16) [-16|15.9375] "m/s2"  FR,ADS
 SG_ FR_OBJ3_Vx_std : 135|12@0+ (0.0625,-128) [-128|127.9375] "m/s"  FR,ADS
 SG_ FR_OBJ3_Vx : 116|12@0+ (0.0625,-128) [-128|127.9375] "m/s"  FR,ADS
 SG_ FR_OBJ3_Vy_std : 111|10@0+ (0.125,-64) [-64|63.875] "m/s"  FR,ADS
 SG_ FR_OBJ3_Vy : 89|10@0+ (0.125,-64) [-64|63.875] "m/s"  FR,ADS
 SG_ FR_OBJ3_Dx_Vnce : 73|14@0+ (0.05,0) [0|50] ""  FR,ADS
 SG_ FR_OBJ3_Dx : 71|13@0+ (0.0625,-256) [-256|255.9375] "m"  FR,ADS
 SG_ FR_OBJ3_Dy_Vnce : 49|10@0+ (0.02,0) [0|20] "m2"  FR,ADS
 SG_ FR_OBJ3_Dy : 45|11@0+ (0.125,-128) [-128|127.875] "m"  FR,ADS
 SG_ FR_OBJ3_HeadingAngle : 38|9@0+ (0.01,-1.57) [-1.57|1.57] "rad"  FR,ADS
 SG_ FR_OBJ3_Length : 31|9@0+ (0.05,0) [0|25.5] "m"  FR,ADS
 SG_ FR_OBJ3_Height : 8|9@0+ (0.01,0) [0|5.11] "m"  FR,ADS
 SG_ FR_OBJ3_Width : 3|11@0+ (0.01,0) [0|12] "m"  FR,ADS
 SG_ FR_OBJ3_Class : 7|3@0+ (1,0) [0|7] ""  FR,ADS

BO_ 451 FR_1C3: 64 FR
 SG_ FC_RollingCounter_1C3 : 491|4@0+ (1,0) [0|15] ""  FR,ADS
 SG_ FC_CRCCheck_1C3 : 503|16@0+ (1,0) [0|65535] ""  FR,ADS
 SG_ FR_OBJ6_Track_Age : 479|8@0+ (1,0) [0|255] ""  FR,ADS
 SG_ FR_OBJ6_Track_ID : 460|8@0+ (1,0) [0|255] ""  FR,ADS
 SG_ FR_OBJ6_FusionedFC_Track_ID : 487|8@0+ (1,0) [0|255] ""  FR,ADS
 SG_ FR_OBJ6_fusion_Sts : 463|2@0+ (1,0) [0|3] ""  FR,ADS
 SG_ FR_OBJ6_ObstacleProb : 453|6@0+ (2,0) [0|100] "%"  FR,ADS
 SG_ FR_OBJ6_ExistProb : 445|6@0+ (2,0) [0|100] "%"  FR,ADS
 SG_ FR_OBJ6_Brakelight_Info : 447|1@0+ (1,0) [0|1] ""  FR,ADS
 SG_ FR_OBJ6_Taillight_Info : 434|3@0+ (1,0) [0|7] ""  FR,ADS
 SG_ FR_OBJ6_Dis_to_R_LaneMark : 428|9@0+ (0.01,0) [0|5] "m"  FR,ADS
 SG_ FR_OBJ6_Dis_to_L_LaneMark : 422|9@0+ (0.01,0) [0|5] "m"  FR,ADS
 SG_ FR_OBJ6_Ax : 401|10@0+ (0.03125,-16) [-16|15.96875] "m/s2"  FR,ADS
 SG_ FR_OBJ6_Ay : 394|9@0+ (0.0625,-16) [-16|15.9375] "m/s2"  FR,ADS
 SG_ FR_OBJ6_Vx_std : 391|12@0+ (0.0625,-128) [-128|127.9375] "m/s"  FR,ADS
 SG_ FR_OBJ6_Vx : 372|12@0+ (0.0625,-128) [-128|127.9375] "m/s"  FR,ADS
 SG_ FR_OBJ6_Vy_std : 367|10@0+ (0.125,-64) [-64|63.875] "m/s"  FR,ADS
 SG_ FR_OBJ6_Vy : 345|10@0+ (0.125,-64) [-64|63.875] "m/s"  FR,ADS
 SG_ FR_OBJ6_Dx_Vnce : 329|14@0+ (0.05,0) [0|50] ""  FR,ADS
 SG_ FR_OBJ6_Dx : 327|13@0+ (0.0625,-256) [-256|255.9375] "m"  FR,ADS
 SG_ FR_OBJ6_Dy_Vnce : 305|10@0+ (0.02,0) [0|20] "m2"  FR,ADS
 SG_ FR_OBJ6_Dy : 301|11@0+ (0.125,-128) [-128|127.875] "m"  FR,ADS
 SG_ FR_OBJ6_HeadingAngle : 294|9@0+ (0.01,-1.57) [-1.57|1.57] "rad"  FR,ADS
 SG_ FR_OBJ6_Length : 287|9@0+ (0.05,0) [0|25.5] "m"  FR,ADS
 SG_ FR_OBJ6_Height : 264|9@0+ (0.01,0) [0|5.11] "m"  FR,ADS
 SG_ FR_OBJ6_Width : 259|11@0+ (0.01,0) [0|12] "m"  FR,ADS
 SG_ FR_OBJ6_Class : 263|3@0+ (1,0) [0|7] ""  FR,ADS
 SG_ FR_OBJ5_Track_Age : 223|8@0+ (1,0) [0|255] ""  FR,ADS
 SG_ FR_OBJ5_Track_ID : 204|8@0+ (1,0) [0|255] ""  FR,ADS
 SG_ FR_OBJ5_FusionedFC_Track_ID : 231|8@0+ (1,0) [0|255] ""  FR,ADS
 SG_ FR_OBJ5_fusion_Sts : 207|2@0+ (1,0) [0|3] ""  FR,ADS
 SG_ FR_OBJ5_ObstacleProb : 197|6@0+ (2,0) [0|100] "%"  FR,ADS
 SG_ FR_OBJ5_ExistProb : 189|6@0+ (2,0) [0|100] "%"  FR,ADS
 SG_ FR_OBJ5_Brakelight_Info : 191|1@0+ (1,0) [0|1] ""  FR,ADS
 SG_ FR_OBJ5_Taillight_Info : 178|3@0+ (1,0) [0|7] ""  FR,ADS
 SG_ FR_OBJ5_Dis_to_R_LaneMark : 172|9@0+ (0.01,0) [0|5] "m"  FR,ADS
 SG_ FR_OBJ5_Dis_to_L_LaneMark : 166|9@0+ (0.01,0) [0|5] "m"  FR,ADS
 SG_ FR_OBJ5_Ax : 145|10@0+ (0.03125,-16) [-16|15.96875] "m/s2"  FR,ADS
 SG_ FR_OBJ5_Ay : 138|9@0+ (0.0625,-16) [-16|15.9375] "m/s2"  FR,ADS
 SG_ FR_OBJ5_Vx_std : 135|12@0+ (0.0625,-128) [-128|127.9375] "m/s"  FR,ADS
 SG_ FR_OBJ5_Vx : 116|12@0+ (0.0625,-128) [-128|127.9375] "m/s"  FR,ADS
 SG_ FR_OBJ5_Vy_std : 111|10@0+ (0.125,-64) [-64|63.875] "m/s"  FR,ADS
 SG_ FR_OBJ5_Vy : 89|10@0+ (0.125,-64) [-64|63.875] "m/s"  FR,ADS
 SG_ FR_OBJ5_Dx_Vnce : 73|14@0+ (0.05,0) [0|50] ""  FR,ADS
 SG_ FR_OBJ5_Dx : 71|13@0+ (0.0625,-256) [-256|255.9375] "m"  FR,ADS
 SG_ FR_OBJ5_Dy_Vnce : 49|10@0+ (0.02,0) [0|20] "m2"  FR,ADS
 SG_ FR_OBJ5_Dy : 45|11@0+ (0.125,-128) [-128|127.875] "m"  FR,ADS
 SG_ FR_OBJ5_HeadingAngle : 38|9@0+ (0.01,-1.57) [-1.57|1.57] "rad"  FR,ADS
 SG_ FR_OBJ5_Length : 31|9@0+ (0.05,0) [0|25.5] "m"  FR,ADS
 SG_ FR_OBJ5_Height : 8|9@0+ (0.01,0) [0|5.11] "m"  FR,ADS
 SG_ FR_OBJ5_Width : 3|11@0+ (0.01,0) [0|12] "m"  FR,ADS
 SG_ FR_OBJ5_Class : 7|3@0+ (1,0) [0|7] ""  FR,ADS

BO_ 452 FR_1C4: 64 FR
 SG_ FC_RollingCounter_1C4 : 491|4@0+ (1,0) [0|15] ""  FR,ADS
 SG_ FC_CRCCheck_1C4 : 503|16@0+ (1,0) [0|65535] ""  FR,ADS
 SG_ FR_AEBOBJ_Track_Age : 479|8@0+ (1,0) [0|255] ""  FR,ADS
 SG_ FR_AEBOBJ_Track_ID : 460|8@0+ (1,0) [0|255] ""  FR,ADS
 SG_ FR_AEBOBJ_FusionedFC_Track_ID : 487|8@0+ (1,0) [0|255] ""  FR,ADS
 SG_ FR_AEBOBJ_fusion_Sts : 463|2@0+ (1,0) [0|3] ""  FR,ADS
 SG_ FR_AEBOBJ_ObstacleProb : 453|6@0+ (2,0) [0|100] "%"  FR,ADS
 SG_ FR_AEBOBJ_ExistProb : 445|6@0+ (2,0) [0|100] "%"  FR,ADS
 SG_ FR_AEBOBJ_Brakelight_Info : 447|1@0+ (1,0) [0|1] ""  FR,ADS
 SG_ FR_AEBOBJ_Taillight_Info : 434|3@0+ (1,0) [0|7] ""  FR,ADS
 SG_ FR_AEBOBJ_Dis_to_R_LaneMark : 428|9@0+ (0.01,0) [0|5] "m"  FR,ADS
 SG_ FR_AEBOBJ_Dis_to_L_LaneMark : 422|9@0+ (0.01,0) [0|5] "m"  FR,ADS
 SG_ FR_AEBOBJ_Ax : 401|10@0+ (0.03125,-16) [-16|15.96875] "m/s2"  FR,ADS
 SG_ FR_AEBOBJ_Ay : 394|9@0+ (0.0625,-16) [-16|15.9375] "m/s2"  FR,ADS
 SG_ FR_AEBOBJ_Vx_std : 391|12@0+ (0.0625,-128) [-128|127.9375] "m/s"  FR,ADS
 SG_ FR_AEBOBJ_Vx : 372|12@0+ (0.0625,-128) [-128|127.9375] "m/s"  FR,ADS
 SG_ FR_AEBOBJ_Vy_std : 367|10@0+ (0.125,-64) [-64|63.875] "m/s"  FR,ADS
 SG_ FR_AEBOBJ_Vy : 345|10@0+ (0.125,-64) [-64|63.875] "m/s"  FR,ADS
 SG_ FR_AEBOBJ_Dx_Vnce : 329|14@0+ (0.05,0) [0|50] ""  FR,ADS
 SG_ FR_AEBOBJ_Dx : 327|13@0+ (0.0625,-256) [-256|255.9375] "m"  FR,ADS
 SG_ FR_AEBOBJ_Dy_Vnce : 305|10@0+ (0.02,0) [0|20] "m2"  FR,ADS
 SG_ FR_AEBOBJ_Dy : 301|11@0+ (0.125,-128) [-128|127.875] "m"  FR,ADS
 SG_ FR_AEBOBJ_HeadingAngle : 294|9@0+ (0.01,-1.57) [-1.57|1.57] "rad"  FR,ADS
 SG_ FR_AEBOBJ_Length : 287|9@0+ (0.05,0) [0|25.5] "m"  FR,ADS
 SG_ FR_AEBOBJ_Height : 264|9@0+ (0.01,0) [0|5.11] "m"  FR,ADS
 SG_ FR_AEBOBJ_Width : 259|11@0+ (0.01,0) [0|12] "m"  FR,ADS
 SG_ FR_AEBOBJ_Class : 263|3@0+ (1,0) [0|7] ""  FR,ADS

BO_ 423 FC_1A7: 64 FC
 SG_ FC_Reserved_1A7 : 0|1@0+ (1,0) [0|1] ""  FR,ADS

BO_ 425 FC_1A9: 64 FC
 SG_ FC_Reserved_1A9 : 0|1@0+ (1,0) [0|1] ""  FR,ADS

BO_ 453 FR_1C5: 64 FR
 SG_ FR_Reserved_1C5 : 0|1@0+ (1,0) [0|1] ""  FR,ADS

BO_ 454 FR_1C6: 64 FR
 SG_ FR_Reserved_1C6 : 0|1@0+ (1,0) [0|1] ""  FR,ADS

CM_ BO_ 427 " ";
CM_ SG_ 427 LeFr_AccOBJ_Track_Age " ";
CM_ SG_ 427 LeFr_AccOBJ_Track_ID " ";
CM_ SG_ 427 LeFr_AccOBJ_FusionedFC_Track_ID " ";
CM_ SG_ 427 LeFr_AccOBJ_fusion_Sts " ";
CM_ SG_ 427 LeFr_AccOBJ_ObstacleProb " ";
CM_ SG_ 427 LeFr_AccOBJ_ExistProb " ";
CM_ SG_ 427 LeFr_AccOBJ_Brakelight_Info " ";
CM_ SG_ 427 LeFr_AccOBJ_Taillight_Info " ";
CM_ SG_ 427 LeFr_AccOBJ_Dis_to_R_LaneMark " ";
CM_ SG_ 427 LeFr_AccOBJ_Dis_to_L_LaneMark " ";
CM_ SG_ 427 LeFr_AccOBJ_Ax " ";
CM_ SG_ 427 LeFr_AccOBJ_Ay " ";
CM_ SG_ 427 LeFr_AccOBJ_Vx_std " ";
CM_ SG_ 427 LeFr_AccOBJ_Vx " ";
CM_ SG_ 427 LeFr_AccOBJ_Vy_std " ";
CM_ SG_ 427 LeFr_AccOBJ_Vy " ";
CM_ SG_ 427 LeFr_AccOBJ_Dx_Vnce " ";
CM_ SG_ 427 LeFr_AccOBJ_Dx " ";
CM_ SG_ 427 LeFr_AccOBJ_Dy_Vnce " ";
CM_ SG_ 427 LeFr_AccOBJ_Dy " ";
CM_ SG_ 427 LeFr_AccOBJ_HeadingAngle " ";
CM_ SG_ 427 LeFr_AccOBJ_Length " ";
CM_ SG_ 427 LeFr_AccOBJ_Height " ";
CM_ SG_ 427 LeFr_AccOBJ_Width " ";
CM_ SG_ 427 LeFr_AccOBJ_Class " ";
CM_ SG_ 427 Le_AccOBJ_Track_Age " ";
CM_ SG_ 427 Le_AccOBJ_Track_ID " ";
CM_ SG_ 427 Le_AccOBJ_FusionedFC_Track_ID " ";
CM_ SG_ 427 Le_AccOBJ_fusion_Sts " ";
CM_ SG_ 427 Le_AccOBJ_ObstacleProb " ";
CM_ SG_ 427 Le_AccOBJ_ExistProb " ";
CM_ SG_ 427 Le_AccOBJ_Brakelight_Info " ";
CM_ SG_ 427 Le_AccOBJ_Taillight_Info " ";
CM_ SG_ 427 Le_AccOBJ_Dis_to_R_LaneMark " ";
CM_ SG_ 427 Le_AccOBJ_Dis_to_L_LaneMark " ";
CM_ SG_ 427 Le_AccOBJ_Ax " ";
CM_ SG_ 427 Le_AccOBJ_Ay " ";
CM_ SG_ 427 Le_AccOBJ_Vx_std " ";
CM_ SG_ 427 Le_AccOBJ_Vx " ";
CM_ SG_ 427 Le_AccOBJ_Vy_std " ";
CM_ SG_ 427 Le_AccOBJ_Vy " ";
CM_ SG_ 427 Le_AccOBJ_Dx_Vnce " ";
CM_ SG_ 427 Le_AccOBJ_Dx " ";
CM_ SG_ 427 Le_AccOBJ_Dy_Vnce " ";
CM_ SG_ 427 Le_AccOBJ_Dy " ";
CM_ SG_ 427 Le_AccOBJ_HeadingAngle " ";
CM_ SG_ 427 Le_AccOBJ_Length " ";
CM_ SG_ 427 Le_AccOBJ_Height " ";
CM_ SG_ 427 Le_AccOBJ_Width " ";
CM_ SG_ 427 Le_AccOBJ_Class " ";
CM_ BO_ 428 " ";
CM_ SG_ 428 RiFr_AccOBJ_Track_Age " ";
CM_ SG_ 428 RiFr_AccOBJ_Track_ID " ";
CM_ SG_ 428 RiFr_AccOBJ_FusionedFC_Track_ID " ";
CM_ SG_ 428 RiFr_AccOBJ_fusion_Sts " ";
CM_ SG_ 428 RiFr_AccOBJ_ObstacleProb " ";
CM_ SG_ 428 RiFr_AccOBJ_ExistProb " ";
CM_ SG_ 428 RiFr_AccOBJ_Brakelight_Info " ";
CM_ SG_ 428 RiFr_AccOBJ_Taillight_Info " ";
CM_ SG_ 428 RiFr_AccOBJ_Dis_to_R_LaneMark " ";
CM_ SG_ 428 RiFr_AccOBJ_Dis_to_L_LaneMark " ";
CM_ SG_ 428 RiFr_AccOBJ_Ax " ";
CM_ SG_ 428 RiFr_AccOBJ_Ay " ";
CM_ SG_ 428 RiFr_AccOBJ_Vx_std " ";
CM_ SG_ 428 RiFr_AccOBJ_Vx " ";
CM_ SG_ 428 RiFr_AccOBJ_Vy_std " ";
CM_ SG_ 428 RiFr_AccOBJ_Vy " ";
CM_ SG_ 428 RiFr_AccOBJ_Dx_Vnce " ";
CM_ SG_ 428 RiFr_AccOBJ_Dx " ";
CM_ SG_ 428 RiFr_AccOBJ_Dy_Vnce " ";
CM_ SG_ 428 RiFr_AccOBJ_Dy " ";
CM_ SG_ 428 RiFr_AccOBJ_HeadingAngle " ";
CM_ SG_ 428 RiFr_AccOBJ_Length " ";
CM_ SG_ 428 RiFr_AccOBJ_Height " ";
CM_ SG_ 428 RiFr_AccOBJ_Width " ";
CM_ SG_ 428 RiFr_AccOBJ_Class " ";
CM_ SG_ 428 Ri_AccOBJ_Track_Age " ";
CM_ SG_ 428 Ri_AccOBJ_Track_ID " ";
CM_ SG_ 428 Ri_AccOBJ_FusionedFC_Track_ID " ";
CM_ SG_ 428 Ri_AccOBJ_fusion_Sts " ";
CM_ SG_ 428 Ri_AccOBJ_ObstacleProb " ";
CM_ SG_ 428 Ri_AccOBJ_ExistProb " ";
CM_ SG_ 428 Ri_AccOBJ_Brakelight_Info " ";
CM_ SG_ 428 Ri_AccOBJ_Taillight_Info " ";
CM_ SG_ 428 Ri_AccOBJ_Dis_to_R_LaneMark " ";
CM_ SG_ 428 Ri_AccOBJ_Dis_to_L_LaneMark " ";
CM_ SG_ 428 Ri_AccOBJ_Ax " ";
CM_ SG_ 428 Ri_AccOBJ_Ay " ";
CM_ SG_ 428 Ri_AccOBJ_Vx_std " ";
CM_ SG_ 428 Ri_AccOBJ_Vx " ";
CM_ SG_ 428 Ri_AccOBJ_Vy_std " ";
CM_ SG_ 428 Ri_AccOBJ_Vy " ";
CM_ SG_ 428 Ri_AccOBJ_Dx_Vnce " ";
CM_ SG_ 428 Ri_AccOBJ_Dx " ";
CM_ SG_ 428 Ri_AccOBJ_Dy_Vnce " ";
CM_ SG_ 428 Ri_AccOBJ_Dy " ";
CM_ SG_ 428 Ri_AccOBJ_HeadingAngle " ";
CM_ SG_ 428 Ri_AccOBJ_Length " ";
CM_ SG_ 428 Ri_AccOBJ_Height " ";
CM_ SG_ 428 Ri_AccOBJ_Width " ";
CM_ SG_ 428 Ri_AccOBJ_Class " ";
CM_ BO_ 429 " ";
CM_ SG_ 429 FR_OBJ8_Track_Age " ";
CM_ SG_ 429 FR_OBJ8_Track_ID " ";
CM_ SG_ 429 FR_OBJ8_FusionedFC_Track_ID " ";
CM_ SG_ 429 FR_OBJ8_fusion_Sts " ";
CM_ SG_ 429 FR_OBJ8_ObstacleProb " ";
CM_ SG_ 429 FR_OBJ8_ExistProb " ";
CM_ SG_ 429 FR_OBJ8_Brakelight_Info " ";
CM_ SG_ 429 FR_OBJ8_Taillight_Info " ";
CM_ SG_ 429 FR_OBJ8_Dis_to_R_LaneMark " ";
CM_ SG_ 429 FR_OBJ8_Dis_to_L_LaneMark " ";
CM_ SG_ 429 FR_OBJ8_Ax " ";
CM_ SG_ 429 FR_OBJ8_Ay " ";
CM_ SG_ 429 FR_OBJ8_Vx_std " ";
CM_ SG_ 429 FR_OBJ8_Vx " ";
CM_ SG_ 429 FR_OBJ8_Vy_std " ";
CM_ SG_ 429 FR_OBJ8_Vy " ";
CM_ SG_ 429 FR_OBJ8_Dx_Vnce " ";
CM_ SG_ 429 FR_OBJ8_Dx " ";
CM_ SG_ 429 FR_OBJ8_Dy_Vnce " ";
CM_ SG_ 429 FR_OBJ8_Dy " ";
CM_ SG_ 429 FR_OBJ8_HeadingAngle " ";
CM_ SG_ 429 FR_OBJ8_Length " ";
CM_ SG_ 429 FR_OBJ8_Height " ";
CM_ SG_ 429 FR_OBJ8_Width " ";
CM_ SG_ 429 FR_OBJ8_Class " ";
CM_ SG_ 429 FR_OBJ7_Track_Age " ";
CM_ SG_ 429 FR_OBJ7_Track_ID " ";
CM_ SG_ 429 FR_OBJ7_FusionedFC_Track_ID " ";
CM_ SG_ 429 FR_OBJ7_fusion_Sts " ";
CM_ SG_ 429 FR_OBJ7_ObstacleProb " ";
CM_ SG_ 429 FR_OBJ7_ExistProb " ";
CM_ SG_ 429 FR_OBJ7_Brakelight_Info " ";
CM_ SG_ 429 FR_OBJ7_Taillight_Info " ";
CM_ SG_ 429 FR_OBJ7_Dis_to_R_LaneMark " ";
CM_ SG_ 429 FR_OBJ7_Dis_to_L_LaneMark " ";
CM_ SG_ 429 FR_OBJ7_Ax " ";
CM_ SG_ 429 FR_OBJ7_Ay " ";
CM_ SG_ 429 FR_OBJ7_Vx_std " ";
CM_ SG_ 429 FR_OBJ7_Vx " ";
CM_ SG_ 429 FR_OBJ7_Vy_std " ";
CM_ SG_ 429 FR_OBJ7_Vy " ";
CM_ SG_ 429 FR_OBJ7_Dx_Vnce " ";
CM_ SG_ 429 FR_OBJ7_Dx " ";
CM_ SG_ 429 FR_OBJ7_Dy_Vnce " ";
CM_ SG_ 429 FR_OBJ7_Dy " ";
CM_ SG_ 429 FR_OBJ7_HeadingAngle " ";
CM_ SG_ 429 FR_OBJ7_Length " ";
CM_ SG_ 429 FR_OBJ7_Height " ";
CM_ SG_ 429 FR_OBJ7_Width " ";
CM_ SG_ 429 FR_OBJ7_Class " ";
CM_ BO_ 430 " ";
CM_ SG_ 430 FR_OBJ10_Track_Age " ";
CM_ SG_ 430 FR_OBJ10_Track_ID " ";
CM_ SG_ 430 FR_OBJ10_FusionedFC_Track_ID " ";
CM_ SG_ 430 FR_OBJ10_fusion_Sts " ";
CM_ SG_ 430 FR_OBJ10_ObstacleProb " ";
CM_ SG_ 430 FR_OBJ10_ExistProb " ";
CM_ SG_ 430 FR_OBJ10_Brakelight_Info " ";
CM_ SG_ 430 FR_OBJ10_Taillight_Info " ";
CM_ SG_ 430 FR_OBJ10_Dis_to_R_LaneMark " ";
CM_ SG_ 430 FR_OBJ10_Dis_to_L_LaneMark " ";
CM_ SG_ 430 FR_OBJ10_Ax " ";
CM_ SG_ 430 FR_OBJ10_Ay " ";
CM_ SG_ 430 FR_OBJ10_Vx_std " ";
CM_ SG_ 430 FR_OBJ10_Vx " ";
CM_ SG_ 430 FR_OBJ10_Vy_std " ";
CM_ SG_ 430 FR_OBJ10_Vy " ";
CM_ SG_ 430 FR_OBJ10_Dx_Vnce " ";
CM_ SG_ 430 FR_OBJ10_Dx " ";
CM_ SG_ 430 FR_OBJ10_Dy_Vnce " ";
CM_ SG_ 430 FR_OBJ10_Dy " ";
CM_ SG_ 430 FR_OBJ10_HeadingAngle " ";
CM_ SG_ 430 FR_OBJ10_Length " ";
CM_ SG_ 430 FR_OBJ10_Height " ";
CM_ SG_ 430 FR_OBJ10_Width " ";
CM_ SG_ 430 FR_OBJ10_Class " ";
CM_ SG_ 430 FR_OBJ9_Track_Age " ";
CM_ SG_ 430 FR_OBJ9_Track_ID " ";
CM_ SG_ 430 FR_OBJ9_FusionedFC_Track_ID " ";
CM_ SG_ 430 FR_OBJ9_fusion_Sts " ";
CM_ SG_ 430 FR_OBJ9_ObstacleProb " ";
CM_ SG_ 430 FR_OBJ9_ExistProb " ";
CM_ SG_ 430 FR_OBJ9_Brakelight_Info " ";
CM_ SG_ 430 FR_OBJ9_Taillight_Info " ";
CM_ SG_ 430 FR_OBJ9_Dis_to_R_LaneMark " ";
CM_ SG_ 430 FR_OBJ9_Dis_to_L_LaneMark " ";
CM_ SG_ 430 FR_OBJ9_Ax " ";
CM_ SG_ 430 FR_OBJ9_Ay " ";
CM_ SG_ 430 FR_OBJ9_Vx_std " ";
CM_ SG_ 430 FR_OBJ9_Vx " ";
CM_ SG_ 430 FR_OBJ9_Vy_std " ";
CM_ SG_ 430 FR_OBJ9_Vy " ";
CM_ SG_ 430 FR_OBJ9_Dx_Vnce " ";
CM_ SG_ 430 FR_OBJ9_Dx " ";
CM_ SG_ 430 FR_OBJ9_Dy_Vnce " ";
CM_ SG_ 430 FR_OBJ9_Dy " ";
CM_ SG_ 430 FR_OBJ9_HeadingAngle " ";
CM_ SG_ 430 FR_OBJ9_Length " ";
CM_ SG_ 430 FR_OBJ9_Height " ";
CM_ SG_ 430 FR_OBJ9_Width " ";
CM_ SG_ 430 FR_OBJ9_Class " ";
CM_ BO_ 431 " ";
CM_ SG_ 431 FR_OBJ12_Track_Age " ";
CM_ SG_ 431 FR_OBJ12_Track_ID " ";
CM_ SG_ 431 FR_OBJ12_FusionedFC_Track_ID " ";
CM_ SG_ 431 FR_OBJ12_fusion_Sts " ";
CM_ SG_ 431 FR_OBJ12_ObstacleProb " ";
CM_ SG_ 431 FR_OBJ12_ExistProb " ";
CM_ SG_ 431 FR_OBJ12_Brakelight_Info " ";
CM_ SG_ 431 FR_OBJ12_Taillight_Info " ";
CM_ SG_ 431 FR_OBJ12_Dis_to_R_LaneMark " ";
CM_ SG_ 431 FR_OBJ12_Dis_to_L_LaneMark " ";
CM_ SG_ 431 FR_OBJ12_Ax " ";
CM_ SG_ 431 FR_OBJ12_Ay " ";
CM_ SG_ 431 FR_OBJ12_Vx_std " ";
CM_ SG_ 431 FR_OBJ12_Vx " ";
CM_ SG_ 431 FR_OBJ12_Vy_std " ";
CM_ SG_ 431 FR_OBJ12_Vy " ";
CM_ SG_ 431 FR_OBJ12_Dx_Vnce " ";
CM_ SG_ 431 FR_OBJ12_Dx " ";
CM_ SG_ 431 FR_OBJ12_Dy_Vnce " ";
CM_ SG_ 431 FR_OBJ12_Dy " ";
CM_ SG_ 431 FR_OBJ12_HeadingAngle " ";
CM_ SG_ 431 FR_OBJ12_Length " ";
CM_ SG_ 431 FR_OBJ12_Height " ";
CM_ SG_ 431 FR_OBJ12_Width " ";
CM_ SG_ 431 FR_OBJ12_Class " ";
CM_ SG_ 431 FR_OBJ11_Track_Age " ";
CM_ SG_ 431 FR_OBJ11_Track_ID " ";
CM_ SG_ 431 FR_OBJ11_FusionedFC_Track_ID " ";
CM_ SG_ 431 FR_OBJ11_fusion_Sts " ";
CM_ SG_ 431 FR_OBJ11_ObstacleProb " ";
CM_ SG_ 431 FR_OBJ11_ExistProb " ";
CM_ SG_ 431 FR_OBJ11_Brakelight_Info " ";
CM_ SG_ 431 FR_OBJ11_Taillight_Info " ";
CM_ SG_ 431 FR_OBJ11_Dis_to_R_LaneMark " ";
CM_ SG_ 431 FR_OBJ11_Dis_to_L_LaneMark " ";
CM_ SG_ 431 FR_OBJ11_Ax " ";
CM_ SG_ 431 FR_OBJ11_Ay " ";
CM_ SG_ 431 FR_OBJ11_Vx_std " ";
CM_ SG_ 431 FR_OBJ11_Vx " ";
CM_ SG_ 431 FR_OBJ11_Vy_std " ";
CM_ SG_ 431 FR_OBJ11_Vy " ";
CM_ SG_ 431 FR_OBJ11_Dx_Vnce " ";
CM_ SG_ 431 FR_OBJ11_Dx " ";
CM_ SG_ 431 FR_OBJ11_Dy_Vnce " ";
CM_ SG_ 431 FR_OBJ11_Dy " ";
CM_ SG_ 431 FR_OBJ11_HeadingAngle " ";
CM_ SG_ 431 FR_OBJ11_Length " ";
CM_ SG_ 431 FR_OBJ11_Height " ";
CM_ SG_ 431 FR_OBJ11_Width " ";
CM_ SG_ 431 FR_OBJ11_Class " ";
CM_ BO_ 432 " ";
CM_ SG_ 432 FR_OBJ14_Track_Age " ";
CM_ SG_ 432 FR_OBJ14_Track_ID " ";
CM_ SG_ 432 FR_OBJ14_FusionedFC_Track_ID " ";
CM_ SG_ 432 FR_OBJ14_fusion_Sts " ";
CM_ SG_ 432 FR_OBJ14_ObstacleProb " ";
CM_ SG_ 432 FR_OBJ14_ExistProb " ";
CM_ SG_ 432 FR_OBJ14_Brakelight_Info " ";
CM_ SG_ 432 FR_OBJ14_Taillight_Info " ";
CM_ SG_ 432 FR_OBJ14_Dis_to_R_LaneMark " ";
CM_ SG_ 432 FR_OBJ14_Dis_to_L_LaneMark " ";
CM_ SG_ 432 FR_OBJ14_Ax " ";
CM_ SG_ 432 FR_OBJ14_Ay " ";
CM_ SG_ 432 FR_OBJ14_Vx_std " ";
CM_ SG_ 432 FR_OBJ14_Vx " ";
CM_ SG_ 432 FR_OBJ14_Vy_std " ";
CM_ SG_ 432 FR_OBJ14_Vy " ";
CM_ SG_ 432 FR_OBJ14_Dx_Vnce " ";
CM_ SG_ 432 FR_OBJ14_Dx " ";
CM_ SG_ 432 FR_OBJ14_Dy_Vnce " ";
CM_ SG_ 432 FR_OBJ14_Dy " ";
CM_ SG_ 432 FR_OBJ14_HeadingAngle " ";
CM_ SG_ 432 FR_OBJ14_Length " ";
CM_ SG_ 432 FR_OBJ14_Height " ";
CM_ SG_ 432 FR_OBJ14_Width " ";
CM_ SG_ 432 FR_OBJ14_Class " ";
CM_ SG_ 432 FR_OBJ13_Track_Age " ";
CM_ SG_ 432 FR_OBJ13_Track_ID " ";
CM_ SG_ 432 FR_OBJ13_FusionedFC_Track_ID " ";
CM_ SG_ 432 FR_OBJ13_fusion_Sts " ";
CM_ SG_ 432 FR_OBJ13_ObstacleProb " ";
CM_ SG_ 432 FR_OBJ13_ExistProb " ";
CM_ SG_ 432 FR_OBJ13_Brakelight_Info " ";
CM_ SG_ 432 FR_OBJ13_Taillight_Info " ";
CM_ SG_ 432 FR_OBJ13_Dis_to_R_LaneMark " ";
CM_ SG_ 432 FR_OBJ13_Dis_to_L_LaneMark " ";
CM_ SG_ 432 FR_OBJ13_Ax " ";
CM_ SG_ 432 FR_OBJ13_Ay " ";
CM_ SG_ 432 FR_OBJ13_Vx_std " ";
CM_ SG_ 432 FR_OBJ13_Vx " ";
CM_ SG_ 432 FR_OBJ13_Vy_std " ";
CM_ SG_ 432 FR_OBJ13_Vy " ";
CM_ SG_ 432 FR_OBJ13_Dx_Vnce " ";
CM_ SG_ 432 FR_OBJ13_Dx " ";
CM_ SG_ 432 FR_OBJ13_Dy_Vnce " ";
CM_ SG_ 432 FR_OBJ13_Dy " ";
CM_ SG_ 432 FR_OBJ13_HeadingAngle " ";
CM_ SG_ 432 FR_OBJ13_Length " ";
CM_ SG_ 432 FR_OBJ13_Height " ";
CM_ SG_ 432 FR_OBJ13_Width " ";
CM_ SG_ 432 FR_OBJ13_Class " ";
CM_ BO_ 433 " ";
CM_ SG_ 433 FR_OBJ16_Track_Age " ";
CM_ SG_ 433 FR_OBJ16_Track_ID " ";
CM_ SG_ 433 FR_OBJ16_FusionedFC_Track_ID " ";
CM_ SG_ 433 FR_OBJ16_fusion_Sts " ";
CM_ SG_ 433 FR_OBJ16_ObstacleProb " ";
CM_ SG_ 433 FR_OBJ16_ExistProb " ";
CM_ SG_ 433 FR_OBJ16_Brakelight_Info " ";
CM_ SG_ 433 FR_OBJ16_Taillight_Info " ";
CM_ SG_ 433 FR_OBJ16_Dis_to_R_LaneMark " ";
CM_ SG_ 433 FR_OBJ16_Dis_to_L_LaneMark " ";
CM_ SG_ 433 FR_OBJ16_Ax " ";
CM_ SG_ 433 FR_OBJ16_Ay " ";
CM_ SG_ 433 FR_OBJ16_Vx_std " ";
CM_ SG_ 433 FR_OBJ16_Vx " ";
CM_ SG_ 433 FR_OBJ16_Vy_std " ";
CM_ SG_ 433 FR_OBJ16_Vy " ";
CM_ SG_ 433 FR_OBJ16_Dx_Vnce " ";
CM_ SG_ 433 FR_OBJ16_Dx " ";
CM_ SG_ 433 FR_OBJ16_Dy_Vnce " ";
CM_ SG_ 433 FR_OBJ16_Dy " ";
CM_ SG_ 433 FR_OBJ16_HeadingAngle " ";
CM_ SG_ 433 FR_OBJ16_Length " ";
CM_ SG_ 433 FR_OBJ16_Height " ";
CM_ SG_ 433 FR_OBJ16_Width " ";
CM_ SG_ 433 FR_OBJ16_Class " ";
CM_ SG_ 433 FR_OBJ15_Track_Age " ";
CM_ SG_ 433 FR_OBJ15_Track_ID " ";
CM_ SG_ 433 FR_OBJ15_FusionedFC_Track_ID " ";
CM_ SG_ 433 FR_OBJ15_fusion_Sts " ";
CM_ SG_ 433 FR_OBJ15_ObstacleProb " ";
CM_ SG_ 433 FR_OBJ15_ExistProb " ";
CM_ SG_ 433 FR_OBJ15_Brakelight_Info " ";
CM_ SG_ 433 FR_OBJ15_Taillight_Info " ";
CM_ SG_ 433 FR_OBJ15_Dis_to_R_LaneMark " ";
CM_ SG_ 433 FR_OBJ15_Dis_to_L_LaneMark " ";
CM_ SG_ 433 FR_OBJ15_Ax " ";
CM_ SG_ 433 FR_OBJ15_Ay " ";
CM_ SG_ 433 FR_OBJ15_Vx_std " ";
CM_ SG_ 433 FR_OBJ15_Vx " ";
CM_ SG_ 433 FR_OBJ15_Vy_std " ";
CM_ SG_ 433 FR_OBJ15_Vy " ";
CM_ SG_ 433 FR_OBJ15_Dx_Vnce " ";
CM_ SG_ 433 FR_OBJ15_Dx " ";
CM_ SG_ 433 FR_OBJ15_Dy_Vnce " ";
CM_ SG_ 433 FR_OBJ15_Dy " ";
CM_ SG_ 433 FR_OBJ15_HeadingAngle " ";
CM_ SG_ 433 FR_OBJ15_Length " ";
CM_ SG_ 433 FR_OBJ15_Height " ";
CM_ SG_ 433 FR_OBJ15_Width " ";
CM_ SG_ 433 FR_OBJ15_Class " ";
CM_ BO_ 434 " ";
CM_ SG_ 434 FR_OBJ18_Track_Age " ";
CM_ SG_ 434 FR_OBJ18_Track_ID " ";
CM_ SG_ 434 FR_OBJ18_FusionedFC_Track_ID " ";
CM_ SG_ 434 FR_OBJ18_fusion_Sts " ";
CM_ SG_ 434 FR_OBJ18_ObstacleProb " ";
CM_ SG_ 434 FR_OBJ18_ExistProb " ";
CM_ SG_ 434 FR_OBJ18_Brakelight_Info " ";
CM_ SG_ 434 FR_OBJ18_Taillight_Info " ";
CM_ SG_ 434 FR_OBJ18_Dis_to_R_LaneMark " ";
CM_ SG_ 434 FR_OBJ18_Dis_to_L_LaneMark " ";
CM_ SG_ 434 FR_OBJ18_Ax " ";
CM_ SG_ 434 FR_OBJ18_Ay " ";
CM_ SG_ 434 FR_OBJ18_Vx_std " ";
CM_ SG_ 434 FR_OBJ18_Vx " ";
CM_ SG_ 434 FR_OBJ18_Vy_std " ";
CM_ SG_ 434 FR_OBJ18_Vy " ";
CM_ SG_ 434 FR_OBJ18_Dx_Vnce " ";
CM_ SG_ 434 FR_OBJ18_Dx " ";
CM_ SG_ 434 FR_OBJ18_Dy_Vnce " ";
CM_ SG_ 434 FR_OBJ18_Dy " ";
CM_ SG_ 434 FR_OBJ18_HeadingAngle " ";
CM_ SG_ 434 FR_OBJ18_Length " ";
CM_ SG_ 434 FR_OBJ18_Height " ";
CM_ SG_ 434 FR_OBJ18_Width " ";
CM_ SG_ 434 FR_OBJ18_Class " ";
CM_ SG_ 434 FR_OBJ17_Track_Age " ";
CM_ SG_ 434 FR_OBJ17_Track_ID " ";
CM_ SG_ 434 FR_OBJ17_FusionedFC_Track_ID " ";
CM_ SG_ 434 FR_OBJ17_fusion_Sts " ";
CM_ SG_ 434 FR_OBJ17_ObstacleProb " ";
CM_ SG_ 434 FR_OBJ17_ExistProb " ";
CM_ SG_ 434 FR_OBJ17_Brakelight_Info " ";
CM_ SG_ 434 FR_OBJ17_Taillight_Info " ";
CM_ SG_ 434 FR_OBJ17_Dis_to_R_LaneMark " ";
CM_ SG_ 434 FR_OBJ17_Dis_to_L_LaneMark " ";
CM_ SG_ 434 FR_OBJ17_Ax " ";
CM_ SG_ 434 FR_OBJ17_Ay " ";
CM_ SG_ 434 FR_OBJ17_Vx_std " ";
CM_ SG_ 434 FR_OBJ17_Vx " ";
CM_ SG_ 434 FR_OBJ17_Vy_std " ";
CM_ SG_ 434 FR_OBJ17_Vy " ";
CM_ SG_ 434 FR_OBJ17_Dx_Vnce " ";
CM_ SG_ 434 FR_OBJ17_Dx " ";
CM_ SG_ 434 FR_OBJ17_Dy_Vnce " ";
CM_ SG_ 434 FR_OBJ17_Dy " ";
CM_ SG_ 434 FR_OBJ17_HeadingAngle " ";
CM_ SG_ 434 FR_OBJ17_Length " ";
CM_ SG_ 434 FR_OBJ17_Height " ";
CM_ SG_ 434 FR_OBJ17_Width " ";
CM_ SG_ 434 FR_OBJ17_Class " ";
CM_ BO_ 435 " ";
CM_ SG_ 435 FR_OBJ20_Track_Age " ";
CM_ SG_ 435 FR_OBJ20_Track_ID " ";
CM_ SG_ 435 FR_OBJ20_FusionedFC_Track_ID " ";
CM_ SG_ 435 FR_OBJ20_fusion_Sts " ";
CM_ SG_ 435 FR_OBJ20_ObstacleProb " ";
CM_ SG_ 435 FR_OBJ20_ExistProb " ";
CM_ SG_ 435 FR_OBJ20_Brakelight_Info " ";
CM_ SG_ 435 FR_OBJ20_Taillight_Info " ";
CM_ SG_ 435 FR_OBJ20_Dis_to_R_LaneMark " ";
CM_ SG_ 435 FR_OBJ20_Dis_to_L_LaneMark " ";
CM_ SG_ 435 FR_OBJ20_Ax " ";
CM_ SG_ 435 FR_OBJ20_Ay " ";
CM_ SG_ 435 FR_OBJ20_Vx_std " ";
CM_ SG_ 435 FR_OBJ20_Vx " ";
CM_ SG_ 435 FR_OBJ20_Vy_std " ";
CM_ SG_ 435 FR_OBJ20_Vy " ";
CM_ SG_ 435 FR_OBJ20_Dx_Vnce " ";
CM_ SG_ 435 FR_OBJ20_Dx " ";
CM_ SG_ 435 FR_OBJ20_Dy_Vnce " ";
CM_ SG_ 435 FR_OBJ20_Dy " ";
CM_ SG_ 435 FR_OBJ20_HeadingAngle " ";
CM_ SG_ 435 FR_OBJ20_Length " ";
CM_ SG_ 435 FR_OBJ20_Height " ";
CM_ SG_ 435 FR_OBJ20_Width " ";
CM_ SG_ 435 FR_OBJ20_Class " ";
CM_ SG_ 435 FR_OBJ19_Track_Age " ";
CM_ SG_ 435 FR_OBJ19_Track_ID " ";
CM_ SG_ 435 FR_OBJ19_FusionedFC_Track_ID " ";
CM_ SG_ 435 FR_OBJ19_fusion_Sts " ";
CM_ SG_ 435 FR_OBJ19_ObstacleProb " ";
CM_ SG_ 435 FR_OBJ19_ExistProb " ";
CM_ SG_ 435 FR_OBJ19_Brakelight_Info " ";
CM_ SG_ 435 FR_OBJ19_Taillight_Info " ";
CM_ SG_ 435 FR_OBJ19_Dis_to_R_LaneMark " ";
CM_ SG_ 435 FR_OBJ19_Dis_to_L_LaneMark " ";
CM_ SG_ 435 FR_OBJ19_Ax " ";
CM_ SG_ 435 FR_OBJ19_Ay " ";
CM_ SG_ 435 FR_OBJ19_Vx_std " ";
CM_ SG_ 435 FR_OBJ19_Vx " ";
CM_ SG_ 435 FR_OBJ19_Vy_std " ";
CM_ SG_ 435 FR_OBJ19_Vy " ";
CM_ SG_ 435 FR_OBJ19_Dx_Vnce " ";
CM_ SG_ 435 FR_OBJ19_Dx " ";
CM_ SG_ 435 FR_OBJ19_Dy_Vnce " ";
CM_ SG_ 435 FR_OBJ19_Dy " ";
CM_ SG_ 435 FR_OBJ19_HeadingAngle " ";
CM_ SG_ 435 FR_OBJ19_Length " ";
CM_ SG_ 435 FR_OBJ19_Height " ";
CM_ SG_ 435 FR_OBJ19_Width " ";
CM_ SG_ 435 FR_OBJ19_Class " ";
CM_ BO_ 436 " ";
CM_ SG_ 436 FR_OBJ22_Track_Age " ";
CM_ SG_ 436 FR_OBJ22_Track_ID " ";
CM_ SG_ 436 FR_OBJ22_FusionedFC_Track_ID " ";
CM_ SG_ 436 FR_OBJ22_fusion_Sts " ";
CM_ SG_ 436 FR_OBJ22_ObstacleProb " ";
CM_ SG_ 436 FR_OBJ22_ExistProb " ";
CM_ SG_ 436 FR_OBJ22_Brakelight_Info " ";
CM_ SG_ 436 FR_OBJ22_Taillight_Info " ";
CM_ SG_ 436 FR_OBJ22_Dis_to_R_LaneMark " ";
CM_ SG_ 436 FR_OBJ22_Dis_to_L_LaneMark " ";
CM_ SG_ 436 FR_OBJ22_Ax " ";
CM_ SG_ 436 FR_OBJ22_Ay " ";
CM_ SG_ 436 FR_OBJ22_Vx_std " ";
CM_ SG_ 436 FR_OBJ22_Vx " ";
CM_ SG_ 436 FR_OBJ22_Vy_std " ";
CM_ SG_ 436 FR_OBJ22_Vy " ";
CM_ SG_ 436 FR_OBJ22_Dx_Vnce " ";
CM_ SG_ 436 FR_OBJ22_Dx " ";
CM_ SG_ 436 FR_OBJ22_Dy_Vnce " ";
CM_ SG_ 436 FR_OBJ22_Dy " ";
CM_ SG_ 436 FR_OBJ22_HeadingAngle " ";
CM_ SG_ 436 FR_OBJ22_Length " ";
CM_ SG_ 436 FR_OBJ22_Height " ";
CM_ SG_ 436 FR_OBJ22_Width " ";
CM_ SG_ 436 FR_OBJ22_Class " ";
CM_ SG_ 436 FR_OBJ21_Track_Age " ";
CM_ SG_ 436 FR_OBJ21_Track_ID " ";
CM_ SG_ 436 FR_OBJ21_FusionedFC_Track_ID " ";
CM_ SG_ 436 FR_OBJ21_fusion_Sts " ";
CM_ SG_ 436 FR_OBJ21_ObstacleProb " ";
CM_ SG_ 436 FR_OBJ21_ExistProb " ";
CM_ SG_ 436 FR_OBJ21_Brakelight_Info " ";
CM_ SG_ 436 FR_OBJ21_Taillight_Info " ";
CM_ SG_ 436 FR_OBJ21_Dis_to_R_LaneMark " ";
CM_ SG_ 436 FR_OBJ21_Dis_to_L_LaneMark " ";
CM_ SG_ 436 FR_OBJ21_Ax " ";
CM_ SG_ 436 FR_OBJ21_Ay " ";
CM_ SG_ 436 FR_OBJ21_Vx_std " ";
CM_ SG_ 436 FR_OBJ21_Vx " ";
CM_ SG_ 436 FR_OBJ21_Vy_std " ";
CM_ SG_ 436 FR_OBJ21_Vy " ";
CM_ SG_ 436 FR_OBJ21_Dx_Vnce " ";
CM_ SG_ 436 FR_OBJ21_Dx " ";
CM_ SG_ 436 FR_OBJ21_Dy_Vnce " ";
CM_ SG_ 436 FR_OBJ21_Dy " ";
CM_ SG_ 436 FR_OBJ21_HeadingAngle " ";
CM_ SG_ 436 FR_OBJ21_Length " ";
CM_ SG_ 436 FR_OBJ21_Height " ";
CM_ SG_ 436 FR_OBJ21_Width " ";
CM_ SG_ 436 FR_OBJ21_Class " ";
CM_ BO_ 437 " ";
CM_ SG_ 437 FR_OBJ24_Track_Age " ";
CM_ SG_ 437 FR_OBJ24_Track_ID " ";
CM_ SG_ 437 FR_OBJ24_FusionedFC_Track_ID " ";
CM_ SG_ 437 FR_OBJ24_fusion_Sts " ";
CM_ SG_ 437 FR_OBJ24_ObstacleProb " ";
CM_ SG_ 437 FR_OBJ24_ExistProb " ";
CM_ SG_ 437 FR_OBJ24_Brakelight_Info " ";
CM_ SG_ 437 FR_OBJ24_Taillight_Info " ";
CM_ SG_ 437 FR_OBJ24_Dis_to_R_LaneMark " ";
CM_ SG_ 437 FR_OBJ24_Dis_to_L_LaneMark " ";
CM_ SG_ 437 FR_OBJ24_Ax " ";
CM_ SG_ 437 FR_OBJ24_Ay " ";
CM_ SG_ 437 FR_OBJ24_Vx_std " ";
CM_ SG_ 437 FR_OBJ24_Vx " ";
CM_ SG_ 437 FR_OBJ24_Vy_std " ";
CM_ SG_ 437 FR_OBJ24_Vy " ";
CM_ SG_ 437 FR_OBJ24_Dx_Vnce " ";
CM_ SG_ 437 FR_OBJ24_Dx " ";
CM_ SG_ 437 FR_OBJ24_Dy_Vnce " ";
CM_ SG_ 437 FR_OBJ24_Dy " ";
CM_ SG_ 437 FR_OBJ24_HeadingAngle " ";
CM_ SG_ 437 FR_OBJ24_Length " ";
CM_ SG_ 437 FR_OBJ24_Height " ";
CM_ SG_ 437 FR_OBJ24_Width " ";
CM_ SG_ 437 FR_OBJ24_Class " ";
CM_ SG_ 437 FR_OBJ23_Track_Age " ";
CM_ SG_ 437 FR_OBJ23_Track_ID " ";
CM_ SG_ 437 FR_OBJ23_FusionedFC_Track_ID " ";
CM_ SG_ 437 FR_OBJ23_fusion_Sts " ";
CM_ SG_ 437 FR_OBJ23_ObstacleProb " ";
CM_ SG_ 437 FR_OBJ23_ExistProb " ";
CM_ SG_ 437 FR_OBJ23_Brakelight_Info " ";
CM_ SG_ 437 FR_OBJ23_Taillight_Info " ";
CM_ SG_ 437 FR_OBJ23_Dis_to_R_LaneMark " ";
CM_ SG_ 437 FR_OBJ23_Dis_to_L_LaneMark " ";
CM_ SG_ 437 FR_OBJ23_Ax " ";
CM_ SG_ 437 FR_OBJ23_Ay " ";
CM_ SG_ 437 FR_OBJ23_Vx_std " ";
CM_ SG_ 437 FR_OBJ23_Vx " ";
CM_ SG_ 437 FR_OBJ23_Vy_std " ";
CM_ SG_ 437 FR_OBJ23_Vy " ";
CM_ SG_ 437 FR_OBJ23_Dx_Vnce " ";
CM_ SG_ 437 FR_OBJ23_Dx " ";
CM_ SG_ 437 FR_OBJ23_Dy_Vnce " ";
CM_ SG_ 437 FR_OBJ23_Dy " ";
CM_ SG_ 437 FR_OBJ23_HeadingAngle " ";
CM_ SG_ 437 FR_OBJ23_Length " ";
CM_ SG_ 437 FR_OBJ23_Height " ";
CM_ SG_ 437 FR_OBJ23_Width " ";
CM_ SG_ 437 FR_OBJ23_Class " ";
CM_ BO_ 438 " ";
CM_ SG_ 438 FR_OBJ26_Track_Age " ";
CM_ SG_ 438 FR_OBJ26_Track_ID " ";
CM_ SG_ 438 FR_OBJ26_FusionedFC_Track_ID " ";
CM_ SG_ 438 FR_OBJ26_fusion_Sts " ";
CM_ SG_ 438 FR_OBJ26_ObstacleProb " ";
CM_ SG_ 438 FR_OBJ26_ExistProb " ";
CM_ SG_ 438 FR_OBJ26_Brakelight_Info " ";
CM_ SG_ 438 FR_OBJ26_Taillight_Info " ";
CM_ SG_ 438 FR_OBJ26_Dis_to_R_LaneMark " ";
CM_ SG_ 438 FR_OBJ26_Dis_to_L_LaneMark " ";
CM_ SG_ 438 FR_OBJ26_Ax " ";
CM_ SG_ 438 FR_OBJ26_Ay " ";
CM_ SG_ 438 FR_OBJ26_Vx_std " ";
CM_ SG_ 438 FR_OBJ26_Vx " ";
CM_ SG_ 438 FR_OBJ26_Vy_std " ";
CM_ SG_ 438 FR_OBJ26_Vy " ";
CM_ SG_ 438 FR_OBJ26_Dx_Vnce " ";
CM_ SG_ 438 FR_OBJ26_Dx " ";
CM_ SG_ 438 FR_OBJ26_Dy_Vnce " ";
CM_ SG_ 438 FR_OBJ26_Dy " ";
CM_ SG_ 438 FR_OBJ26_HeadingAngle " ";
CM_ SG_ 438 FR_OBJ26_Length " ";
CM_ SG_ 438 FR_OBJ26_Height " ";
CM_ SG_ 438 FR_OBJ26_Width " ";
CM_ SG_ 438 FR_OBJ26_Class " ";
CM_ SG_ 438 FR_OBJ25_Track_Age " ";
CM_ SG_ 438 FR_OBJ25_Track_ID " ";
CM_ SG_ 438 FR_OBJ25_FusionedFC_Track_ID " ";
CM_ SG_ 438 FR_OBJ25_fusion_Sts " ";
CM_ SG_ 438 FR_OBJ25_ObstacleProb " ";
CM_ SG_ 438 FR_OBJ25_ExistProb " ";
CM_ SG_ 438 FR_OBJ25_Brakelight_Info " ";
CM_ SG_ 438 FR_OBJ25_Taillight_Info " ";
CM_ SG_ 438 FR_OBJ25_Dis_to_R_LaneMark " ";
CM_ SG_ 438 FR_OBJ25_Dis_to_L_LaneMark " ";
CM_ SG_ 438 FR_OBJ25_Ax " ";
CM_ SG_ 438 FR_OBJ25_Ay " ";
CM_ SG_ 438 FR_OBJ25_Vx_std " ";
CM_ SG_ 438 FR_OBJ25_Vx " ";
CM_ SG_ 438 FR_OBJ25_Vy_std " ";
CM_ SG_ 438 FR_OBJ25_Vy " ";
CM_ SG_ 438 FR_OBJ25_Dx_Vnce " ";
CM_ SG_ 438 FR_OBJ25_Dx " ";
CM_ SG_ 438 FR_OBJ25_Dy_Vnce " ";
CM_ SG_ 438 FR_OBJ25_Dy " ";
CM_ SG_ 438 FR_OBJ25_HeadingAngle " ";
CM_ SG_ 438 FR_OBJ25_Length " ";
CM_ SG_ 438 FR_OBJ25_Height " ";
CM_ SG_ 438 FR_OBJ25_Width " ";
CM_ SG_ 438 FR_OBJ25_Class " ";
CM_ BO_ 439 " ";
CM_ SG_ 439 FR_OBJ28_Track_Age " ";
CM_ SG_ 439 FR_OBJ28_Track_ID " ";
CM_ SG_ 439 FR_OBJ28_FusionedFC_Track_ID " ";
CM_ SG_ 439 FR_OBJ28_fusion_Sts " ";
CM_ SG_ 439 FR_OBJ28_ObstacleProb " ";
CM_ SG_ 439 FR_OBJ28_ExistProb " ";
CM_ SG_ 439 FR_OBJ28_Brakelight_Info " ";
CM_ SG_ 439 FR_OBJ28_Taillight_Info " ";
CM_ SG_ 439 FR_OBJ28_Dis_to_R_LaneMark " ";
CM_ SG_ 439 FR_OBJ28_Dis_to_L_LaneMark " ";
CM_ SG_ 439 FR_OBJ28_Ax " ";
CM_ SG_ 439 FR_OBJ28_Ay " ";
CM_ SG_ 439 FR_OBJ28_Vx_std " ";
CM_ SG_ 439 FR_OBJ28_Vx " ";
CM_ SG_ 439 FR_OBJ28_Vy_std " ";
CM_ SG_ 439 FR_OBJ28_Vy " ";
CM_ SG_ 439 FR_OBJ28_Dx_Vnce " ";
CM_ SG_ 439 FR_OBJ28_Dx " ";
CM_ SG_ 439 FR_OBJ28_Dy_Vnce " ";
CM_ SG_ 439 FR_OBJ28_Dy " ";
CM_ SG_ 439 FR_OBJ28_HeadingAngle " ";
CM_ SG_ 439 FR_OBJ28_Length " ";
CM_ SG_ 439 FR_OBJ28_Height " ";
CM_ SG_ 439 FR_OBJ28_Width " ";
CM_ SG_ 439 FR_OBJ28_Class " ";
CM_ SG_ 439 FR_OBJ27_Track_Age " ";
CM_ SG_ 439 FR_OBJ27_Track_ID " ";
CM_ SG_ 439 FR_OBJ27_FusionedFC_Track_ID " ";
CM_ SG_ 439 FR_OBJ27_fusion_Sts " ";
CM_ SG_ 439 FR_OBJ27_ObstacleProb " ";
CM_ SG_ 439 FR_OBJ27_ExistProb " ";
CM_ SG_ 439 FR_OBJ27_Brakelight_Info " ";
CM_ SG_ 439 FR_OBJ27_Taillight_Info " ";
CM_ SG_ 439 FR_OBJ27_Dis_to_R_LaneMark " ";
CM_ SG_ 439 FR_OBJ27_Dis_to_L_LaneMark " ";
CM_ SG_ 439 FR_OBJ27_Ax " ";
CM_ SG_ 439 FR_OBJ27_Ay " ";
CM_ SG_ 439 FR_OBJ27_Vx_std " ";
CM_ SG_ 439 FR_OBJ27_Vx " ";
CM_ SG_ 439 FR_OBJ27_Vy_std " ";
CM_ SG_ 439 FR_OBJ27_Vy " ";
CM_ SG_ 439 FR_OBJ27_Dx_Vnce " ";
CM_ SG_ 439 FR_OBJ27_Dx " ";
CM_ SG_ 439 FR_OBJ27_Dy_Vnce " ";
CM_ SG_ 439 FR_OBJ27_Dy " ";
CM_ SG_ 439 FR_OBJ27_HeadingAngle " ";
CM_ SG_ 439 FR_OBJ27_Length " ";
CM_ SG_ 439 FR_OBJ27_Height " ";
CM_ SG_ 439 FR_OBJ27_Width " ";
CM_ SG_ 439 FR_OBJ27_Class " ";
CM_ BO_ 440 " ";
CM_ SG_ 440 FR_OBJ30_Track_Age " ";
CM_ SG_ 440 FR_OBJ30_Track_ID " ";
CM_ SG_ 440 FR_OBJ30_FusionedFC_Track_ID " ";
CM_ SG_ 440 FR_OBJ30_fusion_Sts " ";
CM_ SG_ 440 FR_OBJ30_ObstacleProb " ";
CM_ SG_ 440 FR_OBJ30_ExistProb " ";
CM_ SG_ 440 FR_OBJ30_Brakelight_Info " ";
CM_ SG_ 440 FR_OBJ30_Taillight_Info " ";
CM_ SG_ 440 FR_OBJ30_Dis_to_R_LaneMark " ";
CM_ SG_ 440 FR_OBJ30_Dis_to_L_LaneMark " ";
CM_ SG_ 440 FR_OBJ30_Ax " ";
CM_ SG_ 440 FR_OBJ30_Ay " ";
CM_ SG_ 440 FR_OBJ30_Vx_std " ";
CM_ SG_ 440 FR_OBJ30_Vx " ";
CM_ SG_ 440 FR_OBJ30_Vy_std " ";
CM_ SG_ 440 FR_OBJ30_Vy " ";
CM_ SG_ 440 FR_OBJ30_Dx_Vnce " ";
CM_ SG_ 440 FR_OBJ30_Dx " ";
CM_ SG_ 440 FR_OBJ30_Dy_Vnce " ";
CM_ SG_ 440 FR_OBJ30_Dy " ";
CM_ SG_ 440 FR_OBJ30_HeadingAngle " ";
CM_ SG_ 440 FR_OBJ30_Length " ";
CM_ SG_ 440 FR_OBJ30_Height " ";
CM_ SG_ 440 FR_OBJ30_Width " ";
CM_ SG_ 440 FR_OBJ30_Class " ";
CM_ SG_ 440 FR_OBJ29_Track_Age " ";
CM_ SG_ 440 FR_OBJ29_Track_ID " ";
CM_ SG_ 440 FR_OBJ29_FusionedFC_Track_ID " ";
CM_ SG_ 440 FR_OBJ29_fusion_Sts " ";
CM_ SG_ 440 FR_OBJ29_ObstacleProb " ";
CM_ SG_ 440 FR_OBJ29_ExistProb " ";
CM_ SG_ 440 FR_OBJ29_Brakelight_Info " ";
CM_ SG_ 440 FR_OBJ29_Taillight_Info " ";
CM_ SG_ 440 FR_OBJ29_Dis_to_R_LaneMark " ";
CM_ SG_ 440 FR_OBJ29_Dis_to_L_LaneMark " ";
CM_ SG_ 440 FR_OBJ29_Ax " ";
CM_ SG_ 440 FR_OBJ29_Ay " ";
CM_ SG_ 440 FR_OBJ29_Vx_std " ";
CM_ SG_ 440 FR_OBJ29_Vx " ";
CM_ SG_ 440 FR_OBJ29_Vy_std " ";
CM_ SG_ 440 FR_OBJ29_Vy " ";
CM_ SG_ 440 FR_OBJ29_Dx_Vnce " ";
CM_ SG_ 440 FR_OBJ29_Dx " ";
CM_ SG_ 440 FR_OBJ29_Dy_Vnce " ";
CM_ SG_ 440 FR_OBJ29_Dy " ";
CM_ SG_ 440 FR_OBJ29_HeadingAngle " ";
CM_ SG_ 440 FR_OBJ29_Length " ";
CM_ SG_ 440 FR_OBJ29_Height " ";
CM_ SG_ 440 FR_OBJ29_Width " ";
CM_ SG_ 440 FR_OBJ29_Class " ";
CM_ BO_ 441 " ";
CM_ SG_ 441 FR_OBJ32_Track_Age " ";
CM_ SG_ 441 FR_OBJ32_Track_ID " ";
CM_ SG_ 441 FR_OBJ32_FusionedFC_Track_ID " ";
CM_ SG_ 441 FR_OBJ32_fusion_Sts " ";
CM_ SG_ 441 FR_OBJ32_ObstacleProb " ";
CM_ SG_ 441 FR_OBJ32_ExistProb " ";
CM_ SG_ 441 FR_OBJ32_Brakelight_Info " ";
CM_ SG_ 441 FR_OBJ32_Taillight_Info " ";
CM_ SG_ 441 FR_OBJ32_Dis_to_R_LaneMark " ";
CM_ SG_ 441 FR_OBJ32_Dis_to_L_LaneMark " ";
CM_ SG_ 441 FR_OBJ32_Ax " ";
CM_ SG_ 441 FR_OBJ32_Ay " ";
CM_ SG_ 441 FR_OBJ32_Vx_std " ";
CM_ SG_ 441 FR_OBJ32_Vx " ";
CM_ SG_ 441 FR_OBJ32_Vy_std " ";
CM_ SG_ 441 FR_OBJ32_Vy " ";
CM_ SG_ 441 FR_OBJ32_Dx_Vnce " ";
CM_ SG_ 441 FR_OBJ32_Dx " ";
CM_ SG_ 441 FR_OBJ32_Dy_Vnce " ";
CM_ SG_ 441 FR_OBJ32_Dy " ";
CM_ SG_ 441 FR_OBJ32_HeadingAngle " ";
CM_ SG_ 441 FR_OBJ32_Length " ";
CM_ SG_ 441 FR_OBJ32_Height " ";
CM_ SG_ 441 FR_OBJ32_Width " ";
CM_ SG_ 441 FR_OBJ32_Class " ";
CM_ SG_ 441 FR_OBJ31_Track_Age " ";
CM_ SG_ 441 FR_OBJ31_Track_ID " ";
CM_ SG_ 441 FR_OBJ31_FusionedFC_Track_ID " ";
CM_ SG_ 441 FR_OBJ31_fusion_Sts " ";
CM_ SG_ 441 FR_OBJ31_ObstacleProb " ";
CM_ SG_ 441 FR_OBJ31_ExistProb " ";
CM_ SG_ 441 FR_OBJ31_Brakelight_Info " ";
CM_ SG_ 441 FR_OBJ31_Taillight_Info " ";
CM_ SG_ 441 FR_OBJ31_Dis_to_R_LaneMark " ";
CM_ SG_ 441 FR_OBJ31_Dis_to_L_LaneMark " ";
CM_ SG_ 441 FR_OBJ31_Ax " ";
CM_ SG_ 441 FR_OBJ31_Ay " ";
CM_ SG_ 441 FR_OBJ31_Vx_std " ";
CM_ SG_ 441 FR_OBJ31_Vx " ";
CM_ SG_ 441 FR_OBJ31_Vy_std " ";
CM_ SG_ 441 FR_OBJ31_Vy " ";
CM_ SG_ 441 FR_OBJ31_Dx_Vnce " ";
CM_ SG_ 441 FR_OBJ31_Dx " ";
CM_ SG_ 441 FR_OBJ31_Dy_Vnce " ";
CM_ SG_ 441 FR_OBJ31_Dy " ";
CM_ SG_ 441 FR_OBJ31_HeadingAngle " ";
CM_ SG_ 441 FR_OBJ31_Length " ";
CM_ SG_ 441 FR_OBJ31_Height " ";
CM_ SG_ 441 FR_OBJ31_Width " ";
CM_ SG_ 441 FR_OBJ31_Class " ";
CM_ BO_ 442 " ";
CM_ SG_ 442 FR_RightGuardrail_dy " ";
CM_ SG_ 442 FR_RightGuardrailConfidence " ";
CM_ SG_ 442 FR_LeftGuardrail_dy " ";
CM_ SG_ 442 FR_LeftGuardrailConfidence " ";
CM_ BO_ 443 " ";
CM_ SG_ 443 FR_FCWPreWarning " ";
CM_ SG_ 443 FR_FCWLatentWarning " ";
CM_ SG_ 443 FR_FCWActive " ";
CM_ SG_ 443 FR_FCWStatus " ";
CM_ SG_ 443 FR_AEBTargetLatRange " ";
CM_ SG_ 443 FR_AEBTargetLngRange " ";
CM_ SG_ 443 FR_AEBTargetRelSpeed " ";
CM_ SG_ 443 FR_AEBTextInfo " ";
CM_ SG_ 443 FR_AEBStatus " ";
CM_ SG_ 443 FR_ABAActive " ";
CM_ SG_ 443 FR_ABAlevel " ";
CM_ SG_ 443 FR_AWBActive " ";
CM_ SG_ 443 FR_AWBlevel " ";
CM_ SG_ 443 FR_PrefillActive " ";
CM_ SG_ 443 FR_AEBVehilceHoldReq " ";
CM_ SG_ 443 FR_AEBCtrlType " ";
CM_ SG_ 443 FR_AEBTargetDeceleration " ";
CM_ SG_ 443 FR_AEBActive " ";
CM_ SG_ 443 FR_AEBTargetmode " ";
CM_ SG_ 443 FR_OBJ_TTC " ";
CM_ SG_ 443 FR_OBJ_AEB_ID " ";
CM_ BO_ 444 " ";
CM_ SG_ 444 FR_LKATakeoverReq " ";
CM_ SG_ 444 FR_LKAStatus " ";
CM_ SG_ 444 FR_LDWVibrationWarningReq " ";
CM_ SG_ 444 FR_LDWStatus " ";
CM_ BO_ 445 " ";
CM_ SG_ 445 FR_LatAngReqActive " ";
CM_ SG_ 445 FR_LatAngReq " ";
CM_ SG_ 445 FR_MotorTorqueMinLimitRequest " ";
CM_ SG_ 445 FR_MotorTorqueMaxLimitRequest " ";
CM_ BO_ 446 " ";
CM_ SG_ 446 FR_ELKEnableStatus " ";
CM_ SG_ 446 FR_RadarFailureStatus " ";
CM_ SG_ 446 FR_FRadarCalibrationStatus " ";
CM_ SG_ 446 FR_HostLaneLeftStatus " ";
CM_ SG_ 446 FR_HostLaneRightStatus " ";
CM_ SG_ 446 FR_Voiceinfo " ";
CM_ SG_ 446 FR_ELKInterventionMode " ";
CM_ SG_ 446 FR_ELKMode " ";
CM_ BO_ 448 " ";
CM_ SG_ 448 ADS_UDLCStatus " ";
CM_ SG_ 448 ADS_IACCHWAMode " ";
CM_ BO_ 449 " ";
CM_ SG_ 449 FR_OBJ2_Track_Age " ";
CM_ SG_ 449 FR_OBJ2_Track_ID " ";
CM_ SG_ 449 FR_OBJ2_FusionedFC_Track_ID " ";
CM_ SG_ 449 FR_OBJ2_fusion_Sts " ";
CM_ SG_ 449 FR_OBJ2_ObstacleProb " ";
CM_ SG_ 449 FR_OBJ2_ExistProb " ";
CM_ SG_ 449 FR_OBJ2_Brakelight_Info " ";
CM_ SG_ 449 FR_OBJ2_Taillight_Info " ";
CM_ SG_ 449 FR_OBJ2_Dis_to_R_LaneMark " ";
CM_ SG_ 449 FR_OBJ2_Dis_to_L_LaneMark " ";
CM_ SG_ 449 FR_OBJ2_Ax " ";
CM_ SG_ 449 FR_OBJ2_Ay " ";
CM_ SG_ 449 FR_OBJ2_Vx_std " ";
CM_ SG_ 449 FR_OBJ2_Vx " ";
CM_ SG_ 449 FR_OBJ2_Vy_std " ";
CM_ SG_ 449 FR_OBJ2_Vy " ";
CM_ SG_ 449 FR_OBJ2_Dx_Vnce " ";
CM_ SG_ 449 FR_OBJ2_Dx " ";
CM_ SG_ 449 FR_OBJ2_Dy_Vnce " ";
CM_ SG_ 449 FR_OBJ2_Dy " ";
CM_ SG_ 449 FR_OBJ2_HeadingAngle " ";
CM_ SG_ 449 FR_OBJ2_Length " ";
CM_ SG_ 449 FR_OBJ2_Height " ";
CM_ SG_ 449 FR_OBJ2_Width " ";
CM_ SG_ 449 FR_OBJ2_Class " ";
CM_ SG_ 449 FR_OBJ1_Track_Age " ";
CM_ SG_ 449 FR_OBJ1_Track_ID " ";
CM_ SG_ 449 FR_OBJ1_FusionedFC_Track_ID " ";
CM_ SG_ 449 FR_OBJ1_fusion_Sts " ";
CM_ SG_ 449 FR_OBJ1_ObstacleProb " ";
CM_ SG_ 449 FR_OBJ1_ExistProb " ";
CM_ SG_ 449 FR_OBJ1_Brakelight_Info " ";
CM_ SG_ 449 FR_OBJ1_Taillight_Info " ";
CM_ SG_ 449 FR_OBJ1_Dis_to_R_LaneMark " ";
CM_ SG_ 449 FR_OBJ1_Dis_to_L_LaneMark " ";
CM_ SG_ 449 FR_OBJ1_Ax " ";
CM_ SG_ 449 FR_OBJ1_Ay " ";
CM_ SG_ 449 FR_OBJ1_Vx_std " ";
CM_ SG_ 449 FR_OBJ1_Vx " ";
CM_ SG_ 449 FR_OBJ1_Vy_std " ";
CM_ SG_ 449 FR_OBJ1_Vy " ";
CM_ SG_ 449 FR_OBJ1_Dx_Vnce " ";
CM_ SG_ 449 FR_OBJ1_Dx " ";
CM_ SG_ 449 FR_OBJ1_Dy_Vnce " ";
CM_ SG_ 449 FR_OBJ1_Dy " ";
CM_ SG_ 449 FR_OBJ1_HeadingAngle " ";
CM_ SG_ 449 FR_OBJ1_Length " ";
CM_ SG_ 449 FR_OBJ1_Height " ";
CM_ SG_ 449 FR_OBJ1_Width " ";
CM_ SG_ 449 FR_OBJ1_Class " ";
CM_ BO_ 450 " ";
CM_ SG_ 450 FR_OBJ4_Track_Age " ";
CM_ SG_ 450 FR_OBJ4_Track_ID " ";
CM_ SG_ 450 FR_OBJ4_FusionedFC_Track_ID " ";
CM_ SG_ 450 FR_OBJ4_fusion_Sts " ";
CM_ SG_ 450 FR_OBJ4_ObstacleProb " ";
CM_ SG_ 450 FR_OBJ4_ExistProb " ";
CM_ SG_ 450 FR_OBJ4_Brakelight_Info " ";
CM_ SG_ 450 FR_OBJ4_Taillight_Info " ";
CM_ SG_ 450 FR_OBJ4_Dis_to_R_LaneMark " ";
CM_ SG_ 450 FR_OBJ4_Dis_to_L_LaneMark " ";
CM_ SG_ 450 FR_OBJ4_Ax " ";
CM_ SG_ 450 FR_OBJ4_Ay " ";
CM_ SG_ 450 FR_OBJ4_Vx_std " ";
CM_ SG_ 450 FR_OBJ4_Vx " ";
CM_ SG_ 450 FR_OBJ4_Vy_std " ";
CM_ SG_ 450 FR_OBJ4_Vy " ";
CM_ SG_ 450 FR_OBJ4_Dx_Vnce " ";
CM_ SG_ 450 FR_OBJ4_Dx " ";
CM_ SG_ 450 FR_OBJ4_Dy_Vnce " ";
CM_ SG_ 450 FR_OBJ4_Dy " ";
CM_ SG_ 450 FR_OBJ4_HeadingAngle " ";
CM_ SG_ 450 FR_OBJ4_Length " ";
CM_ SG_ 450 FR_OBJ4_Height " ";
CM_ SG_ 450 FR_OBJ4_Width " ";
CM_ SG_ 450 FR_OBJ4_Class " ";
CM_ SG_ 450 FR_OBJ3_Track_Age " ";
CM_ SG_ 450 FR_OBJ3_Track_ID " ";
CM_ SG_ 450 FR_OBJ3_FusionedFC_Track_ID " ";
CM_ SG_ 450 FR_OBJ3_fusion_Sts " ";
CM_ SG_ 450 FR_OBJ3_ObstacleProb " ";
CM_ SG_ 450 FR_OBJ3_ExistProb " ";
CM_ SG_ 450 FR_OBJ3_Brakelight_Info " ";
CM_ SG_ 450 FR_OBJ3_Taillight_Info " ";
CM_ SG_ 450 FR_OBJ3_Dis_to_R_LaneMark " ";
CM_ SG_ 450 FR_OBJ3_Dis_to_L_LaneMark " ";
CM_ SG_ 450 FR_OBJ3_Ax " ";
CM_ SG_ 450 FR_OBJ3_Ay " ";
CM_ SG_ 450 FR_OBJ3_Vx_std " ";
CM_ SG_ 450 FR_OBJ3_Vx " ";
CM_ SG_ 450 FR_OBJ3_Vy_std " ";
CM_ SG_ 450 FR_OBJ3_Vy " ";
CM_ SG_ 450 FR_OBJ3_Dx_Vnce " ";
CM_ SG_ 450 FR_OBJ3_Dx " ";
CM_ SG_ 450 FR_OBJ3_Dy_Vnce " ";
CM_ SG_ 450 FR_OBJ3_Dy " ";
CM_ SG_ 450 FR_OBJ3_HeadingAngle " ";
CM_ SG_ 450 FR_OBJ3_Length " ";
CM_ SG_ 450 FR_OBJ3_Height " ";
CM_ SG_ 450 FR_OBJ3_Width " ";
CM_ SG_ 450 FR_OBJ3_Class " ";
CM_ BO_ 451 " ";
CM_ SG_ 451 FR_OBJ6_Track_Age " ";
CM_ SG_ 451 FR_OBJ6_Track_ID " ";
CM_ SG_ 451 FR_OBJ6_FusionedFC_Track_ID " ";
CM_ SG_ 451 FR_OBJ6_fusion_Sts " ";
CM_ SG_ 451 FR_OBJ6_ObstacleProb " ";
CM_ SG_ 451 FR_OBJ6_ExistProb " ";
CM_ SG_ 451 FR_OBJ6_Brakelight_Info " ";
CM_ SG_ 451 FR_OBJ6_Taillight_Info " ";
CM_ SG_ 451 FR_OBJ6_Dis_to_R_LaneMark " ";
CM_ SG_ 451 FR_OBJ6_Dis_to_L_LaneMark " ";
CM_ SG_ 451 FR_OBJ6_Ax " ";
CM_ SG_ 451 FR_OBJ6_Ay " ";
CM_ SG_ 451 FR_OBJ6_Vx_std " ";
CM_ SG_ 451 FR_OBJ6_Vx " ";
CM_ SG_ 451 FR_OBJ6_Vy_std " ";
CM_ SG_ 451 FR_OBJ6_Vy " ";
CM_ SG_ 451 FR_OBJ6_Dx_Vnce " ";
CM_ SG_ 451 FR_OBJ6_Dx " ";
CM_ SG_ 451 FR_OBJ6_Dy_Vnce " ";
CM_ SG_ 451 FR_OBJ6_Dy " ";
CM_ SG_ 451 FR_OBJ6_HeadingAngle " ";
CM_ SG_ 451 FR_OBJ6_Length " ";
CM_ SG_ 451 FR_OBJ6_Height " ";
CM_ SG_ 451 FR_OBJ6_Width " ";
CM_ SG_ 451 FR_OBJ6_Class " ";
CM_ SG_ 451 FR_OBJ5_Track_Age " ";
CM_ SG_ 451 FR_OBJ5_Track_ID " ";
CM_ SG_ 451 FR_OBJ5_FusionedFC_Track_ID " ";
CM_ SG_ 451 FR_OBJ5_fusion_Sts " ";
CM_ SG_ 451 FR_OBJ5_ObstacleProb " ";
CM_ SG_ 451 FR_OBJ5_ExistProb " ";
CM_ SG_ 451 FR_OBJ5_Brakelight_Info " ";
CM_ SG_ 451 FR_OBJ5_Taillight_Info " ";
CM_ SG_ 451 FR_OBJ5_Dis_to_R_LaneMark " ";
CM_ SG_ 451 FR_OBJ5_Dis_to_L_LaneMark " ";
CM_ SG_ 451 FR_OBJ5_Ax " ";
CM_ SG_ 451 FR_OBJ5_Ay " ";
CM_ SG_ 451 FR_OBJ5_Vx_std " ";
CM_ SG_ 451 FR_OBJ5_Vx " ";
CM_ SG_ 451 FR_OBJ5_Vy_std " ";
CM_ SG_ 451 FR_OBJ5_Vy " ";
CM_ SG_ 451 FR_OBJ5_Dx_Vnce " ";
CM_ SG_ 451 FR_OBJ5_Dx " ";
CM_ SG_ 451 FR_OBJ5_Dy_Vnce " ";
CM_ SG_ 451 FR_OBJ5_Dy " ";
CM_ SG_ 451 FR_OBJ5_HeadingAngle " ";
CM_ SG_ 451 FR_OBJ5_Length " ";
CM_ SG_ 451 FR_OBJ5_Height " ";
CM_ SG_ 451 FR_OBJ5_Width " ";
CM_ SG_ 451 FR_OBJ5_Class " ";
CM_ BO_ 452 " ";
CM_ SG_ 452 FR_AEBOBJ_Track_Age " ";
CM_ SG_ 452 FR_AEBOBJ_Track_ID " ";
CM_ SG_ 452 FR_AEBOBJ_FusionedFC_Track_ID " ";
CM_ SG_ 452 FR_AEBOBJ_fusion_Sts " ";
CM_ SG_ 452 FR_AEBOBJ_ObstacleProb " ";
CM_ SG_ 452 FR_AEBOBJ_ExistProb " ";
CM_ SG_ 452 FR_AEBOBJ_Brakelight_Info " ";
CM_ SG_ 452 FR_AEBOBJ_Taillight_Info " ";
CM_ SG_ 452 FR_AEBOBJ_Dis_to_R_LaneMark " ";
CM_ SG_ 452 FR_AEBOBJ_Dis_to_L_LaneMark " ";
CM_ SG_ 452 FR_AEBOBJ_Ax " ";
CM_ SG_ 452 FR_AEBOBJ_Ay " ";
CM_ SG_ 452 FR_AEBOBJ_Vx_std " ";
CM_ SG_ 452 FR_AEBOBJ_Vx " ";
CM_ SG_ 452 FR_AEBOBJ_Vy_std " ";
CM_ SG_ 452 FR_AEBOBJ_Vy " ";
CM_ SG_ 452 FR_AEBOBJ_Dx_Vnce " ";
CM_ SG_ 452 FR_AEBOBJ_Dx " ";
CM_ SG_ 452 FR_AEBOBJ_Dy_Vnce " ";
CM_ SG_ 452 FR_AEBOBJ_Dy " ";
CM_ SG_ 452 FR_AEBOBJ_HeadingAngle " ";
CM_ SG_ 452 FR_AEBOBJ_Length " ";
CM_ SG_ 452 FR_AEBOBJ_Height " ";
CM_ SG_ 452 FR_AEBOBJ_Width " ";
CM_ SG_ 452 FR_AEBOBJ_Class " ";
CM_ BO_ 423 "reserved ";
CM_ SG_ 423 FC_Reserved_1A7 " ";
CM_ BO_ 425 "reserved ";
CM_ SG_ 425 FC_Reserved_1A9 " ";
CM_ BO_ 453 "reserved ";
CM_ SG_ 453 FR_Reserved_1C5 " ";
CM_ BO_ 454 "reserved ";
CM_ SG_ 454 FR_Reserved_1C6 " ";
BA_DEF_ SG_  "GenSigStartValue" INT 0 0;
BA_DEF_ SG_  "GenSigInvalidValue" STRING ;
BA_DEF_ SG_  "GenSigCycleTime" INT 0 0;
BA_DEF_ SG_  "GenSigSendType" ENUM  "Cyclic","OnWrite","OnWriteWithRepetition","OnChange","OnChangeWithRepetition","IfActive","IfActiveWithRepetition","NoSigSendType","NotUsed","NotUsed","NotUsed","NotUsed","NotUsed";
BA_DEF_ BO_  "GenMsgSendType" ENUM  "Cyclic","Event","NotUsed","NotUsed","NotUsed","Cyclic","NotUsed","IfActive","NoMsgSendType","NotUsed";
BA_DEF_ BO_  "GenMsgILSupport" ENUM  "No","Yes";
BA_DEF_ BO_  "GenMsgCycleTime" INT 0 65535;
BA_DEF_ BO_  "CANFD_BRS" ENUM  "0","1";
BA_DEF_ BO_  "VFrameFormat" ENUM  "StandardCAN","ExtendedCAN","reserved","reserved","reserved","reserved","reserved","reserved","reserved","reserved","reserved","reserved","reserved","reserved","StandardCAN_FD","ExtendedCAN_FD";
BA_DEF_DEF_  "GenSigStartValue" 0;
BA_DEF_DEF_  "GenSigInvalidValue" "/";
BA_DEF_DEF_  "GenSigCycleTime" 0;
BA_DEF_DEF_  "GenSigSendType" "Cyclic";
BA_DEF_DEF_  "GenMsgSendType" "NoMsgSendType";
BA_DEF_DEF_  "GenMsgILSupport" "Yes";
BA_DEF_DEF_  "GenMsgCycleTime" 0;
BA_DEF_DEF_  "CANFD_BRS" "1";
BA_DEF_DEF_  "VFrameFormat" "StandardCAN";
BA_ "GenMsgSendType" BO_ 427 0;
BA_ "GenMsgCycleTime" BO_ 427 50;
BA_ "VFrameFormat" BO_ 427 14;
BA_ "GenMsgSendType" BO_ 428 0;
BA_ "GenMsgCycleTime" BO_ 428 50;
BA_ "VFrameFormat" BO_ 428 14;
BA_ "GenMsgSendType" BO_ 429 0;
BA_ "GenMsgCycleTime" BO_ 429 50;
BA_ "VFrameFormat" BO_ 429 14;
BA_ "GenMsgSendType" BO_ 430 0;
BA_ "GenMsgCycleTime" BO_ 430 50;
BA_ "VFrameFormat" BO_ 430 14;
BA_ "GenMsgSendType" BO_ 431 0;
BA_ "GenMsgCycleTime" BO_ 431 50;
BA_ "VFrameFormat" BO_ 431 14;
BA_ "GenMsgSendType" BO_ 432 0;
BA_ "GenMsgCycleTime" BO_ 432 50;
BA_ "VFrameFormat" BO_ 432 14;
BA_ "GenMsgSendType" BO_ 433 0;
BA_ "GenMsgCycleTime" BO_ 433 50;
BA_ "VFrameFormat" BO_ 433 14;
BA_ "GenMsgSendType" BO_ 434 0;
BA_ "GenMsgCycleTime" BO_ 434 50;
BA_ "VFrameFormat" BO_ 434 14;
BA_ "GenMsgSendType" BO_ 435 0;
BA_ "GenMsgCycleTime" BO_ 435 50;
BA_ "VFrameFormat" BO_ 435 14;
BA_ "GenMsgSendType" BO_ 436 0;
BA_ "GenMsgCycleTime" BO_ 436 50;
BA_ "VFrameFormat" BO_ 436 14;
BA_ "GenMsgSendType" BO_ 437 0;
BA_ "GenMsgCycleTime" BO_ 437 50;
BA_ "VFrameFormat" BO_ 437 14;
BA_ "GenMsgSendType" BO_ 438 0;
BA_ "GenMsgCycleTime" BO_ 438 50;
BA_ "VFrameFormat" BO_ 438 14;
BA_ "GenMsgSendType" BO_ 439 0;
BA_ "GenMsgCycleTime" BO_ 439 50;
BA_ "VFrameFormat" BO_ 439 14;
BA_ "GenMsgSendType" BO_ 440 0;
BA_ "GenMsgCycleTime" BO_ 440 50;
BA_ "VFrameFormat" BO_ 440 14;
BA_ "GenMsgSendType" BO_ 441 0;
BA_ "GenMsgCycleTime" BO_ 441 50;
BA_ "VFrameFormat" BO_ 441 14;
BA_ "GenMsgSendType" BO_ 442 0;
BA_ "GenMsgCycleTime" BO_ 442 100;
BA_ "VFrameFormat" BO_ 442 14;
BA_ "GenMsgSendType" BO_ 443 0;
BA_ "GenMsgCycleTime" BO_ 443 20;
BA_ "VFrameFormat" BO_ 443 14;
BA_ "GenMsgSendType" BO_ 444 0;
BA_ "GenMsgCycleTime" BO_ 444 20;
BA_ "VFrameFormat" BO_ 444 14;
BA_ "GenMsgSendType" BO_ 445 0;
BA_ "GenMsgCycleTime" BO_ 445 10;
BA_ "VFrameFormat" BO_ 445 14;
BA_ "GenMsgSendType" BO_ 446 0;
BA_ "GenMsgCycleTime" BO_ 446 100;
BA_ "VFrameFormat" BO_ 446 14;
BA_ "GenMsgSendType" BO_ 448 0;
BA_ "GenMsgCycleTime" BO_ 448 100;
BA_ "VFrameFormat" BO_ 448 14;
BA_ "GenMsgSendType" BO_ 449 0;
BA_ "GenMsgCycleTime" BO_ 449 50;
BA_ "VFrameFormat" BO_ 449 14;
BA_ "GenMsgSendType" BO_ 450 0;
BA_ "GenMsgCycleTime" BO_ 450 50;
BA_ "VFrameFormat" BO_ 450 14;
BA_ "GenMsgSendType" BO_ 451 0;
BA_ "GenMsgCycleTime" BO_ 451 50;
BA_ "VFrameFormat" BO_ 451 14;
BA_ "GenMsgSendType" BO_ 452 0;
BA_ "GenMsgCycleTime" BO_ 452 50;
BA_ "VFrameFormat" BO_ 452 14;
BA_ "GenMsgSendType" BO_ 423 0;
BA_ "GenMsgCycleTime" BO_ 423 60;
BA_ "VFrameFormat" BO_ 423 14;
BA_ "GenMsgSendType" BO_ 425 0;
BA_ "GenMsgCycleTime" BO_ 425 60;
BA_ "VFrameFormat" BO_ 425 14;
BA_ "GenMsgSendType" BO_ 453 0;
BA_ "GenMsgCycleTime" BO_ 453 50;
BA_ "VFrameFormat" BO_ 453 14;
BA_ "GenMsgSendType" BO_ 454 0;
BA_ "GenMsgCycleTime" BO_ 454 50;
BA_ "VFrameFormat" BO_ 454 14;
BA_ "GenSigCycleTime" SG_ 427 FC_RollingCounter_1AB 100;
BA_ "GenSigCycleTime" SG_ 427 FC_CRCCheck_1AB 100;
BA_ "GenSigCycleTime" SG_ 427 LeFr_AccOBJ_Track_Age 50;
BA_ "GenSigCycleTime" SG_ 427 LeFr_AccOBJ_Track_ID 50;
BA_ "GenSigCycleTime" SG_ 427 LeFr_AccOBJ_FusionedFC_Track_ID 50;
BA_ "GenSigCycleTime" SG_ 427 LeFr_AccOBJ_fusion_Sts 50;
BA_ "GenSigCycleTime" SG_ 427 LeFr_AccOBJ_ObstacleProb 50;
BA_ "GenSigCycleTime" SG_ 427 LeFr_AccOBJ_ExistProb 50;
BA_ "GenSigCycleTime" SG_ 427 LeFr_AccOBJ_Brakelight_Info 50;
BA_ "GenSigCycleTime" SG_ 427 LeFr_AccOBJ_Taillight_Info 50;
BA_ "GenSigCycleTime" SG_ 427 LeFr_AccOBJ_Dis_to_R_LaneMark 50;
BA_ "GenSigCycleTime" SG_ 427 LeFr_AccOBJ_Dis_to_L_LaneMark 50;
BA_ "GenSigCycleTime" SG_ 427 LeFr_AccOBJ_Ax 50;
BA_ "GenSigCycleTime" SG_ 427 LeFr_AccOBJ_Ay 50;
BA_ "GenSigCycleTime" SG_ 427 LeFr_AccOBJ_Vx_std 50;
BA_ "GenSigCycleTime" SG_ 427 LeFr_AccOBJ_Vx 50;
BA_ "GenSigCycleTime" SG_ 427 LeFr_AccOBJ_Vy_std 50;
BA_ "GenSigCycleTime" SG_ 427 LeFr_AccOBJ_Vy 50;
BA_ "GenSigCycleTime" SG_ 427 LeFr_AccOBJ_Dx_Vnce 50;
BA_ "GenSigCycleTime" SG_ 427 LeFr_AccOBJ_Dx 50;
BA_ "GenSigCycleTime" SG_ 427 LeFr_AccOBJ_Dy_Vnce 50;
BA_ "GenSigCycleTime" SG_ 427 LeFr_AccOBJ_Dy 50;
BA_ "GenSigCycleTime" SG_ 427 LeFr_AccOBJ_HeadingAngle 50;
BA_ "GenSigCycleTime" SG_ 427 LeFr_AccOBJ_Length 50;
BA_ "GenSigCycleTime" SG_ 427 LeFr_AccOBJ_Height 50;
BA_ "GenSigCycleTime" SG_ 427 LeFr_AccOBJ_Width 50;
BA_ "GenSigCycleTime" SG_ 427 LeFr_AccOBJ_Class 50;
BA_ "GenSigCycleTime" SG_ 427 Le_AccOBJ_Track_Age 50;
BA_ "GenSigCycleTime" SG_ 427 Le_AccOBJ_Track_ID 50;
BA_ "GenSigCycleTime" SG_ 427 Le_AccOBJ_FusionedFC_Track_ID 50;
BA_ "GenSigCycleTime" SG_ 427 Le_AccOBJ_fusion_Sts 50;
BA_ "GenSigCycleTime" SG_ 427 Le_AccOBJ_ObstacleProb 50;
BA_ "GenSigCycleTime" SG_ 427 Le_AccOBJ_ExistProb 50;
BA_ "GenSigCycleTime" SG_ 427 Le_AccOBJ_Brakelight_Info 50;
BA_ "GenSigCycleTime" SG_ 427 Le_AccOBJ_Taillight_Info 50;
BA_ "GenSigCycleTime" SG_ 427 Le_AccOBJ_Dis_to_R_LaneMark 50;
BA_ "GenSigCycleTime" SG_ 427 Le_AccOBJ_Dis_to_L_LaneMark 50;
BA_ "GenSigCycleTime" SG_ 427 Le_AccOBJ_Ax 50;
BA_ "GenSigCycleTime" SG_ 427 Le_AccOBJ_Ay 50;
BA_ "GenSigCycleTime" SG_ 427 Le_AccOBJ_Vx_std 50;
BA_ "GenSigCycleTime" SG_ 427 Le_AccOBJ_Vx 50;
BA_ "GenSigCycleTime" SG_ 427 Le_AccOBJ_Vy_std 50;
BA_ "GenSigCycleTime" SG_ 427 Le_AccOBJ_Vy 50;
BA_ "GenSigCycleTime" SG_ 427 Le_AccOBJ_Dx_Vnce 50;
BA_ "GenSigCycleTime" SG_ 427 Le_AccOBJ_Dx 50;
BA_ "GenSigCycleTime" SG_ 427 Le_AccOBJ_Dy_Vnce 50;
BA_ "GenSigCycleTime" SG_ 427 Le_AccOBJ_Dy 50;
BA_ "GenSigCycleTime" SG_ 427 Le_AccOBJ_HeadingAngle 50;
BA_ "GenSigCycleTime" SG_ 427 Le_AccOBJ_Length 50;
BA_ "GenSigCycleTime" SG_ 427 Le_AccOBJ_Height 50;
BA_ "GenSigCycleTime" SG_ 427 Le_AccOBJ_Width 50;
BA_ "GenSigCycleTime" SG_ 427 Le_AccOBJ_Class 50;
BA_ "GenSigCycleTime" SG_ 428 FC_RollingCounter_1AC 100;
BA_ "GenSigCycleTime" SG_ 428 FC_CRCCheck_1AC 100;
BA_ "GenSigCycleTime" SG_ 428 RiFr_AccOBJ_Track_Age 50;
BA_ "GenSigCycleTime" SG_ 428 RiFr_AccOBJ_Track_ID 50;
BA_ "GenSigCycleTime" SG_ 428 RiFr_AccOBJ_FusionedFC_Track_ID 50;
BA_ "GenSigCycleTime" SG_ 428 RiFr_AccOBJ_fusion_Sts 50;
BA_ "GenSigCycleTime" SG_ 428 RiFr_AccOBJ_ObstacleProb 50;
BA_ "GenSigCycleTime" SG_ 428 RiFr_AccOBJ_ExistProb 50;
BA_ "GenSigCycleTime" SG_ 428 RiFr_AccOBJ_Brakelight_Info 50;
BA_ "GenSigCycleTime" SG_ 428 RiFr_AccOBJ_Taillight_Info 50;
BA_ "GenSigCycleTime" SG_ 428 RiFr_AccOBJ_Dis_to_R_LaneMark 50;
BA_ "GenSigCycleTime" SG_ 428 RiFr_AccOBJ_Dis_to_L_LaneMark 50;
BA_ "GenSigCycleTime" SG_ 428 RiFr_AccOBJ_Ax 50;
BA_ "GenSigCycleTime" SG_ 428 RiFr_AccOBJ_Ay 50;
BA_ "GenSigCycleTime" SG_ 428 RiFr_AccOBJ_Vx_std 50;
BA_ "GenSigCycleTime" SG_ 428 RiFr_AccOBJ_Vx 50;
BA_ "GenSigCycleTime" SG_ 428 RiFr_AccOBJ_Vy_std 50;
BA_ "GenSigCycleTime" SG_ 428 RiFr_AccOBJ_Vy 50;
BA_ "GenSigCycleTime" SG_ 428 RiFr_AccOBJ_Dx_Vnce 50;
BA_ "GenSigCycleTime" SG_ 428 RiFr_AccOBJ_Dx 50;
BA_ "GenSigCycleTime" SG_ 428 RiFr_AccOBJ_Dy_Vnce 50;
BA_ "GenSigCycleTime" SG_ 428 RiFr_AccOBJ_Dy 50;
BA_ "GenSigCycleTime" SG_ 428 RiFr_AccOBJ_HeadingAngle 50;
BA_ "GenSigCycleTime" SG_ 428 RiFr_AccOBJ_Length 50;
BA_ "GenSigCycleTime" SG_ 428 RiFr_AccOBJ_Height 50;
BA_ "GenSigCycleTime" SG_ 428 RiFr_AccOBJ_Width 50;
BA_ "GenSigCycleTime" SG_ 428 RiFr_AccOBJ_Class 50;
BA_ "GenSigCycleTime" SG_ 428 Ri_AccOBJ_Track_Age 50;
BA_ "GenSigCycleTime" SG_ 428 Ri_AccOBJ_Track_ID 50;
BA_ "GenSigCycleTime" SG_ 428 Ri_AccOBJ_FusionedFC_Track_ID 50;
BA_ "GenSigCycleTime" SG_ 428 Ri_AccOBJ_fusion_Sts 50;
BA_ "GenSigCycleTime" SG_ 428 Ri_AccOBJ_ObstacleProb 50;
BA_ "GenSigCycleTime" SG_ 428 Ri_AccOBJ_ExistProb 50;
BA_ "GenSigCycleTime" SG_ 428 Ri_AccOBJ_Brakelight_Info 50;
BA_ "GenSigCycleTime" SG_ 428 Ri_AccOBJ_Taillight_Info 50;
BA_ "GenSigCycleTime" SG_ 428 Ri_AccOBJ_Dis_to_R_LaneMark 50;
BA_ "GenSigCycleTime" SG_ 428 Ri_AccOBJ_Dis_to_L_LaneMark 50;
BA_ "GenSigCycleTime" SG_ 428 Ri_AccOBJ_Ax 50;
BA_ "GenSigCycleTime" SG_ 428 Ri_AccOBJ_Ay 50;
BA_ "GenSigCycleTime" SG_ 428 Ri_AccOBJ_Vx_std 50;
BA_ "GenSigCycleTime" SG_ 428 Ri_AccOBJ_Vx 50;
BA_ "GenSigCycleTime" SG_ 428 Ri_AccOBJ_Vy_std 50;
BA_ "GenSigCycleTime" SG_ 428 Ri_AccOBJ_Vy 50;
BA_ "GenSigCycleTime" SG_ 428 Ri_AccOBJ_Dx_Vnce 50;
BA_ "GenSigCycleTime" SG_ 428 Ri_AccOBJ_Dx 50;
BA_ "GenSigCycleTime" SG_ 428 Ri_AccOBJ_Dy_Vnce 50;
BA_ "GenSigCycleTime" SG_ 428 Ri_AccOBJ_Dy 50;
BA_ "GenSigCycleTime" SG_ 428 Ri_AccOBJ_HeadingAngle 50;
BA_ "GenSigCycleTime" SG_ 428 Ri_AccOBJ_Length 50;
BA_ "GenSigCycleTime" SG_ 428 Ri_AccOBJ_Height 50;
BA_ "GenSigCycleTime" SG_ 428 Ri_AccOBJ_Width 50;
BA_ "GenSigCycleTime" SG_ 428 Ri_AccOBJ_Class 50;
BA_ "GenSigCycleTime" SG_ 429 FC_RollingCounter_1AD 100;
BA_ "GenSigCycleTime" SG_ 429 FC_CRCCheck_1AD 100;
BA_ "GenSigCycleTime" SG_ 429 FR_OBJ8_Track_Age 50;
BA_ "GenSigCycleTime" SG_ 429 FR_OBJ8_Track_ID 50;
BA_ "GenSigCycleTime" SG_ 429 FR_OBJ8_FusionedFC_Track_ID 50;
BA_ "GenSigCycleTime" SG_ 429 FR_OBJ8_fusion_Sts 50;
BA_ "GenSigCycleTime" SG_ 429 FR_OBJ8_ObstacleProb 50;
BA_ "GenSigCycleTime" SG_ 429 FR_OBJ8_ExistProb 50;
BA_ "GenSigCycleTime" SG_ 429 FR_OBJ8_Brakelight_Info 50;
BA_ "GenSigCycleTime" SG_ 429 FR_OBJ8_Taillight_Info 50;
BA_ "GenSigCycleTime" SG_ 429 FR_OBJ8_Dis_to_R_LaneMark 50;
BA_ "GenSigCycleTime" SG_ 429 FR_OBJ8_Dis_to_L_LaneMark 50;
BA_ "GenSigCycleTime" SG_ 429 FR_OBJ8_Ax 50;
BA_ "GenSigCycleTime" SG_ 429 FR_OBJ8_Ay 50;
BA_ "GenSigCycleTime" SG_ 429 FR_OBJ8_Vx_std 50;
BA_ "GenSigCycleTime" SG_ 429 FR_OBJ8_Vx 50;
BA_ "GenSigCycleTime" SG_ 429 FR_OBJ8_Vy_std 50;
BA_ "GenSigCycleTime" SG_ 429 FR_OBJ8_Vy 50;
BA_ "GenSigCycleTime" SG_ 429 FR_OBJ8_Dx_Vnce 50;
BA_ "GenSigCycleTime" SG_ 429 FR_OBJ8_Dx 50;
BA_ "GenSigCycleTime" SG_ 429 FR_OBJ8_Dy_Vnce 50;
BA_ "GenSigCycleTime" SG_ 429 FR_OBJ8_Dy 50;
BA_ "GenSigCycleTime" SG_ 429 FR_OBJ8_HeadingAngle 50;
BA_ "GenSigCycleTime" SG_ 429 FR_OBJ8_Length 50;
BA_ "GenSigCycleTime" SG_ 429 FR_OBJ8_Height 50;
BA_ "GenSigCycleTime" SG_ 429 FR_OBJ8_Width 50;
BA_ "GenSigCycleTime" SG_ 429 FR_OBJ8_Class 50;
BA_ "GenSigCycleTime" SG_ 429 FR_OBJ7_Track_Age 50;
BA_ "GenSigCycleTime" SG_ 429 FR_OBJ7_Track_ID 50;
BA_ "GenSigCycleTime" SG_ 429 FR_OBJ7_FusionedFC_Track_ID 50;
BA_ "GenSigCycleTime" SG_ 429 FR_OBJ7_fusion_Sts 50;
BA_ "GenSigCycleTime" SG_ 429 FR_OBJ7_ObstacleProb 50;
BA_ "GenSigCycleTime" SG_ 429 FR_OBJ7_ExistProb 50;
BA_ "GenSigCycleTime" SG_ 429 FR_OBJ7_Brakelight_Info 50;
BA_ "GenSigCycleTime" SG_ 429 FR_OBJ7_Taillight_Info 50;
BA_ "GenSigCycleTime" SG_ 429 FR_OBJ7_Dis_to_R_LaneMark 50;
BA_ "GenSigCycleTime" SG_ 429 FR_OBJ7_Dis_to_L_LaneMark 50;
BA_ "GenSigCycleTime" SG_ 429 FR_OBJ7_Ax 50;
BA_ "GenSigCycleTime" SG_ 429 FR_OBJ7_Ay 50;
BA_ "GenSigCycleTime" SG_ 429 FR_OBJ7_Vx_std 50;
BA_ "GenSigCycleTime" SG_ 429 FR_OBJ7_Vx 50;
BA_ "GenSigCycleTime" SG_ 429 FR_OBJ7_Vy_std 50;
BA_ "GenSigCycleTime" SG_ 429 FR_OBJ7_Vy 50;
BA_ "GenSigCycleTime" SG_ 429 FR_OBJ7_Dx_Vnce 50;
BA_ "GenSigCycleTime" SG_ 429 FR_OBJ7_Dx 50;
BA_ "GenSigCycleTime" SG_ 429 FR_OBJ7_Dy_Vnce 50;
BA_ "GenSigCycleTime" SG_ 429 FR_OBJ7_Dy 50;
BA_ "GenSigCycleTime" SG_ 429 FR_OBJ7_HeadingAngle 50;
BA_ "GenSigCycleTime" SG_ 429 FR_OBJ7_Length 50;
BA_ "GenSigCycleTime" SG_ 429 FR_OBJ7_Height 50;
BA_ "GenSigCycleTime" SG_ 429 FR_OBJ7_Width 50;
BA_ "GenSigCycleTime" SG_ 429 FR_OBJ7_Class 50;
BA_ "GenSigCycleTime" SG_ 430 FC_RollingCounter_1AE 100;
BA_ "GenSigCycleTime" SG_ 430 FC_CRCCheck_1AE 100;
BA_ "GenSigCycleTime" SG_ 430 FR_OBJ10_Track_Age 50;
BA_ "GenSigCycleTime" SG_ 430 FR_OBJ10_Track_ID 50;
BA_ "GenSigCycleTime" SG_ 430 FR_OBJ10_FusionedFC_Track_ID 50;
BA_ "GenSigCycleTime" SG_ 430 FR_OBJ10_fusion_Sts 50;
BA_ "GenSigCycleTime" SG_ 430 FR_OBJ10_ObstacleProb 50;
BA_ "GenSigCycleTime" SG_ 430 FR_OBJ10_ExistProb 50;
BA_ "GenSigCycleTime" SG_ 430 FR_OBJ10_Brakelight_Info 50;
BA_ "GenSigCycleTime" SG_ 430 FR_OBJ10_Taillight_Info 50;
BA_ "GenSigCycleTime" SG_ 430 FR_OBJ10_Dis_to_R_LaneMark 50;
BA_ "GenSigCycleTime" SG_ 430 FR_OBJ10_Dis_to_L_LaneMark 50;
BA_ "GenSigCycleTime" SG_ 430 FR_OBJ10_Ax 50;
BA_ "GenSigCycleTime" SG_ 430 FR_OBJ10_Ay 50;
BA_ "GenSigCycleTime" SG_ 430 FR_OBJ10_Vx_std 50;
BA_ "GenSigCycleTime" SG_ 430 FR_OBJ10_Vx 50;
BA_ "GenSigCycleTime" SG_ 430 FR_OBJ10_Vy_std 50;
BA_ "GenSigCycleTime" SG_ 430 FR_OBJ10_Vy 50;
BA_ "GenSigCycleTime" SG_ 430 FR_OBJ10_Dx_Vnce 50;
BA_ "GenSigCycleTime" SG_ 430 FR_OBJ10_Dx 50;
BA_ "GenSigCycleTime" SG_ 430 FR_OBJ10_Dy_Vnce 50;
BA_ "GenSigCycleTime" SG_ 430 FR_OBJ10_Dy 50;
BA_ "GenSigCycleTime" SG_ 430 FR_OBJ10_HeadingAngle 50;
BA_ "GenSigCycleTime" SG_ 430 FR_OBJ10_Length 50;
BA_ "GenSigCycleTime" SG_ 430 FR_OBJ10_Height 50;
BA_ "GenSigCycleTime" SG_ 430 FR_OBJ10_Width 50;
BA_ "GenSigCycleTime" SG_ 430 FR_OBJ10_Class 50;
BA_ "GenSigCycleTime" SG_ 430 FR_OBJ9_Track_Age 50;
BA_ "GenSigCycleTime" SG_ 430 FR_OBJ9_Track_ID 50;
BA_ "GenSigCycleTime" SG_ 430 FR_OBJ9_FusionedFC_Track_ID 50;
BA_ "GenSigCycleTime" SG_ 430 FR_OBJ9_fusion_Sts 50;
BA_ "GenSigCycleTime" SG_ 430 FR_OBJ9_ObstacleProb 50;
BA_ "GenSigCycleTime" SG_ 430 FR_OBJ9_ExistProb 50;
BA_ "GenSigCycleTime" SG_ 430 FR_OBJ9_Brakelight_Info 50;
BA_ "GenSigCycleTime" SG_ 430 FR_OBJ9_Taillight_Info 50;
BA_ "GenSigCycleTime" SG_ 430 FR_OBJ9_Dis_to_R_LaneMark 50;
BA_ "GenSigCycleTime" SG_ 430 FR_OBJ9_Dis_to_L_LaneMark 50;
BA_ "GenSigCycleTime" SG_ 430 FR_OBJ9_Ax 50;
BA_ "GenSigCycleTime" SG_ 430 FR_OBJ9_Ay 50;
BA_ "GenSigCycleTime" SG_ 430 FR_OBJ9_Vx_std 50;
BA_ "GenSigCycleTime" SG_ 430 FR_OBJ9_Vx 50;
BA_ "GenSigCycleTime" SG_ 430 FR_OBJ9_Vy_std 50;
BA_ "GenSigCycleTime" SG_ 430 FR_OBJ9_Vy 50;
BA_ "GenSigCycleTime" SG_ 430 FR_OBJ9_Dx_Vnce 50;
BA_ "GenSigCycleTime" SG_ 430 FR_OBJ9_Dx 50;
BA_ "GenSigCycleTime" SG_ 430 FR_OBJ9_Dy_Vnce 50;
BA_ "GenSigCycleTime" SG_ 430 FR_OBJ9_Dy 50;
BA_ "GenSigCycleTime" SG_ 430 FR_OBJ9_HeadingAngle 50;
BA_ "GenSigCycleTime" SG_ 430 FR_OBJ9_Length 50;
BA_ "GenSigCycleTime" SG_ 430 FR_OBJ9_Height 50;
BA_ "GenSigCycleTime" SG_ 430 FR_OBJ9_Width 50;
BA_ "GenSigCycleTime" SG_ 430 FR_OBJ9_Class 50;
BA_ "GenSigCycleTime" SG_ 431 FC_RollingCounter_1AF 100;
BA_ "GenSigCycleTime" SG_ 431 FC_CRCCheck_1AF 100;
BA_ "GenSigCycleTime" SG_ 431 FR_OBJ12_Track_Age 50;
BA_ "GenSigCycleTime" SG_ 431 FR_OBJ12_Track_ID 50;
BA_ "GenSigCycleTime" SG_ 431 FR_OBJ12_FusionedFC_Track_ID 50;
BA_ "GenSigCycleTime" SG_ 431 FR_OBJ12_fusion_Sts 50;
BA_ "GenSigCycleTime" SG_ 431 FR_OBJ12_ObstacleProb 50;
BA_ "GenSigCycleTime" SG_ 431 FR_OBJ12_ExistProb 50;
BA_ "GenSigCycleTime" SG_ 431 FR_OBJ12_Brakelight_Info 50;
BA_ "GenSigCycleTime" SG_ 431 FR_OBJ12_Taillight_Info 50;
BA_ "GenSigCycleTime" SG_ 431 FR_OBJ12_Dis_to_R_LaneMark 50;
BA_ "GenSigCycleTime" SG_ 431 FR_OBJ12_Dis_to_L_LaneMark 50;
BA_ "GenSigCycleTime" SG_ 431 FR_OBJ12_Ax 50;
BA_ "GenSigCycleTime" SG_ 431 FR_OBJ12_Ay 50;
BA_ "GenSigCycleTime" SG_ 431 FR_OBJ12_Vx_std 50;
BA_ "GenSigCycleTime" SG_ 431 FR_OBJ12_Vx 50;
BA_ "GenSigCycleTime" SG_ 431 FR_OBJ12_Vy_std 50;
BA_ "GenSigCycleTime" SG_ 431 FR_OBJ12_Vy 50;
BA_ "GenSigCycleTime" SG_ 431 FR_OBJ12_Dx_Vnce 50;
BA_ "GenSigCycleTime" SG_ 431 FR_OBJ12_Dx 50;
BA_ "GenSigCycleTime" SG_ 431 FR_OBJ12_Dy_Vnce 50;
BA_ "GenSigCycleTime" SG_ 431 FR_OBJ12_Dy 50;
BA_ "GenSigCycleTime" SG_ 431 FR_OBJ12_HeadingAngle 50;
BA_ "GenSigCycleTime" SG_ 431 FR_OBJ12_Length 50;
BA_ "GenSigCycleTime" SG_ 431 FR_OBJ12_Height 50;
BA_ "GenSigCycleTime" SG_ 431 FR_OBJ12_Width 50;
BA_ "GenSigCycleTime" SG_ 431 FR_OBJ12_Class 50;
BA_ "GenSigCycleTime" SG_ 431 FR_OBJ11_Track_Age 50;
BA_ "GenSigCycleTime" SG_ 431 FR_OBJ11_Track_ID 50;
BA_ "GenSigCycleTime" SG_ 431 FR_OBJ11_FusionedFC_Track_ID 50;
BA_ "GenSigCycleTime" SG_ 431 FR_OBJ11_fusion_Sts 50;
BA_ "GenSigCycleTime" SG_ 431 FR_OBJ11_ObstacleProb 50;
BA_ "GenSigCycleTime" SG_ 431 FR_OBJ11_ExistProb 50;
BA_ "GenSigCycleTime" SG_ 431 FR_OBJ11_Brakelight_Info 50;
BA_ "GenSigCycleTime" SG_ 431 FR_OBJ11_Taillight_Info 50;
BA_ "GenSigCycleTime" SG_ 431 FR_OBJ11_Dis_to_R_LaneMark 50;
BA_ "GenSigCycleTime" SG_ 431 FR_OBJ11_Dis_to_L_LaneMark 50;
BA_ "GenSigCycleTime" SG_ 431 FR_OBJ11_Ax 50;
BA_ "GenSigCycleTime" SG_ 431 FR_OBJ11_Ay 50;
BA_ "GenSigCycleTime" SG_ 431 FR_OBJ11_Vx_std 50;
BA_ "GenSigCycleTime" SG_ 431 FR_OBJ11_Vx 50;
BA_ "GenSigCycleTime" SG_ 431 FR_OBJ11_Vy_std 50;
BA_ "GenSigCycleTime" SG_ 431 FR_OBJ11_Vy 50;
BA_ "GenSigCycleTime" SG_ 431 FR_OBJ11_Dx_Vnce 50;
BA_ "GenSigCycleTime" SG_ 431 FR_OBJ11_Dx 50;
BA_ "GenSigCycleTime" SG_ 431 FR_OBJ11_Dy_Vnce 50;
BA_ "GenSigCycleTime" SG_ 431 FR_OBJ11_Dy 50;
BA_ "GenSigCycleTime" SG_ 431 FR_OBJ11_HeadingAngle 50;
BA_ "GenSigCycleTime" SG_ 431 FR_OBJ11_Length 50;
BA_ "GenSigCycleTime" SG_ 431 FR_OBJ11_Height 50;
BA_ "GenSigCycleTime" SG_ 431 FR_OBJ11_Width 50;
BA_ "GenSigCycleTime" SG_ 431 FR_OBJ11_Class 50;
BA_ "GenSigCycleTime" SG_ 432 FC_RollingCounter_1B0 100;
BA_ "GenSigCycleTime" SG_ 432 FC_CRCCheck_1B0 100;
BA_ "GenSigCycleTime" SG_ 432 FR_OBJ14_Track_Age 50;
BA_ "GenSigCycleTime" SG_ 432 FR_OBJ14_Track_ID 50;
BA_ "GenSigCycleTime" SG_ 432 FR_OBJ14_FusionedFC_Track_ID 50;
BA_ "GenSigCycleTime" SG_ 432 FR_OBJ14_fusion_Sts 50;
BA_ "GenSigCycleTime" SG_ 432 FR_OBJ14_ObstacleProb 50;
BA_ "GenSigCycleTime" SG_ 432 FR_OBJ14_ExistProb 50;
BA_ "GenSigCycleTime" SG_ 432 FR_OBJ14_Brakelight_Info 50;
BA_ "GenSigCycleTime" SG_ 432 FR_OBJ14_Taillight_Info 50;
BA_ "GenSigCycleTime" SG_ 432 FR_OBJ14_Dis_to_R_LaneMark 50;
BA_ "GenSigCycleTime" SG_ 432 FR_OBJ14_Dis_to_L_LaneMark 50;
BA_ "GenSigCycleTime" SG_ 432 FR_OBJ14_Ax 50;
BA_ "GenSigCycleTime" SG_ 432 FR_OBJ14_Ay 50;
BA_ "GenSigCycleTime" SG_ 432 FR_OBJ14_Vx_std 50;
BA_ "GenSigCycleTime" SG_ 432 FR_OBJ14_Vx 50;
BA_ "GenSigCycleTime" SG_ 432 FR_OBJ14_Vy_std 50;
BA_ "GenSigCycleTime" SG_ 432 FR_OBJ14_Vy 50;
BA_ "GenSigCycleTime" SG_ 432 FR_OBJ14_Dx_Vnce 50;
BA_ "GenSigCycleTime" SG_ 432 FR_OBJ14_Dx 50;
BA_ "GenSigCycleTime" SG_ 432 FR_OBJ14_Dy_Vnce 50;
BA_ "GenSigCycleTime" SG_ 432 FR_OBJ14_Dy 50;
BA_ "GenSigCycleTime" SG_ 432 FR_OBJ14_HeadingAngle 50;
BA_ "GenSigCycleTime" SG_ 432 FR_OBJ14_Length 50;
BA_ "GenSigCycleTime" SG_ 432 FR_OBJ14_Height 50;
BA_ "GenSigCycleTime" SG_ 432 FR_OBJ14_Width 50;
BA_ "GenSigCycleTime" SG_ 432 FR_OBJ14_Class 50;
BA_ "GenSigCycleTime" SG_ 432 FR_OBJ13_Track_Age 50;
BA_ "GenSigCycleTime" SG_ 432 FR_OBJ13_Track_ID 50;
BA_ "GenSigCycleTime" SG_ 432 FR_OBJ13_FusionedFC_Track_ID 50;
BA_ "GenSigCycleTime" SG_ 432 FR_OBJ13_fusion_Sts 50;
BA_ "GenSigCycleTime" SG_ 432 FR_OBJ13_ObstacleProb 50;
BA_ "GenSigCycleTime" SG_ 432 FR_OBJ13_ExistProb 50;
BA_ "GenSigCycleTime" SG_ 432 FR_OBJ13_Brakelight_Info 50;
BA_ "GenSigCycleTime" SG_ 432 FR_OBJ13_Taillight_Info 50;
BA_ "GenSigCycleTime" SG_ 432 FR_OBJ13_Dis_to_R_LaneMark 50;
BA_ "GenSigCycleTime" SG_ 432 FR_OBJ13_Dis_to_L_LaneMark 50;
BA_ "GenSigCycleTime" SG_ 432 FR_OBJ13_Ax 50;
BA_ "GenSigCycleTime" SG_ 432 FR_OBJ13_Ay 50;
BA_ "GenSigCycleTime" SG_ 432 FR_OBJ13_Vx_std 50;
BA_ "GenSigCycleTime" SG_ 432 FR_OBJ13_Vx 50;
BA_ "GenSigCycleTime" SG_ 432 FR_OBJ13_Vy_std 50;
BA_ "GenSigCycleTime" SG_ 432 FR_OBJ13_Vy 50;
BA_ "GenSigCycleTime" SG_ 432 FR_OBJ13_Dx_Vnce 50;
BA_ "GenSigCycleTime" SG_ 432 FR_OBJ13_Dx 50;
BA_ "GenSigCycleTime" SG_ 432 FR_OBJ13_Dy_Vnce 50;
BA_ "GenSigCycleTime" SG_ 432 FR_OBJ13_Dy 50;
BA_ "GenSigCycleTime" SG_ 432 FR_OBJ13_HeadingAngle 50;
BA_ "GenSigCycleTime" SG_ 432 FR_OBJ13_Length 50;
BA_ "GenSigCycleTime" SG_ 432 FR_OBJ13_Height 50;
BA_ "GenSigCycleTime" SG_ 432 FR_OBJ13_Width 50;
BA_ "GenSigCycleTime" SG_ 432 FR_OBJ13_Class 50;
BA_ "GenSigCycleTime" SG_ 433 FC_RollingCounter_1B1 100;
BA_ "GenSigCycleTime" SG_ 433 FC_CRCCheck_1B1 100;
BA_ "GenSigCycleTime" SG_ 433 FR_OBJ16_Track_Age 50;
BA_ "GenSigCycleTime" SG_ 433 FR_OBJ16_Track_ID 50;
BA_ "GenSigCycleTime" SG_ 433 FR_OBJ16_FusionedFC_Track_ID 50;
BA_ "GenSigCycleTime" SG_ 433 FR_OBJ16_fusion_Sts 50;
BA_ "GenSigCycleTime" SG_ 433 FR_OBJ16_ObstacleProb 50;
BA_ "GenSigCycleTime" SG_ 433 FR_OBJ16_ExistProb 50;
BA_ "GenSigCycleTime" SG_ 433 FR_OBJ16_Brakelight_Info 50;
BA_ "GenSigCycleTime" SG_ 433 FR_OBJ16_Taillight_Info 50;
BA_ "GenSigCycleTime" SG_ 433 FR_OBJ16_Dis_to_R_LaneMark 50;
BA_ "GenSigCycleTime" SG_ 433 FR_OBJ16_Dis_to_L_LaneMark 50;
BA_ "GenSigCycleTime" SG_ 433 FR_OBJ16_Ax 50;
BA_ "GenSigCycleTime" SG_ 433 FR_OBJ16_Ay 50;
BA_ "GenSigCycleTime" SG_ 433 FR_OBJ16_Vx_std 50;
BA_ "GenSigCycleTime" SG_ 433 FR_OBJ16_Vx 50;
BA_ "GenSigCycleTime" SG_ 433 FR_OBJ16_Vy_std 50;
BA_ "GenSigCycleTime" SG_ 433 FR_OBJ16_Vy 50;
BA_ "GenSigCycleTime" SG_ 433 FR_OBJ16_Dx_Vnce 50;
BA_ "GenSigCycleTime" SG_ 433 FR_OBJ16_Dx 50;
BA_ "GenSigCycleTime" SG_ 433 FR_OBJ16_Dy_Vnce 50;
BA_ "GenSigCycleTime" SG_ 433 FR_OBJ16_Dy 50;
BA_ "GenSigCycleTime" SG_ 433 FR_OBJ16_HeadingAngle 50;
BA_ "GenSigCycleTime" SG_ 433 FR_OBJ16_Length 50;
BA_ "GenSigCycleTime" SG_ 433 FR_OBJ16_Height 50;
BA_ "GenSigCycleTime" SG_ 433 FR_OBJ16_Width 50;
BA_ "GenSigCycleTime" SG_ 433 FR_OBJ16_Class 50;
BA_ "GenSigCycleTime" SG_ 433 FR_OBJ15_Track_Age 50;
BA_ "GenSigCycleTime" SG_ 433 FR_OBJ15_Track_ID 50;
BA_ "GenSigCycleTime" SG_ 433 FR_OBJ15_FusionedFC_Track_ID 50;
BA_ "GenSigCycleTime" SG_ 433 FR_OBJ15_fusion_Sts 50;
BA_ "GenSigCycleTime" SG_ 433 FR_OBJ15_ObstacleProb 50;
BA_ "GenSigCycleTime" SG_ 433 FR_OBJ15_ExistProb 50;
BA_ "GenSigCycleTime" SG_ 433 FR_OBJ15_Brakelight_Info 50;
BA_ "GenSigCycleTime" SG_ 433 FR_OBJ15_Taillight_Info 50;
BA_ "GenSigCycleTime" SG_ 433 FR_OBJ15_Dis_to_R_LaneMark 50;
BA_ "GenSigCycleTime" SG_ 433 FR_OBJ15_Dis_to_L_LaneMark 50;
BA_ "GenSigCycleTime" SG_ 433 FR_OBJ15_Ax 50;
BA_ "GenSigCycleTime" SG_ 433 FR_OBJ15_Ay 50;
BA_ "GenSigCycleTime" SG_ 433 FR_OBJ15_Vx_std 50;
BA_ "GenSigCycleTime" SG_ 433 FR_OBJ15_Vx 50;
BA_ "GenSigCycleTime" SG_ 433 FR_OBJ15_Vy_std 50;
BA_ "GenSigCycleTime" SG_ 433 FR_OBJ15_Vy 50;
BA_ "GenSigCycleTime" SG_ 433 FR_OBJ15_Dx_Vnce 50;
BA_ "GenSigCycleTime" SG_ 433 FR_OBJ15_Dx 50;
BA_ "GenSigCycleTime" SG_ 433 FR_OBJ15_Dy_Vnce 50;
BA_ "GenSigCycleTime" SG_ 433 FR_OBJ15_Dy 50;
BA_ "GenSigCycleTime" SG_ 433 FR_OBJ15_HeadingAngle 50;
BA_ "GenSigCycleTime" SG_ 433 FR_OBJ15_Length 50;
BA_ "GenSigCycleTime" SG_ 433 FR_OBJ15_Height 50;
BA_ "GenSigCycleTime" SG_ 433 FR_OBJ15_Width 50;
BA_ "GenSigCycleTime" SG_ 433 FR_OBJ15_Class 50;
BA_ "GenSigCycleTime" SG_ 434 FC_RollingCounter_1B2 100;
BA_ "GenSigCycleTime" SG_ 434 FC_CRCCheck_1B2 100;
BA_ "GenSigCycleTime" SG_ 434 FR_OBJ18_Track_Age 50;
BA_ "GenSigCycleTime" SG_ 434 FR_OBJ18_Track_ID 50;
BA_ "GenSigCycleTime" SG_ 434 FR_OBJ18_FusionedFC_Track_ID 50;
BA_ "GenSigCycleTime" SG_ 434 FR_OBJ18_fusion_Sts 50;
BA_ "GenSigCycleTime" SG_ 434 FR_OBJ18_ObstacleProb 50;
BA_ "GenSigCycleTime" SG_ 434 FR_OBJ18_ExistProb 50;
BA_ "GenSigCycleTime" SG_ 434 FR_OBJ18_Brakelight_Info 50;
BA_ "GenSigCycleTime" SG_ 434 FR_OBJ18_Taillight_Info 50;
BA_ "GenSigCycleTime" SG_ 434 FR_OBJ18_Dis_to_R_LaneMark 50;
BA_ "GenSigCycleTime" SG_ 434 FR_OBJ18_Dis_to_L_LaneMark 50;
BA_ "GenSigCycleTime" SG_ 434 FR_OBJ18_Ax 50;
BA_ "GenSigCycleTime" SG_ 434 FR_OBJ18_Ay 50;
BA_ "GenSigCycleTime" SG_ 434 FR_OBJ18_Vx_std 50;
BA_ "GenSigCycleTime" SG_ 434 FR_OBJ18_Vx 50;
BA_ "GenSigCycleTime" SG_ 434 FR_OBJ18_Vy_std 50;
BA_ "GenSigCycleTime" SG_ 434 FR_OBJ18_Vy 50;
BA_ "GenSigCycleTime" SG_ 434 FR_OBJ18_Dx_Vnce 50;
BA_ "GenSigCycleTime" SG_ 434 FR_OBJ18_Dx 50;
BA_ "GenSigCycleTime" SG_ 434 FR_OBJ18_Dy_Vnce 50;
BA_ "GenSigCycleTime" SG_ 434 FR_OBJ18_Dy 50;
BA_ "GenSigCycleTime" SG_ 434 FR_OBJ18_HeadingAngle 50;
BA_ "GenSigCycleTime" SG_ 434 FR_OBJ18_Length 50;
BA_ "GenSigCycleTime" SG_ 434 FR_OBJ18_Height 50;
BA_ "GenSigCycleTime" SG_ 434 FR_OBJ18_Width 50;
BA_ "GenSigCycleTime" SG_ 434 FR_OBJ18_Class 50;
BA_ "GenSigCycleTime" SG_ 434 FR_OBJ17_Track_Age 50;
BA_ "GenSigCycleTime" SG_ 434 FR_OBJ17_Track_ID 50;
BA_ "GenSigCycleTime" SG_ 434 FR_OBJ17_FusionedFC_Track_ID 50;
BA_ "GenSigCycleTime" SG_ 434 FR_OBJ17_fusion_Sts 50;
BA_ "GenSigCycleTime" SG_ 434 FR_OBJ17_ObstacleProb 50;
BA_ "GenSigCycleTime" SG_ 434 FR_OBJ17_ExistProb 50;
BA_ "GenSigCycleTime" SG_ 434 FR_OBJ17_Brakelight_Info 50;
BA_ "GenSigCycleTime" SG_ 434 FR_OBJ17_Taillight_Info 50;
BA_ "GenSigCycleTime" SG_ 434 FR_OBJ17_Dis_to_R_LaneMark 50;
BA_ "GenSigCycleTime" SG_ 434 FR_OBJ17_Dis_to_L_LaneMark 50;
BA_ "GenSigCycleTime" SG_ 434 FR_OBJ17_Ax 50;
BA_ "GenSigCycleTime" SG_ 434 FR_OBJ17_Ay 50;
BA_ "GenSigCycleTime" SG_ 434 FR_OBJ17_Vx_std 50;
BA_ "GenSigCycleTime" SG_ 434 FR_OBJ17_Vx 50;
BA_ "GenSigCycleTime" SG_ 434 FR_OBJ17_Vy_std 50;
BA_ "GenSigCycleTime" SG_ 434 FR_OBJ17_Vy 50;
BA_ "GenSigCycleTime" SG_ 434 FR_OBJ17_Dx_Vnce 50;
BA_ "GenSigCycleTime" SG_ 434 FR_OBJ17_Dx 50;
BA_ "GenSigCycleTime" SG_ 434 FR_OBJ17_Dy_Vnce 50;
BA_ "GenSigCycleTime" SG_ 434 FR_OBJ17_Dy 50;
BA_ "GenSigCycleTime" SG_ 434 FR_OBJ17_HeadingAngle 50;
BA_ "GenSigCycleTime" SG_ 434 FR_OBJ17_Length 50;
BA_ "GenSigCycleTime" SG_ 434 FR_OBJ17_Height 50;
BA_ "GenSigCycleTime" SG_ 434 FR_OBJ17_Width 50;
BA_ "GenSigCycleTime" SG_ 434 FR_OBJ17_Class 50;
BA_ "GenSigCycleTime" SG_ 435 FC_RollingCounter_1B3 100;
BA_ "GenSigCycleTime" SG_ 435 FC_CRCCheck_1B3 100;
BA_ "GenSigCycleTime" SG_ 435 FR_OBJ20_Track_Age 50;
BA_ "GenSigCycleTime" SG_ 435 FR_OBJ20_Track_ID 50;
BA_ "GenSigCycleTime" SG_ 435 FR_OBJ20_FusionedFC_Track_ID 50;
BA_ "GenSigCycleTime" SG_ 435 FR_OBJ20_fusion_Sts 50;
BA_ "GenSigCycleTime" SG_ 435 FR_OBJ20_ObstacleProb 50;
BA_ "GenSigCycleTime" SG_ 435 FR_OBJ20_ExistProb 50;
BA_ "GenSigCycleTime" SG_ 435 FR_OBJ20_Brakelight_Info 50;
BA_ "GenSigCycleTime" SG_ 435 FR_OBJ20_Taillight_Info 50;
BA_ "GenSigCycleTime" SG_ 435 FR_OBJ20_Dis_to_R_LaneMark 50;
BA_ "GenSigCycleTime" SG_ 435 FR_OBJ20_Dis_to_L_LaneMark 50;
BA_ "GenSigCycleTime" SG_ 435 FR_OBJ20_Ax 50;
BA_ "GenSigCycleTime" SG_ 435 FR_OBJ20_Ay 50;
BA_ "GenSigCycleTime" SG_ 435 FR_OBJ20_Vx_std 50;
BA_ "GenSigCycleTime" SG_ 435 FR_OBJ20_Vx 50;
BA_ "GenSigCycleTime" SG_ 435 FR_OBJ20_Vy_std 50;
BA_ "GenSigCycleTime" SG_ 435 FR_OBJ20_Vy 50;
BA_ "GenSigCycleTime" SG_ 435 FR_OBJ20_Dx_Vnce 50;
BA_ "GenSigCycleTime" SG_ 435 FR_OBJ20_Dx 50;
BA_ "GenSigCycleTime" SG_ 435 FR_OBJ20_Dy_Vnce 50;
BA_ "GenSigCycleTime" SG_ 435 FR_OBJ20_Dy 50;
BA_ "GenSigCycleTime" SG_ 435 FR_OBJ20_HeadingAngle 50;
BA_ "GenSigCycleTime" SG_ 435 FR_OBJ20_Length 50;
BA_ "GenSigCycleTime" SG_ 435 FR_OBJ20_Height 50;
BA_ "GenSigCycleTime" SG_ 435 FR_OBJ20_Width 50;
BA_ "GenSigCycleTime" SG_ 435 FR_OBJ20_Class 50;
BA_ "GenSigCycleTime" SG_ 435 FR_OBJ19_Track_Age 50;
BA_ "GenSigCycleTime" SG_ 435 FR_OBJ19_Track_ID 50;
BA_ "GenSigCycleTime" SG_ 435 FR_OBJ19_FusionedFC_Track_ID 50;
BA_ "GenSigCycleTime" SG_ 435 FR_OBJ19_fusion_Sts 50;
BA_ "GenSigCycleTime" SG_ 435 FR_OBJ19_ObstacleProb 50;
BA_ "GenSigCycleTime" SG_ 435 FR_OBJ19_ExistProb 50;
BA_ "GenSigCycleTime" SG_ 435 FR_OBJ19_Brakelight_Info 50;
BA_ "GenSigCycleTime" SG_ 435 FR_OBJ19_Taillight_Info 50;
BA_ "GenSigCycleTime" SG_ 435 FR_OBJ19_Dis_to_R_LaneMark 50;
BA_ "GenSigCycleTime" SG_ 435 FR_OBJ19_Dis_to_L_LaneMark 50;
BA_ "GenSigCycleTime" SG_ 435 FR_OBJ19_Ax 50;
BA_ "GenSigCycleTime" SG_ 435 FR_OBJ19_Ay 50;
BA_ "GenSigCycleTime" SG_ 435 FR_OBJ19_Vx_std 50;
BA_ "GenSigCycleTime" SG_ 435 FR_OBJ19_Vx 50;
BA_ "GenSigCycleTime" SG_ 435 FR_OBJ19_Vy_std 50;
BA_ "GenSigCycleTime" SG_ 435 FR_OBJ19_Vy 50;
BA_ "GenSigCycleTime" SG_ 435 FR_OBJ19_Dx_Vnce 50;
BA_ "GenSigCycleTime" SG_ 435 FR_OBJ19_Dx 50;
BA_ "GenSigCycleTime" SG_ 435 FR_OBJ19_Dy_Vnce 50;
BA_ "GenSigCycleTime" SG_ 435 FR_OBJ19_Dy 50;
BA_ "GenSigCycleTime" SG_ 435 FR_OBJ19_HeadingAngle 50;
BA_ "GenSigCycleTime" SG_ 435 FR_OBJ19_Length 50;
BA_ "GenSigCycleTime" SG_ 435 FR_OBJ19_Height 50;
BA_ "GenSigCycleTime" SG_ 435 FR_OBJ19_Width 50;
BA_ "GenSigCycleTime" SG_ 435 FR_OBJ19_Class 50;
BA_ "GenSigCycleTime" SG_ 436 FC_RollingCounter_1B4 100;
BA_ "GenSigCycleTime" SG_ 436 FC_CRCCheck_1B4 100;
BA_ "GenSigCycleTime" SG_ 436 FR_OBJ22_Track_Age 50;
BA_ "GenSigCycleTime" SG_ 436 FR_OBJ22_Track_ID 50;
BA_ "GenSigCycleTime" SG_ 436 FR_OBJ22_FusionedFC_Track_ID 50;
BA_ "GenSigCycleTime" SG_ 436 FR_OBJ22_fusion_Sts 50;
BA_ "GenSigCycleTime" SG_ 436 FR_OBJ22_ObstacleProb 50;
BA_ "GenSigCycleTime" SG_ 436 FR_OBJ22_ExistProb 50;
BA_ "GenSigCycleTime" SG_ 436 FR_OBJ22_Brakelight_Info 50;
BA_ "GenSigCycleTime" SG_ 436 FR_OBJ22_Taillight_Info 50;
BA_ "GenSigCycleTime" SG_ 436 FR_OBJ22_Dis_to_R_LaneMark 50;
BA_ "GenSigCycleTime" SG_ 436 FR_OBJ22_Dis_to_L_LaneMark 50;
BA_ "GenSigCycleTime" SG_ 436 FR_OBJ22_Ax 50;
BA_ "GenSigCycleTime" SG_ 436 FR_OBJ22_Ay 50;
BA_ "GenSigCycleTime" SG_ 436 FR_OBJ22_Vx_std 50;
BA_ "GenSigCycleTime" SG_ 436 FR_OBJ22_Vx 50;
BA_ "GenSigCycleTime" SG_ 436 FR_OBJ22_Vy_std 50;
BA_ "GenSigCycleTime" SG_ 436 FR_OBJ22_Vy 50;
BA_ "GenSigCycleTime" SG_ 436 FR_OBJ22_Dx_Vnce 50;
BA_ "GenSigCycleTime" SG_ 436 FR_OBJ22_Dx 50;
BA_ "GenSigCycleTime" SG_ 436 FR_OBJ22_Dy_Vnce 50;
BA_ "GenSigCycleTime" SG_ 436 FR_OBJ22_Dy 50;
BA_ "GenSigCycleTime" SG_ 436 FR_OBJ22_HeadingAngle 50;
BA_ "GenSigCycleTime" SG_ 436 FR_OBJ22_Length 50;
BA_ "GenSigCycleTime" SG_ 436 FR_OBJ22_Height 50;
BA_ "GenSigCycleTime" SG_ 436 FR_OBJ22_Width 50;
BA_ "GenSigCycleTime" SG_ 436 FR_OBJ22_Class 50;
BA_ "GenSigCycleTime" SG_ 436 FR_OBJ21_Track_Age 50;
BA_ "GenSigCycleTime" SG_ 436 FR_OBJ21_Track_ID 50;
BA_ "GenSigCycleTime" SG_ 436 FR_OBJ21_FusionedFC_Track_ID 50;
BA_ "GenSigCycleTime" SG_ 436 FR_OBJ21_fusion_Sts 50;
BA_ "GenSigCycleTime" SG_ 436 FR_OBJ21_ObstacleProb 50;
BA_ "GenSigCycleTime" SG_ 436 FR_OBJ21_ExistProb 50;
BA_ "GenSigCycleTime" SG_ 436 FR_OBJ21_Brakelight_Info 50;
BA_ "GenSigCycleTime" SG_ 436 FR_OBJ21_Taillight_Info 50;
BA_ "GenSigCycleTime" SG_ 436 FR_OBJ21_Dis_to_R_LaneMark 50;
BA_ "GenSigCycleTime" SG_ 436 FR_OBJ21_Dis_to_L_LaneMark 50;
BA_ "GenSigCycleTime" SG_ 436 FR_OBJ21_Ax 50;
BA_ "GenSigCycleTime" SG_ 436 FR_OBJ21_Ay 50;
BA_ "GenSigCycleTime" SG_ 436 FR_OBJ21_Vx_std 50;
BA_ "GenSigCycleTime" SG_ 436 FR_OBJ21_Vx 50;
BA_ "GenSigCycleTime" SG_ 436 FR_OBJ21_Vy_std 50;
BA_ "GenSigCycleTime" SG_ 436 FR_OBJ21_Vy 50;
BA_ "GenSigCycleTime" SG_ 436 FR_OBJ21_Dx_Vnce 50;
BA_ "GenSigCycleTime" SG_ 436 FR_OBJ21_Dx 50;
BA_ "GenSigCycleTime" SG_ 436 FR_OBJ21_Dy_Vnce 50;
BA_ "GenSigCycleTime" SG_ 436 FR_OBJ21_Dy 50;
BA_ "GenSigCycleTime" SG_ 436 FR_OBJ21_HeadingAngle 50;
BA_ "GenSigCycleTime" SG_ 436 FR_OBJ21_Length 50;
BA_ "GenSigCycleTime" SG_ 436 FR_OBJ21_Height 50;
BA_ "GenSigCycleTime" SG_ 436 FR_OBJ21_Width 50;
BA_ "GenSigCycleTime" SG_ 436 FR_OBJ21_Class 50;
BA_ "GenSigCycleTime" SG_ 437 FC_RollingCounter_1B5 100;
BA_ "GenSigCycleTime" SG_ 437 FC_CRCCheck_1B5 100;
BA_ "GenSigCycleTime" SG_ 437 FR_OBJ24_Track_Age 50;
BA_ "GenSigCycleTime" SG_ 437 FR_OBJ24_Track_ID 50;
BA_ "GenSigCycleTime" SG_ 437 FR_OBJ24_FusionedFC_Track_ID 50;
BA_ "GenSigCycleTime" SG_ 437 FR_OBJ24_fusion_Sts 50;
BA_ "GenSigCycleTime" SG_ 437 FR_OBJ24_ObstacleProb 50;
BA_ "GenSigCycleTime" SG_ 437 FR_OBJ24_ExistProb 50;
BA_ "GenSigCycleTime" SG_ 437 FR_OBJ24_Brakelight_Info 50;
BA_ "GenSigCycleTime" SG_ 437 FR_OBJ24_Taillight_Info 50;
BA_ "GenSigCycleTime" SG_ 437 FR_OBJ24_Dis_to_R_LaneMark 50;
BA_ "GenSigCycleTime" SG_ 437 FR_OBJ24_Dis_to_L_LaneMark 50;
BA_ "GenSigCycleTime" SG_ 437 FR_OBJ24_Ax 50;
BA_ "GenSigCycleTime" SG_ 437 FR_OBJ24_Ay 50;
BA_ "GenSigCycleTime" SG_ 437 FR_OBJ24_Vx_std 50;
BA_ "GenSigCycleTime" SG_ 437 FR_OBJ24_Vx 50;
BA_ "GenSigCycleTime" SG_ 437 FR_OBJ24_Vy_std 50;
BA_ "GenSigCycleTime" SG_ 437 FR_OBJ24_Vy 50;
BA_ "GenSigCycleTime" SG_ 437 FR_OBJ24_Dx_Vnce 50;
BA_ "GenSigCycleTime" SG_ 437 FR_OBJ24_Dx 50;
BA_ "GenSigCycleTime" SG_ 437 FR_OBJ24_Dy_Vnce 50;
BA_ "GenSigCycleTime" SG_ 437 FR_OBJ24_Dy 50;
BA_ "GenSigCycleTime" SG_ 437 FR_OBJ24_HeadingAngle 50;
BA_ "GenSigCycleTime" SG_ 437 FR_OBJ24_Length 50;
BA_ "GenSigCycleTime" SG_ 437 FR_OBJ24_Height 50;
BA_ "GenSigCycleTime" SG_ 437 FR_OBJ24_Width 50;
BA_ "GenSigCycleTime" SG_ 437 FR_OBJ24_Class 50;
BA_ "GenSigCycleTime" SG_ 437 FR_OBJ23_Track_Age 50;
BA_ "GenSigCycleTime" SG_ 437 FR_OBJ23_Track_ID 50;
BA_ "GenSigCycleTime" SG_ 437 FR_OBJ23_FusionedFC_Track_ID 50;
BA_ "GenSigCycleTime" SG_ 437 FR_OBJ23_fusion_Sts 50;
BA_ "GenSigCycleTime" SG_ 437 FR_OBJ23_ObstacleProb 50;
BA_ "GenSigCycleTime" SG_ 437 FR_OBJ23_ExistProb 50;
BA_ "GenSigCycleTime" SG_ 437 FR_OBJ23_Brakelight_Info 50;
BA_ "GenSigCycleTime" SG_ 437 FR_OBJ23_Taillight_Info 50;
BA_ "GenSigCycleTime" SG_ 437 FR_OBJ23_Dis_to_R_LaneMark 50;
BA_ "GenSigCycleTime" SG_ 437 FR_OBJ23_Dis_to_L_LaneMark 50;
BA_ "GenSigCycleTime" SG_ 437 FR_OBJ23_Ax 50;
BA_ "GenSigCycleTime" SG_ 437 FR_OBJ23_Ay 50;
BA_ "GenSigCycleTime" SG_ 437 FR_OBJ23_Vx_std 50;
BA_ "GenSigCycleTime" SG_ 437 FR_OBJ23_Vx 50;
BA_ "GenSigCycleTime" SG_ 437 FR_OBJ23_Vy_std 50;
BA_ "GenSigCycleTime" SG_ 437 FR_OBJ23_Vy 50;
BA_ "GenSigCycleTime" SG_ 437 FR_OBJ23_Dx_Vnce 50;
BA_ "GenSigCycleTime" SG_ 437 FR_OBJ23_Dx 50;
BA_ "GenSigCycleTime" SG_ 437 FR_OBJ23_Dy_Vnce 50;
BA_ "GenSigCycleTime" SG_ 437 FR_OBJ23_Dy 50;
BA_ "GenSigCycleTime" SG_ 437 FR_OBJ23_HeadingAngle 50;
BA_ "GenSigCycleTime" SG_ 437 FR_OBJ23_Length 50;
BA_ "GenSigCycleTime" SG_ 437 FR_OBJ23_Height 50;
BA_ "GenSigCycleTime" SG_ 437 FR_OBJ23_Width 50;
BA_ "GenSigCycleTime" SG_ 437 FR_OBJ23_Class 50;
BA_ "GenSigCycleTime" SG_ 438 FC_RollingCounter_1B6 100;
BA_ "GenSigCycleTime" SG_ 438 FC_CRCCheck_1B6 100;
BA_ "GenSigCycleTime" SG_ 438 FR_OBJ26_Track_Age 50;
BA_ "GenSigCycleTime" SG_ 438 FR_OBJ26_Track_ID 50;
BA_ "GenSigCycleTime" SG_ 438 FR_OBJ26_FusionedFC_Track_ID 50;
BA_ "GenSigCycleTime" SG_ 438 FR_OBJ26_fusion_Sts 50;
BA_ "GenSigCycleTime" SG_ 438 FR_OBJ26_ObstacleProb 50;
BA_ "GenSigCycleTime" SG_ 438 FR_OBJ26_ExistProb 50;
BA_ "GenSigCycleTime" SG_ 438 FR_OBJ26_Brakelight_Info 50;
BA_ "GenSigCycleTime" SG_ 438 FR_OBJ26_Taillight_Info 50;
BA_ "GenSigCycleTime" SG_ 438 FR_OBJ26_Dis_to_R_LaneMark 50;
BA_ "GenSigCycleTime" SG_ 438 FR_OBJ26_Dis_to_L_LaneMark 50;
BA_ "GenSigCycleTime" SG_ 438 FR_OBJ26_Ax 50;
BA_ "GenSigCycleTime" SG_ 438 FR_OBJ26_Ay 50;
BA_ "GenSigCycleTime" SG_ 438 FR_OBJ26_Vx_std 50;
BA_ "GenSigCycleTime" SG_ 438 FR_OBJ26_Vx 50;
BA_ "GenSigCycleTime" SG_ 438 FR_OBJ26_Vy_std 50;
BA_ "GenSigCycleTime" SG_ 438 FR_OBJ26_Vy 50;
BA_ "GenSigCycleTime" SG_ 438 FR_OBJ26_Dx_Vnce 50;
BA_ "GenSigCycleTime" SG_ 438 FR_OBJ26_Dx 50;
BA_ "GenSigCycleTime" SG_ 438 FR_OBJ26_Dy_Vnce 50;
BA_ "GenSigCycleTime" SG_ 438 FR_OBJ26_Dy 50;
BA_ "GenSigCycleTime" SG_ 438 FR_OBJ26_HeadingAngle 50;
BA_ "GenSigCycleTime" SG_ 438 FR_OBJ26_Length 50;
BA_ "GenSigCycleTime" SG_ 438 FR_OBJ26_Height 50;
BA_ "GenSigCycleTime" SG_ 438 FR_OBJ26_Width 50;
BA_ "GenSigCycleTime" SG_ 438 FR_OBJ26_Class 50;
BA_ "GenSigCycleTime" SG_ 438 FR_OBJ25_Track_Age 50;
BA_ "GenSigCycleTime" SG_ 438 FR_OBJ25_Track_ID 50;
BA_ "GenSigCycleTime" SG_ 438 FR_OBJ25_FusionedFC_Track_ID 50;
BA_ "GenSigCycleTime" SG_ 438 FR_OBJ25_fusion_Sts 50;
BA_ "GenSigCycleTime" SG_ 438 FR_OBJ25_ObstacleProb 50;
BA_ "GenSigCycleTime" SG_ 438 FR_OBJ25_ExistProb 50;
BA_ "GenSigCycleTime" SG_ 438 FR_OBJ25_Brakelight_Info 50;
BA_ "GenSigCycleTime" SG_ 438 FR_OBJ25_Taillight_Info 50;
BA_ "GenSigCycleTime" SG_ 438 FR_OBJ25_Dis_to_R_LaneMark 50;
BA_ "GenSigCycleTime" SG_ 438 FR_OBJ25_Dis_to_L_LaneMark 50;
BA_ "GenSigCycleTime" SG_ 438 FR_OBJ25_Ax 50;
BA_ "GenSigCycleTime" SG_ 438 FR_OBJ25_Ay 50;
BA_ "GenSigCycleTime" SG_ 438 FR_OBJ25_Vx_std 50;
BA_ "GenSigCycleTime" SG_ 438 FR_OBJ25_Vx 50;
BA_ "GenSigCycleTime" SG_ 438 FR_OBJ25_Vy_std 50;
BA_ "GenSigCycleTime" SG_ 438 FR_OBJ25_Vy 50;
BA_ "GenSigCycleTime" SG_ 438 FR_OBJ25_Dx_Vnce 50;
BA_ "GenSigCycleTime" SG_ 438 FR_OBJ25_Dx 50;
BA_ "GenSigCycleTime" SG_ 438 FR_OBJ25_Dy_Vnce 50;
BA_ "GenSigCycleTime" SG_ 438 FR_OBJ25_Dy 50;
BA_ "GenSigCycleTime" SG_ 438 FR_OBJ25_HeadingAngle 50;
BA_ "GenSigCycleTime" SG_ 438 FR_OBJ25_Length 50;
BA_ "GenSigCycleTime" SG_ 438 FR_OBJ25_Height 50;
BA_ "GenSigCycleTime" SG_ 438 FR_OBJ25_Width 50;
BA_ "GenSigCycleTime" SG_ 438 FR_OBJ25_Class 50;
BA_ "GenSigCycleTime" SG_ 439 FC_RollingCounter_1B7 100;
BA_ "GenSigCycleTime" SG_ 439 FC_CRCCheck_1B7 100;
BA_ "GenSigCycleTime" SG_ 439 FR_OBJ28_Track_Age 50;
BA_ "GenSigCycleTime" SG_ 439 FR_OBJ28_Track_ID 50;
BA_ "GenSigCycleTime" SG_ 439 FR_OBJ28_FusionedFC_Track_ID 50;
BA_ "GenSigCycleTime" SG_ 439 FR_OBJ28_fusion_Sts 50;
BA_ "GenSigCycleTime" SG_ 439 FR_OBJ28_ObstacleProb 50;
BA_ "GenSigCycleTime" SG_ 439 FR_OBJ28_ExistProb 50;
BA_ "GenSigCycleTime" SG_ 439 FR_OBJ28_Brakelight_Info 50;
BA_ "GenSigCycleTime" SG_ 439 FR_OBJ28_Taillight_Info 50;
BA_ "GenSigCycleTime" SG_ 439 FR_OBJ28_Dis_to_R_LaneMark 50;
BA_ "GenSigCycleTime" SG_ 439 FR_OBJ28_Dis_to_L_LaneMark 50;
BA_ "GenSigCycleTime" SG_ 439 FR_OBJ28_Ax 50;
BA_ "GenSigCycleTime" SG_ 439 FR_OBJ28_Ay 50;
BA_ "GenSigCycleTime" SG_ 439 FR_OBJ28_Vx_std 50;
BA_ "GenSigCycleTime" SG_ 439 FR_OBJ28_Vx 50;
BA_ "GenSigCycleTime" SG_ 439 FR_OBJ28_Vy_std 50;
BA_ "GenSigCycleTime" SG_ 439 FR_OBJ28_Vy 50;
BA_ "GenSigCycleTime" SG_ 439 FR_OBJ28_Dx_Vnce 50;
BA_ "GenSigCycleTime" SG_ 439 FR_OBJ28_Dx 50;
BA_ "GenSigCycleTime" SG_ 439 FR_OBJ28_Dy_Vnce 50;
BA_ "GenSigCycleTime" SG_ 439 FR_OBJ28_Dy 50;
BA_ "GenSigCycleTime" SG_ 439 FR_OBJ28_HeadingAngle 50;
BA_ "GenSigCycleTime" SG_ 439 FR_OBJ28_Length 50;
BA_ "GenSigCycleTime" SG_ 439 FR_OBJ28_Height 50;
BA_ "GenSigCycleTime" SG_ 439 FR_OBJ28_Width 50;
BA_ "GenSigCycleTime" SG_ 439 FR_OBJ28_Class 50;
BA_ "GenSigCycleTime" SG_ 439 FR_OBJ27_Track_Age 50;
BA_ "GenSigCycleTime" SG_ 439 FR_OBJ27_Track_ID 50;
BA_ "GenSigCycleTime" SG_ 439 FR_OBJ27_FusionedFC_Track_ID 50;
BA_ "GenSigCycleTime" SG_ 439 FR_OBJ27_fusion_Sts 50;
BA_ "GenSigCycleTime" SG_ 439 FR_OBJ27_ObstacleProb 50;
BA_ "GenSigCycleTime" SG_ 439 FR_OBJ27_ExistProb 50;
BA_ "GenSigCycleTime" SG_ 439 FR_OBJ27_Brakelight_Info 50;
BA_ "GenSigCycleTime" SG_ 439 FR_OBJ27_Taillight_Info 50;
BA_ "GenSigCycleTime" SG_ 439 FR_OBJ27_Dis_to_R_LaneMark 50;
BA_ "GenSigCycleTime" SG_ 439 FR_OBJ27_Dis_to_L_LaneMark 50;
BA_ "GenSigCycleTime" SG_ 439 FR_OBJ27_Ax 50;
BA_ "GenSigCycleTime" SG_ 439 FR_OBJ27_Ay 50;
BA_ "GenSigCycleTime" SG_ 439 FR_OBJ27_Vx_std 50;
BA_ "GenSigCycleTime" SG_ 439 FR_OBJ27_Vx 50;
BA_ "GenSigCycleTime" SG_ 439 FR_OBJ27_Vy_std 50;
BA_ "GenSigCycleTime" SG_ 439 FR_OBJ27_Vy 50;
BA_ "GenSigCycleTime" SG_ 439 FR_OBJ27_Dx_Vnce 50;
BA_ "GenSigCycleTime" SG_ 439 FR_OBJ27_Dx 50;
BA_ "GenSigCycleTime" SG_ 439 FR_OBJ27_Dy_Vnce 50;
BA_ "GenSigCycleTime" SG_ 439 FR_OBJ27_Dy 50;
BA_ "GenSigCycleTime" SG_ 439 FR_OBJ27_HeadingAngle 50;
BA_ "GenSigCycleTime" SG_ 439 FR_OBJ27_Length 50;
BA_ "GenSigCycleTime" SG_ 439 FR_OBJ27_Height 50;
BA_ "GenSigCycleTime" SG_ 439 FR_OBJ27_Width 50;
BA_ "GenSigCycleTime" SG_ 439 FR_OBJ27_Class 50;
BA_ "GenSigCycleTime" SG_ 440 FC_RollingCounter_1B8 100;
BA_ "GenSigCycleTime" SG_ 440 FC_CRCCheck_1B8 100;
BA_ "GenSigCycleTime" SG_ 440 FR_OBJ30_Track_Age 50;
BA_ "GenSigCycleTime" SG_ 440 FR_OBJ30_Track_ID 50;
BA_ "GenSigCycleTime" SG_ 440 FR_OBJ30_FusionedFC_Track_ID 50;
BA_ "GenSigCycleTime" SG_ 440 FR_OBJ30_fusion_Sts 50;
BA_ "GenSigCycleTime" SG_ 440 FR_OBJ30_ObstacleProb 50;
BA_ "GenSigCycleTime" SG_ 440 FR_OBJ30_ExistProb 50;
BA_ "GenSigCycleTime" SG_ 440 FR_OBJ30_Brakelight_Info 50;
BA_ "GenSigCycleTime" SG_ 440 FR_OBJ30_Taillight_Info 50;
BA_ "GenSigCycleTime" SG_ 440 FR_OBJ30_Dis_to_R_LaneMark 50;
BA_ "GenSigCycleTime" SG_ 440 FR_OBJ30_Dis_to_L_LaneMark 50;
BA_ "GenSigCycleTime" SG_ 440 FR_OBJ30_Ax 50;
BA_ "GenSigCycleTime" SG_ 440 FR_OBJ30_Ay 50;
BA_ "GenSigCycleTime" SG_ 440 FR_OBJ30_Vx_std 50;
BA_ "GenSigCycleTime" SG_ 440 FR_OBJ30_Vx 50;
BA_ "GenSigCycleTime" SG_ 440 FR_OBJ30_Vy_std 50;
BA_ "GenSigCycleTime" SG_ 440 FR_OBJ30_Vy 50;
BA_ "GenSigCycleTime" SG_ 440 FR_OBJ30_Dx_Vnce 50;
BA_ "GenSigCycleTime" SG_ 440 FR_OBJ30_Dx 50;
BA_ "GenSigCycleTime" SG_ 440 FR_OBJ30_Dy_Vnce 50;
BA_ "GenSigCycleTime" SG_ 440 FR_OBJ30_Dy 50;
BA_ "GenSigCycleTime" SG_ 440 FR_OBJ30_HeadingAngle 50;
BA_ "GenSigCycleTime" SG_ 440 FR_OBJ30_Length 50;
BA_ "GenSigCycleTime" SG_ 440 FR_OBJ30_Height 50;
BA_ "GenSigCycleTime" SG_ 440 FR_OBJ30_Width 50;
BA_ "GenSigCycleTime" SG_ 440 FR_OBJ30_Class 50;
BA_ "GenSigCycleTime" SG_ 440 FR_OBJ29_Track_Age 50;
BA_ "GenSigCycleTime" SG_ 440 FR_OBJ29_Track_ID 50;
BA_ "GenSigCycleTime" SG_ 440 FR_OBJ29_FusionedFC_Track_ID 50;
BA_ "GenSigCycleTime" SG_ 440 FR_OBJ29_fusion_Sts 50;
BA_ "GenSigCycleTime" SG_ 440 FR_OBJ29_ObstacleProb 50;
BA_ "GenSigCycleTime" SG_ 440 FR_OBJ29_ExistProb 50;
BA_ "GenSigCycleTime" SG_ 440 FR_OBJ29_Brakelight_Info 50;
BA_ "GenSigCycleTime" SG_ 440 FR_OBJ29_Taillight_Info 50;
BA_ "GenSigCycleTime" SG_ 440 FR_OBJ29_Dis_to_R_LaneMark 50;
BA_ "GenSigCycleTime" SG_ 440 FR_OBJ29_Dis_to_L_LaneMark 50;
BA_ "GenSigCycleTime" SG_ 440 FR_OBJ29_Ax 50;
BA_ "GenSigCycleTime" SG_ 440 FR_OBJ29_Ay 50;
BA_ "GenSigCycleTime" SG_ 440 FR_OBJ29_Vx_std 50;
BA_ "GenSigCycleTime" SG_ 440 FR_OBJ29_Vx 50;
BA_ "GenSigCycleTime" SG_ 440 FR_OBJ29_Vy_std 50;
BA_ "GenSigCycleTime" SG_ 440 FR_OBJ29_Vy 50;
BA_ "GenSigCycleTime" SG_ 440 FR_OBJ29_Dx_Vnce 50;
BA_ "GenSigCycleTime" SG_ 440 FR_OBJ29_Dx 50;
BA_ "GenSigCycleTime" SG_ 440 FR_OBJ29_Dy_Vnce 50;
BA_ "GenSigCycleTime" SG_ 440 FR_OBJ29_Dy 50;
BA_ "GenSigCycleTime" SG_ 440 FR_OBJ29_HeadingAngle 50;
BA_ "GenSigCycleTime" SG_ 440 FR_OBJ29_Length 50;
BA_ "GenSigCycleTime" SG_ 440 FR_OBJ29_Height 50;
BA_ "GenSigCycleTime" SG_ 440 FR_OBJ29_Width 50;
BA_ "GenSigCycleTime" SG_ 440 FR_OBJ29_Class 50;
BA_ "GenSigCycleTime" SG_ 441 FC_RollingCounter_1B9 100;
BA_ "GenSigCycleTime" SG_ 441 FC_CRCCheck_1B9 100;
BA_ "GenSigCycleTime" SG_ 441 FR_OBJ32_Track_Age 50;
BA_ "GenSigCycleTime" SG_ 441 FR_OBJ32_Track_ID 50;
BA_ "GenSigCycleTime" SG_ 441 FR_OBJ32_FusionedFC_Track_ID 50;
BA_ "GenSigCycleTime" SG_ 441 FR_OBJ32_fusion_Sts 50;
BA_ "GenSigCycleTime" SG_ 441 FR_OBJ32_ObstacleProb 50;
BA_ "GenSigCycleTime" SG_ 441 FR_OBJ32_ExistProb 50;
BA_ "GenSigCycleTime" SG_ 441 FR_OBJ32_Brakelight_Info 50;
BA_ "GenSigCycleTime" SG_ 441 FR_OBJ32_Taillight_Info 50;
BA_ "GenSigCycleTime" SG_ 441 FR_OBJ32_Dis_to_R_LaneMark 50;
BA_ "GenSigCycleTime" SG_ 441 FR_OBJ32_Dis_to_L_LaneMark 50;
BA_ "GenSigCycleTime" SG_ 441 FR_OBJ32_Ax 50;
BA_ "GenSigCycleTime" SG_ 441 FR_OBJ32_Ay 50;
BA_ "GenSigCycleTime" SG_ 441 FR_OBJ32_Vx_std 50;
BA_ "GenSigCycleTime" SG_ 441 FR_OBJ32_Vx 50;
BA_ "GenSigCycleTime" SG_ 441 FR_OBJ32_Vy_std 50;
BA_ "GenSigCycleTime" SG_ 441 FR_OBJ32_Vy 50;
BA_ "GenSigCycleTime" SG_ 441 FR_OBJ32_Dx_Vnce 50;
BA_ "GenSigCycleTime" SG_ 441 FR_OBJ32_Dx 50;
BA_ "GenSigCycleTime" SG_ 441 FR_OBJ32_Dy_Vnce 50;
BA_ "GenSigCycleTime" SG_ 441 FR_OBJ32_Dy 50;
BA_ "GenSigCycleTime" SG_ 441 FR_OBJ32_HeadingAngle 50;
BA_ "GenSigCycleTime" SG_ 441 FR_OBJ32_Length 50;
BA_ "GenSigCycleTime" SG_ 441 FR_OBJ32_Height 50;
BA_ "GenSigCycleTime" SG_ 441 FR_OBJ32_Width 50;
BA_ "GenSigCycleTime" SG_ 441 FR_OBJ32_Class 50;
BA_ "GenSigCycleTime" SG_ 441 FR_OBJ31_Track_Age 50;
BA_ "GenSigCycleTime" SG_ 441 FR_OBJ31_Track_ID 50;
BA_ "GenSigCycleTime" SG_ 441 FR_OBJ31_FusionedFC_Track_ID 50;
BA_ "GenSigCycleTime" SG_ 441 FR_OBJ31_fusion_Sts 50;
BA_ "GenSigCycleTime" SG_ 441 FR_OBJ31_ObstacleProb 50;
BA_ "GenSigCycleTime" SG_ 441 FR_OBJ31_ExistProb 50;
BA_ "GenSigCycleTime" SG_ 441 FR_OBJ31_Brakelight_Info 50;
BA_ "GenSigCycleTime" SG_ 441 FR_OBJ31_Taillight_Info 50;
BA_ "GenSigCycleTime" SG_ 441 FR_OBJ31_Dis_to_R_LaneMark 50;
BA_ "GenSigCycleTime" SG_ 441 FR_OBJ31_Dis_to_L_LaneMark 50;
BA_ "GenSigCycleTime" SG_ 441 FR_OBJ31_Ax 50;
BA_ "GenSigCycleTime" SG_ 441 FR_OBJ31_Ay 50;
BA_ "GenSigCycleTime" SG_ 441 FR_OBJ31_Vx_std 50;
BA_ "GenSigCycleTime" SG_ 441 FR_OBJ31_Vx 50;
BA_ "GenSigCycleTime" SG_ 441 FR_OBJ31_Vy_std 50;
BA_ "GenSigCycleTime" SG_ 441 FR_OBJ31_Vy 50;
BA_ "GenSigCycleTime" SG_ 441 FR_OBJ31_Dx_Vnce 50;
BA_ "GenSigCycleTime" SG_ 441 FR_OBJ31_Dx 50;
BA_ "GenSigCycleTime" SG_ 441 FR_OBJ31_Dy_Vnce 50;
BA_ "GenSigCycleTime" SG_ 441 FR_OBJ31_Dy 50;
BA_ "GenSigCycleTime" SG_ 441 FR_OBJ31_HeadingAngle 50;
BA_ "GenSigCycleTime" SG_ 441 FR_OBJ31_Length 50;
BA_ "GenSigCycleTime" SG_ 441 FR_OBJ31_Height 50;
BA_ "GenSigCycleTime" SG_ 441 FR_OBJ31_Width 50;
BA_ "GenSigCycleTime" SG_ 441 FR_OBJ31_Class 50;
BA_ "GenSigCycleTime" SG_ 442 FC_RollingCounter_1BA 100;
BA_ "GenSigCycleTime" SG_ 442 FC_CRCCheck_1BA 100;
BA_ "GenSigCycleTime" SG_ 442 FR_RightGuardrail_dy 100;
BA_ "GenSigCycleTime" SG_ 442 FR_RightGuardrailConfidence 100;
BA_ "GenSigCycleTime" SG_ 442 FR_LeftGuardrail_dy 100;
BA_ "GenSigCycleTime" SG_ 442 FR_LeftGuardrailConfidence 100;
BA_ "GenSigCycleTime" SG_ 443 FC_RollingCounter_1BB 100;
BA_ "GenSigCycleTime" SG_ 443 FC_CRCCheck_1BB 100;
BA_ "GenSigStartValue" SG_ 443 FR_AEBEnable 1;
BA_ "GenSigCycleTime" SG_ 443 FR_AEBEnable 20;
BA_ "GenSigStartValue" SG_ 443 FR_FCWSettingStatus 1;
BA_ "GenSigCycleTime" SG_ 443 FR_FCWSettingStatus 20;
BA_ "GenSigCycleTime" SG_ 443 FR_FCWPreWarning 20;
BA_ "GenSigCycleTime" SG_ 443 FR_FCWLatentWarning 20;
BA_ "GenSigCycleTime" SG_ 443 FR_FCWActive 20;
BA_ "GenSigInvalidValue" SG_ 443 FR_FCWStatus "3";
BA_ "GenSigCycleTime" SG_ 443 FR_FCWStatus 20;
BA_ "GenSigStartValue" SG_ 443 FR_AEBTargetLatRange 500;
BA_ "GenSigCycleTime" SG_ 443 FR_AEBTargetLatRange 20;
BA_ "GenSigStartValue" SG_ 443 FR_AEBTargetLngRange 500;
BA_ "GenSigCycleTime" SG_ 443 FR_AEBTargetLngRange 20;
BA_ "GenSigCycleTime" SG_ 443 FR_AEBTargetDetection 20;
BA_ "GenSigStartValue" SG_ 443 FR_AEBTargetType 15;
BA_ "GenSigCycleTime" SG_ 443 FR_AEBTargetType 20;
BA_ "GenSigStartValue" SG_ 443 FR_AEBTargetRelSpeed 250;
BA_ "GenSigCycleTime" SG_ 443 FR_AEBTargetRelSpeed 20;
BA_ "GenSigCycleTime" SG_ 443 FR_AEBTextInfo 20;
BA_ "GenSigInvalidValue" SG_ 443 FR_AEBStatus "3";
BA_ "GenSigCycleTime" SG_ 443 FR_AEBStatus 20;
BA_ "GenSigInvalidValue" SG_ 443 FR_ABAActive "0";
BA_ "GenSigCycleTime" SG_ 443 FR_ABAActive 20;
BA_ "GenSigInvalidValue" SG_ 443 FR_ABAlevel "3";
BA_ "GenSigStartValue" SG_ 443 FR_ABAlevel 3;
BA_ "GenSigCycleTime" SG_ 443 FR_ABAlevel 20;
BA_ "GenSigInvalidValue" SG_ 443 FR_AWBActive "0";
BA_ "GenSigCycleTime" SG_ 443 FR_AWBActive 20;
BA_ "GenSigInvalidValue" SG_ 443 FR_AWBlevel "0";
BA_ "GenSigCycleTime" SG_ 443 FR_AWBlevel 20;
BA_ "GenSigInvalidValue" SG_ 443 FR_PrefillActive "0";
BA_ "GenSigCycleTime" SG_ 443 FR_PrefillActive 20;
BA_ "GenSigInvalidValue" SG_ 443 FR_AEBVehilceHoldReq "0";
BA_ "GenSigCycleTime" SG_ 443 FR_AEBVehilceHoldReq 20;
BA_ "GenSigCycleTime" SG_ 443 FR_AEBCtrlType 20;
BA_ "GenSigCycleTime" SG_ 443 FR_AEBTargetDeceleration 20;
BA_ "GenSigCycleTime" SG_ 443 FR_AEBActive 20;
BA_ "GenSigCycleTime" SG_ 443 FR_AEBTargetmode 20;
BA_ "GenSigCycleTime" SG_ 443 FR_OBJ_TTC 20;
BA_ "GenSigCycleTime" SG_ 443 FR_OBJ_AEB_ID 20;
BA_ "GenSigCycleTime" SG_ 444 FC_RollingCounter_1BC 100;
BA_ "GenSigCycleTime" SG_ 444 FC_CRCCheck_1BC 100;
BA_ "GenSigCycleTime" SG_ 444 FR_LKATakeoverReq 20;
BA_ "GenSigInvalidValue" SG_ 444 FR_LKAStatus "3";
BA_ "GenSigCycleTime" SG_ 444 FR_LKAStatus 20;
BA_ "GenSigCycleTime" SG_ 444 FR_LDWVibrationWarningReq 20;
BA_ "GenSigInvalidValue" SG_ 444 FR_LDWStatus "3";
BA_ "GenSigCycleTime" SG_ 444 FR_LDWStatus 20;
BA_ "GenSigCycleTime" SG_ 445 FC_RollingCounter_1BD 100;
BA_ "GenSigCycleTime" SG_ 445 FC_CRCCheck_1BD 100;
BA_ "GenSigCycleTime" SG_ 445 FR_LatAngReqActive 10;
BA_ "GenSigCycleTime" SG_ 445 FR_LatAngReq 10;
BA_ "GenSigCycleTime" SG_ 445 FR_MotorTorqueMinLimitRequest 10;
BA_ "GenSigCycleTime" SG_ 445 FR_MotorTorqueMaxLimitRequest 10;
BA_ "GenSigCycleTime" SG_ 446 FC_RollingCounter_1BE 100;
BA_ "GenSigCycleTime" SG_ 446 FC_CRCCheck_1BE 100;
BA_ "GenSigCycleTime" SG_ 446 FR_ELKEnableStatus 20;
BA_ "GenSigInvalidValue" SG_ 446 FR_RadarFailureStatus "3";
BA_ "GenSigCycleTime" SG_ 446 FR_RadarFailureStatus 20;
BA_ "GenSigInvalidValue" SG_ 446 FR_FRadarCalibrationStatus "3";
BA_ "GenSigCycleTime" SG_ 446 FR_FRadarCalibrationStatus 20;
BA_ "GenSigCycleTime" SG_ 446 FR_HostLaneLeftStatus 20;
BA_ "GenSigCycleTime" SG_ 446 FR_HostLaneRightStatus 20;
BA_ "GenSigCycleTime" SG_ 446 FR_Voiceinfo 20;
BA_ "GenSigCycleTime" SG_ 446 FR_ELKInterventionMode 20;
BA_ "GenSigInvalidValue" SG_ 446 FR_ELKMode "3";
BA_ "GenSigCycleTime" SG_ 446 FR_ELKMode 20;
BA_ "GenSigStartValue" SG_ 446 FR_LDWShakeLevStatus 2;
BA_ "GenSigCycleTime" SG_ 446 FR_LDWShakeLevStatus 20;
BA_ "GenSigStartValue" SG_ 446 FR_LASWarningModeSelectionSts 2;
BA_ "GenSigCycleTime" SG_ 446 FR_LASWarningModeSelectionSts 20;
BA_ "GenSigStartValue" SG_ 446 FR_LASModeSelectionStatus 1;
BA_ "GenSigCycleTime" SG_ 446 FR_LASModeSelectionStatus 20;
BA_ "GenSigInvalidValue" SG_ 448 ADS_UDLCStatus "6";
BA_ "GenSigCycleTime" SG_ 448 ADS_UDLCStatus 100;
BA_ "GenSigInvalidValue" SG_ 448 ADS_IACCHWAMode "7";
BA_ "GenSigCycleTime" SG_ 448 ADS_IACCHWAMode 100;
BA_ "GenSigCycleTime" SG_ 449 FC_RollingCounter_1C1 100;
BA_ "GenSigCycleTime" SG_ 449 FC_CRCCheck_1C1 100;
BA_ "GenSigCycleTime" SG_ 449 FR_OBJ2_Track_Age 50;
BA_ "GenSigCycleTime" SG_ 449 FR_OBJ2_Track_ID 50;
BA_ "GenSigCycleTime" SG_ 449 FR_OBJ2_FusionedFC_Track_ID 50;
BA_ "GenSigCycleTime" SG_ 449 FR_OBJ2_fusion_Sts 50;
BA_ "GenSigCycleTime" SG_ 449 FR_OBJ2_ObstacleProb 50;
BA_ "GenSigCycleTime" SG_ 449 FR_OBJ2_ExistProb 50;
BA_ "GenSigCycleTime" SG_ 449 FR_OBJ2_Brakelight_Info 50;
BA_ "GenSigCycleTime" SG_ 449 FR_OBJ2_Taillight_Info 50;
BA_ "GenSigCycleTime" SG_ 449 FR_OBJ2_Dis_to_R_LaneMark 50;
BA_ "GenSigCycleTime" SG_ 449 FR_OBJ2_Dis_to_L_LaneMark 50;
BA_ "GenSigCycleTime" SG_ 449 FR_OBJ2_Ax 50;
BA_ "GenSigCycleTime" SG_ 449 FR_OBJ2_Ay 50;
BA_ "GenSigCycleTime" SG_ 449 FR_OBJ2_Vx_std 50;
BA_ "GenSigCycleTime" SG_ 449 FR_OBJ2_Vx 50;
BA_ "GenSigCycleTime" SG_ 449 FR_OBJ2_Vy_std 50;
BA_ "GenSigCycleTime" SG_ 449 FR_OBJ2_Vy 50;
BA_ "GenSigCycleTime" SG_ 449 FR_OBJ2_Dx_Vnce 50;
BA_ "GenSigCycleTime" SG_ 449 FR_OBJ2_Dx 50;
BA_ "GenSigCycleTime" SG_ 449 FR_OBJ2_Dy_Vnce 50;
BA_ "GenSigCycleTime" SG_ 449 FR_OBJ2_Dy 50;
BA_ "GenSigCycleTime" SG_ 449 FR_OBJ2_HeadingAngle 50;
BA_ "GenSigCycleTime" SG_ 449 FR_OBJ2_Length 50;
BA_ "GenSigCycleTime" SG_ 449 FR_OBJ2_Height 50;
BA_ "GenSigCycleTime" SG_ 449 FR_OBJ2_Width 50;
BA_ "GenSigCycleTime" SG_ 449 FR_OBJ2_Class 50;
BA_ "GenSigCycleTime" SG_ 449 FR_OBJ1_Track_Age 50;
BA_ "GenSigCycleTime" SG_ 449 FR_OBJ1_Track_ID 50;
BA_ "GenSigCycleTime" SG_ 449 FR_OBJ1_FusionedFC_Track_ID 50;
BA_ "GenSigCycleTime" SG_ 449 FR_OBJ1_fusion_Sts 50;
BA_ "GenSigCycleTime" SG_ 449 FR_OBJ1_ObstacleProb 50;
BA_ "GenSigCycleTime" SG_ 449 FR_OBJ1_ExistProb 50;
BA_ "GenSigCycleTime" SG_ 449 FR_OBJ1_Brakelight_Info 50;
BA_ "GenSigCycleTime" SG_ 449 FR_OBJ1_Taillight_Info 50;
BA_ "GenSigCycleTime" SG_ 449 FR_OBJ1_Dis_to_R_LaneMark 50;
BA_ "GenSigCycleTime" SG_ 449 FR_OBJ1_Dis_to_L_LaneMark 50;
BA_ "GenSigCycleTime" SG_ 449 FR_OBJ1_Ax 50;
BA_ "GenSigCycleTime" SG_ 449 FR_OBJ1_Ay 50;
BA_ "GenSigCycleTime" SG_ 449 FR_OBJ1_Vx_std 50;
BA_ "GenSigCycleTime" SG_ 449 FR_OBJ1_Vx 50;
BA_ "GenSigCycleTime" SG_ 449 FR_OBJ1_Vy_std 50;
BA_ "GenSigCycleTime" SG_ 449 FR_OBJ1_Vy 50;
BA_ "GenSigCycleTime" SG_ 449 FR_OBJ1_Dx_Vnce 50;
BA_ "GenSigCycleTime" SG_ 449 FR_OBJ1_Dx 50;
BA_ "GenSigCycleTime" SG_ 449 FR_OBJ1_Dy_Vnce 50;
BA_ "GenSigCycleTime" SG_ 449 FR_OBJ1_Dy 50;
BA_ "GenSigCycleTime" SG_ 449 FR_OBJ1_HeadingAngle 50;
BA_ "GenSigCycleTime" SG_ 449 FR_OBJ1_Length 50;
BA_ "GenSigCycleTime" SG_ 449 FR_OBJ1_Height 50;
BA_ "GenSigCycleTime" SG_ 449 FR_OBJ1_Width 50;
BA_ "GenSigCycleTime" SG_ 449 FR_OBJ1_Class 50;
BA_ "GenSigCycleTime" SG_ 450 FC_RollingCounter_1C2 100;
BA_ "GenSigCycleTime" SG_ 450 FC_CRCCheck_1C2 100;
BA_ "GenSigCycleTime" SG_ 450 FR_OBJ4_Track_Age 50;
BA_ "GenSigCycleTime" SG_ 450 FR_OBJ4_Track_ID 50;
BA_ "GenSigCycleTime" SG_ 450 FR_OBJ4_FusionedFC_Track_ID 50;
BA_ "GenSigCycleTime" SG_ 450 FR_OBJ4_fusion_Sts 50;
BA_ "GenSigCycleTime" SG_ 450 FR_OBJ4_ObstacleProb 50;
BA_ "GenSigCycleTime" SG_ 450 FR_OBJ4_ExistProb 50;
BA_ "GenSigCycleTime" SG_ 450 FR_OBJ4_Brakelight_Info 50;
BA_ "GenSigCycleTime" SG_ 450 FR_OBJ4_Taillight_Info 50;
BA_ "GenSigCycleTime" SG_ 450 FR_OBJ4_Dis_to_R_LaneMark 50;
BA_ "GenSigCycleTime" SG_ 450 FR_OBJ4_Dis_to_L_LaneMark 50;
BA_ "GenSigCycleTime" SG_ 450 FR_OBJ4_Ax 50;
BA_ "GenSigCycleTime" SG_ 450 FR_OBJ4_Ay 50;
BA_ "GenSigCycleTime" SG_ 450 FR_OBJ4_Vx_std 50;
BA_ "GenSigCycleTime" SG_ 450 FR_OBJ4_Vx 50;
BA_ "GenSigCycleTime" SG_ 450 FR_OBJ4_Vy_std 50;
BA_ "GenSigCycleTime" SG_ 450 FR_OBJ4_Vy 50;
BA_ "GenSigCycleTime" SG_ 450 FR_OBJ4_Dx_Vnce 50;
BA_ "GenSigCycleTime" SG_ 450 FR_OBJ4_Dx 50;
BA_ "GenSigCycleTime" SG_ 450 FR_OBJ4_Dy_Vnce 50;
BA_ "GenSigCycleTime" SG_ 450 FR_OBJ4_Dy 50;
BA_ "GenSigCycleTime" SG_ 450 FR_OBJ4_HeadingAngle 50;
BA_ "GenSigCycleTime" SG_ 450 FR_OBJ4_Length 50;
BA_ "GenSigCycleTime" SG_ 450 FR_OBJ4_Height 50;
BA_ "GenSigCycleTime" SG_ 450 FR_OBJ4_Width 50;
BA_ "GenSigCycleTime" SG_ 450 FR_OBJ4_Class 50;
BA_ "GenSigCycleTime" SG_ 450 FR_OBJ3_Track_Age 50;
BA_ "GenSigCycleTime" SG_ 450 FR_OBJ3_Track_ID 50;
BA_ "GenSigCycleTime" SG_ 450 FR_OBJ3_FusionedFC_Track_ID 50;
BA_ "GenSigCycleTime" SG_ 450 FR_OBJ3_fusion_Sts 50;
BA_ "GenSigCycleTime" SG_ 450 FR_OBJ3_ObstacleProb 50;
BA_ "GenSigCycleTime" SG_ 450 FR_OBJ3_ExistProb 50;
BA_ "GenSigCycleTime" SG_ 450 FR_OBJ3_Brakelight_Info 50;
BA_ "GenSigCycleTime" SG_ 450 FR_OBJ3_Taillight_Info 50;
BA_ "GenSigCycleTime" SG_ 450 FR_OBJ3_Dis_to_R_LaneMark 50;
BA_ "GenSigCycleTime" SG_ 450 FR_OBJ3_Dis_to_L_LaneMark 50;
BA_ "GenSigCycleTime" SG_ 450 FR_OBJ3_Ax 50;
BA_ "GenSigCycleTime" SG_ 450 FR_OBJ3_Ay 50;
BA_ "GenSigCycleTime" SG_ 450 FR_OBJ3_Vx_std 50;
BA_ "GenSigCycleTime" SG_ 450 FR_OBJ3_Vx 50;
BA_ "GenSigCycleTime" SG_ 450 FR_OBJ3_Vy_std 50;
BA_ "GenSigCycleTime" SG_ 450 FR_OBJ3_Vy 50;
BA_ "GenSigCycleTime" SG_ 450 FR_OBJ3_Dx_Vnce 50;
BA_ "GenSigCycleTime" SG_ 450 FR_OBJ3_Dx 50;
BA_ "GenSigCycleTime" SG_ 450 FR_OBJ3_Dy_Vnce 50;
BA_ "GenSigCycleTime" SG_ 450 FR_OBJ3_Dy 50;
BA_ "GenSigCycleTime" SG_ 450 FR_OBJ3_HeadingAngle 50;
BA_ "GenSigCycleTime" SG_ 450 FR_OBJ3_Length 50;
BA_ "GenSigCycleTime" SG_ 450 FR_OBJ3_Height 50;
BA_ "GenSigCycleTime" SG_ 450 FR_OBJ3_Width 50;
BA_ "GenSigCycleTime" SG_ 450 FR_OBJ3_Class 50;
BA_ "GenSigCycleTime" SG_ 451 FC_RollingCounter_1C3 100;
BA_ "GenSigCycleTime" SG_ 451 FC_CRCCheck_1C3 100;
BA_ "GenSigCycleTime" SG_ 451 FR_OBJ6_Track_Age 50;
BA_ "GenSigCycleTime" SG_ 451 FR_OBJ6_Track_ID 50;
BA_ "GenSigCycleTime" SG_ 451 FR_OBJ6_FusionedFC_Track_ID 50;
BA_ "GenSigCycleTime" SG_ 451 FR_OBJ6_fusion_Sts 50;
BA_ "GenSigCycleTime" SG_ 451 FR_OBJ6_ObstacleProb 50;
BA_ "GenSigCycleTime" SG_ 451 FR_OBJ6_ExistProb 50;
BA_ "GenSigCycleTime" SG_ 451 FR_OBJ6_Brakelight_Info 50;
BA_ "GenSigCycleTime" SG_ 451 FR_OBJ6_Taillight_Info 50;
BA_ "GenSigCycleTime" SG_ 451 FR_OBJ6_Dis_to_R_LaneMark 50;
BA_ "GenSigCycleTime" SG_ 451 FR_OBJ6_Dis_to_L_LaneMark 50;
BA_ "GenSigCycleTime" SG_ 451 FR_OBJ6_Ax 50;
BA_ "GenSigCycleTime" SG_ 451 FR_OBJ6_Ay 50;
BA_ "GenSigCycleTime" SG_ 451 FR_OBJ6_Vx_std 50;
BA_ "GenSigCycleTime" SG_ 451 FR_OBJ6_Vx 50;
BA_ "GenSigCycleTime" SG_ 451 FR_OBJ6_Vy_std 50;
BA_ "GenSigCycleTime" SG_ 451 FR_OBJ6_Vy 50;
BA_ "GenSigCycleTime" SG_ 451 FR_OBJ6_Dx_Vnce 50;
BA_ "GenSigCycleTime" SG_ 451 FR_OBJ6_Dx 50;
BA_ "GenSigCycleTime" SG_ 451 FR_OBJ6_Dy_Vnce 50;
BA_ "GenSigCycleTime" SG_ 451 FR_OBJ6_Dy 50;
BA_ "GenSigCycleTime" SG_ 451 FR_OBJ6_HeadingAngle 50;
BA_ "GenSigCycleTime" SG_ 451 FR_OBJ6_Length 50;
BA_ "GenSigCycleTime" SG_ 451 FR_OBJ6_Height 50;
BA_ "GenSigCycleTime" SG_ 451 FR_OBJ6_Width 50;
BA_ "GenSigCycleTime" SG_ 451 FR_OBJ6_Class 50;
BA_ "GenSigCycleTime" SG_ 451 FR_OBJ5_Track_Age 50;
BA_ "GenSigCycleTime" SG_ 451 FR_OBJ5_Track_ID 50;
BA_ "GenSigCycleTime" SG_ 451 FR_OBJ5_FusionedFC_Track_ID 50;
BA_ "GenSigCycleTime" SG_ 451 FR_OBJ5_fusion_Sts 50;
BA_ "GenSigCycleTime" SG_ 451 FR_OBJ5_ObstacleProb 50;
BA_ "GenSigCycleTime" SG_ 451 FR_OBJ5_ExistProb 50;
BA_ "GenSigCycleTime" SG_ 451 FR_OBJ5_Brakelight_Info 50;
BA_ "GenSigCycleTime" SG_ 451 FR_OBJ5_Taillight_Info 50;
BA_ "GenSigCycleTime" SG_ 451 FR_OBJ5_Dis_to_R_LaneMark 50;
BA_ "GenSigCycleTime" SG_ 451 FR_OBJ5_Dis_to_L_LaneMark 50;
BA_ "GenSigCycleTime" SG_ 451 FR_OBJ5_Ax 50;
BA_ "GenSigCycleTime" SG_ 451 FR_OBJ5_Ay 50;
BA_ "GenSigCycleTime" SG_ 451 FR_OBJ5_Vx_std 50;
BA_ "GenSigCycleTime" SG_ 451 FR_OBJ5_Vx 50;
BA_ "GenSigCycleTime" SG_ 451 FR_OBJ5_Vy_std 50;
BA_ "GenSigCycleTime" SG_ 451 FR_OBJ5_Vy 50;
BA_ "GenSigCycleTime" SG_ 451 FR_OBJ5_Dx_Vnce 50;
BA_ "GenSigCycleTime" SG_ 451 FR_OBJ5_Dx 50;
BA_ "GenSigCycleTime" SG_ 451 FR_OBJ5_Dy_Vnce 50;
BA_ "GenSigCycleTime" SG_ 451 FR_OBJ5_Dy 50;
BA_ "GenSigCycleTime" SG_ 451 FR_OBJ5_HeadingAngle 50;
BA_ "GenSigCycleTime" SG_ 451 FR_OBJ5_Length 50;
BA_ "GenSigCycleTime" SG_ 451 FR_OBJ5_Height 50;
BA_ "GenSigCycleTime" SG_ 451 FR_OBJ5_Width 50;
BA_ "GenSigCycleTime" SG_ 451 FR_OBJ5_Class 50;
BA_ "GenSigCycleTime" SG_ 452 FC_RollingCounter_1C4 100;
BA_ "GenSigCycleTime" SG_ 452 FC_CRCCheck_1C4 100;
BA_ "GenSigCycleTime" SG_ 452 FR_AEBOBJ_Track_Age 50;
BA_ "GenSigCycleTime" SG_ 452 FR_AEBOBJ_Track_ID 50;
BA_ "GenSigCycleTime" SG_ 452 FR_AEBOBJ_FusionedFC_Track_ID 50;
BA_ "GenSigCycleTime" SG_ 452 FR_AEBOBJ_fusion_Sts 50;
BA_ "GenSigCycleTime" SG_ 452 FR_AEBOBJ_ObstacleProb 50;
BA_ "GenSigCycleTime" SG_ 452 FR_AEBOBJ_ExistProb 50;
BA_ "GenSigCycleTime" SG_ 452 FR_AEBOBJ_Brakelight_Info 50;
BA_ "GenSigCycleTime" SG_ 452 FR_AEBOBJ_Taillight_Info 50;
BA_ "GenSigCycleTime" SG_ 452 FR_AEBOBJ_Dis_to_R_LaneMark 50;
BA_ "GenSigCycleTime" SG_ 452 FR_AEBOBJ_Dis_to_L_LaneMark 50;
BA_ "GenSigCycleTime" SG_ 452 FR_AEBOBJ_Ax 50;
BA_ "GenSigCycleTime" SG_ 452 FR_AEBOBJ_Ay 50;
BA_ "GenSigCycleTime" SG_ 452 FR_AEBOBJ_Vx_std 50;
BA_ "GenSigCycleTime" SG_ 452 FR_AEBOBJ_Vx 50;
BA_ "GenSigCycleTime" SG_ 452 FR_AEBOBJ_Vy_std 50;
BA_ "GenSigCycleTime" SG_ 452 FR_AEBOBJ_Vy 50;
BA_ "GenSigCycleTime" SG_ 452 FR_AEBOBJ_Dx_Vnce 50;
BA_ "GenSigCycleTime" SG_ 452 FR_AEBOBJ_Dx 50;
BA_ "GenSigCycleTime" SG_ 452 FR_AEBOBJ_Dy_Vnce 50;
BA_ "GenSigCycleTime" SG_ 452 FR_AEBOBJ_Dy 50;
BA_ "GenSigCycleTime" SG_ 452 FR_AEBOBJ_HeadingAngle 50;
BA_ "GenSigCycleTime" SG_ 452 FR_AEBOBJ_Length 50;
BA_ "GenSigCycleTime" SG_ 452 FR_AEBOBJ_Height 50;
BA_ "GenSigCycleTime" SG_ 452 FR_AEBOBJ_Width 50;
BA_ "GenSigCycleTime" SG_ 452 FR_AEBOBJ_Class 50;
BA_ "GenSigStartValue" SG_ 423 FC_Reserved_1A7 1;
BA_ "GenSigCycleTime" SG_ 423 FC_Reserved_1A7 60;
BA_ "GenSigStartValue" SG_ 425 FC_Reserved_1A9 1;
BA_ "GenSigCycleTime" SG_ 425 FC_Reserved_1A9 60;
BA_ "GenSigStartValue" SG_ 453 FR_Reserved_1C5 1;
BA_ "GenSigCycleTime" SG_ 453 FR_Reserved_1C5 50;
BA_ "GenSigStartValue" SG_ 454 FR_Reserved_1C6 1;
BA_ "GenSigCycleTime" SG_ 454 FR_Reserved_1C6 50;
VAL_ 427 LeFr_AccOBJ_fusion_Sts 0 "undefined" 1 "fusion" 2 "carmera only" 3 "radar only" ;
VAL_ 427 LeFr_AccOBJ_Brakelight_Info 0 "off; 0x1=on" ;
VAL_ 427 LeFr_AccOBJ_Taillight_Info 0 "off; 0x1=left; 0x2=right; 0x3=left and right; 0x4=invalid;0x5=reserved" ;
VAL_ 427 LeFr_AccOBJ_Class 0 "Not Detected;
0x1=car" 2 "truck" 3 "bicycle/motorbike" 4 "pedestrian" 5 "general" 6 "animal" 7 "uncertain" ;
VAL_ 427 Le_AccOBJ_fusion_Sts 0 "undefined" 1 "fusion" 2 "carmera only" 3 "radar only" ;
VAL_ 427 Le_AccOBJ_Brakelight_Info 0 "off; 0x1=on" ;
VAL_ 427 Le_AccOBJ_Taillight_Info 0 "off; 0x1=left; 0x2=right; 0x3=left and right; 0x4=invalid;0x5=reserved" ;
VAL_ 427 Le_AccOBJ_Class 0 "Not Detected;
0x1=car" 2 "truck" 3 "bicycle/motorbike" 4 "pedestrian" 5 "general" 6 "animal" 7 "uncertain" ;
VAL_ 428 RiFr_AccOBJ_fusion_Sts 0 "undefined" 1 "fusion" 2 "carmera only" 3 "radar only" ;
VAL_ 428 RiFr_AccOBJ_Brakelight_Info 0 "off; 0x1=on" ;
VAL_ 428 RiFr_AccOBJ_Taillight_Info 0 "off; 0x1=left; 0x2=right; 0x3=left and right; 0x4=invalid;0x5=reserved" ;
VAL_ 428 RiFr_AccOBJ_Class 0 "Not Detected;
0x1=car" 2 "truck" 3 "bicycle/motorbike" 4 "pedestrian" 5 "general" 6 "animal" 7 "uncertain" ;
VAL_ 428 Ri_AccOBJ_fusion_Sts 0 "undefined" 1 "fusion" 2 "carmera only" 3 "radar only" ;
VAL_ 428 Ri_AccOBJ_Brakelight_Info 0 "off; 0x1=on" ;
VAL_ 428 Ri_AccOBJ_Taillight_Info 0 "off; 0x1=left; 0x2=right; 0x3=left and right; 0x4=invalid;0x5=reserved" ;
VAL_ 428 Ri_AccOBJ_Class 0 "Not Detected;
0x1=car" 2 "truck" 3 "bicycle/motorbike" 4 "pedestrian" 5 "general" 6 "animal" 7 "uncertain" ;
VAL_ 429 FR_OBJ8_fusion_Sts 0 "undefined" 1 "fusion" 2 "carmera only" 3 "radar only" ;
VAL_ 429 FR_OBJ8_Brakelight_Info 0 "off; 0x1=on" ;
VAL_ 429 FR_OBJ8_Taillight_Info 0 "off; 0x1=left; 0x2=right; 0x3=left and right; 0x4=invalid;0x5=reserved" ;
VAL_ 429 FR_OBJ8_Class 0 "Not Detected;
0x1=car" 2 "truck" 3 "bicycle/motorbike" 4 "pedestrian" 5 "general" 6 "animal" 7 "uncertain" ;
VAL_ 429 FR_OBJ7_fusion_Sts 0 "undefined" 1 "fusion" 2 "carmera only" 3 "radar only" ;
VAL_ 429 FR_OBJ7_Brakelight_Info 0 "off; 0x1=on" ;
VAL_ 429 FR_OBJ7_Taillight_Info 0 "off; 0x1=left; 0x2=right; 0x3=left and right; 0x4=invalid;0x5=reserved" ;
VAL_ 429 FR_OBJ7_Class 0 "Not Detected;
0x1=car" 2 "truck" 3 "bicycle/motorbike" 4 "pedestrian" 5 "general" 6 "animal" 7 "uncertain" ;
VAL_ 430 FR_OBJ10_fusion_Sts 0 "undefined" 1 "fusion" 2 "carmera only" 3 "radar only" ;
VAL_ 430 FR_OBJ10_Brakelight_Info 0 "off; 0x1=on" ;
VAL_ 430 FR_OBJ10_Taillight_Info 0 "off; 0x1=left; 0x2=right; 0x3=left and right; 0x4=invalid;0x5=reserved" ;
VAL_ 430 FR_OBJ10_Class 0 "Not Detected;
0x1=car" 2 "truck" 3 "bicycle/motorbike" 4 "pedestrian" 5 "general" 6 "animal" 7 "uncertain" ;
VAL_ 430 FR_OBJ9_fusion_Sts 0 "undefined" 1 "fusion" 2 "carmera only" 3 "radar only" ;
VAL_ 430 FR_OBJ9_Brakelight_Info 0 "off; 0x1=on" ;
VAL_ 430 FR_OBJ9_Taillight_Info 0 "off; 0x1=left; 0x2=right; 0x3=left and right; 0x4=invalid;0x5=reserved" ;
VAL_ 430 FR_OBJ9_Class 0 "Not Detected;
0x1=car" 2 "truck" 3 "bicycle/motorbike" 4 "pedestrian" 5 "general" 6 "animal" 7 "uncertain" ;
VAL_ 431 FR_OBJ12_fusion_Sts 0 "undefined" 1 "fusion" 2 "carmera only" 3 "radar only" ;
VAL_ 431 FR_OBJ12_Brakelight_Info 0 "off; 0x1=on" ;
VAL_ 431 FR_OBJ12_Taillight_Info 0 "off; 0x1=left; 0x2=right; 0x3=left and right; 0x4=invalid;0x5=reserved" ;
VAL_ 431 FR_OBJ12_Class 0 "Not Detected;
0x1=car" 2 "truck" 3 "bicycle/motorbike" 4 "pedestrian" 5 "general" 6 "animal" 7 "uncertain" ;
VAL_ 431 FR_OBJ11_fusion_Sts 0 "undefined" 1 "fusion" 2 "carmera only" 3 "radar only" ;
VAL_ 431 FR_OBJ11_Brakelight_Info 0 "off; 0x1=on" ;
VAL_ 431 FR_OBJ11_Taillight_Info 0 "off; 0x1=left; 0x2=right; 0x3=left and right; 0x4=invalid;0x5=reserved" ;
VAL_ 431 FR_OBJ11_Class 0 "Not Detected;
0x1=car" 2 "truck" 3 "bicycle/motorbike" 4 "pedestrian" 5 "general" 6 "animal" 7 "uncertain" ;
VAL_ 432 FR_OBJ14_fusion_Sts 0 "undefined" 1 "fusion" 2 "carmera only" 3 "radar only" ;
VAL_ 432 FR_OBJ14_Brakelight_Info 0 "off; 0x1=on" ;
VAL_ 432 FR_OBJ14_Taillight_Info 0 "off; 0x1=left; 0x2=right; 0x3=left and right; 0x4=invalid;0x5=reserved" ;
VAL_ 432 FR_OBJ14_Class 0 "Not Detected;
0x1=car" 2 "truck" 3 "bicycle/motorbike" 4 "pedestrian" 5 "general" 6 "animal" 7 "uncertain" ;
VAL_ 432 FR_OBJ13_fusion_Sts 0 "undefined" 1 "fusion" 2 "carmera only" 3 "radar only" ;
VAL_ 432 FR_OBJ13_Brakelight_Info 0 "off; 0x1=on" ;
VAL_ 432 FR_OBJ13_Taillight_Info 0 "off; 0x1=left; 0x2=right; 0x3=left and right; 0x4=invalid;0x5=reserved" ;
VAL_ 432 FR_OBJ13_Class 0 "Not Detected;
0x1=car" 2 "truck" 3 "bicycle/motorbike" 4 "pedestrian" 5 "general" 6 "animal" 7 "uncertain" ;
VAL_ 433 FR_OBJ16_fusion_Sts 0 "undefined" 1 "fusion" 2 "carmera only" 3 "radar only" ;
VAL_ 433 FR_OBJ16_Brakelight_Info 0 "off; 0x1=on" ;
VAL_ 433 FR_OBJ16_Taillight_Info 0 "off; 0x1=left; 0x2=right; 0x3=left and right; 0x4=invalid;0x5=reserved" ;
VAL_ 433 FR_OBJ16_Class 0 "Not Detected;
0x1=car" 2 "truck" 3 "bicycle/motorbike" 4 "pedestrian" 5 "general" 6 "animal" 7 "uncertain" ;
VAL_ 433 FR_OBJ15_fusion_Sts 0 "undefined" 1 "fusion" 2 "carmera only" 3 "radar only" ;
VAL_ 433 FR_OBJ15_Brakelight_Info 0 "off; 0x1=on" ;
VAL_ 433 FR_OBJ15_Taillight_Info 0 "off; 0x1=left; 0x2=right; 0x3=left and right; 0x4=invalid;0x5=reserved" ;
VAL_ 433 FR_OBJ15_Class 0 "Not Detected;
0x1=car" 2 "truck" 3 "bicycle/motorbike" 4 "pedestrian" 5 "general" 6 "animal" 7 "uncertain" ;
VAL_ 434 FR_OBJ18_fusion_Sts 0 "undefined" 1 "fusion" 2 "carmera only" 3 "radar only" ;
VAL_ 434 FR_OBJ18_Brakelight_Info 0 "off; 0x1=on" ;
VAL_ 434 FR_OBJ18_Taillight_Info 0 "off; 0x1=left; 0x2=right; 0x3=left and right; 0x4=invalid;0x5=reserved" ;
VAL_ 434 FR_OBJ18_Class 0 "Not Detected;
0x1=car" 2 "truck" 3 "bicycle/motorbike" 4 "pedestrian" 5 "general" 6 "animal" 7 "uncertain" ;
VAL_ 434 FR_OBJ17_fusion_Sts 0 "undefined" 1 "fusion" 2 "carmera only" 3 "radar only" ;
VAL_ 434 FR_OBJ17_Brakelight_Info 0 "off; 0x1=on" ;
VAL_ 434 FR_OBJ17_Taillight_Info 0 "off; 0x1=left; 0x2=right; 0x3=left and right; 0x4=invalid;0x5=reserved" ;
VAL_ 434 FR_OBJ17_Class 0 "Not Detected;
0x1=car" 2 "truck" 3 "bicycle/motorbike" 4 "pedestrian" 5 "general" 6 "animal" 7 "uncertain" ;
VAL_ 435 FR_OBJ20_fusion_Sts 0 "undefined" 1 "fusion" 2 "carmera only" 3 "radar only" ;
VAL_ 435 FR_OBJ20_Brakelight_Info 0 "off; 0x1=on" ;
VAL_ 435 FR_OBJ20_Taillight_Info 0 "off; 0x1=left; 0x2=right; 0x3=left and right; 0x4=invalid;0x5=reserved" ;
VAL_ 435 FR_OBJ20_Class 0 "Not Detected;
0x1=car" 2 "truck" 3 "bicycle/motorbike" 4 "pedestrian" 5 "general" 6 "animal" 7 "uncertain" ;
VAL_ 435 FR_OBJ19_fusion_Sts 0 "undefined" 1 "fusion" 2 "carmera only" 3 "radar only" ;
VAL_ 435 FR_OBJ19_Brakelight_Info 0 "off; 0x1=on" ;
VAL_ 435 FR_OBJ19_Taillight_Info 0 "off; 0x1=left; 0x2=right; 0x3=left and right; 0x4=invalid;0x5=reserved" ;
VAL_ 435 FR_OBJ19_Class 0 "Not Detected;
0x1=car" 2 "truck" 3 "bicycle/motorbike" 4 "pedestrian" 5 "general" 6 "animal" 7 "uncertain" ;
VAL_ 436 FR_OBJ22_fusion_Sts 0 "undefined" 1 "fusion" 2 "carmera only" 3 "radar only" ;
VAL_ 436 FR_OBJ22_Brakelight_Info 0 "off; 0x1=on" ;
VAL_ 436 FR_OBJ22_Taillight_Info 0 "off; 0x1=left; 0x2=right; 0x3=left and right; 0x4=invalid;0x5=reserved" ;
VAL_ 436 FR_OBJ22_Class 0 "Not Detected;
0x1=car" 2 "truck" 3 "bicycle/motorbike" 4 "pedestrian" 5 "general" 6 "animal" 7 "uncertain" ;
VAL_ 436 FR_OBJ21_fusion_Sts 0 "undefined" 1 "fusion" 2 "carmera only" 3 "radar only" ;
VAL_ 436 FR_OBJ21_Brakelight_Info 0 "off; 0x1=on" ;
VAL_ 436 FR_OBJ21_Taillight_Info 0 "off; 0x1=left; 0x2=right; 0x3=left and right; 0x4=invalid;0x5=reserved" ;
VAL_ 436 FR_OBJ21_Class 0 "Not Detected;
0x1=car" 2 "truck" 3 "bicycle/motorbike" 4 "pedestrian" 5 "general" 6 "animal" 7 "uncertain" ;
VAL_ 437 FR_OBJ24_fusion_Sts 0 "undefined" 1 "fusion" 2 "carmera only" 3 "radar only" ;
VAL_ 437 FR_OBJ24_Brakelight_Info 0 "off; 0x1=on" ;
VAL_ 437 FR_OBJ24_Taillight_Info 0 "off; 0x1=left; 0x2=right; 0x3=left and right; 0x4=invalid;0x5=reserved" ;
VAL_ 437 FR_OBJ24_Class 0 "Not Detected;
0x1=car" 2 "truck" 3 "bicycle/motorbike" 4 "pedestrian" 5 "general" 6 "animal" 7 "uncertain" ;
VAL_ 437 FR_OBJ23_fusion_Sts 0 "undefined" 1 "fusion" 2 "carmera only" 3 "radar only" ;
VAL_ 437 FR_OBJ23_Brakelight_Info 0 "off; 0x1=on" ;
VAL_ 437 FR_OBJ23_Taillight_Info 0 "off; 0x1=left; 0x2=right; 0x3=left and right; 0x4=invalid;0x5=reserved" ;
VAL_ 437 FR_OBJ23_Class 0 "Not Detected;
0x1=car" 2 "truck" 3 "bicycle/motorbike" 4 "pedestrian" 5 "general" 6 "animal" 7 "uncertain" ;
VAL_ 438 FR_OBJ26_fusion_Sts 0 "undefined" 1 "fusion" 2 "carmera only" 3 "radar only" ;
VAL_ 438 FR_OBJ26_Brakelight_Info 0 "off; 0x1=on" ;
VAL_ 438 FR_OBJ26_Taillight_Info 0 "off; 0x1=left; 0x2=right; 0x3=left and right; 0x4=invalid;0x5=reserved" ;
VAL_ 438 FR_OBJ26_Class 0 "Not Detected;
0x1=car" 2 "truck" 3 "bicycle/motorbike" 4 "pedestrian" 5 "general" 6 "animal" 7 "uncertain" ;
VAL_ 438 FR_OBJ25_fusion_Sts 0 "undefined" 1 "fusion" 2 "carmera only" 3 "radar only" ;
VAL_ 438 FR_OBJ25_Brakelight_Info 0 "off; 0x1=on" ;
VAL_ 438 FR_OBJ25_Taillight_Info 0 "off; 0x1=left; 0x2=right; 0x3=left and right; 0x4=invalid;0x5=reserved" ;
VAL_ 438 FR_OBJ25_Class 0 "Not Detected;
0x1=car" 2 "truck" 3 "bicycle/motorbike" 4 "pedestrian" 5 "general" 6 "animal" 7 "uncertain" ;
VAL_ 439 FR_OBJ28_fusion_Sts 0 "undefined" 1 "fusion" 2 "carmera only" 3 "radar only" ;
VAL_ 439 FR_OBJ28_Brakelight_Info 0 "off; 0x1=on" ;
VAL_ 439 FR_OBJ28_Taillight_Info 0 "off; 0x1=left; 0x2=right; 0x3=left and right; 0x4=invalid;0x5=reserved" ;
VAL_ 439 FR_OBJ28_Class 0 "Not Detected;
0x1=car" 2 "truck" 3 "bicycle/motorbike" 4 "pedestrian" 5 "general" 6 "animal" 7 "uncertain" ;
VAL_ 439 FR_OBJ27_fusion_Sts 0 "undefined" 1 "fusion" 2 "carmera only" 3 "radar only" ;
VAL_ 439 FR_OBJ27_Brakelight_Info 0 "off; 0x1=on" ;
VAL_ 439 FR_OBJ27_Taillight_Info 0 "off; 0x1=left; 0x2=right; 0x3=left and right; 0x4=invalid;0x5=reserved" ;
VAL_ 439 FR_OBJ27_Class 0 "Not Detected;
0x1=car" 2 "truck" 3 "bicycle/motorbike" 4 "pedestrian" 5 "general" 6 "animal" 7 "uncertain" ;
VAL_ 440 FR_OBJ30_fusion_Sts 0 "undefined" 1 "fusion" 2 "carmera only" 3 "radar only" ;
VAL_ 440 FR_OBJ30_Brakelight_Info 0 "off; 0x1=on" ;
VAL_ 440 FR_OBJ30_Taillight_Info 0 "off; 0x1=left; 0x2=right; 0x3=left and right; 0x4=invalid;0x5=reserved" ;
VAL_ 440 FR_OBJ30_Class 0 "Not Detected;
0x1=car" 2 "truck" 3 "bicycle/motorbike" 4 "pedestrian" 5 "general" 6 "animal" 7 "uncertain" ;
VAL_ 440 FR_OBJ29_fusion_Sts 0 "undefined" 1 "fusion" 2 "carmera only" 3 "radar only" ;
VAL_ 440 FR_OBJ29_Brakelight_Info 0 "off; 0x1=on" ;
VAL_ 440 FR_OBJ29_Taillight_Info 0 "off; 0x1=left; 0x2=right; 0x3=left and right; 0x4=invalid;0x5=reserved" ;
VAL_ 440 FR_OBJ29_Class 0 "Not Detected;
0x1=car" 2 "truck" 3 "bicycle/motorbike" 4 "pedestrian" 5 "general" 6 "animal" 7 "uncertain" ;
VAL_ 441 FR_OBJ32_fusion_Sts 0 "undefined" 1 "fusion" 2 "carmera only" 3 "radar only" ;
VAL_ 441 FR_OBJ32_Brakelight_Info 0 "off; 0x1=on" ;
VAL_ 441 FR_OBJ32_Taillight_Info 0 "off; 0x1=left; 0x2=right; 0x3=left and right; 0x4=invalid;0x5=reserved" ;
VAL_ 441 FR_OBJ32_Class 0 "Not Detected;
0x1=car" 2 "truck" 3 "bicycle/motorbike" 4 "pedestrian" 5 "general" 6 "animal" 7 "uncertain" ;
VAL_ 441 FR_OBJ31_fusion_Sts 0 "undefined" 1 "fusion" 2 "carmera only" 3 "radar only" ;
VAL_ 441 FR_OBJ31_Brakelight_Info 0 "off; 0x1=on" ;
VAL_ 441 FR_OBJ31_Taillight_Info 0 "off; 0x1=left; 0x2=right; 0x3=left and right; 0x4=invalid;0x5=reserved" ;
VAL_ 441 FR_OBJ31_Class 0 "Not Detected;
0x1=car" 2 "truck" 3 "bicycle/motorbike" 4 "pedestrian" 5 "general" 6 "animal" 7 "uncertain" ;
VAL_ 443 FR_AEBEnable 0 "off" 1 "on" ;
VAL_ 443 FR_FCWSettingStatus 0 "early" 1 "normal" 2 "late" 3 "Off" 4 "Reserved" ;
VAL_ 443 FR_FCWPreWarning 0 " no warning" 1 " warning" ;
VAL_ 443 FR_FCWLatentWarning 0 " no warning" 1 " warning" ;
VAL_ 443 FR_FCWActive 0 " not Active" 1 " Active." ;
VAL_ 443 FR_FCWStatus 0 "off" 1 "on" 2 " reserved;
0x3=failure;" ;
VAL_ 443 FR_AEBTargetLatRange 0 "" 1001 "" ;
VAL_ 443 FR_AEBTargetLngRange 0 "-70~180" 501 "reserved" 511 "no display" ;
VAL_ 443 FR_AEBTargetDetection 0 "no detected" 1 "detected" ;
VAL_ 443 FR_AEBTargetType 0 "sedan" 1 "truck" 2 "motorcycle" 3 "pedestrian" 4 "other" 5 "Bicycle" 6 "BUS" 7 "reserved 0xF=no display" ;
VAL_ 443 FR_AEBTargetRelSpeed 0 "" 501 "" ;
VAL_ 443 FR_AEBTextInfo 0 "no display" 2 "AEB Error by FR" 3 "AEB Error by Dasy" 4 "AEB Error by FCR" 5 "AEB Error by EPBi" 6 "AEB Error by SAS" 7 "AEB Error by SRS" 8 "AEB Error by EMS" 9 "AEB Error by TCU" 10 "AEB Error by other" 11 "reserved" ;
VAL_ 443 FR_AEBStatus 0 "off" 1 "on" 2 " reserved;
0x3=failure;" ;
VAL_ 443 FR_ABAActive 0 " not Active" 1 " Active." ;
VAL_ 443 FR_ABAlevel 0 "level 0" 1 "level 1" 2 "level 2" 3 "level 3" ;
VAL_ 443 FR_AWBActive 0 " not Active" 1 " Active." ;
VAL_ 443 FR_AWBlevel 0 "no level" 1 "level 1" 2 "level 2" 3 "level 3" 4 "level 4" 5 "reserved" ;
VAL_ 443 FR_PrefillActive 0 " not Active" 1 " Active." ;
VAL_ 443 FR_AEBVehilceHoldReq 0 "No hold" 1 "hold" ;
VAL_ 443 FR_AEBCtrlType 0 "no request" 1 "AEB C&UAEB" 2 "AEB VRUAEB" 3 "AEB CyclistAEB" 4 "EBA" 5 "FCTB" 6 "RCTB(AEB)" 7 "Reserved" ;
VAL_ 443 FR_AEBActive 0 " not Active" 1 " Active." ;
VAL_ 443 FR_AEBTargetmode 0 "none" 1 "video only mode" 2 "rader only mode" 3 "fusion mode" ;
VAL_ 444 FR_LKATakeoverReq 0 "Not Req" 1 "Req" ;
VAL_ 444 FR_LKAStatus 0 "Off" 1 "Standby" 2 "Active" 3 "Failure" ;
VAL_ 444 FR_LDWVibrationWarningReq 0 " No Warning" 1 " Left Warning" 2 "Right Warning" 3 " reserved" ;
VAL_ 444 FR_LDWStatus 0 "Off" 1 "Standby" 2 "Active" 3 "Failure" ;
VAL_ 445 FR_LatAngReqActive 0 "not Active" 1 "Active" ;
VAL_ 445 FR_LatAngReq 14410 "Reserved" ;
VAL_ 445 FR_MotorTorqueMinLimitRequest 2047 " Reserved" ;
VAL_ 445 FR_MotorTorqueMaxLimitRequest 2047 " Reserved" ;
VAL_ 446 FR_ELKEnableStatus 0 "off" 1 "on" ;
VAL_ 446 FR_RadarFailureStatus 0 " no failure" 1 "blind" 2 "reversible failure" 3 " irrversible failure" ;
VAL_ 446 FR_FRadarCalibrationStatus 0 " Calibration is ok" 1 " Calibration In Process" 2 " Calibration never done" 3 "  Calibration Failed" ;
VAL_ 446 FR_HostLaneLeftStatus 0 "No display" 1 " reserved" 2 "Intervention" 3 "Warning" 4 "Centering" 5 "reserved" ;
VAL_ 446 FR_HostLaneRightStatus 0 "No display" 1 " reserved" 2 "Intervention" 3 "Warning" 4 "Centering" 5 "reserved" ;
VAL_ 446 FR_Voiceinfo 0 "no voice" 1 "latentWarning voive" 2 "FCW/AEB voice" 3 " reserved" 6 "Lane Left dangerous warning? voice" 7 "Lane Right dangerous warning? voice" 8 " reserved" 14 "TrafficWarning" 15 "reserved" ;
VAL_ 446 FR_ELKInterventionMode 0 " off;
0x1= Road edge;
0x2= Overtaking;
0x3= Oncoming." ;
VAL_ 446 FR_ELKMode 0 " off" 1 " passive;
0x2:=active;
0x3= fault;
0x4-0x7= reserved." ;
VAL_ 446 FR_LDWShakeLevStatus 0 "reserved" 1 "low" 2 "normal" 3 "high" ;
VAL_ 446 FR_LASWarningModeSelectionSts 0 "Reserved" 1 "sound" 2 "vibration" 3 "sound and vibration" 4 "Reserved" ;
VAL_ 446 FR_LASModeSelectionStatus 0 "Reserved" 1 "LDW" 2 "LKA" 3 "LCS" 4 "Reserved" 7 "OFF" ;
VAL_ 448 ADS_UDLCStatus 0 "OFF" 1 "Passive" 2 "Active" 3 "Return to lane by driver" 4 "Return to lane by system " 5 "Maual Override" 6 "Failure" 7 "Reserved" ;
VAL_ 448 ADS_IACCHWAMode 0 "off" 1 "standby" 2 "passive" 3 "active" 4 "suspend" 5 " prohibition" 6 "reserved" 7 "failure" ;
VAL_ 449 FR_OBJ2_fusion_Sts 0 "undefined" 1 "fusion" 2 "carmera only" 3 "radar only" ;
VAL_ 449 FR_OBJ2_Brakelight_Info 0 "off; 0x1=on" ;
VAL_ 449 FR_OBJ2_Taillight_Info 0 "off; 0x1=left; 0x2=right; 0x3=left and right; 0x4=invalid;0x5=reserved" ;
VAL_ 449 FR_OBJ2_Class 0 "Not Detected;
0x1=car" 2 "truck" 3 "bicycle/motorbike" 4 "pedestrian" 5 "general" 6 "animal" 7 "uncertain" ;
VAL_ 449 FR_OBJ1_fusion_Sts 0 "undefined" 1 "fusion" 2 "carmera only" 3 "radar only" ;
VAL_ 449 FR_OBJ1_Brakelight_Info 0 "off; 0x1=on" ;
VAL_ 449 FR_OBJ1_Taillight_Info 0 "off; 0x1=left; 0x2=right; 0x3=left and right; 0x4=invalid;0x5=reserved" ;
VAL_ 449 FR_OBJ1_Class 0 "Not Detected;
0x1=car" 2 "truck" 3 "bicycle/motorbike" 4 "pedestrian" 5 "general" 6 "animal" 7 "uncertain" ;
VAL_ 450 FR_OBJ4_fusion_Sts 0 "undefined" 1 "fusion" 2 "carmera only" 3 "radar only" ;
VAL_ 450 FR_OBJ4_Brakelight_Info 0 "off; 0x1=on" ;
VAL_ 450 FR_OBJ4_Taillight_Info 0 "off; 0x1=left; 0x2=right; 0x3=left and right; 0x4=invalid;0x5=reserved" ;
VAL_ 450 FR_OBJ4_Class 0 "Not Detected;
0x1=car" 2 "truck" 3 "bicycle/motorbike" 4 "pedestrian" 5 "general" 6 "animal" 7 "uncertain" ;
VAL_ 450 FR_OBJ3_fusion_Sts 0 "undefined" 1 "fusion" 2 "carmera only" 3 "radar only" ;
VAL_ 450 FR_OBJ3_Brakelight_Info 0 "off; 0x1=on" ;
VAL_ 450 FR_OBJ3_Taillight_Info 0 "off; 0x1=left; 0x2=right; 0x3=left and right; 0x4=invalid;0x5=reserved" ;
VAL_ 450 FR_OBJ3_Class 0 "Not Detected;
0x1=car" 2 "truck" 3 "bicycle/motorbike" 4 "pedestrian" 5 "general" 6 "animal" 7 "uncertain" ;
VAL_ 451 FR_OBJ6_fusion_Sts 0 "undefined" 1 "fusion" 2 "carmera only" 3 "radar only" ;
VAL_ 451 FR_OBJ6_Brakelight_Info 0 "off; 0x1=on" ;
VAL_ 451 FR_OBJ6_Taillight_Info 0 "off; 0x1=left; 0x2=right; 0x3=left and right; 0x4=invalid;0x5=reserved" ;
VAL_ 451 FR_OBJ6_Class 0 "Not Detected;
0x1=car" 2 "truck" 3 "bicycle/motorbike" 4 "pedestrian" 5 "general" 6 "animal" 7 "uncertain" ;
VAL_ 451 FR_OBJ5_fusion_Sts 0 "undefined" 1 "fusion" 2 "carmera only" 3 "radar only" ;
VAL_ 451 FR_OBJ5_Brakelight_Info 0 "off; 0x1=on" ;
VAL_ 451 FR_OBJ5_Taillight_Info 0 "off; 0x1=left; 0x2=right; 0x3=left and right; 0x4=invalid;0x5=reserved" ;
VAL_ 451 FR_OBJ5_Class 0 "Not Detected;
0x1=car" 2 "truck" 3 "bicycle/motorbike" 4 "pedestrian" 5 "general" 6 "animal" 7 "uncertain" ;
VAL_ 452 FR_AEBOBJ_fusion_Sts 0 "undefined" 1 "fusion" 2 "carmera only" 3 "radar only" ;
VAL_ 452 FR_AEBOBJ_Brakelight_Info 0 "off; 0x1=on" ;
VAL_ 452 FR_AEBOBJ_Taillight_Info 0 "off; 0x1=left; 0x2=right; 0x3=left and right; 0x4=invalid;0x5=reserved" ;
VAL_ 452 FR_AEBOBJ_Class 0 "Not Detected;
0x1=car" 2 "truck" 3 "bicycle/motorbike" 4 "pedestrian" 5 "general" 6 "animal" 7 "uncertain" ;
