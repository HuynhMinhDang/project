/*@!Encoding:1252*/

variables
{
    //Used interact between raw and the physical environment variables
    byte chgEv_GW_3B8_HU_Byroad = 0;
    byte chgEv_GW_3B8_HU_RoadCurvature = 0;
    byte chgEv_GW_3B8_HU_EnterSlopeInfo = 0;
    byte chgEv_GW_3B8_HU_EnterTunnelInfo = 0;
    byte chgEv_GW_3B8_HU_SlopeDistance = 0;
    byte chgEv_GW_3B8_HU_TunnelDistance = 0;
    byte chgEv_GW_3B8_HU_NavGuiganceStatus = 0;
    byte chgEv_GW_3B8_HU_TunnelLength = 0;
    byte chgEv_GW_3B8_HU_RoadCurvatureFar = 0;
    byte chgEv_GW_387_BCM_FrontWiperStatus = 0;
    byte chgEv_GW_387_BCM_RainfallLevel = 0;
    byte chgEv_GW_3C4_HU_RoadCurvature_30m = 0;
    byte chgEv_GW_3C4_HU_RoadCurvature_20m = 0;
    byte chgEv_GW_3C4_HU_To_NumchangeOfLanes_Dist = 0;
    byte chgEv_GW_3C4_HU_RoadCurvature_40m = 0;
    byte chgEv_GW_3C4_HU_RoadCurvature_10m = 0;
    byte chgEv_GW_3C4_HU_Lane_Changtype = 0;
    byte chgEv_GW_3FF_BCM_FrontFoglampStatus = 0;
    byte chgEv_GW_3FF_BCM_RearFoglampStatus = 0;
    byte chgEv_GW_3FF_BCM_AutoHeadlightSts = 0;
    byte chgEv_GW_50_SRS_WarningLampStatus = 0;
    byte chgEv_GW_50_SRS_DriverBuckleSwitchStatus = 0;
    byte chgEv_GW_50_SRS_PassengerBuckleSwitchStatus = 0;
    byte chgEv_GW_50_SRS_CrashOutputStatus = 0;
    byte chgEv_GW_208_Wheel_Speed_RL_Data = 0;
    byte chgEv_GW_208_Wheel_Speed_RR_Valid_Data = 0;
    byte chgEv_GW_208_Wheel_Speed_RL_Direction = 0;
    byte chgEv_GW_208_Wheel_Speed_RL_Valid_Data = 0;
    byte chgEv_GW_208_Wheel_Speed_RR_Data = 0;
    byte chgEv_GW_208_Wheel_Speed_RR_Direction = 0;
    byte chgEv_GW_24F_EPS_TorqueAssistMode = 0;
    byte chgEv_GW_24F_EPS_IACC_abortreason = 0;
    byte chgEv_GW_24F_EPS_ConcussAvailabilityStatus = 0;
    byte chgEv_GW_258_Wheel_Speed_RR_Pulse = 0;
    byte chgEv_GW_258_ESP_MasCylBrakePressureValid = 0;
    byte chgEv_GW_258_Wheel_Speed_RL_Pulse = 0;
    byte chgEv_GW_258_Wheel_Speed_FL_Pulse = 0;
    byte chgEv_GW_258_Wheel_Speed_FR_Pulse = 0;
    byte chgEv_GW_258_ESP_MasCylBrakePressure = 0;
    byte chgEv_GW_277_ESP_TCSActive = 0;
    byte chgEv_GW_277_ESP_VDCActive = 0;
    byte chgEv_GW_277_ESP_BrakeForce = 0;
    byte chgEv_GW_277_ESP_OnlyABSActive = 0;
    byte chgEv_GW_277_ESP_VehicleStandstill = 0;
    byte chgEv_GW_356_IMS_DistractionStatus = 0;
    byte chgEv_GW_356_IMS_IMSStatus = 0;
    byte chgEv_GW_356_IMS_DriverEyesFovArea = 0;
    byte chgEv_GW_356_IMS_DriverEyeClosestatus = 0;
    byte chgEv_GW_356_IMS_DriverEyeDetect = 0;
    byte chgEv_GW_356_IMS_DriverEyeConfidence = 0;
    byte chgEv_GW_356_IMS_PhoneCallSts = 0;
    byte chgEv_GW_356_IMS_DrowsinessStatus = 0;
    byte chgEv_GW_356_IMS_EyeGazeStatus = 0;
    byte chgEv_GW_356_IMS_EyeDetectSatus = 0;
    byte chgEv_GW_356_IMS_DriverHeadDetect = 0;
    byte chgEv_GW_500_HU_CurrentLocationLatitude = 0;
    byte chgEv_GW_500_HU_CurrentLocationLongitude = 0;
    byte chgEv_GW_500_HU_CurrentLocationValid = 0;
    byte chgEv_GW_501_HU_LocalTimeSecond = 0;
    byte chgEv_GW_501_HU_LocalTimeMonth = 0;
    byte chgEv_GW_501_HU_LocalTimeHour = 0;
    byte chgEv_GW_501_HU_LocalTimeDate = 0;
    byte chgEv_GW_501_HU_LocalTimeMinute = 0;
    byte chgEv_GW_501_HU_LocalTimeYear = 0;
    byte chgEv_GW_501_HU_LocalTimeValid = 0;
    byte chgEv_GW_278_ESP_LongAccel = 0;
    byte chgEv_GW_278_ESP_YawRateValid = 0;
    byte chgEv_GW_278_ESP_YawRate = 0;
    byte chgEv_GW_278_ESP_LatAccel = 0;
    byte chgEv_GW_3C7_HU_RoadCurvature_400m = 0;
    byte chgEv_GW_3C7_HU_RoadCurvature_600m = 0;
    byte chgEv_GW_3C7_HU_SlopeGradient_300m = 0;
    byte chgEv_GW_3C7_HU_RoadCurvature_100m = 0;
    byte chgEv_GW_3C7_HU_RoadCurvature_300m = 0;
    byte chgEv_GW_3C7_HU_MapMatchStatus = 0;
    byte chgEv_GW_3C6_HU_BranchInfo = 0;
    byte chgEv_GW_3C6_HU_RoadCurvature_70m = 0;
    byte chgEv_GW_3C6_HU_RoadCurvature_80m = 0;
    byte chgEv_GW_3C6_HU_RoadCurvature_90m = 0;
    byte chgEv_GW_3C6_HU_RoadCurvature_60m = 0;
    byte chgEv_GW_3C6_HU_RoadCurvature_50m = 0;
    byte chgEv_GW_1A8_TCU_ShiftPostionValid = 0;
    byte chgEv_GW_1A8_TCU_GearShiftPosition = 0;
    byte chgEv_GW_1A8_TCU_ActualGearValid = 0;
    byte chgEv_GW_1A8_TCU_ActualGear = 0;
    byte chgEv_GW_3C2_HU_Road_TrafficFlow = 0;
    byte chgEv_GW_3C2_HU_RampSide = 0;
    byte chgEv_GW_3C2_HU_To_Branch_Dis = 0;
    byte chgEv_GW_3C2_HU_LaneCnt = 0;
    byte chgEv_GW_3C2_HU_TrafficAccident_Info = 0;
    byte chgEv_GW_3C2_HU_To_TrafficAccident_Dis = 0;
    byte chgEv_GW_3C2_HU_MapDataUpdateStatus = 0;
    byte chgEv_GW_3C2_HU_Construction_Info = 0;
    byte chgEv_GW_3C2_HU_To_Construction_Dis = 0;
    byte chgEv_GW_3C2_HU_FallingRockInfo = 0;
    byte chgEv_GW_3C2_HU_ForwardRoadType = 0;
    byte chgEv_GW_3C2_HU_FallingRockDi = 0;
    byte chgEv_GW_3C2_HU_TollInfo = 0;
    byte chgEv_GW_3C2_HU_TollDis = 0;
    byte chgEv_GW_3E7_BCM_Status_Temp = 0;
    byte chgEv_GW_3E7_BCM_T_BATT = 0;
    byte chgEv_GW_3E8_BCM_SOF_Q_STATE = 0;
    byte chgEv_GW_3E8_BCM_SOF_Q = 0;
    byte chgEv_GW_3AF_HU_NavStatus = 0;
    byte chgEv_GW_3AF_HU_EnterCurveInfo = 0;
    byte chgEv_GW_3AF_HU_NavSpeedLimitType = 0;
    byte chgEv_GW_3AF_HU_NavCountryCode = 0;
    byte chgEv_GW_3AF_HU_NavSpeedLimit = 0;
    byte chgEv_GW_3AF_HU_NavSpeedLimitUnits = 0;
    byte chgEv_GW_3AF_HU_NavCurrentRoadType = 0;
    byte chgEv_GW_3AF_HU_CurveDistance = 0;
    byte chgEv_GW_3AF_HU_RampDistance = 0;
    byte chgEv_GW_3AF_HU_NavSpeedLimitStatus = 0;
    byte chgEv_GW_3AF_HU_RampInfo = 0;
    byte chgEv_GW_3AF_HU_EnterRampInfo = 0;
    byte chgEv_GW_1A6_EMS_EngineStatus = 0;
    byte chgEv_GW_196_EMS_AccPedal = 0;
    byte chgEv_GW_196_EMS_BrakePedalStatus = 0;
    byte chgEv_GW_196_EMS_EngineSpeed = 0;
    byte chgEv_GW_196_EMS_RealAccPedal = 0;
    byte chgEv_GW_394_HU_TLAEnable = 0;
    byte chgEv_GW_394_HU_ELKEnable = 0;
    byte chgEv_GW_390_BCM_SOH_LifePercent = 0;
    byte chgEv_GW_390_BCM_PMSLevel = 0;
    byte chgEv_GW_17E_EPS_LatCtrlActive = 0;
    byte chgEv_GW_17E_EPS_MeasuredTorsionBarTorqValid = 0;
    byte chgEv_GW_17E_EPS_MeasuredTorsionBarTorque = 0;
    byte chgEv_GW_17E_EPS_LatCtrlAvailabilityStatus = 0;
    byte chgEv_GW_514_HU_OverspeedWarningOffset = 0;
    byte chgEv_GW_514_HU_LASWarningModeSelection = 0;
    byte chgEv_GW_514_HU_LDWShakeLev = 0;
    byte chgEv_GW_514_HU_HMAEnable = 0;
    byte chgEv_GW_514_HU_OverspeedWarningEnable = 0;
    byte chgEv_GW_514_HU_OverspeedSoundWarEnable = 0;
    byte chgEv_GW_514_HU_TSRSwitch = 0;
    byte chgEv_GW_514_HU_IACCEnable = 0;
    byte chgEv_GW_514_HU_LASModeSelection = 0;
    byte chgEv_GW_206_Wheel_Speed_FR_Direction = 0;
    byte chgEv_GW_206_Wheel_Speed_FR_Valid_Data = 0;
    byte chgEv_GW_206_Wheel_Speed_FL_Data = 0;
    byte chgEv_GW_206_Wheel_Speed_FL_Direction = 0;
    byte chgEv_GW_206_Wheel_Speed_FR_Data = 0;
    byte chgEv_GW_206_Wheel_Speed_FL_Valid_Data = 0;
    byte chgEv_GW_340_AC_FrBlowType = 0;
    byte chgEv_GW_28C_GW_MFS_HODSystemStatus = 0;
    byte chgEv_GW_28C_GW_MFS_HODLinStatus = 0;
    byte chgEv_GW_28C_GW_MFS_HODSenserStatus = 0;
    byte chgEv_GW_28C_GW_MFS_HODAppStatus = 0;
    byte chgEv_GW_28C_GW_MFS_handsoffAbilityDetect = 0;
    byte chgEv_GW_28C_GW_MFS_handsoffDetectResult = 0;
    byte chgEv_GW_28C_GW_MFS_DiagInfoSW_28C = 0;
    byte chgEv_GW_28C_GW_MFS_IACCenable_switch_signal = 0;
    byte chgEv_GW_28C_GW_MFS_HODCalibratedStatus = 0;
    byte chgEv_GW_366_AC_EnvironmentalTemp = 0;
    byte chgEv_GW_366_AC_EnvironmentalTempVD = 0;
    byte chgEv_GW_360_IMS_BrowOffsetValue = 0;
    byte chgEv_GW_360_IMS_HeadDetectSts_Pitch = 0;
    byte chgEv_GW_360_IMS_JawOffsetValue = 0;
    byte chgEv_GW_360_IMS_HeadDetectSts_Roll = 0;
    byte chgEv_GW_360_IMS_HeadDetectSts_Yaw = 0;
    byte chgEv_GW_530_IP_TotalOdometer = 0;
    byte chgEv_GW_170_EPS_ActualTorsionBarTorq = 0;
    byte chgEv_GW_170_EPS_MinSafetyTorsionBarTorq = 0;
    byte chgEv_GW_170_EPS_MaxSafetyTorsionBarTorq = 0;
    byte chgEv_GW_187_ESP_ESPActiveStatus = 0;
    byte chgEv_GW_187_ESP_ABSFailStatus = 0;
    byte chgEv_GW_187_ESP_ESPFunctionStatus = 0;
    byte chgEv_GW_187_ESP_VehicleSpeedValid = 0;
    byte chgEv_GW_187_ESP_VehicleSpeed = 0;
    byte chgEv_GW_187_ESP_TCSFailStatus = 0;
    byte chgEv_GW_180_SAS_SteeringAngleValid = 0;
    byte chgEv_GW_180_SAS_Calibrated = 0;
    byte chgEv_GW_180_SAS_SteeringAngle = 0;
    byte chgEv_GW_180_SAS_SteeringAngleSpeed = 0;
    byte chgEv_GW_180_SAS_SASFailure = 0;
    byte chgEv_GW_3BB_HU_SpeedLimitDistance = 0;
    byte chgEv_GW_188_TCU_ShiftinProgressValid = 0;
    byte chgEv_GW_188_TCU_ShiftinProgress = 0;
    byte chgEv_GW_28B_LCM_LASSwitch = 0;
    byte chgEv_GW_28B_BCM_emergencylightstatus = 0;
    byte chgEv_GW_28B_BCM_LowBeamStatus = 0;
    byte chgEv_GW_28B_BCM_TurnIndicatorLeft = 0;
    byte chgEv_GW_28B_BCM_TurnLightSwitchSts = 0;
    byte chgEv_GW_28B_BCM_HighBeamStatus = 0;
    byte chgEv_GW_28B_BCM_TurnIndicatorRight = 0;
    
    message GW_3B8        Msg_GW_3B8;
    msTimer Tm_GW_3B8;
    int Cycle_GW_3B8 = 100;
    message GW_387        Msg_GW_387;
    msTimer Tm_GW_387;
    int Cycle_GW_387 = 100;
    message GW_3C4        Msg_GW_3C4;
    msTimer Tm_GW_3C4;
    int Cycle_GW_3C4 = 100;
    message GW_3FF        Msg_GW_3FF;
    msTimer Tm_GW_3FF;
    int Cycle_GW_3FF = 100;
    message GW_50        Msg_GW_50;
    msTimer Tm_GW_50;
    int Cycle_GW_50 = 500;
    message GW_208        Msg_GW_208;
    msTimer Tm_GW_208;
    int Cycle_GW_208 = 20;
    message GW_24F        Msg_GW_24F;
    msTimer Tm_GW_24F;
    int Cycle_GW_24F = 20;
    message GW_258        Msg_GW_258;
    msTimer Tm_GW_258;
    int Cycle_GW_258 = 20;
    message GW_277        Msg_GW_277;
    msTimer Tm_GW_277;
    int Cycle_GW_277 = 20;
    message GW_356        Msg_GW_356;
    msTimer Tm_GW_356;
    int Cycle_GW_356 = 100;
    message GW_500        Msg_GW_500;
    msTimer Tm_GW_500;
    int Cycle_GW_500 = 1000;
    message GW_501        Msg_GW_501;
    msTimer Tm_GW_501;
    int Cycle_GW_501 = 1000;
    message GW_278        Msg_GW_278;
    msTimer Tm_GW_278;
    int Cycle_GW_278 = 20;
    message GW_3C7        Msg_GW_3C7;
    msTimer Tm_GW_3C7;
    int Cycle_GW_3C7 = 100;
    message GW_3C6        Msg_GW_3C6;
    msTimer Tm_GW_3C6;
    int Cycle_GW_3C6 = 100;
    message GW_1A8        Msg_GW_1A8;
    msTimer Tm_GW_1A8;
    int Cycle_GW_1A8 = 10;
    message GW_3C2        Msg_GW_3C2;
    msTimer Tm_GW_3C2;
    int Cycle_GW_3C2 = 100;
    message GW_3E7        Msg_GW_3E7;
    msTimer Tm_GW_3E7;
    int Cycle_GW_3E7 = 100;
    message GW_3E8        Msg_GW_3E8;
    msTimer Tm_GW_3E8;
    int Cycle_GW_3E8 = 100;
    message GW_3AF        Msg_GW_3AF;
    msTimer Tm_GW_3AF;
    int Cycle_GW_3AF = 100;
    message GW_1A6        Msg_GW_1A6;
    msTimer Tm_GW_1A6;
    int Cycle_GW_1A6 = 10;
    message GW_196        Msg_GW_196;
    msTimer Tm_GW_196;
    int Cycle_GW_196 = 10;
    message GW_394        Msg_GW_394;
    msTimer Tm_GW_394;
    int Cycle_GW_394 = 100;
    message GW_390        Msg_GW_390;
    msTimer Tm_GW_390;
    int Cycle_GW_390 = 500;
    message GW_17E        Msg_GW_17E;
    msTimer Tm_GW_17E;
    int Cycle_GW_17E = 10;
    message GW_514        Msg_GW_514;
    message GW_206        Msg_GW_206;
    msTimer Tm_GW_206;
    int Cycle_GW_206 = 20;
    message GW_340        Msg_GW_340;
    msTimer Tm_GW_340;
    int Cycle_GW_340 = 100;
    message GW_28C        Msg_GW_28C;
    msTimer Tm_GW_28C;
    int Cycle_GW_28C = 40;
    message GW_366        Msg_GW_366;
    msTimer Tm_GW_366;
    int Cycle_GW_366 = 100;
    message GW_360        Msg_GW_360;
    msTimer Tm_GW_360;
    int Cycle_GW_360 = 100;
    message GW_530        Msg_GW_530;
    msTimer Tm_GW_530;
    int Cycle_GW_530 = 500;
    message GW_170        Msg_GW_170;
    msTimer Tm_GW_170;
    int Cycle_GW_170 = 10;
    message GW_187        Msg_GW_187;
    msTimer Tm_GW_187;
    int Cycle_GW_187 = 10;
    message GW_180        Msg_GW_180;
    msTimer Tm_GW_180;
    int Cycle_GW_180 = 10;
    message GW_3BB        Msg_GW_3BB;
    msTimer Tm_GW_3BB;
    int Cycle_GW_3BB = 100;
    message GW_188        Msg_GW_188;
    msTimer Tm_GW_188;
    int Cycle_GW_188 = 10;
    message GW_28B        Msg_GW_28B;
    msTimer Tm_GW_28B;
    int Cycle_GW_28B = 40;
    
    int GW_3B8_HU_CRCCheck_3B8_counter =0;
    int GW_3B8_HU_CRCCheck_3B8_wrongvalctr =0;
    int GW_3B8_HU_RollingCounter_3B8_counter =0;
    int GW_3B8_HU_RollingCounter_3B8_wrongvalctr =0;
    int GW_3C4_HU_CRCCheck_3C4_counter =0;
    int GW_3C4_HU_CRCCheck_3C4_wrongvalctr =0;
    int GW_3C4_HU_RollingCounter_3C4_counter =0;
    int GW_3C4_HU_RollingCounter_3C4_wrongvalctr =0;
    int GW_50_SRS_CrashOutputStatusCheckSum_counter =0;
    int GW_50_SRS_CrashOutputStatusCheckSum_wrongvalctr =0;
    int GW_50_SRS_RollingCounter_id050_counter =0;
    int GW_50_SRS_RollingCounter_id050_wrongvalctr =0;
    int GW_208_ESP_CRCCheck_208_counter =0;
    int GW_208_ESP_CRCCheck_208_wrongvalctr =0;
    int GW_208_ESP_RollingCounter_208_counter =0;
    int GW_208_ESP_RollingCounter_208_wrongvalctr =0;
    int GW_24F_EPS_CRCCheck_24F_counter =0;
    int GW_24F_EPS_CRCCheck_24F_wrongvalctr =0;
    int GW_24F_EPS_RollingCounter_24F_counter =0;
    int GW_24F_EPS_RollingCounter_24F_wrongvalctr =0;
    int GW_258_ESP_CRCCheck_258_counter =0;
    int GW_258_ESP_CRCCheck_258_wrongvalctr =0;
    int GW_258_ESP_RollingCounter_258_counter =0;
    int GW_258_ESP_RollingCounter_258_wrongvalctr =0;
    int GW_277_ESP_CRCCheck_277_counter =0;
    int GW_277_ESP_CRCCheck_277_wrongvalctr =0;
    int GW_277_ESP_RollingCounter_277_counter =0;
    int GW_277_ESP_RollingCounter_277_wrongvalctr =0;
    int GW_356_IMS_CRCCheck_356_counter =0;
    int GW_356_IMS_CRCCheck_356_wrongvalctr =0;
    int GW_356_IMS_RollingCounter_356_counter =0;
    int GW_356_IMS_RollingCounter_356_wrongvalctr =0;
    int GW_278_ESP_CRCCheck_278_counter =0;
    int GW_278_ESP_CRCCheck_278_wrongvalctr =0;
    int GW_278_ESP_RollingCounter_278_counter =0;
    int GW_278_ESP_RollingCounter_278_wrongvalctr =0;
    int GW_3C7_HU_CRCCheck_3C7_counter =0;
    int GW_3C7_HU_CRCCheck_3C7_wrongvalctr =0;
    int GW_3C7_HU_RollingCounter_3C7_counter =0;
    int GW_3C7_HU_RollingCounter_3C7_wrongvalctr =0;
    int GW_3C6_HU_CRCCheck_3C6_counter =0;
    int GW_3C6_HU_CRCCheck_3C6_wrongvalctr =0;
    int GW_3C6_HU_RollingCounter_3C6_counter =0;
    int GW_3C6_HU_RollingCounter_3C6_wrongvalctr =0;
    int GW_1A8_TCU_CRCCheck_1A8_counter =0;
    int GW_1A8_TCU_CRCCheck_1A8_wrongvalctr =0;
    int GW_1A8_TCU_RollingCounter_1A8_counter =0;
    int GW_1A8_TCU_RollingCounter_1A8_wrongvalctr =0;
    int GW_3C2_HU_CRCCheck_3C2_counter =0;
    int GW_3C2_HU_CRCCheck_3C2_wrongvalctr =0;
    int GW_3C2_HU_RollingCounter_3C2_counter =0;
    int GW_3C2_HU_RollingCounter_3C2_wrongvalctr =0;
    int GW_3AF_HU_CRCCheck_3AF_counter =0;
    int GW_3AF_HU_CRCCheck_3AF_wrongvalctr =0;
    int GW_3AF_HU_RollingCounter_3AF_counter =0;
    int GW_3AF_HU_RollingCounter_3AF_wrongvalctr =0;
    int GW_1A6_EMS_CRCCheck_1A6_counter =0;
    int GW_1A6_EMS_CRCCheck_1A6_wrongvalctr =0;
    int GW_1A6_EMS_RollingCounter_1A6_counter =0;
    int GW_1A6_EMS_RollingCounter_1A6_wrongvalctr =0;
    int GW_196_EMS_CRCCheck_196_counter =0;
    int GW_196_EMS_CRCCheck_196_wrongvalctr =0;
    int GW_196_EMS_RollingCounter_196_counter =0;
    int GW_196_EMS_RollingCounter_196_wrongvalctr =0;
    int GW_17E_EPS_CRCCheck_17E_counter =0;
    int GW_17E_EPS_CRCCheck_17E_wrongvalctr =0;
    int GW_17E_EPS_RollingCounter_17E_counter =0;
    int GW_17E_EPS_RollingCounter_17E_wrongvalctr =0;
    int GW_206_ESP_CRCCheck_206_counter =0;
    int GW_206_ESP_CRCCheck_206_wrongvalctr =0;
    int GW_206_ESP_RollingCounter_206_counter =0;
    int GW_206_ESP_RollingCounter_206_wrongvalctr =0;
    int GW_28C_GW_MFS_CRCCheck_28C_counter =0;
    int GW_28C_GW_MFS_CRCCheck_28C_wrongvalctr =0;
    int GW_28C_GW_MFS_RollingCounter_28C_counter =0;
    int GW_28C_GW_MFS_RollingCounter_28C_wrongvalctr =0;
    int GW_360_IMS_CRCCheck_360_counter =0;
    int GW_360_IMS_CRCCheck_360_wrongvalctr =0;
    int GW_360_IMS_RollingCounter_360_counter =0;
    int GW_360_IMS_RollingCounter_360_wrongvalctr =0;
    int GW_170_EPS_CRCCheck_170_counter =0;
    int GW_170_EPS_CRCCheck_170_wrongvalctr =0;
    int GW_170_EPS_RollingCounter_170_counter =0;
    int GW_170_EPS_RollingCounter_170_wrongvalctr =0;
    int GW_187_ESP_CRCCheck_187_counter =0;
    int GW_187_ESP_CRCCheck_187_wrongvalctr =0;
    int GW_187_ESP_RollingCounter_187_counter =0;
    int GW_187_ESP_RollingCounter_187_wrongvalctr =0;
    int GW_180_SAS_CRCCheck_counter =0;
    int GW_180_SAS_CRCCheck_wrongvalctr =0;
    int GW_180_SAS_RollingCounter_counter =0;
    int GW_180_SAS_RollingCounter_wrongvalctr =0;
    int GW_188_TCU_CRCCheck_188_counter =0;
    int GW_188_TCU_CRCCheck_188_wrongvalctr =0;
    int GW_188_TCU_RollingCounter_188_counter =0;
    int GW_188_TCU_RollingCounter_188_wrongvalctr =0;
    
    ///CRC Polynomial for MQB     
    byte cb_CRC_POLY_MQB =0x2F;
	
    

    
        byte CRC_J1850_Table[256] = {
 /*0 - 7*/  0x00, 0x1D, 0x3A, 0x27, 0x74, 0x69, 0x4E, 0x53,
 /*8 - 15*/ 0xE8, 0xF5, 0xD2, 0xCF, 0x9C, 0x81, 0xA6, 0xBB,
 /*16 - 23*/ 0xCD, 0xD0, 0xF7, 0xEA, 0xB9, 0xA4, 0x83, 0x9E,
 /*24 - 31*/ 0x25, 0x38, 0x1F, 0x02, 0x51, 0x4C, 0x6B, 0x76,
 /*32 - 39*/ 0x87, 0x9A, 0xBD, 0xA0, 0xF3, 0xEE, 0xC9, 0xD4,
 /*40 - 47*/ 0x6F, 0x72, 0x55, 0x48, 0x1B, 0x06, 0x21, 0x3C,
 /*48 - 55*/ 0x4A, 0x57, 0x70, 0x6D, 0x3E, 0x23, 0x04, 0x19,
 /*56 - 63*/ 0xA2, 0xBF, 0x98, 0x85, 0xD6, 0xCB, 0xEC, 0xF1,
 /*64 - 71*/  0x13, 0x0E, 0x29, 0x34, 0x67, 0x7A, 0x5D, 0x40,
 /*72 - 79*/ 0xFB, 0xE6, 0xC1, 0xDC, 0x8F, 0x92, 0xB5, 0xA8,
 /*80 - 87*/ 0xDE, 0xC3, 0xE4, 0xF9, 0xAA, 0xB7, 0x90, 0x8D,
 /*88 - 95*/ 0x36, 0x2B, 0x0C, 0x11, 0x42, 0x5F, 0x78, 0x65,
 /*96 - 103*/ 0x94, 0x89, 0xAE, 0xB3, 0xE0, 0xFD, 0xDA, 0xC7,
 /*104 - 111*/ 0x7C, 0x61, 0x46, 0x5B, 0x08, 0x15, 0x32, 0x2F,
 /*112 - 119*/ 0x59, 0x44, 0x63, 0x7E, 0x2D, 0x30, 0x17, 0x0A,
 /*120 - 127*/ 0xB1, 0xAC, 0x8B, 0x96, 0xC5, 0xD8, 0xFF, 0xE2,
 /*128 - 135*/ 0x26, 0x3B, 0x1C, 0x01, 0x52, 0x4F, 0x68, 0x75,
 /*136 - 143*/ 0xCE, 0xD3, 0xF4, 0xE9, 0xBA, 0xA7, 0x80, 0x9D,
 /*144 - 151*/ 0xEB, 0xF6, 0xD1, 0xCC, 0x9F, 0x82, 0xA5, 0xB8,
 /*152 - 159*/ 0x03, 0x1E, 0x39, 0x24, 0x77, 0x6A, 0x4D, 0x50,
 /*160 - 167*/ 0xA1, 0xBC, 0x9B, 0x86, 0xD5, 0xC8, 0xEF, 0xF2,
 /*168 - 175*/ 0x49, 0x54, 0x73, 0x6E, 0x3D, 0x20, 0x07, 0x1A,
 /*176 - 183*/ 0x6C, 0x71, 0x56, 0x4B, 0x18, 0x05, 0x22, 0x3F,
 /*184 - 191*/ 0x84, 0x99, 0xBE, 0xA3, 0xF0, 0xED, 0xCA, 0xD7,
 /*192 - 199*/ 0x35, 0x28, 0x0F, 0x12, 0x41, 0x5C, 0x7B, 0x66,
 /*200 - 207*/ 0xDD, 0xC0, 0xE7, 0xFA, 0xA9, 0xB4, 0x93, 0x8E,
 /*208 - 215*/ 0xF8, 0xE5, 0xC2, 0xDF, 0x8C, 0x91, 0xB6, 0xAB,
 /*216 - 223*/ 0x10, 0x0D, 0x2A, 0x37, 0x64, 0x79, 0x5E, 0x43,
 /*224 - 231*/ 0xB2, 0xAF, 0x88, 0x95, 0xC6, 0xDB, 0xFC, 0xE1,
 /*232 - 239*/ 0x5A, 0x47, 0x60, 0x7D, 0x2E, 0x33, 0x14, 0x09,
 /*240 - 247*/ 0x7F, 0x62, 0x45, 0x58, 0x0B, 0x16, 0x31, 0x2C,
 /*248 - 255*/ 0x97, 0x8A, 0xAD, 0xB0, 0xE3, 0xFE, 0xD9, 0xC4
};

         
}


on start
{
    //Initialise cycle time and message timer 
    putValue(E_pubc_GW_GW_3B8_cycleTm,Cycle_GW_3B8);
    SetTimer( Tm_GW_3B8,100);
    putValue(E_pubc_GW_GW_3B8_Tm,1);
    putValue(E_pubc_GW_GW_387_cycleTm,Cycle_GW_387);
    SetTimer( Tm_GW_387,101);
    putValue(E_pubc_GW_GW_387_Tm,1);
    putValue(E_pubc_GW_GW_3C4_cycleTm,Cycle_GW_3C4);
    SetTimer( Tm_GW_3C4,102);
    putValue(E_pubc_GW_GW_3C4_Tm,1);
    putValue(E_pubc_GW_GW_3FF_cycleTm,Cycle_GW_3FF);
    SetTimer( Tm_GW_3FF,103);
    putValue(E_pubc_GW_GW_3FF_Tm,1);
    putValue(E_pubc_GW_GW_50_cycleTm,Cycle_GW_50);
    SetTimer( Tm_GW_50,104);
    putValue(E_pubc_GW_GW_50_Tm,1);
    putValue(E_pubc_GW_GW_208_cycleTm,Cycle_GW_208);
    SetTimer( Tm_GW_208,105);
    putValue(E_pubc_GW_GW_208_Tm,1);
    putValue(E_pubc_GW_GW_24F_cycleTm,Cycle_GW_24F);
    SetTimer( Tm_GW_24F,106);
    putValue(E_pubc_GW_GW_24F_Tm,1);
    putValue(E_pubc_GW_GW_258_cycleTm,Cycle_GW_258);
    SetTimer( Tm_GW_258,107);
    putValue(E_pubc_GW_GW_258_Tm,1);
    putValue(E_pubc_GW_GW_277_cycleTm,Cycle_GW_277);
    SetTimer( Tm_GW_277,108);
    putValue(E_pubc_GW_GW_277_Tm,1);
    putValue(E_pubc_GW_GW_356_cycleTm,Cycle_GW_356);
    SetTimer( Tm_GW_356,109);
    putValue(E_pubc_GW_GW_356_Tm,1);
    putValue(E_pubc_GW_GW_500_cycleTm,Cycle_GW_500);
    SetTimer( Tm_GW_500,110);
    putValue(E_pubc_GW_GW_500_Tm,1);
    putValue(E_pubc_GW_GW_501_cycleTm,Cycle_GW_501);
    SetTimer( Tm_GW_501,111);
    putValue(E_pubc_GW_GW_501_Tm,1);
    putValue(E_pubc_GW_GW_278_cycleTm,Cycle_GW_278);
    SetTimer( Tm_GW_278,112);
    putValue(E_pubc_GW_GW_278_Tm,1);
    putValue(E_pubc_GW_GW_3C7_cycleTm,Cycle_GW_3C7);
    SetTimer( Tm_GW_3C7,113);
    putValue(E_pubc_GW_GW_3C7_Tm,1);
    putValue(E_pubc_GW_GW_3C6_cycleTm,Cycle_GW_3C6);
    SetTimer( Tm_GW_3C6,114);
    putValue(E_pubc_GW_GW_3C6_Tm,1);
    putValue(E_pubc_GW_GW_1A8_cycleTm,Cycle_GW_1A8);
    SetTimer( Tm_GW_1A8,115);
    putValue(E_pubc_GW_GW_1A8_Tm,1);
    putValue(E_pubc_GW_GW_3C2_cycleTm,Cycle_GW_3C2);
    SetTimer( Tm_GW_3C2,116);
    putValue(E_pubc_GW_GW_3C2_Tm,1);
    putValue(E_pubc_GW_GW_3E7_cycleTm,Cycle_GW_3E7);
    SetTimer( Tm_GW_3E7,117);
    putValue(E_pubc_GW_GW_3E7_Tm,1);
    putValue(E_pubc_GW_GW_3E8_cycleTm,Cycle_GW_3E8);
    SetTimer( Tm_GW_3E8,118);
    putValue(E_pubc_GW_GW_3E8_Tm,1);
    putValue(E_pubc_GW_GW_3AF_cycleTm,Cycle_GW_3AF);
    SetTimer( Tm_GW_3AF,119);
    putValue(E_pubc_GW_GW_3AF_Tm,1);
    putValue(E_pubc_GW_GW_1A6_cycleTm,Cycle_GW_1A6);
    SetTimer( Tm_GW_1A6,120);
    putValue(E_pubc_GW_GW_1A6_Tm,1);
    putValue(E_pubc_GW_GW_196_cycleTm,Cycle_GW_196);
    SetTimer( Tm_GW_196,121);
    putValue(E_pubc_GW_GW_196_Tm,1);
    putValue(E_pubc_GW_GW_394_cycleTm,Cycle_GW_394);
    SetTimer( Tm_GW_394,122);
    putValue(E_pubc_GW_GW_394_Tm,1);
    putValue(E_pubc_GW_GW_390_cycleTm,Cycle_GW_390);
    SetTimer( Tm_GW_390,123);
    putValue(E_pubc_GW_GW_390_Tm,1);
    putValue(E_pubc_GW_GW_17E_cycleTm,Cycle_GW_17E);
    SetTimer( Tm_GW_17E,124);
    putValue(E_pubc_GW_GW_17E_Tm,1);
    putValue(E_pubc_GW_GW_206_cycleTm,Cycle_GW_206);
    SetTimer( Tm_GW_206,125);
    putValue(E_pubc_GW_GW_206_Tm,1);
    putValue(E_pubc_GW_GW_340_cycleTm,Cycle_GW_340);
    SetTimer( Tm_GW_340,126);
    putValue(E_pubc_GW_GW_340_Tm,1);
    putValue(E_pubc_GW_GW_28C_cycleTm,Cycle_GW_28C);
    SetTimer( Tm_GW_28C,127);
    putValue(E_pubc_GW_GW_28C_Tm,1);
    putValue(E_pubc_GW_GW_366_cycleTm,Cycle_GW_366);
    SetTimer( Tm_GW_366,128);
    putValue(E_pubc_GW_GW_366_Tm,1);
    putValue(E_pubc_GW_GW_360_cycleTm,Cycle_GW_360);
    SetTimer( Tm_GW_360,129);
    putValue(E_pubc_GW_GW_360_Tm,1);
    putValue(E_pubc_GW_GW_530_cycleTm,Cycle_GW_530);
    SetTimer( Tm_GW_530,130);
    putValue(E_pubc_GW_GW_530_Tm,1);
    putValue(E_pubc_GW_GW_170_cycleTm,Cycle_GW_170);
    SetTimer( Tm_GW_170,131);
    putValue(E_pubc_GW_GW_170_Tm,1);
    putValue(E_pubc_GW_GW_187_cycleTm,Cycle_GW_187);
    SetTimer( Tm_GW_187,132);
    putValue(E_pubc_GW_GW_187_Tm,1);
    putValue(E_pubc_GW_GW_180_cycleTm,Cycle_GW_180);
    SetTimer( Tm_GW_180,133);
    putValue(E_pubc_GW_GW_180_Tm,1);
    putValue(E_pubc_GW_GW_3BB_cycleTm,Cycle_GW_3BB);
    SetTimer( Tm_GW_3BB,134);
    putValue(E_pubc_GW_GW_3BB_Tm,1);
    putValue(E_pubc_GW_GW_188_cycleTm,Cycle_GW_188);
    SetTimer( Tm_GW_188,135);
    putValue(E_pubc_GW_GW_188_Tm,1);
    putValue(E_pubc_GW_GW_28B_cycleTm,Cycle_GW_28B);
    SetTimer( Tm_GW_28B,136);
    putValue(E_pubc_GW_GW_28B_Tm,1);
    
    //Initialise signals with init raw value
    Msg_GW_3B8.HU_Byroad   =getvalue(E_pubc_GW_GW_3B8_HU_Byroad_Rv);
    Msg_GW_3B8.HU_RoadCurvature   =getvalue(E_pubc_GW_GW_3B8_HU_RoadCurvature_Rv);
    Msg_GW_3B8.HU_EnterSlopeInfo   =getvalue(E_pubc_GW_GW_3B8_HU_EnterSlopeInfo_Rv);
    Msg_GW_3B8.HU_EnterTunnelInfo   =getvalue(E_pubc_GW_GW_3B8_HU_EnterTunnelInfo_Rv);
    Msg_GW_3B8.HU_SlopeDistance   =getvalue(E_pubc_GW_GW_3B8_HU_SlopeDistance_Rv);
    Msg_GW_3B8.HU_TunnelDistance   =getvalue(E_pubc_GW_GW_3B8_HU_TunnelDistance_Rv);
    Msg_GW_3B8.HU_NavGuiganceStatus   =getvalue(E_pubc_GW_GW_3B8_HU_NavGuiganceStatus_Rv);
    Msg_GW_3B8.HU_TunnelLength   =getvalue(E_pubc_GW_GW_3B8_HU_TunnelLength_Rv);
    Msg_GW_3B8.HU_RoadCurvatureFar   =getvalue(E_pubc_GW_GW_3B8_HU_RoadCurvatureFar_Rv);
    Msg_GW_387.BCM_FrontWiperStatus   =getvalue(E_pubc_GW_GW_387_BCM_FrontWiperStatus_Rv);
    Msg_GW_387.BCM_RainfallLevel   =getvalue(E_pubc_GW_GW_387_BCM_RainfallLevel_Rv);
    Msg_GW_3C4.HU_RoadCurvature_30m   =getvalue(E_pubc_GW_GW_3C4_HU_RoadCurvature_30m_Rv);
    Msg_GW_3C4.HU_RoadCurvature_20m   =getvalue(E_pubc_GW_GW_3C4_HU_RoadCurvature_20m_Rv);
    Msg_GW_3C4.HU_To_NumchangeOfLanes_Dist   =getvalue(E_pubc_GW_GW_3C4_HU_To_NumchangeOfLanes_Dist_Rv);
    Msg_GW_3C4.HU_RoadCurvature_40m   =getvalue(E_pubc_GW_GW_3C4_HU_RoadCurvature_40m_Rv);
    Msg_GW_3C4.HU_RoadCurvature_10m   =getvalue(E_pubc_GW_GW_3C4_HU_RoadCurvature_10m_Rv);
    Msg_GW_3C4.HU_Lane_Changtype   =getvalue(E_pubc_GW_GW_3C4_HU_Lane_Changtype_Rv);
    Msg_GW_3FF.BCM_FrontFoglampStatus   =getvalue(E_pubc_GW_GW_3FF_BCM_FrontFoglampStatus_Rv);
    Msg_GW_3FF.BCM_RearFoglampStatus   =getvalue(E_pubc_GW_GW_3FF_BCM_RearFoglampStatus_Rv);
    Msg_GW_3FF.BCM_AutoHeadlightSts   =getvalue(E_pubc_GW_GW_3FF_BCM_AutoHeadlightSts_Rv);
    Msg_GW_50.SRS_WarningLampStatus   =getvalue(E_pubc_GW_GW_50_SRS_WarningLampStatus_Rv);
    Msg_GW_50.SRS_DriverBuckleSwitchStatus   =getvalue(E_pubc_GW_GW_50_SRS_DriverBuckleSwitchStatus_Rv);
    Msg_GW_50.SRS_PassengerBuckleSwitchStatus   =getvalue(E_pubc_GW_GW_50_SRS_PassengerBuckleSwitchStatus_Rv);
    Msg_GW_50.SRS_CrashOutputStatus   =getvalue(E_pubc_GW_GW_50_SRS_CrashOutputStatus_Rv);
    Msg_GW_208.Wheel_Speed_RL_Data   =getvalue(E_pubc_GW_GW_208_Wheel_Speed_RL_Data_Rv);
    Msg_GW_208.Wheel_Speed_RR_Valid_Data   =getvalue(E_pubc_GW_GW_208_Wheel_Speed_RR_Valid_Data_Rv);
    Msg_GW_208.Wheel_Speed_RL_Direction   =getvalue(E_pubc_GW_GW_208_Wheel_Speed_RL_Direction_Rv);
    Msg_GW_208.Wheel_Speed_RL_Valid_Data   =getvalue(E_pubc_GW_GW_208_Wheel_Speed_RL_Valid_Data_Rv);
    Msg_GW_208.Wheel_Speed_RR_Data   =getvalue(E_pubc_GW_GW_208_Wheel_Speed_RR_Data_Rv);
    Msg_GW_208.Wheel_Speed_RR_Direction   =getvalue(E_pubc_GW_GW_208_Wheel_Speed_RR_Direction_Rv);
    Msg_GW_24F.EPS_TorqueAssistMode   =getvalue(E_pubc_GW_GW_24F_EPS_TorqueAssistMode_Rv);
    Msg_GW_24F.EPS_IACC_abortreason   =getvalue(E_pubc_GW_GW_24F_EPS_IACC_abortreason_Rv);
    Msg_GW_24F.EPS_ConcussAvailabilityStatus   =getvalue(E_pubc_GW_GW_24F_EPS_ConcussAvailabilityStatus_Rv);
    Msg_GW_258.Wheel_Speed_RR_Pulse   =getvalue(E_pubc_GW_GW_258_Wheel_Speed_RR_Pulse_Rv);
    Msg_GW_258.ESP_MasCylBrakePressureValid   =getvalue(E_pubc_GW_GW_258_ESP_MasCylBrakePressureValid_Rv);
    Msg_GW_258.Wheel_Speed_RL_Pulse   =getvalue(E_pubc_GW_GW_258_Wheel_Speed_RL_Pulse_Rv);
    Msg_GW_258.Wheel_Speed_FL_Pulse   =getvalue(E_pubc_GW_GW_258_Wheel_Speed_FL_Pulse_Rv);
    Msg_GW_258.Wheel_Speed_FR_Pulse   =getvalue(E_pubc_GW_GW_258_Wheel_Speed_FR_Pulse_Rv);
    Msg_GW_258.ESP_MasCylBrakePressure   =getvalue(E_pubc_GW_GW_258_ESP_MasCylBrakePressure_Rv);
    Msg_GW_277.ESP_TCSActive   =getvalue(E_pubc_GW_GW_277_ESP_TCSActive_Rv);
    Msg_GW_277.ESP_VDCActive   =getvalue(E_pubc_GW_GW_277_ESP_VDCActive_Rv);
    Msg_GW_277.ESP_BrakeForce   =getvalue(E_pubc_GW_GW_277_ESP_BrakeForce_Rv);
    Msg_GW_277.ESP_OnlyABSActive   =getvalue(E_pubc_GW_GW_277_ESP_OnlyABSActive_Rv);
    Msg_GW_277.ESP_VehicleStandstill   =getvalue(E_pubc_GW_GW_277_ESP_VehicleStandstill_Rv);
    Msg_GW_356.IMS_DistractionStatus   =getvalue(E_pubc_GW_GW_356_IMS_DistractionStatus_Rv);
    Msg_GW_356.IMS_IMSStatus   =getvalue(E_pubc_GW_GW_356_IMS_IMSStatus_Rv);
    Msg_GW_356.IMS_DriverEyesFovArea   =getvalue(E_pubc_GW_GW_356_IMS_DriverEyesFovArea_Rv);
    Msg_GW_356.IMS_DriverEyeClosestatus   =getvalue(E_pubc_GW_GW_356_IMS_DriverEyeClosestatus_Rv);
    Msg_GW_356.IMS_DriverEyeDetect   =getvalue(E_pubc_GW_GW_356_IMS_DriverEyeDetect_Rv);
    Msg_GW_356.IMS_DriverEyeConfidence   =getvalue(E_pubc_GW_GW_356_IMS_DriverEyeConfidence_Rv);
    Msg_GW_356.IMS_PhoneCallSts   =getvalue(E_pubc_GW_GW_356_IMS_PhoneCallSts_Rv);
    Msg_GW_356.IMS_DrowsinessStatus   =getvalue(E_pubc_GW_GW_356_IMS_DrowsinessStatus_Rv);
    Msg_GW_356.IMS_EyeGazeStatus   =getvalue(E_pubc_GW_GW_356_IMS_EyeGazeStatus_Rv);
    Msg_GW_356.IMS_EyeDetectSatus   =getvalue(E_pubc_GW_GW_356_IMS_EyeDetectSatus_Rv);
    Msg_GW_356.IMS_DriverHeadDetect   =getvalue(E_pubc_GW_GW_356_IMS_DriverHeadDetect_Rv);
    Msg_GW_500.HU_CurrentLocationLatitude   =getvalue(E_pubc_GW_GW_500_HU_CurrentLocationLatitude_Rv);
    Msg_GW_500.HU_CurrentLocationLongitude   =getvalue(E_pubc_GW_GW_500_HU_CurrentLocationLongitude_Rv);
    Msg_GW_500.HU_CurrentLocationValid   =getvalue(E_pubc_GW_GW_500_HU_CurrentLocationValid_Rv);
    Msg_GW_501.HU_LocalTimeSecond   =getvalue(E_pubc_GW_GW_501_HU_LocalTimeSecond_Rv);
    Msg_GW_501.HU_LocalTimeMonth   =getvalue(E_pubc_GW_GW_501_HU_LocalTimeMonth_Rv);
    Msg_GW_501.HU_LocalTimeHour   =getvalue(E_pubc_GW_GW_501_HU_LocalTimeHour_Rv);
    Msg_GW_501.HU_LocalTimeDate   =getvalue(E_pubc_GW_GW_501_HU_LocalTimeDate_Rv);
    Msg_GW_501.HU_LocalTimeMinute   =getvalue(E_pubc_GW_GW_501_HU_LocalTimeMinute_Rv);
    Msg_GW_501.HU_LocalTimeYear   =getvalue(E_pubc_GW_GW_501_HU_LocalTimeYear_Rv);
    Msg_GW_501.HU_LocalTimeValid   =getvalue(E_pubc_GW_GW_501_HU_LocalTimeValid_Rv);
    Msg_GW_278.ESP_LongAccel   =getvalue(E_pubc_GW_GW_278_ESP_LongAccel_Rv);
    Msg_GW_278.ESP_YawRateValid   =getvalue(E_pubc_GW_GW_278_ESP_YawRateValid_Rv);
    Msg_GW_278.ESP_YawRate   =getvalue(E_pubc_GW_GW_278_ESP_YawRate_Rv);
    Msg_GW_278.ESP_LatAccel   =getvalue(E_pubc_GW_GW_278_ESP_LatAccel_Rv);
    Msg_GW_3C7.HU_RoadCurvature_400m   =getvalue(E_pubc_GW_GW_3C7_HU_RoadCurvature_400m_Rv);
    Msg_GW_3C7.HU_RoadCurvature_600m   =getvalue(E_pubc_GW_GW_3C7_HU_RoadCurvature_600m_Rv);
    Msg_GW_3C7.HU_SlopeGradient_300m   =getvalue(E_pubc_GW_GW_3C7_HU_SlopeGradient_300m_Rv);
    Msg_GW_3C7.HU_RoadCurvature_100m   =getvalue(E_pubc_GW_GW_3C7_HU_RoadCurvature_100m_Rv);
    Msg_GW_3C7.HU_RoadCurvature_300m   =getvalue(E_pubc_GW_GW_3C7_HU_RoadCurvature_300m_Rv);
    Msg_GW_3C7.HU_MapMatchStatus   =getvalue(E_pubc_GW_GW_3C7_HU_MapMatchStatus_Rv);
    Msg_GW_3C6.HU_BranchInfo   =getvalue(E_pubc_GW_GW_3C6_HU_BranchInfo_Rv);
    Msg_GW_3C6.HU_RoadCurvature_70m   =getvalue(E_pubc_GW_GW_3C6_HU_RoadCurvature_70m_Rv);
    Msg_GW_3C6.HU_RoadCurvature_80m   =getvalue(E_pubc_GW_GW_3C6_HU_RoadCurvature_80m_Rv);
    Msg_GW_3C6.HU_RoadCurvature_90m   =getvalue(E_pubc_GW_GW_3C6_HU_RoadCurvature_90m_Rv);
    Msg_GW_3C6.HU_RoadCurvature_60m   =getvalue(E_pubc_GW_GW_3C6_HU_RoadCurvature_60m_Rv);
    Msg_GW_3C6.HU_RoadCurvature_50m   =getvalue(E_pubc_GW_GW_3C6_HU_RoadCurvature_50m_Rv);
    Msg_GW_1A8.TCU_ShiftPostionValid   =getvalue(E_pubc_GW_GW_1A8_TCU_ShiftPostionValid_Rv);
    Msg_GW_1A8.TCU_GearShiftPosition   =getvalue(E_pubc_GW_GW_1A8_TCU_GearShiftPosition_Rv);
    Msg_GW_1A8.TCU_ActualGearValid   =getvalue(E_pubc_GW_GW_1A8_TCU_ActualGearValid_Rv);
    Msg_GW_1A8.TCU_ActualGear   =getvalue(E_pubc_GW_GW_1A8_TCU_ActualGear_Rv);
    Msg_GW_3C2.HU_Road_TrafficFlow   =getvalue(E_pubc_GW_GW_3C2_HU_Road_TrafficFlow_Rv);
    Msg_GW_3C2.HU_RampSide   =getvalue(E_pubc_GW_GW_3C2_HU_RampSide_Rv);
    Msg_GW_3C2.HU_To_Branch_Dis   =getvalue(E_pubc_GW_GW_3C2_HU_To_Branch_Dis_Rv);
    Msg_GW_3C2.HU_LaneCnt   =getvalue(E_pubc_GW_GW_3C2_HU_LaneCnt_Rv);
    Msg_GW_3C2.HU_TrafficAccident_Info   =getvalue(E_pubc_GW_GW_3C2_HU_TrafficAccident_Info_Rv);
    Msg_GW_3C2.HU_To_TrafficAccident_Dis   =getvalue(E_pubc_GW_GW_3C2_HU_To_TrafficAccident_Dis_Rv);
    Msg_GW_3C2.HU_MapDataUpdateStatus   =getvalue(E_pubc_GW_GW_3C2_HU_MapDataUpdateStatus_Rv);
    Msg_GW_3C2.HU_Construction_Info   =getvalue(E_pubc_GW_GW_3C2_HU_Construction_Info_Rv);
    Msg_GW_3C2.HU_To_Construction_Dis   =getvalue(E_pubc_GW_GW_3C2_HU_To_Construction_Dis_Rv);
    Msg_GW_3C2.HU_FallingRockInfo   =getvalue(E_pubc_GW_GW_3C2_HU_FallingRockInfo_Rv);
    Msg_GW_3C2.HU_ForwardRoadType   =getvalue(E_pubc_GW_GW_3C2_HU_ForwardRoadType_Rv);
    Msg_GW_3C2.HU_FallingRockDi   =getvalue(E_pubc_GW_GW_3C2_HU_FallingRockDi_Rv);
    Msg_GW_3C2.HU_TollInfo   =getvalue(E_pubc_GW_GW_3C2_HU_TollInfo_Rv);
    Msg_GW_3C2.HU_TollDis   =getvalue(E_pubc_GW_GW_3C2_HU_TollDis_Rv);
    Msg_GW_3E7.BCM_Status_Temp   =getvalue(E_pubc_GW_GW_3E7_BCM_Status_Temp_Rv);
    Msg_GW_3E7.BCM_T_BATT   =getvalue(E_pubc_GW_GW_3E7_BCM_T_BATT_Rv);
    Msg_GW_3E8.BCM_SOF_Q_STATE   =getvalue(E_pubc_GW_GW_3E8_BCM_SOF_Q_STATE_Rv);
    Msg_GW_3E8.BCM_SOF_Q   =getvalue(E_pubc_GW_GW_3E8_BCM_SOF_Q_Rv);
    Msg_GW_3AF.HU_NavStatus   =getvalue(E_pubc_GW_GW_3AF_HU_NavStatus_Rv);
    Msg_GW_3AF.HU_EnterCurveInfo   =getvalue(E_pubc_GW_GW_3AF_HU_EnterCurveInfo_Rv);
    Msg_GW_3AF.HU_NavSpeedLimitType   =getvalue(E_pubc_GW_GW_3AF_HU_NavSpeedLimitType_Rv);
    Msg_GW_3AF.HU_NavCountryCode   =getvalue(E_pubc_GW_GW_3AF_HU_NavCountryCode_Rv);
    Msg_GW_3AF.HU_NavSpeedLimit   =getvalue(E_pubc_GW_GW_3AF_HU_NavSpeedLimit_Rv);
    Msg_GW_3AF.HU_NavSpeedLimitUnits   =getvalue(E_pubc_GW_GW_3AF_HU_NavSpeedLimitUnits_Rv);
    Msg_GW_3AF.HU_NavCurrentRoadType   =getvalue(E_pubc_GW_GW_3AF_HU_NavCurrentRoadType_Rv);
    Msg_GW_3AF.HU_CurveDistance   =getvalue(E_pubc_GW_GW_3AF_HU_CurveDistance_Rv);
    Msg_GW_3AF.HU_RampDistance   =getvalue(E_pubc_GW_GW_3AF_HU_RampDistance_Rv);
    Msg_GW_3AF.HU_NavSpeedLimitStatus   =getvalue(E_pubc_GW_GW_3AF_HU_NavSpeedLimitStatus_Rv);
    Msg_GW_3AF.HU_RampInfo   =getvalue(E_pubc_GW_GW_3AF_HU_RampInfo_Rv);
    Msg_GW_3AF.HU_EnterRampInfo   =getvalue(E_pubc_GW_GW_3AF_HU_EnterRampInfo_Rv);
    Msg_GW_1A6.EMS_EngineStatus   =getvalue(E_pubc_GW_GW_1A6_EMS_EngineStatus_Rv);
    Msg_GW_196.EMS_AccPedal   =getvalue(E_pubc_GW_GW_196_EMS_AccPedal_Rv);
    Msg_GW_196.EMS_BrakePedalStatus   =getvalue(E_pubc_GW_GW_196_EMS_BrakePedalStatus_Rv);
    Msg_GW_196.EMS_EngineSpeed   =getvalue(E_pubc_GW_GW_196_EMS_EngineSpeed_Rv);
    Msg_GW_196.EMS_RealAccPedal   =getvalue(E_pubc_GW_GW_196_EMS_RealAccPedal_Rv);
    Msg_GW_394.HU_TLAEnable   =getvalue(E_pubc_GW_GW_394_HU_TLAEnable_Rv);
    Msg_GW_394.HU_ELKEnable   =getvalue(E_pubc_GW_GW_394_HU_ELKEnable_Rv);
    Msg_GW_390.BCM_SOH_LifePercent   =getvalue(E_pubc_GW_GW_390_BCM_SOH_LifePercent_Rv);
    Msg_GW_390.BCM_PMSLevel   =getvalue(E_pubc_GW_GW_390_BCM_PMSLevel_Rv);
    Msg_GW_17E.EPS_LatCtrlActive   =getvalue(E_pubc_GW_GW_17E_EPS_LatCtrlActive_Rv);
    Msg_GW_17E.EPS_MeasuredTorsionBarTorqValid   =getvalue(E_pubc_GW_GW_17E_EPS_MeasuredTorsionBarTorqValid_Rv);
    Msg_GW_17E.EPS_MeasuredTorsionBarTorque   =getvalue(E_pubc_GW_GW_17E_EPS_MeasuredTorsionBarTorque_Rv);
    Msg_GW_17E.EPS_LatCtrlAvailabilityStatus   =getvalue(E_pubc_GW_GW_17E_EPS_LatCtrlAvailabilityStatus_Rv);
    Msg_GW_514.HU_OverspeedWarningOffset   =getvalue(E_pubc_GW_GW_514_HU_OverspeedWarningOffset_Rv);
    Msg_GW_514.HU_LASWarningModeSelection   =getvalue(E_pubc_GW_GW_514_HU_LASWarningModeSelection_Rv);
    Msg_GW_514.HU_LDWShakeLev   =getvalue(E_pubc_GW_GW_514_HU_LDWShakeLev_Rv);
    Msg_GW_514.HU_HMAEnable   =getvalue(E_pubc_GW_GW_514_HU_HMAEnable_Rv);
    Msg_GW_514.HU_OverspeedWarningEnable   =getvalue(E_pubc_GW_GW_514_HU_OverspeedWarningEnable_Rv);
    Msg_GW_514.HU_OverspeedSoundWarEnable   =getvalue(E_pubc_GW_GW_514_HU_OverspeedSoundWarEnable_Rv);
    Msg_GW_514.HU_TSRSwitch   =getvalue(E_pubc_GW_GW_514_HU_TSRSwitch_Rv);
    Msg_GW_514.HU_IACCEnable   =getvalue(E_pubc_GW_GW_514_HU_IACCEnable_Rv);
    Msg_GW_514.HU_LASModeSelection   =getvalue(E_pubc_GW_GW_514_HU_LASModeSelection_Rv);
    Msg_GW_206.Wheel_Speed_FR_Direction   =getvalue(E_pubc_GW_GW_206_Wheel_Speed_FR_Direction_Rv);
    Msg_GW_206.Wheel_Speed_FR_Valid_Data   =getvalue(E_pubc_GW_GW_206_Wheel_Speed_FR_Valid_Data_Rv);
    Msg_GW_206.Wheel_Speed_FL_Data   =getvalue(E_pubc_GW_GW_206_Wheel_Speed_FL_Data_Rv);
    Msg_GW_206.Wheel_Speed_FL_Direction   =getvalue(E_pubc_GW_GW_206_Wheel_Speed_FL_Direction_Rv);
    Msg_GW_206.Wheel_Speed_FR_Data   =getvalue(E_pubc_GW_GW_206_Wheel_Speed_FR_Data_Rv);
    Msg_GW_206.Wheel_Speed_FL_Valid_Data   =getvalue(E_pubc_GW_GW_206_Wheel_Speed_FL_Valid_Data_Rv);
    Msg_GW_340.AC_FrBlowType   =getvalue(E_pubc_GW_GW_340_AC_FrBlowType_Rv);
    Msg_GW_28C.GW_MFS_HODSystemStatus   =getvalue(E_pubc_GW_GW_28C_GW_MFS_HODSystemStatus_Rv);
    Msg_GW_28C.GW_MFS_HODLinStatus   =getvalue(E_pubc_GW_GW_28C_GW_MFS_HODLinStatus_Rv);
    Msg_GW_28C.GW_MFS_HODSenserStatus   =getvalue(E_pubc_GW_GW_28C_GW_MFS_HODSenserStatus_Rv);
    Msg_GW_28C.GW_MFS_HODAppStatus   =getvalue(E_pubc_GW_GW_28C_GW_MFS_HODAppStatus_Rv);
    Msg_GW_28C.GW_MFS_handsoffAbilityDetect   =getvalue(E_pubc_GW_GW_28C_GW_MFS_handsoffAbilityDetect_Rv);
    Msg_GW_28C.GW_MFS_handsoffDetectResult   =getvalue(E_pubc_GW_GW_28C_GW_MFS_handsoffDetectResult_Rv);
    Msg_GW_28C.GW_MFS_DiagInfoSW_28C   =getvalue(E_pubc_GW_GW_28C_GW_MFS_DiagInfoSW_28C_Rv);
    Msg_GW_28C.GW_MFS_IACCenable_switch_signal   =getvalue(E_pubc_GW_GW_28C_GW_MFS_IACCenable_switch_signal_Rv);
    Msg_GW_28C.GW_MFS_HODCalibratedStatus   =getvalue(E_pubc_GW_GW_28C_GW_MFS_HODCalibratedStatus_Rv);
    Msg_GW_366.AC_EnvironmentalTemp   =getvalue(E_pubc_GW_GW_366_AC_EnvironmentalTemp_Rv);
    Msg_GW_366.AC_EnvironmentalTempVD   =getvalue(E_pubc_GW_GW_366_AC_EnvironmentalTempVD_Rv);
    Msg_GW_360.IMS_BrowOffsetValue   =getvalue(E_pubc_GW_GW_360_IMS_BrowOffsetValue_Rv);
    Msg_GW_360.IMS_HeadDetectSts_Pitch   =getvalue(E_pubc_GW_GW_360_IMS_HeadDetectSts_Pitch_Rv);
    Msg_GW_360.IMS_JawOffsetValue   =getvalue(E_pubc_GW_GW_360_IMS_JawOffsetValue_Rv);
    Msg_GW_360.IMS_HeadDetectSts_Roll   =getvalue(E_pubc_GW_GW_360_IMS_HeadDetectSts_Roll_Rv);
    Msg_GW_360.IMS_HeadDetectSts_Yaw   =getvalue(E_pubc_GW_GW_360_IMS_HeadDetectSts_Yaw_Rv);
    Msg_GW_530.IP_TotalOdometer   =getvalue(E_pubc_GW_GW_530_IP_TotalOdometer_Rv);
    Msg_GW_170.EPS_ActualTorsionBarTorq   =getvalue(E_pubc_GW_GW_170_EPS_ActualTorsionBarTorq_Rv);
    Msg_GW_170.EPS_MinSafetyTorsionBarTorq   =getvalue(E_pubc_GW_GW_170_EPS_MinSafetyTorsionBarTorq_Rv);
    Msg_GW_170.EPS_MaxSafetyTorsionBarTorq   =getvalue(E_pubc_GW_GW_170_EPS_MaxSafetyTorsionBarTorq_Rv);
    Msg_GW_187.ESP_ESPActiveStatus   =getvalue(E_pubc_GW_GW_187_ESP_ESPActiveStatus_Rv);
    Msg_GW_187.ESP_ABSFailStatus   =getvalue(E_pubc_GW_GW_187_ESP_ABSFailStatus_Rv);
    Msg_GW_187.ESP_ESPFunctionStatus   =getvalue(E_pubc_GW_GW_187_ESP_ESPFunctionStatus_Rv);
    Msg_GW_187.ESP_VehicleSpeedValid   =getvalue(E_pubc_GW_GW_187_ESP_VehicleSpeedValid_Rv);
    Msg_GW_187.ESP_VehicleSpeed   =getvalue(E_pubc_GW_GW_187_ESP_VehicleSpeed_Rv);
    Msg_GW_187.ESP_TCSFailStatus   =getvalue(E_pubc_GW_GW_187_ESP_TCSFailStatus_Rv);
    Msg_GW_180.SAS_SteeringAngleValid   =getvalue(E_pubc_GW_GW_180_SAS_SteeringAngleValid_Rv);
    Msg_GW_180.SAS_Calibrated   =getvalue(E_pubc_GW_GW_180_SAS_Calibrated_Rv);
    Msg_GW_180.SAS_SteeringAngle   =getvalue(E_pubc_GW_GW_180_SAS_SteeringAngle_Rv);
    Msg_GW_180.SAS_SteeringAngleSpeed   =getvalue(E_pubc_GW_GW_180_SAS_SteeringAngleSpeed_Rv);
    Msg_GW_180.SAS_SASFailure   =getvalue(E_pubc_GW_GW_180_SAS_SASFailure_Rv);
    Msg_GW_3BB.HU_SpeedLimitDistance   =getvalue(E_pubc_GW_GW_3BB_HU_SpeedLimitDistance_Rv);
    Msg_GW_188.TCU_ShiftinProgressValid   =getvalue(E_pubc_GW_GW_188_TCU_ShiftinProgressValid_Rv);
    Msg_GW_188.TCU_ShiftinProgress   =getvalue(E_pubc_GW_GW_188_TCU_ShiftinProgress_Rv);
    Msg_GW_28B.LCM_LASSwitch   =getvalue(E_pubc_GW_GW_28B_LCM_LASSwitch_Rv);
    Msg_GW_28B.BCM_emergencylightstatus   =getvalue(E_pubc_GW_GW_28B_BCM_emergencylightstatus_Rv);
    Msg_GW_28B.BCM_LowBeamStatus   =getvalue(E_pubc_GW_GW_28B_BCM_LowBeamStatus_Rv);
    Msg_GW_28B.BCM_TurnIndicatorLeft   =getvalue(E_pubc_GW_GW_28B_BCM_TurnIndicatorLeft_Rv);
    Msg_GW_28B.BCM_TurnLightSwitchSts   =getvalue(E_pubc_GW_GW_28B_BCM_TurnLightSwitchSts_Rv);
    Msg_GW_28B.BCM_HighBeamStatus   =getvalue(E_pubc_GW_GW_28B_BCM_HighBeamStatus_Rv);
    Msg_GW_28B.BCM_TurnIndicatorRight   =getvalue(E_pubc_GW_GW_28B_BCM_TurnIndicatorRight_Rv);
}

on envVar E_pubc_GW_CycMsgsON
{
    // enable all the cyclic messages 
    putValue(E_pubc_GW_GW_3B8_Tm,1);
    putValue(E_pubc_GW_GW_387_Tm,1);
    putValue(E_pubc_GW_GW_3C4_Tm,1);
    putValue(E_pubc_GW_GW_3FF_Tm,1);
    putValue(E_pubc_GW_GW_50_Tm,1);
    putValue(E_pubc_GW_GW_208_Tm,1);
    putValue(E_pubc_GW_GW_24F_Tm,1);
    putValue(E_pubc_GW_GW_258_Tm,1);
    putValue(E_pubc_GW_GW_277_Tm,1);
    putValue(E_pubc_GW_GW_356_Tm,1);
    putValue(E_pubc_GW_GW_500_Tm,1);
    putValue(E_pubc_GW_GW_501_Tm,1);
    putValue(E_pubc_GW_GW_278_Tm,1);
    putValue(E_pubc_GW_GW_3C7_Tm,1);
    putValue(E_pubc_GW_GW_3C6_Tm,1);
    putValue(E_pubc_GW_GW_1A8_Tm,1);
    putValue(E_pubc_GW_GW_3C2_Tm,1);
    putValue(E_pubc_GW_GW_3E7_Tm,1);
    putValue(E_pubc_GW_GW_3E8_Tm,1);
    putValue(E_pubc_GW_GW_3AF_Tm,1);
    putValue(E_pubc_GW_GW_1A6_Tm,1);
    putValue(E_pubc_GW_GW_196_Tm,1);
    putValue(E_pubc_GW_GW_394_Tm,1);
    putValue(E_pubc_GW_GW_390_Tm,1);
    putValue(E_pubc_GW_GW_17E_Tm,1);
    putValue(E_pubc_GW_GW_206_Tm,1);
    putValue(E_pubc_GW_GW_340_Tm,1);
    putValue(E_pubc_GW_GW_28C_Tm,1);
    putValue(E_pubc_GW_GW_366_Tm,1);
    putValue(E_pubc_GW_GW_360_Tm,1);
    putValue(E_pubc_GW_GW_530_Tm,1);
    putValue(E_pubc_GW_GW_170_Tm,1);
    putValue(E_pubc_GW_GW_187_Tm,1);
    putValue(E_pubc_GW_GW_180_Tm,1);
    putValue(E_pubc_GW_GW_3BB_Tm,1);
    putValue(E_pubc_GW_GW_188_Tm,1);
    putValue(E_pubc_GW_GW_28B_Tm,1);
}

on envVar E_pubc_GW_CycMsgsOFF
{
    // disable all the cyclic messages
    putValue(E_pubc_GW_GW_3B8_Tm,0);
    putValue(E_pubc_GW_GW_387_Tm,0);
    putValue(E_pubc_GW_GW_3C4_Tm,0);
    putValue(E_pubc_GW_GW_3FF_Tm,0);
    putValue(E_pubc_GW_GW_50_Tm,0);
    putValue(E_pubc_GW_GW_208_Tm,0);
    putValue(E_pubc_GW_GW_24F_Tm,0);
    putValue(E_pubc_GW_GW_258_Tm,0);
    putValue(E_pubc_GW_GW_277_Tm,0);
    putValue(E_pubc_GW_GW_356_Tm,0);
    putValue(E_pubc_GW_GW_500_Tm,0);
    putValue(E_pubc_GW_GW_501_Tm,0);
    putValue(E_pubc_GW_GW_278_Tm,0);
    putValue(E_pubc_GW_GW_3C7_Tm,0);
    putValue(E_pubc_GW_GW_3C6_Tm,0);
    putValue(E_pubc_GW_GW_1A8_Tm,0);
    putValue(E_pubc_GW_GW_3C2_Tm,0);
    putValue(E_pubc_GW_GW_3E7_Tm,0);
    putValue(E_pubc_GW_GW_3E8_Tm,0);
    putValue(E_pubc_GW_GW_3AF_Tm,0);
    putValue(E_pubc_GW_GW_1A6_Tm,0);
    putValue(E_pubc_GW_GW_196_Tm,0);
    putValue(E_pubc_GW_GW_394_Tm,0);
    putValue(E_pubc_GW_GW_390_Tm,0);
    putValue(E_pubc_GW_GW_17E_Tm,0);
    putValue(E_pubc_GW_GW_206_Tm,0);
    putValue(E_pubc_GW_GW_340_Tm,0);
    putValue(E_pubc_GW_GW_28C_Tm,0);
    putValue(E_pubc_GW_GW_366_Tm,0);
    putValue(E_pubc_GW_GW_360_Tm,0);
    putValue(E_pubc_GW_GW_530_Tm,0);
    putValue(E_pubc_GW_GW_170_Tm,0);
    putValue(E_pubc_GW_GW_187_Tm,0);
    putValue(E_pubc_GW_GW_180_Tm,0);
    putValue(E_pubc_GW_GW_3BB_Tm,0);
    putValue(E_pubc_GW_GW_188_Tm,0);
    putValue(E_pubc_GW_GW_28B_Tm,0);
    
}












on timer Tm_GW_3B8
{
    //cyclic message timer 
    if(getValue(E_pubc_GW_GW_3B8_Tm) == 1)
    {
        
        //update the BZ Signal
        if(GW_3B8_HU_RollingCounter_3B8_wrongvalctr == 0)
        {
            update_GW_3B8_HU_RollingCounter_3B8_counter();
            Msg_GW_3B8.HU_RollingCounter_3B8= GW_3B8_HU_RollingCounter_3B8_counter;
        }
        else if(GW_3B8_HU_RollingCounter_3B8_wrongvalctr > 0)
        {
             GW_3B8_HU_RollingCounter_3B8_wrongvalctr--;
             // if counter becomes zero, update panel controller to zero
             if(GW_3B8_HU_RollingCounter_3B8_wrongvalctr == 0)
             {
                putValue(E_pubc_GW_GW_3B8_HU_RollingCounter_3B8_wrongvalctr,0);
             }
        }
        else
        {
            // do nothing
        }
    
        update_GW_3B8_CRC_CheckSum();
        output(Msg_GW_3B8);
        
    }
    //Reset Timer
    SetTimer(Tm_GW_3B8,Cycle_GW_3B8);
}

on envVar E_pubc_GW_GW_3B8_cycleTm
{
    // update the cycle time 
    Cycle_GW_3B8=getvalue(this);
}
on timer Tm_GW_387
{
    //cyclic message timer 
    if(getValue(E_pubc_GW_GW_387_Tm) == 1)
    {
        
    
        output(Msg_GW_387);
        
    }
    //Reset Timer
    SetTimer(Tm_GW_387,Cycle_GW_387);
}

on envVar E_pubc_GW_GW_387_cycleTm
{
    // update the cycle time 
    Cycle_GW_387=getvalue(this);
}
on timer Tm_GW_3C4
{
    //cyclic message timer 
    if(getValue(E_pubc_GW_GW_3C4_Tm) == 1)
    {
        
        //update the BZ Signal
        if(GW_3C4_HU_RollingCounter_3C4_wrongvalctr == 0)
        {
            update_GW_3C4_HU_RollingCounter_3C4_counter();
            Msg_GW_3C4.HU_RollingCounter_3C4= GW_3C4_HU_RollingCounter_3C4_counter;
        }
        else if(GW_3C4_HU_RollingCounter_3C4_wrongvalctr > 0)
        {
             GW_3C4_HU_RollingCounter_3C4_wrongvalctr--;
             // if counter becomes zero, update panel controller to zero
             if(GW_3C4_HU_RollingCounter_3C4_wrongvalctr == 0)
             {
                putValue(E_pubc_GW_GW_3C4_HU_RollingCounter_3C4_wrongvalctr,0);
             }
        }
        else
        {
            // do nothing
        }
    
        update_GW_3C4_CRC_CheckSum();
        output(Msg_GW_3C4);
        
    }
    //Reset Timer
    SetTimer(Tm_GW_3C4,Cycle_GW_3C4);
}

on envVar E_pubc_GW_GW_3C4_cycleTm
{
    // update the cycle time 
    Cycle_GW_3C4=getvalue(this);
}
on timer Tm_GW_3FF
{
    //cyclic message timer 
    if(getValue(E_pubc_GW_GW_3FF_Tm) == 1)
    {
        
    
        output(Msg_GW_3FF);
        
    }
    //Reset Timer
    SetTimer(Tm_GW_3FF,Cycle_GW_3FF);
}

on envVar E_pubc_GW_GW_3FF_cycleTm
{
    // update the cycle time 
    Cycle_GW_3FF=getvalue(this);
}
on timer Tm_GW_50
{
    //cyclic message timer 
    if(getValue(E_pubc_GW_GW_50_Tm) == 1)
    {
        
        //update the BZ Signal
        if(GW_50_SRS_RollingCounter_id050_wrongvalctr == 0)
        {
            update_GW_50_SRS_RollingCounter_id050_counter();
            Msg_GW_50.SRS_RollingCounter_id050= GW_50_SRS_RollingCounter_id050_counter;
        }
        else if(GW_50_SRS_RollingCounter_id050_wrongvalctr > 0)
        {
             GW_50_SRS_RollingCounter_id050_wrongvalctr--;
             // if counter becomes zero, update panel controller to zero
             if(GW_50_SRS_RollingCounter_id050_wrongvalctr == 0)
             {
                putValue(E_pubc_GW_GW_50_SRS_RollingCounter_id050_wrongvalctr,0);
             }
        }
        else
        {
            // do nothing
        }
    
        update_GW_50_CRC_CheckSum();
        output(Msg_GW_50);
        
    }
    //Reset Timer
    SetTimer(Tm_GW_50,Cycle_GW_50);
}

on envVar E_pubc_GW_GW_50_cycleTm
{
    // update the cycle time 
    Cycle_GW_50=getvalue(this);
}
on timer Tm_GW_208
{
    //cyclic message timer 
    if(getValue(E_pubc_GW_GW_208_Tm) == 1)
    {
        
        //update the BZ Signal
        if(GW_208_ESP_RollingCounter_208_wrongvalctr == 0)
        {
            update_GW_208_ESP_RollingCounter_208_counter();
            Msg_GW_208.ESP_RollingCounter_208= GW_208_ESP_RollingCounter_208_counter;
        }
        else if(GW_208_ESP_RollingCounter_208_wrongvalctr > 0)
        {
             GW_208_ESP_RollingCounter_208_wrongvalctr--;
             // if counter becomes zero, update panel controller to zero
             if(GW_208_ESP_RollingCounter_208_wrongvalctr == 0)
             {
                putValue(E_pubc_GW_GW_208_ESP_RollingCounter_208_wrongvalctr,0);
             }
        }
        else
        {
            // do nothing
        }
    
        update_GW_208_CRC_CheckSum();
        output(Msg_GW_208);
        
    }
    //Reset Timer
    SetTimer(Tm_GW_208,Cycle_GW_208);
}

on envVar E_pubc_GW_GW_208_cycleTm
{
    // update the cycle time 
    Cycle_GW_208=getvalue(this);
}
on timer Tm_GW_24F
{
    //cyclic message timer 
    if(getValue(E_pubc_GW_GW_24F_Tm) == 1)
    {
        
        //update the BZ Signal
        if(GW_24F_EPS_RollingCounter_24F_wrongvalctr == 0)
        {
            update_GW_24F_EPS_RollingCounter_24F_counter();
            Msg_GW_24F.EPS_RollingCounter_24F= GW_24F_EPS_RollingCounter_24F_counter;
        }
        else if(GW_24F_EPS_RollingCounter_24F_wrongvalctr > 0)
        {
             GW_24F_EPS_RollingCounter_24F_wrongvalctr--;
             // if counter becomes zero, update panel controller to zero
             if(GW_24F_EPS_RollingCounter_24F_wrongvalctr == 0)
             {
                putValue(E_pubc_GW_GW_24F_EPS_RollingCounter_24F_wrongvalctr,0);
             }
        }
        else
        {
            // do nothing
        }
    
        update_GW_24F_CRC_CheckSum();
        output(Msg_GW_24F);
        
    }
    //Reset Timer
    SetTimer(Tm_GW_24F,Cycle_GW_24F);
}

on envVar E_pubc_GW_GW_24F_cycleTm
{
    // update the cycle time 
    Cycle_GW_24F=getvalue(this);
}
on timer Tm_GW_258
{
    //cyclic message timer 
    if(getValue(E_pubc_GW_GW_258_Tm) == 1)
    {
        
        //update the BZ Signal
        if(GW_258_ESP_RollingCounter_258_wrongvalctr == 0)
        {
            update_GW_258_ESP_RollingCounter_258_counter();
            Msg_GW_258.ESP_RollingCounter_258= GW_258_ESP_RollingCounter_258_counter;
        }
        else if(GW_258_ESP_RollingCounter_258_wrongvalctr > 0)
        {
             GW_258_ESP_RollingCounter_258_wrongvalctr--;
             // if counter becomes zero, update panel controller to zero
             if(GW_258_ESP_RollingCounter_258_wrongvalctr == 0)
             {
                putValue(E_pubc_GW_GW_258_ESP_RollingCounter_258_wrongvalctr,0);
             }
        }
        else
        {
            // do nothing
        }
    
        update_GW_258_CRC_CheckSum();
        output(Msg_GW_258);
        
    }
    //Reset Timer
    SetTimer(Tm_GW_258,Cycle_GW_258);
}

on envVar E_pubc_GW_GW_258_cycleTm
{
    // update the cycle time 
    Cycle_GW_258=getvalue(this);
}
on timer Tm_GW_277
{
    //cyclic message timer 
    if(getValue(E_pubc_GW_GW_277_Tm) == 1)
    {
        
        //update the BZ Signal
        if(GW_277_ESP_RollingCounter_277_wrongvalctr == 0)
        {
            update_GW_277_ESP_RollingCounter_277_counter();
            Msg_GW_277.ESP_RollingCounter_277= GW_277_ESP_RollingCounter_277_counter;
        }
        else if(GW_277_ESP_RollingCounter_277_wrongvalctr > 0)
        {
             GW_277_ESP_RollingCounter_277_wrongvalctr--;
             // if counter becomes zero, update panel controller to zero
             if(GW_277_ESP_RollingCounter_277_wrongvalctr == 0)
             {
                putValue(E_pubc_GW_GW_277_ESP_RollingCounter_277_wrongvalctr,0);
             }
        }
        else
        {
            // do nothing
        }
    
        update_GW_277_CRC_CheckSum();
        output(Msg_GW_277);
        
    }
    //Reset Timer
    SetTimer(Tm_GW_277,Cycle_GW_277);
}

on envVar E_pubc_GW_GW_277_cycleTm
{
    // update the cycle time 
    Cycle_GW_277=getvalue(this);
}
on timer Tm_GW_356
{
    //cyclic message timer 
    if(getValue(E_pubc_GW_GW_356_Tm) == 1)
    {
        
        //update the BZ Signal
        if(GW_356_IMS_RollingCounter_356_wrongvalctr == 0)
        {
            update_GW_356_IMS_RollingCounter_356_counter();
            Msg_GW_356.IMS_RollingCounter_356= GW_356_IMS_RollingCounter_356_counter;
        }
        else if(GW_356_IMS_RollingCounter_356_wrongvalctr > 0)
        {
             GW_356_IMS_RollingCounter_356_wrongvalctr--;
             // if counter becomes zero, update panel controller to zero
             if(GW_356_IMS_RollingCounter_356_wrongvalctr == 0)
             {
                putValue(E_pubc_GW_GW_356_IMS_RollingCounter_356_wrongvalctr,0);
             }
        }
        else
        {
            // do nothing
        }
    
        update_GW_356_CRC_CheckSum();
        output(Msg_GW_356);
        
    }
    //Reset Timer
    SetTimer(Tm_GW_356,Cycle_GW_356);
}

on envVar E_pubc_GW_GW_356_cycleTm
{
    // update the cycle time 
    Cycle_GW_356=getvalue(this);
}
on timer Tm_GW_500
{
    //cyclic message timer 
    if(getValue(E_pubc_GW_GW_500_Tm) == 1)
    {
        
    
        output(Msg_GW_500);
        
    }
    //Reset Timer
    SetTimer(Tm_GW_500,Cycle_GW_500);
}

on envVar E_pubc_GW_GW_500_cycleTm
{
    // update the cycle time 
    Cycle_GW_500=getvalue(this);
}
on timer Tm_GW_501
{
    //cyclic message timer 
    if(getValue(E_pubc_GW_GW_501_Tm) == 1)
    {
        
    
        output(Msg_GW_501);
        
    }
    //Reset Timer
    SetTimer(Tm_GW_501,Cycle_GW_501);
}

on envVar E_pubc_GW_GW_501_cycleTm
{
    // update the cycle time 
    Cycle_GW_501=getvalue(this);
}
on timer Tm_GW_278
{
    //cyclic message timer 
    if(getValue(E_pubc_GW_GW_278_Tm) == 1)
    {
        
        //update the BZ Signal
        if(GW_278_ESP_RollingCounter_278_wrongvalctr == 0)
        {
            update_GW_278_ESP_RollingCounter_278_counter();
            Msg_GW_278.ESP_RollingCounter_278= GW_278_ESP_RollingCounter_278_counter;
        }
        else if(GW_278_ESP_RollingCounter_278_wrongvalctr > 0)
        {
             GW_278_ESP_RollingCounter_278_wrongvalctr--;
             // if counter becomes zero, update panel controller to zero
             if(GW_278_ESP_RollingCounter_278_wrongvalctr == 0)
             {
                putValue(E_pubc_GW_GW_278_ESP_RollingCounter_278_wrongvalctr,0);
             }
        }
        else
        {
            // do nothing
        }
    
        update_GW_278_CRC_CheckSum();
        output(Msg_GW_278);
        
    }
    //Reset Timer
    SetTimer(Tm_GW_278,Cycle_GW_278);
}

on envVar E_pubc_GW_GW_278_cycleTm
{
    // update the cycle time 
    Cycle_GW_278=getvalue(this);
}
on timer Tm_GW_3C7
{
    //cyclic message timer 
    if(getValue(E_pubc_GW_GW_3C7_Tm) == 1)
    {
        
        //update the BZ Signal
        if(GW_3C7_HU_RollingCounter_3C7_wrongvalctr == 0)
        {
            update_GW_3C7_HU_RollingCounter_3C7_counter();
            Msg_GW_3C7.HU_RollingCounter_3C7= GW_3C7_HU_RollingCounter_3C7_counter;
        }
        else if(GW_3C7_HU_RollingCounter_3C7_wrongvalctr > 0)
        {
             GW_3C7_HU_RollingCounter_3C7_wrongvalctr--;
             // if counter becomes zero, update panel controller to zero
             if(GW_3C7_HU_RollingCounter_3C7_wrongvalctr == 0)
             {
                putValue(E_pubc_GW_GW_3C7_HU_RollingCounter_3C7_wrongvalctr,0);
             }
        }
        else
        {
            // do nothing
        }
    
        update_GW_3C7_CRC_CheckSum();
        output(Msg_GW_3C7);
        
    }
    //Reset Timer
    SetTimer(Tm_GW_3C7,Cycle_GW_3C7);
}

on envVar E_pubc_GW_GW_3C7_cycleTm
{
    // update the cycle time 
    Cycle_GW_3C7=getvalue(this);
}
on timer Tm_GW_3C6
{
    //cyclic message timer 
    if(getValue(E_pubc_GW_GW_3C6_Tm) == 1)
    {
        
        //update the BZ Signal
        if(GW_3C6_HU_RollingCounter_3C6_wrongvalctr == 0)
        {
            update_GW_3C6_HU_RollingCounter_3C6_counter();
            Msg_GW_3C6.HU_RollingCounter_3C6= GW_3C6_HU_RollingCounter_3C6_counter;
        }
        else if(GW_3C6_HU_RollingCounter_3C6_wrongvalctr > 0)
        {
             GW_3C6_HU_RollingCounter_3C6_wrongvalctr--;
             // if counter becomes zero, update panel controller to zero
             if(GW_3C6_HU_RollingCounter_3C6_wrongvalctr == 0)
             {
                putValue(E_pubc_GW_GW_3C6_HU_RollingCounter_3C6_wrongvalctr,0);
             }
        }
        else
        {
            // do nothing
        }
    
        update_GW_3C6_CRC_CheckSum();
        output(Msg_GW_3C6);
        
    }
    //Reset Timer
    SetTimer(Tm_GW_3C6,Cycle_GW_3C6);
}

on envVar E_pubc_GW_GW_3C6_cycleTm
{
    // update the cycle time 
    Cycle_GW_3C6=getvalue(this);
}
on timer Tm_GW_1A8
{
    //cyclic message timer 
    if(getValue(E_pubc_GW_GW_1A8_Tm) == 1)
    {
        
        //update the BZ Signal
        if(GW_1A8_TCU_RollingCounter_1A8_wrongvalctr == 0)
        {
            update_GW_1A8_TCU_RollingCounter_1A8_counter();
            Msg_GW_1A8.TCU_RollingCounter_1A8= GW_1A8_TCU_RollingCounter_1A8_counter;
        }
        else if(GW_1A8_TCU_RollingCounter_1A8_wrongvalctr > 0)
        {
             GW_1A8_TCU_RollingCounter_1A8_wrongvalctr--;
             // if counter becomes zero, update panel controller to zero
             if(GW_1A8_TCU_RollingCounter_1A8_wrongvalctr == 0)
             {
                putValue(E_pubc_GW_GW_1A8_TCU_RollingCounter_1A8_wrongvalctr,0);
             }
        }
        else
        {
            // do nothing
        }
    
        update_GW_1A8_CRC_CheckSum();
        output(Msg_GW_1A8);
        
    }
    //Reset Timer
    SetTimer(Tm_GW_1A8,Cycle_GW_1A8);
}

on envVar E_pubc_GW_GW_1A8_cycleTm
{
    // update the cycle time 
    Cycle_GW_1A8=getvalue(this);
}
on timer Tm_GW_3C2
{
    //cyclic message timer 
    if(getValue(E_pubc_GW_GW_3C2_Tm) == 1)
    {
        
        //update the BZ Signal
        if(GW_3C2_HU_RollingCounter_3C2_wrongvalctr == 0)
        {
            update_GW_3C2_HU_RollingCounter_3C2_counter();
            Msg_GW_3C2.HU_RollingCounter_3C2= GW_3C2_HU_RollingCounter_3C2_counter;
        }
        else if(GW_3C2_HU_RollingCounter_3C2_wrongvalctr > 0)
        {
             GW_3C2_HU_RollingCounter_3C2_wrongvalctr--;
             // if counter becomes zero, update panel controller to zero
             if(GW_3C2_HU_RollingCounter_3C2_wrongvalctr == 0)
             {
                putValue(E_pubc_GW_GW_3C2_HU_RollingCounter_3C2_wrongvalctr,0);
             }
        }
        else
        {
            // do nothing
        }
    
        update_GW_3C2_CRC_CheckSum();
        output(Msg_GW_3C2);
        
    }
    //Reset Timer
    SetTimer(Tm_GW_3C2,Cycle_GW_3C2);
}

on envVar E_pubc_GW_GW_3C2_cycleTm
{
    // update the cycle time 
    Cycle_GW_3C2=getvalue(this);
}
on timer Tm_GW_3E7
{
    //cyclic message timer 
    if(getValue(E_pubc_GW_GW_3E7_Tm) == 1)
    {
        
    
        output(Msg_GW_3E7);
        
    }
    //Reset Timer
    SetTimer(Tm_GW_3E7,Cycle_GW_3E7);
}

on envVar E_pubc_GW_GW_3E7_cycleTm
{
    // update the cycle time 
    Cycle_GW_3E7=getvalue(this);
}
on timer Tm_GW_3E8
{
    //cyclic message timer 
    if(getValue(E_pubc_GW_GW_3E8_Tm) == 1)
    {
        
    
        output(Msg_GW_3E8);
        
    }
    //Reset Timer
    SetTimer(Tm_GW_3E8,Cycle_GW_3E8);
}

on envVar E_pubc_GW_GW_3E8_cycleTm
{
    // update the cycle time 
    Cycle_GW_3E8=getvalue(this);
}
on timer Tm_GW_3AF
{
    //cyclic message timer 
    if(getValue(E_pubc_GW_GW_3AF_Tm) == 1)
    {
        
        //update the BZ Signal
        if(GW_3AF_HU_RollingCounter_3AF_wrongvalctr == 0)
        {
            update_GW_3AF_HU_RollingCounter_3AF_counter();
            Msg_GW_3AF.HU_RollingCounter_3AF= GW_3AF_HU_RollingCounter_3AF_counter;
        }
        else if(GW_3AF_HU_RollingCounter_3AF_wrongvalctr > 0)
        {
             GW_3AF_HU_RollingCounter_3AF_wrongvalctr--;
             // if counter becomes zero, update panel controller to zero
             if(GW_3AF_HU_RollingCounter_3AF_wrongvalctr == 0)
             {
                putValue(E_pubc_GW_GW_3AF_HU_RollingCounter_3AF_wrongvalctr,0);
             }
        }
        else
        {
            // do nothing
        }
    
        update_GW_3AF_CRC_CheckSum();
        output(Msg_GW_3AF);
        
    }
    //Reset Timer
    SetTimer(Tm_GW_3AF,Cycle_GW_3AF);
}

on envVar E_pubc_GW_GW_3AF_cycleTm
{
    // update the cycle time 
    Cycle_GW_3AF=getvalue(this);
}
on timer Tm_GW_1A6
{
    //cyclic message timer 
    if(getValue(E_pubc_GW_GW_1A6_Tm) == 1)
    {
        
        //update the BZ Signal
        if(GW_1A6_EMS_RollingCounter_1A6_wrongvalctr == 0)
        {
            update_GW_1A6_EMS_RollingCounter_1A6_counter();
            Msg_GW_1A6.EMS_RollingCounter_1A6= GW_1A6_EMS_RollingCounter_1A6_counter;
        }
        else if(GW_1A6_EMS_RollingCounter_1A6_wrongvalctr > 0)
        {
             GW_1A6_EMS_RollingCounter_1A6_wrongvalctr--;
             // if counter becomes zero, update panel controller to zero
             if(GW_1A6_EMS_RollingCounter_1A6_wrongvalctr == 0)
             {
                putValue(E_pubc_GW_GW_1A6_EMS_RollingCounter_1A6_wrongvalctr,0);
             }
        }
        else
        {
            // do nothing
        }
    
        update_GW_1A6_CRC_CheckSum();
        output(Msg_GW_1A6);
        
    }
    //Reset Timer
    SetTimer(Tm_GW_1A6,Cycle_GW_1A6);
}

on envVar E_pubc_GW_GW_1A6_cycleTm
{
    // update the cycle time 
    Cycle_GW_1A6=getvalue(this);
}
on timer Tm_GW_196
{
    //cyclic message timer 
    if(getValue(E_pubc_GW_GW_196_Tm) == 1)
    {
        
        //update the BZ Signal
        if(GW_196_EMS_RollingCounter_196_wrongvalctr == 0)
        {
            update_GW_196_EMS_RollingCounter_196_counter();
            Msg_GW_196.EMS_RollingCounter_196= GW_196_EMS_RollingCounter_196_counter;
        }
        else if(GW_196_EMS_RollingCounter_196_wrongvalctr > 0)
        {
             GW_196_EMS_RollingCounter_196_wrongvalctr--;
             // if counter becomes zero, update panel controller to zero
             if(GW_196_EMS_RollingCounter_196_wrongvalctr == 0)
             {
                putValue(E_pubc_GW_GW_196_EMS_RollingCounter_196_wrongvalctr,0);
             }
        }
        else
        {
            // do nothing
        }
    
        update_GW_196_CRC_CheckSum();
        output(Msg_GW_196);
        
    }
    //Reset Timer
    SetTimer(Tm_GW_196,Cycle_GW_196);
}

on envVar E_pubc_GW_GW_196_cycleTm
{
    // update the cycle time 
    Cycle_GW_196=getvalue(this);
}
on timer Tm_GW_394
{
    //cyclic message timer 
    if(getValue(E_pubc_GW_GW_394_Tm) == 1)
    {
        
    
        output(Msg_GW_394);
        
    }
    //Reset Timer
    SetTimer(Tm_GW_394,Cycle_GW_394);
}

on envVar E_pubc_GW_GW_394_cycleTm
{
    // update the cycle time 
    Cycle_GW_394=getvalue(this);
}
on timer Tm_GW_390
{
    //cyclic message timer 
    if(getValue(E_pubc_GW_GW_390_Tm) == 1)
    {
        
    
        output(Msg_GW_390);
        
    }
    //Reset Timer
    SetTimer(Tm_GW_390,Cycle_GW_390);
}

on envVar E_pubc_GW_GW_390_cycleTm
{
    // update the cycle time 
    Cycle_GW_390=getvalue(this);
}
on timer Tm_GW_17E
{
    //cyclic message timer 
    if(getValue(E_pubc_GW_GW_17E_Tm) == 1)
    {
        
        //update the BZ Signal
        if(GW_17E_EPS_RollingCounter_17E_wrongvalctr == 0)
        {
            update_GW_17E_EPS_RollingCounter_17E_counter();
            Msg_GW_17E.EPS_RollingCounter_17E= GW_17E_EPS_RollingCounter_17E_counter;
        }
        else if(GW_17E_EPS_RollingCounter_17E_wrongvalctr > 0)
        {
             GW_17E_EPS_RollingCounter_17E_wrongvalctr--;
             // if counter becomes zero, update panel controller to zero
             if(GW_17E_EPS_RollingCounter_17E_wrongvalctr == 0)
             {
                putValue(E_pubc_GW_GW_17E_EPS_RollingCounter_17E_wrongvalctr,0);
             }
        }
        else
        {
            // do nothing
        }
    
        update_GW_17E_CRC_CheckSum();
        output(Msg_GW_17E);
        
    }
    //Reset Timer
    SetTimer(Tm_GW_17E,Cycle_GW_17E);
}

on envVar E_pubc_GW_GW_17E_cycleTm
{
    // update the cycle time 
    Cycle_GW_17E=getvalue(this);
}
on timer Tm_GW_206
{
    //cyclic message timer 
    if(getValue(E_pubc_GW_GW_206_Tm) == 1)
    {
        
        //update the BZ Signal
        if(GW_206_ESP_RollingCounter_206_wrongvalctr == 0)
        {
            update_GW_206_ESP_RollingCounter_206_counter();
            Msg_GW_206.ESP_RollingCounter_206= GW_206_ESP_RollingCounter_206_counter;
        }
        else if(GW_206_ESP_RollingCounter_206_wrongvalctr > 0)
        {
             GW_206_ESP_RollingCounter_206_wrongvalctr--;
             // if counter becomes zero, update panel controller to zero
             if(GW_206_ESP_RollingCounter_206_wrongvalctr == 0)
             {
                putValue(E_pubc_GW_GW_206_ESP_RollingCounter_206_wrongvalctr,0);
             }
        }
        else
        {
            // do nothing
        }
    
        update_GW_206_CRC_CheckSum();
        output(Msg_GW_206);
        
    }
    //Reset Timer
    SetTimer(Tm_GW_206,Cycle_GW_206);
}

on envVar E_pubc_GW_GW_206_cycleTm
{
    // update the cycle time 
    Cycle_GW_206=getvalue(this);
}
on timer Tm_GW_340
{
    //cyclic message timer 
    if(getValue(E_pubc_GW_GW_340_Tm) == 1)
    {
        
    
        output(Msg_GW_340);
        
    }
    //Reset Timer
    SetTimer(Tm_GW_340,Cycle_GW_340);
}

on envVar E_pubc_GW_GW_340_cycleTm
{
    // update the cycle time 
    Cycle_GW_340=getvalue(this);
}
on timer Tm_GW_28C
{
    //cyclic message timer 
    if(getValue(E_pubc_GW_GW_28C_Tm) == 1)
    {
        
        //update the BZ Signal
        if(GW_28C_GW_MFS_RollingCounter_28C_wrongvalctr == 0)
        {
            update_GW_28C_GW_MFS_RollingCounter_28C_counter();
            Msg_GW_28C.GW_MFS_RollingCounter_28C= GW_28C_GW_MFS_RollingCounter_28C_counter;
        }
        else if(GW_28C_GW_MFS_RollingCounter_28C_wrongvalctr > 0)
        {
             GW_28C_GW_MFS_RollingCounter_28C_wrongvalctr--;
             // if counter becomes zero, update panel controller to zero
             if(GW_28C_GW_MFS_RollingCounter_28C_wrongvalctr == 0)
             {
                putValue(E_pubc_GW_GW_28C_GW_MFS_RollingCounter_28C_wrongvalctr,0);
             }
        }
        else
        {
            // do nothing
        }
    
        update_GW_28C_CRC_CheckSum();
        output(Msg_GW_28C);
        
    }
    //Reset Timer
    SetTimer(Tm_GW_28C,Cycle_GW_28C);
}

on envVar E_pubc_GW_GW_28C_cycleTm
{
    // update the cycle time 
    Cycle_GW_28C=getvalue(this);
}
on timer Tm_GW_366
{
    //cyclic message timer 
    if(getValue(E_pubc_GW_GW_366_Tm) == 1)
    {
        
    
        output(Msg_GW_366);
        
    }
    //Reset Timer
    SetTimer(Tm_GW_366,Cycle_GW_366);
}

on envVar E_pubc_GW_GW_366_cycleTm
{
    // update the cycle time 
    Cycle_GW_366=getvalue(this);
}
on timer Tm_GW_360
{
    //cyclic message timer 
    if(getValue(E_pubc_GW_GW_360_Tm) == 1)
    {
        
        //update the BZ Signal
        if(GW_360_IMS_RollingCounter_360_wrongvalctr == 0)
        {
            update_GW_360_IMS_RollingCounter_360_counter();
            Msg_GW_360.IMS_RollingCounter_360= GW_360_IMS_RollingCounter_360_counter;
        }
        else if(GW_360_IMS_RollingCounter_360_wrongvalctr > 0)
        {
             GW_360_IMS_RollingCounter_360_wrongvalctr--;
             // if counter becomes zero, update panel controller to zero
             if(GW_360_IMS_RollingCounter_360_wrongvalctr == 0)
             {
                putValue(E_pubc_GW_GW_360_IMS_RollingCounter_360_wrongvalctr,0);
             }
        }
        else
        {
            // do nothing
        }
    
        update_GW_360_CRC_CheckSum();
        output(Msg_GW_360);
        
    }
    //Reset Timer
    SetTimer(Tm_GW_360,Cycle_GW_360);
}

on envVar E_pubc_GW_GW_360_cycleTm
{
    // update the cycle time 
    Cycle_GW_360=getvalue(this);
}
on timer Tm_GW_530
{
    //cyclic message timer 
    if(getValue(E_pubc_GW_GW_530_Tm) == 1)
    {
        
    
        output(Msg_GW_530);
        
    }
    //Reset Timer
    SetTimer(Tm_GW_530,Cycle_GW_530);
}

on envVar E_pubc_GW_GW_530_cycleTm
{
    // update the cycle time 
    Cycle_GW_530=getvalue(this);
}
on timer Tm_GW_170
{
    //cyclic message timer 
    if(getValue(E_pubc_GW_GW_170_Tm) == 1)
    {
        
        //update the BZ Signal
        if(GW_170_EPS_RollingCounter_170_wrongvalctr == 0)
        {
            update_GW_170_EPS_RollingCounter_170_counter();
            Msg_GW_170.EPS_RollingCounter_170= GW_170_EPS_RollingCounter_170_counter;
        }
        else if(GW_170_EPS_RollingCounter_170_wrongvalctr > 0)
        {
             GW_170_EPS_RollingCounter_170_wrongvalctr--;
             // if counter becomes zero, update panel controller to zero
             if(GW_170_EPS_RollingCounter_170_wrongvalctr == 0)
             {
                putValue(E_pubc_GW_GW_170_EPS_RollingCounter_170_wrongvalctr,0);
             }
        }
        else
        {
            // do nothing
        }
    
        update_GW_170_CRC_CheckSum();
        output(Msg_GW_170);
        
    }
    //Reset Timer
    SetTimer(Tm_GW_170,Cycle_GW_170);
}

on envVar E_pubc_GW_GW_170_cycleTm
{
    // update the cycle time 
    Cycle_GW_170=getvalue(this);
}
on timer Tm_GW_187
{
    //cyclic message timer 
    if(getValue(E_pubc_GW_GW_187_Tm) == 1)
    {
        
        //update the BZ Signal
        if(GW_187_ESP_RollingCounter_187_wrongvalctr == 0)
        {
            update_GW_187_ESP_RollingCounter_187_counter();
            Msg_GW_187.ESP_RollingCounter_187= GW_187_ESP_RollingCounter_187_counter;
        }
        else if(GW_187_ESP_RollingCounter_187_wrongvalctr > 0)
        {
             GW_187_ESP_RollingCounter_187_wrongvalctr--;
             // if counter becomes zero, update panel controller to zero
             if(GW_187_ESP_RollingCounter_187_wrongvalctr == 0)
             {
                putValue(E_pubc_GW_GW_187_ESP_RollingCounter_187_wrongvalctr,0);
             }
        }
        else
        {
            // do nothing
        }
    
        update_GW_187_CRC_CheckSum();
        output(Msg_GW_187);
        
    }
    //Reset Timer
    SetTimer(Tm_GW_187,Cycle_GW_187);
}

on envVar E_pubc_GW_GW_187_cycleTm
{
    // update the cycle time 
    Cycle_GW_187=getvalue(this);
}
on timer Tm_GW_180
{
    //cyclic message timer 
    if(getValue(E_pubc_GW_GW_180_Tm) == 1)
    {
        
        //update the BZ Signal
        if(GW_180_SAS_RollingCounter_wrongvalctr == 0)
        {
            update_GW_180_SAS_RollingCounter_counter();
            Msg_GW_180.SAS_RollingCounter= GW_180_SAS_RollingCounter_counter;
        }
        else if(GW_180_SAS_RollingCounter_wrongvalctr > 0)
        {
             GW_180_SAS_RollingCounter_wrongvalctr--;
             // if counter becomes zero, update panel controller to zero
             if(GW_180_SAS_RollingCounter_wrongvalctr == 0)
             {
                putValue(E_pubc_GW_GW_180_SAS_RollingCounter_wrongvalctr,0);
             }
        }
        else
        {
            // do nothing
        }
    
        update_GW_180_CRC_CheckSum();
        output(Msg_GW_180);
        
    }
    //Reset Timer
    SetTimer(Tm_GW_180,Cycle_GW_180);
}

on envVar E_pubc_GW_GW_180_cycleTm
{
    // update the cycle time 
    Cycle_GW_180=getvalue(this);
}
on timer Tm_GW_3BB
{
    //cyclic message timer 
    if(getValue(E_pubc_GW_GW_3BB_Tm) == 1)
    {
        
    
        output(Msg_GW_3BB);
        
    }
    //Reset Timer
    SetTimer(Tm_GW_3BB,Cycle_GW_3BB);
}

on envVar E_pubc_GW_GW_3BB_cycleTm
{
    // update the cycle time 
    Cycle_GW_3BB=getvalue(this);
}
on timer Tm_GW_188
{
    //cyclic message timer 
    if(getValue(E_pubc_GW_GW_188_Tm) == 1)
    {
        
        //update the BZ Signal
        if(GW_188_TCU_RollingCounter_188_wrongvalctr == 0)
        {
            update_GW_188_TCU_RollingCounter_188_counter();
            Msg_GW_188.TCU_RollingCounter_188= GW_188_TCU_RollingCounter_188_counter;
        }
        else if(GW_188_TCU_RollingCounter_188_wrongvalctr > 0)
        {
             GW_188_TCU_RollingCounter_188_wrongvalctr--;
             // if counter becomes zero, update panel controller to zero
             if(GW_188_TCU_RollingCounter_188_wrongvalctr == 0)
             {
                putValue(E_pubc_GW_GW_188_TCU_RollingCounter_188_wrongvalctr,0);
             }
        }
        else
        {
            // do nothing
        }
    
        update_GW_188_CRC_CheckSum();
        output(Msg_GW_188);
        
    }
    //Reset Timer
    SetTimer(Tm_GW_188,Cycle_GW_188);
}

on envVar E_pubc_GW_GW_188_cycleTm
{
    // update the cycle time 
    Cycle_GW_188=getvalue(this);
}
on timer Tm_GW_28B
{
    //cyclic message timer 
    if(getValue(E_pubc_GW_GW_28B_Tm) == 1)
    {
        
    
        output(Msg_GW_28B);
        
    }
    //Reset Timer
    SetTimer(Tm_GW_28B,Cycle_GW_28B);
}

on envVar E_pubc_GW_GW_28B_cycleTm
{
    // update the cycle time 
    Cycle_GW_28B=getvalue(this);
}

on envVar E_pubc_GW_GW_3B8_tx
{
    if(getValue(this))
    {       
        
        //update the BZ Signal
        if(GW_3B8_HU_RollingCounter_3B8_wrongvalctr == 0)
        {
            update_GW_3B8_HU_RollingCounter_3B8_counter();
            Msg_GW_3B8.HU_RollingCounter_3B8= GW_3B8_HU_RollingCounter_3B8_counter;
        }
        else if(GW_3B8_HU_RollingCounter_3B8_wrongvalctr > 0)
        {
             GW_3B8_HU_RollingCounter_3B8_wrongvalctr--;
              // if counter becomes zero, update panel controller to zero
             if(GW_3B8_HU_RollingCounter_3B8_wrongvalctr == 0)
             {
                 putValue(E_pubc_GW_GW_3B8_HU_RollingCounter_3B8_wrongvalctr,0);
             }
        }
        else
        {
            //do nothing
        }        
        //calculate the CRC CheckSum
        update_GW_3B8_CRC_CheckSum();

        output(Msg_GW_3B8);        
    }
}

on envVar E_pubc_GW_GW_3B8_Range
{
    qword rawstatus = 0ll;
    qword rawValue = 0ll;    
    
    rawstatus = getvalue(this);    
    // set all the signals with min raw /max raw /init raw
    switch (rawstatus) 
    {
     case(0) :
        rawValue= 0;
        putValue(E_pubc_GW_GW_3B8_HU_Byroad_Rv, rawValue);
        rawValue= 0;
        putValue(E_pubc_GW_GW_3B8_HU_RoadCurvature_Rv, rawValue);
        rawValue= 0;
        putValue(E_pubc_GW_GW_3B8_HU_EnterSlopeInfo_Rv, rawValue);
        rawValue= 0;
        putValue(E_pubc_GW_GW_3B8_HU_EnterTunnelInfo_Rv, rawValue);
        rawValue= 0;
        putValue(E_pubc_GW_GW_3B8_HU_SlopeDistance_Rv, rawValue);
        rawValue= 0;
        putValue(E_pubc_GW_GW_3B8_HU_TunnelDistance_Rv, rawValue);
        rawValue= 0;
        putValue(E_pubc_GW_GW_3B8_HU_NavGuiganceStatus_Rv, rawValue);
        rawValue= 0;
        putValue(E_pubc_GW_GW_3B8_HU_TunnelLength_Rv, rawValue);
        rawValue= 0;
        putValue(E_pubc_GW_GW_3B8_HU_RoadCurvatureFar_Rv, rawValue);
        break;
     case(1) :
        rawValue= 3;
        putValue(E_pubc_GW_GW_3B8_HU_Byroad_Rv, rawValue);
        rawValue= 1023;
        putValue(E_pubc_GW_GW_3B8_HU_RoadCurvature_Rv, rawValue);
        rawValue= 3;
        putValue(E_pubc_GW_GW_3B8_HU_EnterSlopeInfo_Rv, rawValue);
        rawValue= 3;
        putValue(E_pubc_GW_GW_3B8_HU_EnterTunnelInfo_Rv, rawValue);
        rawValue= 60;
        putValue(E_pubc_GW_GW_3B8_HU_SlopeDistance_Rv, rawValue);
        rawValue= 60;
        putValue(E_pubc_GW_GW_3B8_HU_TunnelDistance_Rv, rawValue);
        rawValue= 3;
        putValue(E_pubc_GW_GW_3B8_HU_NavGuiganceStatus_Rv, rawValue);
        rawValue= 63;
        putValue(E_pubc_GW_GW_3B8_HU_TunnelLength_Rv, rawValue);
        rawValue= 1023;
        putValue(E_pubc_GW_GW_3B8_HU_RoadCurvatureFar_Rv, rawValue);
        break;
     default :
        rawValue= 0;
        putValue(E_pubc_GW_GW_3B8_HU_Byroad_Rv, rawValue);
        rawValue= 0;
        putValue(E_pubc_GW_GW_3B8_HU_RoadCurvature_Rv, rawValue);
        rawValue= 0;
        putValue(E_pubc_GW_GW_3B8_HU_EnterSlopeInfo_Rv, rawValue);
        rawValue= 0;
        putValue(E_pubc_GW_GW_3B8_HU_EnterTunnelInfo_Rv, rawValue);
        rawValue= 0;
        putValue(E_pubc_GW_GW_3B8_HU_SlopeDistance_Rv, rawValue);
        rawValue= 0;
        putValue(E_pubc_GW_GW_3B8_HU_TunnelDistance_Rv, rawValue);
        rawValue= 0;
        putValue(E_pubc_GW_GW_3B8_HU_NavGuiganceStatus_Rv, rawValue);
        rawValue= 0;
        putValue(E_pubc_GW_GW_3B8_HU_TunnelLength_Rv, rawValue);
        rawValue= 0;
        putValue(E_pubc_GW_GW_3B8_HU_RoadCurvatureFar_Rv, rawValue);
      break;
   }
}

on envVar E_pubc_GW_GW_3B8_Dlc
{
    if(getValue(E_pubc_GW_GW_3B8_enDlc))
    {
        Msg_GW_3B8.dlc =getValue(this);
    }
    else
    {
        Msg_GW_3B8.dlc =8;
    }
}

on envVar E_pubc_GW_GW_3B8_enDlc
{
    //For Messages with DLC = 8, set wrong DLC to smaller than defined DLC
    //For Messages with DLC < 8 set wrong DLC to smaller/longer than defined DLC
    if(getValue(this))
    {
        Msg_GW_3B8.dlc =getValue(E_pubc_GW_GW_3B8_Dlc);
    }
    else
    {
        Msg_GW_3B8.dlc =8;
    }
}

on envVar E_pubc_GW_GW_3B8_HU_CRCCheck_3B8_wrongvalctr
{
    //update disturb count
    //disturb value range:(-1 = always send wrong value),( X>0 ,x is the number of Messages with wrong CHK sent)
    GW_3B8_HU_CRCCheck_3B8_wrongvalctr =getValue(this);    
}
on envVar E_pubc_GW_GW_3B8_HU_RollingCounter_3B8_wrongvalctr
{
    //update disturb count
    //disturb value range:(-1 = always send wrong value),( X>0 ,x is the number of Messages with wrong CHK sent)
    GW_3B8_HU_RollingCounter_3B8_wrongvalctr =getValue(this);    
}

on envVar E_pubc_GW_GW_3B8_HU_Byroad_Rv
{
    int64 rawValue = 0ll;
    float rawValue_float = 0.0;
    float phyValue = 0.0;        

    //set the signal with updated raw value
    if(getValue(E_pubc_GW_GW_3B8_HU_Byroad_SetVt)==0)
    {
        rawValue = getvalue(this);
        if(chgEv_GW_3B8_HU_Byroad == 0)
        {
            //type conversion to float
            rawValue_float = rawValue;        
            // raw to physical conversion
            phyValue = ((rawValue_float *1)+(0));
            putValue(E_pubc_GW_GW_3B8_HU_Byroad_Pv, phyValue);
            chgEv_GW_3B8_HU_Byroad = 1;
        }
        else
        {
            chgEv_GW_3B8_HU_Byroad = 0;
        }    
        //update the signal value
        Msg_GW_3B8.HU_Byroad=rawValue;        
    }                                                                           
}

on envVar E_pubc_GW_GW_3B8_HU_Byroad_Pv
{
    int64 rawValue = 0ll;
    float phyValue = 0.0;
    
    //update the raw value with physical value 
    if(getValue(E_pubc_GW_GW_3B8_HU_Byroad_SetVt)==0)
    {
        if(chgEv_GW_3B8_HU_Byroad == 0)
        {
            phyValue = getvalue(this);
            // physical to raw conversion
            rawValue = ((phyValue -(0))/1);
            putValue(E_pubc_GW_GW_3B8_HU_Byroad_Rv, rawValue);
            chgEv_GW_3B8_HU_Byroad = 1;  
        }
        else
        {
            chgEv_GW_3B8_HU_Byroad = 0;
        }
    }
}

on envVar E_pubc_GW_GW_3B8_HU_Byroad_Vt
{
    qword rawValue = 0ll;
    if(getValue(E_pubc_GW_GW_3B8_HU_Byroad_SetVt))
    {
        //update the signal value
        Msg_GW_3B8.HU_Byroad=getValue(this);
    }
}

on envVar E_pubc_GW_GW_3B8_HU_Byroad_SetVt
{
    if(getValue(E_pubc_GW_GW_3B8_HU_Byroad_SetVt))
    {
        //update the signal value
        Msg_GW_3B8.HU_Byroad=getvalue(E_pubc_GW_GW_3B8_HU_Byroad_Vt);
    }
    else
    {
        Msg_GW_3B8.HU_Byroad=getValue(E_pubc_GW_GW_3B8_HU_Byroad_Rv);
    }
}
 
on envVar E_pubc_GW_GW_3B8_HU_RoadCurvature_Rv
{
    int64 rawValue = 0ll;
    float rawValue_float = 0.0;
    float phyValue = 0.0;        

    //set the signal with updated raw value
    if(getValue(E_pubc_GW_GW_3B8_HU_RoadCurvature_SetVt)==0)
    {
        rawValue = getvalue(this);
        if(chgEv_GW_3B8_HU_RoadCurvature == 0)
        {
            //type conversion to float
            rawValue_float = rawValue;        
            // raw to physical conversion
            phyValue = ((rawValue_float *1)+(0));
            putValue(E_pubc_GW_GW_3B8_HU_RoadCurvature_Pv, phyValue);
            chgEv_GW_3B8_HU_RoadCurvature = 1;
        }
        else
        {
            chgEv_GW_3B8_HU_RoadCurvature = 0;
        }    
        //update the signal value
        Msg_GW_3B8.HU_RoadCurvature=rawValue;        
    }                                                                           
}

on envVar E_pubc_GW_GW_3B8_HU_RoadCurvature_Pv
{
    int64 rawValue = 0ll;
    float phyValue = 0.0;
    
    //update the raw value with physical value 
    if(getValue(E_pubc_GW_GW_3B8_HU_RoadCurvature_SetVt)==0)
    {
        if(chgEv_GW_3B8_HU_RoadCurvature == 0)
        {
            phyValue = getvalue(this);
            // physical to raw conversion
            rawValue = ((phyValue -(0))/1);
            putValue(E_pubc_GW_GW_3B8_HU_RoadCurvature_Rv, rawValue);
            chgEv_GW_3B8_HU_RoadCurvature = 1;  
        }
        else
        {
            chgEv_GW_3B8_HU_RoadCurvature = 0;
        }
    }
}

on envVar E_pubc_GW_GW_3B8_HU_RoadCurvature_Vt
{
    qword rawValue = 0ll;
    if(getValue(E_pubc_GW_GW_3B8_HU_RoadCurvature_SetVt))
    {
        //update the signal value
        Msg_GW_3B8.HU_RoadCurvature=getValue(this);
    }
}

on envVar E_pubc_GW_GW_3B8_HU_RoadCurvature_SetVt
{
    if(getValue(E_pubc_GW_GW_3B8_HU_RoadCurvature_SetVt))
    {
        //update the signal value
        Msg_GW_3B8.HU_RoadCurvature=getvalue(E_pubc_GW_GW_3B8_HU_RoadCurvature_Vt);
    }
    else
    {
        Msg_GW_3B8.HU_RoadCurvature=getValue(E_pubc_GW_GW_3B8_HU_RoadCurvature_Rv);
    }
}
 
on envVar E_pubc_GW_GW_3B8_HU_EnterSlopeInfo_Rv
{
    int64 rawValue = 0ll;
    float rawValue_float = 0.0;
    float phyValue = 0.0;        

    //set the signal with updated raw value
    if(getValue(E_pubc_GW_GW_3B8_HU_EnterSlopeInfo_SetVt)==0)
    {
        rawValue = getvalue(this);
        if(chgEv_GW_3B8_HU_EnterSlopeInfo == 0)
        {
            //type conversion to float
            rawValue_float = rawValue;        
            // raw to physical conversion
            phyValue = ((rawValue_float *1)+(0));
            putValue(E_pubc_GW_GW_3B8_HU_EnterSlopeInfo_Pv, phyValue);
            chgEv_GW_3B8_HU_EnterSlopeInfo = 1;
        }
        else
        {
            chgEv_GW_3B8_HU_EnterSlopeInfo = 0;
        }    
        //update the signal value
        Msg_GW_3B8.HU_EnterSlopeInfo=rawValue;        
    }                                                                           
}

on envVar E_pubc_GW_GW_3B8_HU_EnterSlopeInfo_Pv
{
    int64 rawValue = 0ll;
    float phyValue = 0.0;
    
    //update the raw value with physical value 
    if(getValue(E_pubc_GW_GW_3B8_HU_EnterSlopeInfo_SetVt)==0)
    {
        if(chgEv_GW_3B8_HU_EnterSlopeInfo == 0)
        {
            phyValue = getvalue(this);
            // physical to raw conversion
            rawValue = ((phyValue -(0))/1);
            putValue(E_pubc_GW_GW_3B8_HU_EnterSlopeInfo_Rv, rawValue);
            chgEv_GW_3B8_HU_EnterSlopeInfo = 1;  
        }
        else
        {
            chgEv_GW_3B8_HU_EnterSlopeInfo = 0;
        }
    }
}

on envVar E_pubc_GW_GW_3B8_HU_EnterSlopeInfo_Vt
{
    qword rawValue = 0ll;
    if(getValue(E_pubc_GW_GW_3B8_HU_EnterSlopeInfo_SetVt))
    {
        //update the signal value
        Msg_GW_3B8.HU_EnterSlopeInfo=getValue(this);
    }
}

on envVar E_pubc_GW_GW_3B8_HU_EnterSlopeInfo_SetVt
{
    if(getValue(E_pubc_GW_GW_3B8_HU_EnterSlopeInfo_SetVt))
    {
        //update the signal value
        Msg_GW_3B8.HU_EnterSlopeInfo=getvalue(E_pubc_GW_GW_3B8_HU_EnterSlopeInfo_Vt);
    }
    else
    {
        Msg_GW_3B8.HU_EnterSlopeInfo=getValue(E_pubc_GW_GW_3B8_HU_EnterSlopeInfo_Rv);
    }
}
 
on envVar E_pubc_GW_GW_3B8_HU_EnterTunnelInfo_Rv
{
    int64 rawValue = 0ll;
    float rawValue_float = 0.0;
    float phyValue = 0.0;        

    //set the signal with updated raw value
    if(getValue(E_pubc_GW_GW_3B8_HU_EnterTunnelInfo_SetVt)==0)
    {
        rawValue = getvalue(this);
        if(chgEv_GW_3B8_HU_EnterTunnelInfo == 0)
        {
            //type conversion to float
            rawValue_float = rawValue;        
            // raw to physical conversion
            phyValue = ((rawValue_float *1)+(0));
            putValue(E_pubc_GW_GW_3B8_HU_EnterTunnelInfo_Pv, phyValue);
            chgEv_GW_3B8_HU_EnterTunnelInfo = 1;
        }
        else
        {
            chgEv_GW_3B8_HU_EnterTunnelInfo = 0;
        }    
        //update the signal value
        Msg_GW_3B8.HU_EnterTunnelInfo=rawValue;        
    }                                                                           
}

on envVar E_pubc_GW_GW_3B8_HU_EnterTunnelInfo_Pv
{
    int64 rawValue = 0ll;
    float phyValue = 0.0;
    
    //update the raw value with physical value 
    if(getValue(E_pubc_GW_GW_3B8_HU_EnterTunnelInfo_SetVt)==0)
    {
        if(chgEv_GW_3B8_HU_EnterTunnelInfo == 0)
        {
            phyValue = getvalue(this);
            // physical to raw conversion
            rawValue = ((phyValue -(0))/1);
            putValue(E_pubc_GW_GW_3B8_HU_EnterTunnelInfo_Rv, rawValue);
            chgEv_GW_3B8_HU_EnterTunnelInfo = 1;  
        }
        else
        {
            chgEv_GW_3B8_HU_EnterTunnelInfo = 0;
        }
    }
}

on envVar E_pubc_GW_GW_3B8_HU_EnterTunnelInfo_Vt
{
    qword rawValue = 0ll;
    if(getValue(E_pubc_GW_GW_3B8_HU_EnterTunnelInfo_SetVt))
    {
        //update the signal value
        Msg_GW_3B8.HU_EnterTunnelInfo=getValue(this);
    }
}

on envVar E_pubc_GW_GW_3B8_HU_EnterTunnelInfo_SetVt
{
    if(getValue(E_pubc_GW_GW_3B8_HU_EnterTunnelInfo_SetVt))
    {
        //update the signal value
        Msg_GW_3B8.HU_EnterTunnelInfo=getvalue(E_pubc_GW_GW_3B8_HU_EnterTunnelInfo_Vt);
    }
    else
    {
        Msg_GW_3B8.HU_EnterTunnelInfo=getValue(E_pubc_GW_GW_3B8_HU_EnterTunnelInfo_Rv);
    }
}
 
on envVar E_pubc_GW_GW_3B8_HU_SlopeDistance_Rv
{
    int64 rawValue = 0ll;
    float rawValue_float = 0.0;
    float phyValue = 0.0;        

    //set the signal with updated raw value
    if(getValue(E_pubc_GW_GW_3B8_HU_SlopeDistance_SetVt)==0)
    {
        rawValue = getvalue(this);
        if(chgEv_GW_3B8_HU_SlopeDistance == 0)
        {
            //type conversion to float
            rawValue_float = rawValue;        
            // raw to physical conversion
            phyValue = ((rawValue_float *10)+(0));
            putValue(E_pubc_GW_GW_3B8_HU_SlopeDistance_Pv, phyValue);
            chgEv_GW_3B8_HU_SlopeDistance = 1;
        }
        else
        {
            chgEv_GW_3B8_HU_SlopeDistance = 0;
        }    
        //update the signal value
        Msg_GW_3B8.HU_SlopeDistance=rawValue;        
    }                                                                           
}

on envVar E_pubc_GW_GW_3B8_HU_SlopeDistance_Pv
{
    int64 rawValue = 0ll;
    float phyValue = 0.0;
    
    //update the raw value with physical value 
    if(getValue(E_pubc_GW_GW_3B8_HU_SlopeDistance_SetVt)==0)
    {
        if(chgEv_GW_3B8_HU_SlopeDistance == 0)
        {
            phyValue = getvalue(this);
            // physical to raw conversion
            rawValue = ((phyValue -(0))/10);
            putValue(E_pubc_GW_GW_3B8_HU_SlopeDistance_Rv, rawValue);
            chgEv_GW_3B8_HU_SlopeDistance = 1;  
        }
        else
        {
            chgEv_GW_3B8_HU_SlopeDistance = 0;
        }
    }
}

on envVar E_pubc_GW_GW_3B8_HU_SlopeDistance_Vt
{
    qword rawValue = 0ll;
    if(getValue(E_pubc_GW_GW_3B8_HU_SlopeDistance_SetVt))
    {
        //update the signal value
        Msg_GW_3B8.HU_SlopeDistance=getValue(this);
    }
}

on envVar E_pubc_GW_GW_3B8_HU_SlopeDistance_SetVt
{
    if(getValue(E_pubc_GW_GW_3B8_HU_SlopeDistance_SetVt))
    {
        //update the signal value
        Msg_GW_3B8.HU_SlopeDistance=getvalue(E_pubc_GW_GW_3B8_HU_SlopeDistance_Vt);
    }
    else
    {
        Msg_GW_3B8.HU_SlopeDistance=getValue(E_pubc_GW_GW_3B8_HU_SlopeDistance_Rv);
    }
}
 
on envVar E_pubc_GW_GW_3B8_HU_TunnelDistance_Rv
{
    int64 rawValue = 0ll;
    float rawValue_float = 0.0;
    float phyValue = 0.0;        

    //set the signal with updated raw value
    if(getValue(E_pubc_GW_GW_3B8_HU_TunnelDistance_SetVt)==0)
    {
        rawValue = getvalue(this);
        if(chgEv_GW_3B8_HU_TunnelDistance == 0)
        {
            //type conversion to float
            rawValue_float = rawValue;        
            // raw to physical conversion
            phyValue = ((rawValue_float *10)+(0));
            putValue(E_pubc_GW_GW_3B8_HU_TunnelDistance_Pv, phyValue);
            chgEv_GW_3B8_HU_TunnelDistance = 1;
        }
        else
        {
            chgEv_GW_3B8_HU_TunnelDistance = 0;
        }    
        //update the signal value
        Msg_GW_3B8.HU_TunnelDistance=rawValue;        
    }                                                                           
}

on envVar E_pubc_GW_GW_3B8_HU_TunnelDistance_Pv
{
    int64 rawValue = 0ll;
    float phyValue = 0.0;
    
    //update the raw value with physical value 
    if(getValue(E_pubc_GW_GW_3B8_HU_TunnelDistance_SetVt)==0)
    {
        if(chgEv_GW_3B8_HU_TunnelDistance == 0)
        {
            phyValue = getvalue(this);
            // physical to raw conversion
            rawValue = ((phyValue -(0))/10);
            putValue(E_pubc_GW_GW_3B8_HU_TunnelDistance_Rv, rawValue);
            chgEv_GW_3B8_HU_TunnelDistance = 1;  
        }
        else
        {
            chgEv_GW_3B8_HU_TunnelDistance = 0;
        }
    }
}

on envVar E_pubc_GW_GW_3B8_HU_TunnelDistance_Vt
{
    qword rawValue = 0ll;
    if(getValue(E_pubc_GW_GW_3B8_HU_TunnelDistance_SetVt))
    {
        //update the signal value
        Msg_GW_3B8.HU_TunnelDistance=getValue(this);
    }
}

on envVar E_pubc_GW_GW_3B8_HU_TunnelDistance_SetVt
{
    if(getValue(E_pubc_GW_GW_3B8_HU_TunnelDistance_SetVt))
    {
        //update the signal value
        Msg_GW_3B8.HU_TunnelDistance=getvalue(E_pubc_GW_GW_3B8_HU_TunnelDistance_Vt);
    }
    else
    {
        Msg_GW_3B8.HU_TunnelDistance=getValue(E_pubc_GW_GW_3B8_HU_TunnelDistance_Rv);
    }
}
 
on envVar E_pubc_GW_GW_3B8_HU_NavGuiganceStatus_Rv
{
    int64 rawValue = 0ll;
    float rawValue_float = 0.0;
    float phyValue = 0.0;        

    //set the signal with updated raw value
    if(getValue(E_pubc_GW_GW_3B8_HU_NavGuiganceStatus_SetVt)==0)
    {
        rawValue = getvalue(this);
        if(chgEv_GW_3B8_HU_NavGuiganceStatus == 0)
        {
            //type conversion to float
            rawValue_float = rawValue;        
            // raw to physical conversion
            phyValue = ((rawValue_float *1)+(0));
            putValue(E_pubc_GW_GW_3B8_HU_NavGuiganceStatus_Pv, phyValue);
            chgEv_GW_3B8_HU_NavGuiganceStatus = 1;
        }
        else
        {
            chgEv_GW_3B8_HU_NavGuiganceStatus = 0;
        }    
        //update the signal value
        Msg_GW_3B8.HU_NavGuiganceStatus=rawValue;        
    }                                                                           
}

on envVar E_pubc_GW_GW_3B8_HU_NavGuiganceStatus_Pv
{
    int64 rawValue = 0ll;
    float phyValue = 0.0;
    
    //update the raw value with physical value 
    if(getValue(E_pubc_GW_GW_3B8_HU_NavGuiganceStatus_SetVt)==0)
    {
        if(chgEv_GW_3B8_HU_NavGuiganceStatus == 0)
        {
            phyValue = getvalue(this);
            // physical to raw conversion
            rawValue = ((phyValue -(0))/1);
            putValue(E_pubc_GW_GW_3B8_HU_NavGuiganceStatus_Rv, rawValue);
            chgEv_GW_3B8_HU_NavGuiganceStatus = 1;  
        }
        else
        {
            chgEv_GW_3B8_HU_NavGuiganceStatus = 0;
        }
    }
}

on envVar E_pubc_GW_GW_3B8_HU_NavGuiganceStatus_Vt
{
    qword rawValue = 0ll;
    if(getValue(E_pubc_GW_GW_3B8_HU_NavGuiganceStatus_SetVt))
    {
        //update the signal value
        Msg_GW_3B8.HU_NavGuiganceStatus=getValue(this);
    }
}

on envVar E_pubc_GW_GW_3B8_HU_NavGuiganceStatus_SetVt
{
    if(getValue(E_pubc_GW_GW_3B8_HU_NavGuiganceStatus_SetVt))
    {
        //update the signal value
        Msg_GW_3B8.HU_NavGuiganceStatus=getvalue(E_pubc_GW_GW_3B8_HU_NavGuiganceStatus_Vt);
    }
    else
    {
        Msg_GW_3B8.HU_NavGuiganceStatus=getValue(E_pubc_GW_GW_3B8_HU_NavGuiganceStatus_Rv);
    }
}
 
on envVar E_pubc_GW_GW_3B8_HU_TunnelLength_Rv
{
    int64 rawValue = 0ll;
    float rawValue_float = 0.0;
    float phyValue = 0.0;        

    //set the signal with updated raw value
    if(getValue(E_pubc_GW_GW_3B8_HU_TunnelLength_SetVt)==0)
    {
        rawValue = getvalue(this);
        if(chgEv_GW_3B8_HU_TunnelLength == 0)
        {
            //type conversion to float
            rawValue_float = rawValue;        
            // raw to physical conversion
            phyValue = ((rawValue_float *1)+(0));
            putValue(E_pubc_GW_GW_3B8_HU_TunnelLength_Pv, phyValue);
            chgEv_GW_3B8_HU_TunnelLength = 1;
        }
        else
        {
            chgEv_GW_3B8_HU_TunnelLength = 0;
        }    
        //update the signal value
        Msg_GW_3B8.HU_TunnelLength=rawValue;        
    }                                                                           
}

on envVar E_pubc_GW_GW_3B8_HU_TunnelLength_Pv
{
    int64 rawValue = 0ll;
    float phyValue = 0.0;
    
    //update the raw value with physical value 
    if(getValue(E_pubc_GW_GW_3B8_HU_TunnelLength_SetVt)==0)
    {
        if(chgEv_GW_3B8_HU_TunnelLength == 0)
        {
            phyValue = getvalue(this);
            // physical to raw conversion
            rawValue = ((phyValue -(0))/1);
            putValue(E_pubc_GW_GW_3B8_HU_TunnelLength_Rv, rawValue);
            chgEv_GW_3B8_HU_TunnelLength = 1;  
        }
        else
        {
            chgEv_GW_3B8_HU_TunnelLength = 0;
        }
    }
}

on envVar E_pubc_GW_GW_3B8_HU_TunnelLength_Vt
{
    qword rawValue = 0ll;
    if(getValue(E_pubc_GW_GW_3B8_HU_TunnelLength_SetVt))
    {
        //update the signal value
        Msg_GW_3B8.HU_TunnelLength=getValue(this);
    }
}

on envVar E_pubc_GW_GW_3B8_HU_TunnelLength_SetVt
{
    if(getValue(E_pubc_GW_GW_3B8_HU_TunnelLength_SetVt))
    {
        //update the signal value
        Msg_GW_3B8.HU_TunnelLength=getvalue(E_pubc_GW_GW_3B8_HU_TunnelLength_Vt);
    }
    else
    {
        Msg_GW_3B8.HU_TunnelLength=getValue(E_pubc_GW_GW_3B8_HU_TunnelLength_Rv);
    }
}
 
on envVar E_pubc_GW_GW_3B8_HU_RoadCurvatureFar_Rv
{
    int64 rawValue = 0ll;
    float rawValue_float = 0.0;
    float phyValue = 0.0;        

    //set the signal with updated raw value
    if(getValue(E_pubc_GW_GW_3B8_HU_RoadCurvatureFar_SetVt)==0)
    {
        rawValue = getvalue(this);
        if(chgEv_GW_3B8_HU_RoadCurvatureFar == 0)
        {
            //type conversion to float
            rawValue_float = rawValue;        
            // raw to physical conversion
            phyValue = ((rawValue_float *1)+(0));
            putValue(E_pubc_GW_GW_3B8_HU_RoadCurvatureFar_Pv, phyValue);
            chgEv_GW_3B8_HU_RoadCurvatureFar = 1;
        }
        else
        {
            chgEv_GW_3B8_HU_RoadCurvatureFar = 0;
        }    
        //update the signal value
        Msg_GW_3B8.HU_RoadCurvatureFar=rawValue;        
    }                                                                           
}

on envVar E_pubc_GW_GW_3B8_HU_RoadCurvatureFar_Pv
{
    int64 rawValue = 0ll;
    float phyValue = 0.0;
    
    //update the raw value with physical value 
    if(getValue(E_pubc_GW_GW_3B8_HU_RoadCurvatureFar_SetVt)==0)
    {
        if(chgEv_GW_3B8_HU_RoadCurvatureFar == 0)
        {
            phyValue = getvalue(this);
            // physical to raw conversion
            rawValue = ((phyValue -(0))/1);
            putValue(E_pubc_GW_GW_3B8_HU_RoadCurvatureFar_Rv, rawValue);
            chgEv_GW_3B8_HU_RoadCurvatureFar = 1;  
        }
        else
        {
            chgEv_GW_3B8_HU_RoadCurvatureFar = 0;
        }
    }
}

on envVar E_pubc_GW_GW_3B8_HU_RoadCurvatureFar_Vt
{
    qword rawValue = 0ll;
    if(getValue(E_pubc_GW_GW_3B8_HU_RoadCurvatureFar_SetVt))
    {
        //update the signal value
        Msg_GW_3B8.HU_RoadCurvatureFar=getValue(this);
    }
}

on envVar E_pubc_GW_GW_3B8_HU_RoadCurvatureFar_SetVt
{
    if(getValue(E_pubc_GW_GW_3B8_HU_RoadCurvatureFar_SetVt))
    {
        //update the signal value
        Msg_GW_3B8.HU_RoadCurvatureFar=getvalue(E_pubc_GW_GW_3B8_HU_RoadCurvatureFar_Vt);
    }
    else
    {
        Msg_GW_3B8.HU_RoadCurvatureFar=getValue(E_pubc_GW_GW_3B8_HU_RoadCurvatureFar_Rv);
    }
}
 
on envVar E_pubc_GW_GW_387_tx
{
    if(getValue(this))
    {       
        

        output(Msg_GW_387);        
    }
}

on envVar E_pubc_GW_GW_387_Range
{
    qword rawstatus = 0ll;
    qword rawValue = 0ll;    
    
    rawstatus = getvalue(this);    
    // set all the signals with min raw /max raw /init raw
    switch (rawstatus) 
    {
     case(0) :
        rawValue= 0;
        putValue(E_pubc_GW_GW_387_BCM_FrontWiperStatus_Rv, rawValue);
        rawValue= 0;
        putValue(E_pubc_GW_GW_387_BCM_RainfallLevel_Rv, rawValue);
        break;
     case(1) :
        rawValue= 3;
        putValue(E_pubc_GW_GW_387_BCM_FrontWiperStatus_Rv, rawValue);
        rawValue= 15;
        putValue(E_pubc_GW_GW_387_BCM_RainfallLevel_Rv, rawValue);
        break;
     default :
        rawValue= 0;
        putValue(E_pubc_GW_GW_387_BCM_FrontWiperStatus_Rv, rawValue);
        rawValue= 0;
        putValue(E_pubc_GW_GW_387_BCM_RainfallLevel_Rv, rawValue);
      break;
   }
}

on envVar E_pubc_GW_GW_387_Dlc
{
    if(getValue(E_pubc_GW_GW_387_enDlc))
    {
        Msg_GW_387.dlc =getValue(this);
    }
    else
    {
        Msg_GW_387.dlc =8;
    }
}

on envVar E_pubc_GW_GW_387_enDlc
{
    //For Messages with DLC = 8, set wrong DLC to smaller than defined DLC
    //For Messages with DLC < 8 set wrong DLC to smaller/longer than defined DLC
    if(getValue(this))
    {
        Msg_GW_387.dlc =getValue(E_pubc_GW_GW_387_Dlc);
    }
    else
    {
        Msg_GW_387.dlc =8;
    }
}


on envVar E_pubc_GW_GW_387_BCM_FrontWiperStatus_Rv
{
    int64 rawValue = 0ll;
    float rawValue_float = 0.0;
    float phyValue = 0.0;        

    //set the signal with updated raw value
    if(getValue(E_pubc_GW_GW_387_BCM_FrontWiperStatus_SetVt)==0)
    {
        rawValue = getvalue(this);
        if(chgEv_GW_387_BCM_FrontWiperStatus == 0)
        {
            //type conversion to float
            rawValue_float = rawValue;        
            // raw to physical conversion
            phyValue = ((rawValue_float *1)+(0));
            putValue(E_pubc_GW_GW_387_BCM_FrontWiperStatus_Pv, phyValue);
            chgEv_GW_387_BCM_FrontWiperStatus = 1;
        }
        else
        {
            chgEv_GW_387_BCM_FrontWiperStatus = 0;
        }    
        //update the signal value
        Msg_GW_387.BCM_FrontWiperStatus=rawValue;        
    }                                                                           
}

on envVar E_pubc_GW_GW_387_BCM_FrontWiperStatus_Pv
{
    int64 rawValue = 0ll;
    float phyValue = 0.0;
    
    //update the raw value with physical value 
    if(getValue(E_pubc_GW_GW_387_BCM_FrontWiperStatus_SetVt)==0)
    {
        if(chgEv_GW_387_BCM_FrontWiperStatus == 0)
        {
            phyValue = getvalue(this);
            // physical to raw conversion
            rawValue = ((phyValue -(0))/1);
            putValue(E_pubc_GW_GW_387_BCM_FrontWiperStatus_Rv, rawValue);
            chgEv_GW_387_BCM_FrontWiperStatus = 1;  
        }
        else
        {
            chgEv_GW_387_BCM_FrontWiperStatus = 0;
        }
    }
}

on envVar E_pubc_GW_GW_387_BCM_FrontWiperStatus_Vt
{
    qword rawValue = 0ll;
    if(getValue(E_pubc_GW_GW_387_BCM_FrontWiperStatus_SetVt))
    {
        //update the signal value
        Msg_GW_387.BCM_FrontWiperStatus=getValue(this);
    }
}

on envVar E_pubc_GW_GW_387_BCM_FrontWiperStatus_SetVt
{
    if(getValue(E_pubc_GW_GW_387_BCM_FrontWiperStatus_SetVt))
    {
        //update the signal value
        Msg_GW_387.BCM_FrontWiperStatus=getvalue(E_pubc_GW_GW_387_BCM_FrontWiperStatus_Vt);
    }
    else
    {
        Msg_GW_387.BCM_FrontWiperStatus=getValue(E_pubc_GW_GW_387_BCM_FrontWiperStatus_Rv);
    }
}
 
on envVar E_pubc_GW_GW_387_BCM_RainfallLevel_Rv
{
    int64 rawValue = 0ll;
    float rawValue_float = 0.0;
    float phyValue = 0.0;        

    //set the signal with updated raw value
    if(getValue(E_pubc_GW_GW_387_BCM_RainfallLevel_SetVt)==0)
    {
        rawValue = getvalue(this);
        if(chgEv_GW_387_BCM_RainfallLevel == 0)
        {
            //type conversion to float
            rawValue_float = rawValue;        
            // raw to physical conversion
            phyValue = ((rawValue_float *1)+(0));
            putValue(E_pubc_GW_GW_387_BCM_RainfallLevel_Pv, phyValue);
            chgEv_GW_387_BCM_RainfallLevel = 1;
        }
        else
        {
            chgEv_GW_387_BCM_RainfallLevel = 0;
        }    
        //update the signal value
        Msg_GW_387.BCM_RainfallLevel=rawValue;        
    }                                                                           
}

on envVar E_pubc_GW_GW_387_BCM_RainfallLevel_Pv
{
    int64 rawValue = 0ll;
    float phyValue = 0.0;
    
    //update the raw value with physical value 
    if(getValue(E_pubc_GW_GW_387_BCM_RainfallLevel_SetVt)==0)
    {
        if(chgEv_GW_387_BCM_RainfallLevel == 0)
        {
            phyValue = getvalue(this);
            // physical to raw conversion
            rawValue = ((phyValue -(0))/1);
            putValue(E_pubc_GW_GW_387_BCM_RainfallLevel_Rv, rawValue);
            chgEv_GW_387_BCM_RainfallLevel = 1;  
        }
        else
        {
            chgEv_GW_387_BCM_RainfallLevel = 0;
        }
    }
}

on envVar E_pubc_GW_GW_387_BCM_RainfallLevel_Vt
{
    qword rawValue = 0ll;
    if(getValue(E_pubc_GW_GW_387_BCM_RainfallLevel_SetVt))
    {
        //update the signal value
        Msg_GW_387.BCM_RainfallLevel=getValue(this);
    }
}

on envVar E_pubc_GW_GW_387_BCM_RainfallLevel_SetVt
{
    if(getValue(E_pubc_GW_GW_387_BCM_RainfallLevel_SetVt))
    {
        //update the signal value
        Msg_GW_387.BCM_RainfallLevel=getvalue(E_pubc_GW_GW_387_BCM_RainfallLevel_Vt);
    }
    else
    {
        Msg_GW_387.BCM_RainfallLevel=getValue(E_pubc_GW_GW_387_BCM_RainfallLevel_Rv);
    }
}
 
on envVar E_pubc_GW_GW_3C4_tx
{
    if(getValue(this))
    {       
        
        //update the BZ Signal
        if(GW_3C4_HU_RollingCounter_3C4_wrongvalctr == 0)
        {
            update_GW_3C4_HU_RollingCounter_3C4_counter();
            Msg_GW_3C4.HU_RollingCounter_3C4= GW_3C4_HU_RollingCounter_3C4_counter;
        }
        else if(GW_3C4_HU_RollingCounter_3C4_wrongvalctr > 0)
        {
             GW_3C4_HU_RollingCounter_3C4_wrongvalctr--;
              // if counter becomes zero, update panel controller to zero
             if(GW_3C4_HU_RollingCounter_3C4_wrongvalctr == 0)
             {
                 putValue(E_pubc_GW_GW_3C4_HU_RollingCounter_3C4_wrongvalctr,0);
             }
        }
        else
        {
            //do nothing
        }        
        //calculate the CRC CheckSum
        update_GW_3C4_CRC_CheckSum();

        output(Msg_GW_3C4);        
    }
}

on envVar E_pubc_GW_GW_3C4_Range
{
    qword rawstatus = 0ll;
    qword rawValue = 0ll;    
    
    rawstatus = getvalue(this);    
    // set all the signals with min raw /max raw /init raw
    switch (rawstatus) 
    {
     case(0) :
        rawValue= 0;
        putValue(E_pubc_GW_GW_3C4_HU_RoadCurvature_30m_Rv, rawValue);
        rawValue= 0;
        putValue(E_pubc_GW_GW_3C4_HU_RoadCurvature_20m_Rv, rawValue);
        rawValue= 0;
        putValue(E_pubc_GW_GW_3C4_HU_To_NumchangeOfLanes_Dist_Rv, rawValue);
        rawValue= 0;
        putValue(E_pubc_GW_GW_3C4_HU_RoadCurvature_40m_Rv, rawValue);
        rawValue= 0;
        putValue(E_pubc_GW_GW_3C4_HU_RoadCurvature_10m_Rv, rawValue);
        rawValue= 0;
        putValue(E_pubc_GW_GW_3C4_HU_Lane_Changtype_Rv, rawValue);
        break;
     case(1) :
        rawValue= 1023;
        putValue(E_pubc_GW_GW_3C4_HU_RoadCurvature_30m_Rv, rawValue);
        rawValue= 1023;
        putValue(E_pubc_GW_GW_3C4_HU_RoadCurvature_20m_Rv, rawValue);
        rawValue= 60;
        putValue(E_pubc_GW_GW_3C4_HU_To_NumchangeOfLanes_Dist_Rv, rawValue);
        rawValue= 1023;
        putValue(E_pubc_GW_GW_3C4_HU_RoadCurvature_40m_Rv, rawValue);
        rawValue= 1023;
        putValue(E_pubc_GW_GW_3C4_HU_RoadCurvature_10m_Rv, rawValue);
        rawValue= 3;
        putValue(E_pubc_GW_GW_3C4_HU_Lane_Changtype_Rv, rawValue);
        break;
     default :
        rawValue= 0;
        putValue(E_pubc_GW_GW_3C4_HU_RoadCurvature_30m_Rv, rawValue);
        rawValue= 0;
        putValue(E_pubc_GW_GW_3C4_HU_RoadCurvature_20m_Rv, rawValue);
        rawValue= 0;
        putValue(E_pubc_GW_GW_3C4_HU_To_NumchangeOfLanes_Dist_Rv, rawValue);
        rawValue= 0;
        putValue(E_pubc_GW_GW_3C4_HU_RoadCurvature_40m_Rv, rawValue);
        rawValue= 0;
        putValue(E_pubc_GW_GW_3C4_HU_RoadCurvature_10m_Rv, rawValue);
        rawValue= 0;
        putValue(E_pubc_GW_GW_3C4_HU_Lane_Changtype_Rv, rawValue);
      break;
   }
}

on envVar E_pubc_GW_GW_3C4_Dlc
{
    if(getValue(E_pubc_GW_GW_3C4_enDlc))
    {
        Msg_GW_3C4.dlc =getValue(this);
    }
    else
    {
        Msg_GW_3C4.dlc =8;
    }
}

on envVar E_pubc_GW_GW_3C4_enDlc
{
    //For Messages with DLC = 8, set wrong DLC to smaller than defined DLC
    //For Messages with DLC < 8 set wrong DLC to smaller/longer than defined DLC
    if(getValue(this))
    {
        Msg_GW_3C4.dlc =getValue(E_pubc_GW_GW_3C4_Dlc);
    }
    else
    {
        Msg_GW_3C4.dlc =8;
    }
}

on envVar E_pubc_GW_GW_3C4_HU_CRCCheck_3C4_wrongvalctr
{
    //update disturb count
    //disturb value range:(-1 = always send wrong value),( X>0 ,x is the number of Messages with wrong CHK sent)
    GW_3C4_HU_CRCCheck_3C4_wrongvalctr =getValue(this);    
}
on envVar E_pubc_GW_GW_3C4_HU_RollingCounter_3C4_wrongvalctr
{
    //update disturb count
    //disturb value range:(-1 = always send wrong value),( X>0 ,x is the number of Messages with wrong CHK sent)
    GW_3C4_HU_RollingCounter_3C4_wrongvalctr =getValue(this);    
}

on envVar E_pubc_GW_GW_3C4_HU_RoadCurvature_30m_Rv
{
    int64 rawValue = 0ll;
    float rawValue_float = 0.0;
    float phyValue = 0.0;        

    //set the signal with updated raw value
    if(getValue(E_pubc_GW_GW_3C4_HU_RoadCurvature_30m_SetVt)==0)
    {
        rawValue = getvalue(this);
        if(chgEv_GW_3C4_HU_RoadCurvature_30m == 0)
        {
            //type conversion to float
            rawValue_float = rawValue;        
            // raw to physical conversion
            phyValue = ((rawValue_float *1)+(0));
            putValue(E_pubc_GW_GW_3C4_HU_RoadCurvature_30m_Pv, phyValue);
            chgEv_GW_3C4_HU_RoadCurvature_30m = 1;
        }
        else
        {
            chgEv_GW_3C4_HU_RoadCurvature_30m = 0;
        }    
        //update the signal value
        Msg_GW_3C4.HU_RoadCurvature_30m=rawValue;        
    }                                                                           
}

on envVar E_pubc_GW_GW_3C4_HU_RoadCurvature_30m_Pv
{
    int64 rawValue = 0ll;
    float phyValue = 0.0;
    
    //update the raw value with physical value 
    if(getValue(E_pubc_GW_GW_3C4_HU_RoadCurvature_30m_SetVt)==0)
    {
        if(chgEv_GW_3C4_HU_RoadCurvature_30m == 0)
        {
            phyValue = getvalue(this);
            // physical to raw conversion
            rawValue = ((phyValue -(0))/1);
            putValue(E_pubc_GW_GW_3C4_HU_RoadCurvature_30m_Rv, rawValue);
            chgEv_GW_3C4_HU_RoadCurvature_30m = 1;  
        }
        else
        {
            chgEv_GW_3C4_HU_RoadCurvature_30m = 0;
        }
    }
}

on envVar E_pubc_GW_GW_3C4_HU_RoadCurvature_30m_Vt
{
    qword rawValue = 0ll;
    if(getValue(E_pubc_GW_GW_3C4_HU_RoadCurvature_30m_SetVt))
    {
        //update the signal value
        Msg_GW_3C4.HU_RoadCurvature_30m=getValue(this);
    }
}

on envVar E_pubc_GW_GW_3C4_HU_RoadCurvature_30m_SetVt
{
    if(getValue(E_pubc_GW_GW_3C4_HU_RoadCurvature_30m_SetVt))
    {
        //update the signal value
        Msg_GW_3C4.HU_RoadCurvature_30m=getvalue(E_pubc_GW_GW_3C4_HU_RoadCurvature_30m_Vt);
    }
    else
    {
        Msg_GW_3C4.HU_RoadCurvature_30m=getValue(E_pubc_GW_GW_3C4_HU_RoadCurvature_30m_Rv);
    }
}
 
on envVar E_pubc_GW_GW_3C4_HU_RoadCurvature_20m_Rv
{
    int64 rawValue = 0ll;
    float rawValue_float = 0.0;
    float phyValue = 0.0;        

    //set the signal with updated raw value
    if(getValue(E_pubc_GW_GW_3C4_HU_RoadCurvature_20m_SetVt)==0)
    {
        rawValue = getvalue(this);
        if(chgEv_GW_3C4_HU_RoadCurvature_20m == 0)
        {
            //type conversion to float
            rawValue_float = rawValue;        
            // raw to physical conversion
            phyValue = ((rawValue_float *1)+(0));
            putValue(E_pubc_GW_GW_3C4_HU_RoadCurvature_20m_Pv, phyValue);
            chgEv_GW_3C4_HU_RoadCurvature_20m = 1;
        }
        else
        {
            chgEv_GW_3C4_HU_RoadCurvature_20m = 0;
        }    
        //update the signal value
        Msg_GW_3C4.HU_RoadCurvature_20m=rawValue;        
    }                                                                           
}

on envVar E_pubc_GW_GW_3C4_HU_RoadCurvature_20m_Pv
{
    int64 rawValue = 0ll;
    float phyValue = 0.0;
    
    //update the raw value with physical value 
    if(getValue(E_pubc_GW_GW_3C4_HU_RoadCurvature_20m_SetVt)==0)
    {
        if(chgEv_GW_3C4_HU_RoadCurvature_20m == 0)
        {
            phyValue = getvalue(this);
            // physical to raw conversion
            rawValue = ((phyValue -(0))/1);
            putValue(E_pubc_GW_GW_3C4_HU_RoadCurvature_20m_Rv, rawValue);
            chgEv_GW_3C4_HU_RoadCurvature_20m = 1;  
        }
        else
        {
            chgEv_GW_3C4_HU_RoadCurvature_20m = 0;
        }
    }
}

on envVar E_pubc_GW_GW_3C4_HU_RoadCurvature_20m_Vt
{
    qword rawValue = 0ll;
    if(getValue(E_pubc_GW_GW_3C4_HU_RoadCurvature_20m_SetVt))
    {
        //update the signal value
        Msg_GW_3C4.HU_RoadCurvature_20m=getValue(this);
    }
}

on envVar E_pubc_GW_GW_3C4_HU_RoadCurvature_20m_SetVt
{
    if(getValue(E_pubc_GW_GW_3C4_HU_RoadCurvature_20m_SetVt))
    {
        //update the signal value
        Msg_GW_3C4.HU_RoadCurvature_20m=getvalue(E_pubc_GW_GW_3C4_HU_RoadCurvature_20m_Vt);
    }
    else
    {
        Msg_GW_3C4.HU_RoadCurvature_20m=getValue(E_pubc_GW_GW_3C4_HU_RoadCurvature_20m_Rv);
    }
}
 
on envVar E_pubc_GW_GW_3C4_HU_To_NumchangeOfLanes_Dist_Rv
{
    int64 rawValue = 0ll;
    float rawValue_float = 0.0;
    float phyValue = 0.0;        

    //set the signal with updated raw value
    if(getValue(E_pubc_GW_GW_3C4_HU_To_NumchangeOfLanes_Dist_SetVt)==0)
    {
        rawValue = getvalue(this);
        if(chgEv_GW_3C4_HU_To_NumchangeOfLanes_Dist == 0)
        {
            //type conversion to float
            rawValue_float = rawValue;        
            // raw to physical conversion
            phyValue = ((rawValue_float *10)+(0));
            putValue(E_pubc_GW_GW_3C4_HU_To_NumchangeOfLanes_Dist_Pv, phyValue);
            chgEv_GW_3C4_HU_To_NumchangeOfLanes_Dist = 1;
        }
        else
        {
            chgEv_GW_3C4_HU_To_NumchangeOfLanes_Dist = 0;
        }    
        //update the signal value
        Msg_GW_3C4.HU_To_NumchangeOfLanes_Dist=rawValue;        
    }                                                                           
}

on envVar E_pubc_GW_GW_3C4_HU_To_NumchangeOfLanes_Dist_Pv
{
    int64 rawValue = 0ll;
    float phyValue = 0.0;
    
    //update the raw value with physical value 
    if(getValue(E_pubc_GW_GW_3C4_HU_To_NumchangeOfLanes_Dist_SetVt)==0)
    {
        if(chgEv_GW_3C4_HU_To_NumchangeOfLanes_Dist == 0)
        {
            phyValue = getvalue(this);
            // physical to raw conversion
            rawValue = ((phyValue -(0))/10);
            putValue(E_pubc_GW_GW_3C4_HU_To_NumchangeOfLanes_Dist_Rv, rawValue);
            chgEv_GW_3C4_HU_To_NumchangeOfLanes_Dist = 1;  
        }
        else
        {
            chgEv_GW_3C4_HU_To_NumchangeOfLanes_Dist = 0;
        }
    }
}

on envVar E_pubc_GW_GW_3C4_HU_To_NumchangeOfLanes_Dist_Vt
{
    qword rawValue = 0ll;
    if(getValue(E_pubc_GW_GW_3C4_HU_To_NumchangeOfLanes_Dist_SetVt))
    {
        //update the signal value
        Msg_GW_3C4.HU_To_NumchangeOfLanes_Dist=getValue(this);
    }
}

on envVar E_pubc_GW_GW_3C4_HU_To_NumchangeOfLanes_Dist_SetVt
{
    if(getValue(E_pubc_GW_GW_3C4_HU_To_NumchangeOfLanes_Dist_SetVt))
    {
        //update the signal value
        Msg_GW_3C4.HU_To_NumchangeOfLanes_Dist=getvalue(E_pubc_GW_GW_3C4_HU_To_NumchangeOfLanes_Dist_Vt);
    }
    else
    {
        Msg_GW_3C4.HU_To_NumchangeOfLanes_Dist=getValue(E_pubc_GW_GW_3C4_HU_To_NumchangeOfLanes_Dist_Rv);
    }
}
 
on envVar E_pubc_GW_GW_3C4_HU_RoadCurvature_40m_Rv
{
    int64 rawValue = 0ll;
    float rawValue_float = 0.0;
    float phyValue = 0.0;        

    //set the signal with updated raw value
    if(getValue(E_pubc_GW_GW_3C4_HU_RoadCurvature_40m_SetVt)==0)
    {
        rawValue = getvalue(this);
        if(chgEv_GW_3C4_HU_RoadCurvature_40m == 0)
        {
            //type conversion to float
            rawValue_float = rawValue;        
            // raw to physical conversion
            phyValue = ((rawValue_float *1)+(0));
            putValue(E_pubc_GW_GW_3C4_HU_RoadCurvature_40m_Pv, phyValue);
            chgEv_GW_3C4_HU_RoadCurvature_40m = 1;
        }
        else
        {
            chgEv_GW_3C4_HU_RoadCurvature_40m = 0;
        }    
        //update the signal value
        Msg_GW_3C4.HU_RoadCurvature_40m=rawValue;        
    }                                                                           
}

on envVar E_pubc_GW_GW_3C4_HU_RoadCurvature_40m_Pv
{
    int64 rawValue = 0ll;
    float phyValue = 0.0;
    
    //update the raw value with physical value 
    if(getValue(E_pubc_GW_GW_3C4_HU_RoadCurvature_40m_SetVt)==0)
    {
        if(chgEv_GW_3C4_HU_RoadCurvature_40m == 0)
        {
            phyValue = getvalue(this);
            // physical to raw conversion
            rawValue = ((phyValue -(0))/1);
            putValue(E_pubc_GW_GW_3C4_HU_RoadCurvature_40m_Rv, rawValue);
            chgEv_GW_3C4_HU_RoadCurvature_40m = 1;  
        }
        else
        {
            chgEv_GW_3C4_HU_RoadCurvature_40m = 0;
        }
    }
}

on envVar E_pubc_GW_GW_3C4_HU_RoadCurvature_40m_Vt
{
    qword rawValue = 0ll;
    if(getValue(E_pubc_GW_GW_3C4_HU_RoadCurvature_40m_SetVt))
    {
        //update the signal value
        Msg_GW_3C4.HU_RoadCurvature_40m=getValue(this);
    }
}

on envVar E_pubc_GW_GW_3C4_HU_RoadCurvature_40m_SetVt
{
    if(getValue(E_pubc_GW_GW_3C4_HU_RoadCurvature_40m_SetVt))
    {
        //update the signal value
        Msg_GW_3C4.HU_RoadCurvature_40m=getvalue(E_pubc_GW_GW_3C4_HU_RoadCurvature_40m_Vt);
    }
    else
    {
        Msg_GW_3C4.HU_RoadCurvature_40m=getValue(E_pubc_GW_GW_3C4_HU_RoadCurvature_40m_Rv);
    }
}
 
on envVar E_pubc_GW_GW_3C4_HU_RoadCurvature_10m_Rv
{
    int64 rawValue = 0ll;
    float rawValue_float = 0.0;
    float phyValue = 0.0;        

    //set the signal with updated raw value
    if(getValue(E_pubc_GW_GW_3C4_HU_RoadCurvature_10m_SetVt)==0)
    {
        rawValue = getvalue(this);
        if(chgEv_GW_3C4_HU_RoadCurvature_10m == 0)
        {
            //type conversion to float
            rawValue_float = rawValue;        
            // raw to physical conversion
            phyValue = ((rawValue_float *1)+(0));
            putValue(E_pubc_GW_GW_3C4_HU_RoadCurvature_10m_Pv, phyValue);
            chgEv_GW_3C4_HU_RoadCurvature_10m = 1;
        }
        else
        {
            chgEv_GW_3C4_HU_RoadCurvature_10m = 0;
        }    
        //update the signal value
        Msg_GW_3C4.HU_RoadCurvature_10m=rawValue;        
    }                                                                           
}

on envVar E_pubc_GW_GW_3C4_HU_RoadCurvature_10m_Pv
{
    int64 rawValue = 0ll;
    float phyValue = 0.0;
    
    //update the raw value with physical value 
    if(getValue(E_pubc_GW_GW_3C4_HU_RoadCurvature_10m_SetVt)==0)
    {
        if(chgEv_GW_3C4_HU_RoadCurvature_10m == 0)
        {
            phyValue = getvalue(this);
            // physical to raw conversion
            rawValue = ((phyValue -(0))/1);
            putValue(E_pubc_GW_GW_3C4_HU_RoadCurvature_10m_Rv, rawValue);
            chgEv_GW_3C4_HU_RoadCurvature_10m = 1;  
        }
        else
        {
            chgEv_GW_3C4_HU_RoadCurvature_10m = 0;
        }
    }
}

on envVar E_pubc_GW_GW_3C4_HU_RoadCurvature_10m_Vt
{
    qword rawValue = 0ll;
    if(getValue(E_pubc_GW_GW_3C4_HU_RoadCurvature_10m_SetVt))
    {
        //update the signal value
        Msg_GW_3C4.HU_RoadCurvature_10m=getValue(this);
    }
}

on envVar E_pubc_GW_GW_3C4_HU_RoadCurvature_10m_SetVt
{
    if(getValue(E_pubc_GW_GW_3C4_HU_RoadCurvature_10m_SetVt))
    {
        //update the signal value
        Msg_GW_3C4.HU_RoadCurvature_10m=getvalue(E_pubc_GW_GW_3C4_HU_RoadCurvature_10m_Vt);
    }
    else
    {
        Msg_GW_3C4.HU_RoadCurvature_10m=getValue(E_pubc_GW_GW_3C4_HU_RoadCurvature_10m_Rv);
    }
}
 
on envVar E_pubc_GW_GW_3C4_HU_Lane_Changtype_Rv
{
    int64 rawValue = 0ll;
    float rawValue_float = 0.0;
    float phyValue = 0.0;        

    //set the signal with updated raw value
    if(getValue(E_pubc_GW_GW_3C4_HU_Lane_Changtype_SetVt)==0)
    {
        rawValue = getvalue(this);
        if(chgEv_GW_3C4_HU_Lane_Changtype == 0)
        {
            //type conversion to float
            rawValue_float = rawValue;        
            // raw to physical conversion
            phyValue = ((rawValue_float *1)+(0));
            putValue(E_pubc_GW_GW_3C4_HU_Lane_Changtype_Pv, phyValue);
            chgEv_GW_3C4_HU_Lane_Changtype = 1;
        }
        else
        {
            chgEv_GW_3C4_HU_Lane_Changtype = 0;
        }    
        //update the signal value
        Msg_GW_3C4.HU_Lane_Changtype=rawValue;        
    }                                                                           
}

on envVar E_pubc_GW_GW_3C4_HU_Lane_Changtype_Pv
{
    int64 rawValue = 0ll;
    float phyValue = 0.0;
    
    //update the raw value with physical value 
    if(getValue(E_pubc_GW_GW_3C4_HU_Lane_Changtype_SetVt)==0)
    {
        if(chgEv_GW_3C4_HU_Lane_Changtype == 0)
        {
            phyValue = getvalue(this);
            // physical to raw conversion
            rawValue = ((phyValue -(0))/1);
            putValue(E_pubc_GW_GW_3C4_HU_Lane_Changtype_Rv, rawValue);
            chgEv_GW_3C4_HU_Lane_Changtype = 1;  
        }
        else
        {
            chgEv_GW_3C4_HU_Lane_Changtype = 0;
        }
    }
}

on envVar E_pubc_GW_GW_3C4_HU_Lane_Changtype_Vt
{
    qword rawValue = 0ll;
    if(getValue(E_pubc_GW_GW_3C4_HU_Lane_Changtype_SetVt))
    {
        //update the signal value
        Msg_GW_3C4.HU_Lane_Changtype=getValue(this);
    }
}

on envVar E_pubc_GW_GW_3C4_HU_Lane_Changtype_SetVt
{
    if(getValue(E_pubc_GW_GW_3C4_HU_Lane_Changtype_SetVt))
    {
        //update the signal value
        Msg_GW_3C4.HU_Lane_Changtype=getvalue(E_pubc_GW_GW_3C4_HU_Lane_Changtype_Vt);
    }
    else
    {
        Msg_GW_3C4.HU_Lane_Changtype=getValue(E_pubc_GW_GW_3C4_HU_Lane_Changtype_Rv);
    }
}
 
on envVar E_pubc_GW_GW_3FF_tx
{
    if(getValue(this))
    {       
        

        output(Msg_GW_3FF);        
    }
}

on envVar E_pubc_GW_GW_3FF_Range
{
    qword rawstatus = 0ll;
    qword rawValue = 0ll;    
    
    rawstatus = getvalue(this);    
    // set all the signals with min raw /max raw /init raw
    switch (rawstatus) 
    {
     case(0) :
        rawValue= 0;
        putValue(E_pubc_GW_GW_3FF_BCM_FrontFoglampStatus_Rv, rawValue);
        rawValue= 0;
        putValue(E_pubc_GW_GW_3FF_BCM_RearFoglampStatus_Rv, rawValue);
        rawValue= 0;
        putValue(E_pubc_GW_GW_3FF_BCM_AutoHeadlightSts_Rv, rawValue);
        break;
     case(1) :
        rawValue= 3;
        putValue(E_pubc_GW_GW_3FF_BCM_FrontFoglampStatus_Rv, rawValue);
        rawValue= 3;
        putValue(E_pubc_GW_GW_3FF_BCM_RearFoglampStatus_Rv, rawValue);
        rawValue= 1;
        putValue(E_pubc_GW_GW_3FF_BCM_AutoHeadlightSts_Rv, rawValue);
        break;
     default :
        rawValue= 0;
        putValue(E_pubc_GW_GW_3FF_BCM_FrontFoglampStatus_Rv, rawValue);
        rawValue= 0;
        putValue(E_pubc_GW_GW_3FF_BCM_RearFoglampStatus_Rv, rawValue);
        rawValue= 0;
        putValue(E_pubc_GW_GW_3FF_BCM_AutoHeadlightSts_Rv, rawValue);
      break;
   }
}

on envVar E_pubc_GW_GW_3FF_Dlc
{
    if(getValue(E_pubc_GW_GW_3FF_enDlc))
    {
        Msg_GW_3FF.dlc =getValue(this);
    }
    else
    {
        Msg_GW_3FF.dlc =8;
    }
}

on envVar E_pubc_GW_GW_3FF_enDlc
{
    //For Messages with DLC = 8, set wrong DLC to smaller than defined DLC
    //For Messages with DLC < 8 set wrong DLC to smaller/longer than defined DLC
    if(getValue(this))
    {
        Msg_GW_3FF.dlc =getValue(E_pubc_GW_GW_3FF_Dlc);
    }
    else
    {
        Msg_GW_3FF.dlc =8;
    }
}


on envVar E_pubc_GW_GW_3FF_BCM_FrontFoglampStatus_Rv
{
    int64 rawValue = 0ll;
    float rawValue_float = 0.0;
    float phyValue = 0.0;        

    //set the signal with updated raw value
    if(getValue(E_pubc_GW_GW_3FF_BCM_FrontFoglampStatus_SetVt)==0)
    {
        rawValue = getvalue(this);
        if(chgEv_GW_3FF_BCM_FrontFoglampStatus == 0)
        {
            //type conversion to float
            rawValue_float = rawValue;        
            // raw to physical conversion
            phyValue = ((rawValue_float *1)+(0));
            putValue(E_pubc_GW_GW_3FF_BCM_FrontFoglampStatus_Pv, phyValue);
            chgEv_GW_3FF_BCM_FrontFoglampStatus = 1;
        }
        else
        {
            chgEv_GW_3FF_BCM_FrontFoglampStatus = 0;
        }    
        //update the signal value
        Msg_GW_3FF.BCM_FrontFoglampStatus=rawValue;        
    }                                                                           
}

on envVar E_pubc_GW_GW_3FF_BCM_FrontFoglampStatus_Pv
{
    int64 rawValue = 0ll;
    float phyValue = 0.0;
    
    //update the raw value with physical value 
    if(getValue(E_pubc_GW_GW_3FF_BCM_FrontFoglampStatus_SetVt)==0)
    {
        if(chgEv_GW_3FF_BCM_FrontFoglampStatus == 0)
        {
            phyValue = getvalue(this);
            // physical to raw conversion
            rawValue = ((phyValue -(0))/1);
            putValue(E_pubc_GW_GW_3FF_BCM_FrontFoglampStatus_Rv, rawValue);
            chgEv_GW_3FF_BCM_FrontFoglampStatus = 1;  
        }
        else
        {
            chgEv_GW_3FF_BCM_FrontFoglampStatus = 0;
        }
    }
}

on envVar E_pubc_GW_GW_3FF_BCM_FrontFoglampStatus_Vt
{
    qword rawValue = 0ll;
    if(getValue(E_pubc_GW_GW_3FF_BCM_FrontFoglampStatus_SetVt))
    {
        //update the signal value
        Msg_GW_3FF.BCM_FrontFoglampStatus=getValue(this);
    }
}

on envVar E_pubc_GW_GW_3FF_BCM_FrontFoglampStatus_SetVt
{
    if(getValue(E_pubc_GW_GW_3FF_BCM_FrontFoglampStatus_SetVt))
    {
        //update the signal value
        Msg_GW_3FF.BCM_FrontFoglampStatus=getvalue(E_pubc_GW_GW_3FF_BCM_FrontFoglampStatus_Vt);
    }
    else
    {
        Msg_GW_3FF.BCM_FrontFoglampStatus=getValue(E_pubc_GW_GW_3FF_BCM_FrontFoglampStatus_Rv);
    }
}
 
on envVar E_pubc_GW_GW_3FF_BCM_RearFoglampStatus_Rv
{
    int64 rawValue = 0ll;
    float rawValue_float = 0.0;
    float phyValue = 0.0;        

    //set the signal with updated raw value
    if(getValue(E_pubc_GW_GW_3FF_BCM_RearFoglampStatus_SetVt)==0)
    {
        rawValue = getvalue(this);
        if(chgEv_GW_3FF_BCM_RearFoglampStatus == 0)
        {
            //type conversion to float
            rawValue_float = rawValue;        
            // raw to physical conversion
            phyValue = ((rawValue_float *1)+(0));
            putValue(E_pubc_GW_GW_3FF_BCM_RearFoglampStatus_Pv, phyValue);
            chgEv_GW_3FF_BCM_RearFoglampStatus = 1;
        }
        else
        {
            chgEv_GW_3FF_BCM_RearFoglampStatus = 0;
        }    
        //update the signal value
        Msg_GW_3FF.BCM_RearFoglampStatus=rawValue;        
    }                                                                           
}

on envVar E_pubc_GW_GW_3FF_BCM_RearFoglampStatus_Pv
{
    int64 rawValue = 0ll;
    float phyValue = 0.0;
    
    //update the raw value with physical value 
    if(getValue(E_pubc_GW_GW_3FF_BCM_RearFoglampStatus_SetVt)==0)
    {
        if(chgEv_GW_3FF_BCM_RearFoglampStatus == 0)
        {
            phyValue = getvalue(this);
            // physical to raw conversion
            rawValue = ((phyValue -(0))/1);
            putValue(E_pubc_GW_GW_3FF_BCM_RearFoglampStatus_Rv, rawValue);
            chgEv_GW_3FF_BCM_RearFoglampStatus = 1;  
        }
        else
        {
            chgEv_GW_3FF_BCM_RearFoglampStatus = 0;
        }
    }
}

on envVar E_pubc_GW_GW_3FF_BCM_RearFoglampStatus_Vt
{
    qword rawValue = 0ll;
    if(getValue(E_pubc_GW_GW_3FF_BCM_RearFoglampStatus_SetVt))
    {
        //update the signal value
        Msg_GW_3FF.BCM_RearFoglampStatus=getValue(this);
    }
}

on envVar E_pubc_GW_GW_3FF_BCM_RearFoglampStatus_SetVt
{
    if(getValue(E_pubc_GW_GW_3FF_BCM_RearFoglampStatus_SetVt))
    {
        //update the signal value
        Msg_GW_3FF.BCM_RearFoglampStatus=getvalue(E_pubc_GW_GW_3FF_BCM_RearFoglampStatus_Vt);
    }
    else
    {
        Msg_GW_3FF.BCM_RearFoglampStatus=getValue(E_pubc_GW_GW_3FF_BCM_RearFoglampStatus_Rv);
    }
}
 
on envVar E_pubc_GW_GW_3FF_BCM_AutoHeadlightSts_Rv
{
    int64 rawValue = 0ll;
    float rawValue_float = 0.0;
    float phyValue = 0.0;        

    //set the signal with updated raw value
    if(getValue(E_pubc_GW_GW_3FF_BCM_AutoHeadlightSts_SetVt)==0)
    {
        rawValue = getvalue(this);
        if(chgEv_GW_3FF_BCM_AutoHeadlightSts == 0)
        {
            //type conversion to float
            rawValue_float = rawValue;        
            // raw to physical conversion
            phyValue = ((rawValue_float *1)+(0));
            putValue(E_pubc_GW_GW_3FF_BCM_AutoHeadlightSts_Pv, phyValue);
            chgEv_GW_3FF_BCM_AutoHeadlightSts = 1;
        }
        else
        {
            chgEv_GW_3FF_BCM_AutoHeadlightSts = 0;
        }    
        //update the signal value
        Msg_GW_3FF.BCM_AutoHeadlightSts=rawValue;        
    }                                                                           
}

on envVar E_pubc_GW_GW_3FF_BCM_AutoHeadlightSts_Pv
{
    int64 rawValue = 0ll;
    float phyValue = 0.0;
    
    //update the raw value with physical value 
    if(getValue(E_pubc_GW_GW_3FF_BCM_AutoHeadlightSts_SetVt)==0)
    {
        if(chgEv_GW_3FF_BCM_AutoHeadlightSts == 0)
        {
            phyValue = getvalue(this);
            // physical to raw conversion
            rawValue = ((phyValue -(0))/1);
            putValue(E_pubc_GW_GW_3FF_BCM_AutoHeadlightSts_Rv, rawValue);
            chgEv_GW_3FF_BCM_AutoHeadlightSts = 1;  
        }
        else
        {
            chgEv_GW_3FF_BCM_AutoHeadlightSts = 0;
        }
    }
}

on envVar E_pubc_GW_GW_3FF_BCM_AutoHeadlightSts_Vt
{
    qword rawValue = 0ll;
    if(getValue(E_pubc_GW_GW_3FF_BCM_AutoHeadlightSts_SetVt))
    {
        //update the signal value
        Msg_GW_3FF.BCM_AutoHeadlightSts=getValue(this);
    }
}

on envVar E_pubc_GW_GW_3FF_BCM_AutoHeadlightSts_SetVt
{
    if(getValue(E_pubc_GW_GW_3FF_BCM_AutoHeadlightSts_SetVt))
    {
        //update the signal value
        Msg_GW_3FF.BCM_AutoHeadlightSts=getvalue(E_pubc_GW_GW_3FF_BCM_AutoHeadlightSts_Vt);
    }
    else
    {
        Msg_GW_3FF.BCM_AutoHeadlightSts=getValue(E_pubc_GW_GW_3FF_BCM_AutoHeadlightSts_Rv);
    }
}
 
on envVar E_pubc_GW_GW_50_tx
{
    if(getValue(this))
    {       
        
        //update the BZ Signal
        if(GW_50_SRS_RollingCounter_id050_wrongvalctr == 0)
        {
            update_GW_50_SRS_RollingCounter_id050_counter();
            Msg_GW_50.SRS_RollingCounter_id050= GW_50_SRS_RollingCounter_id050_counter;
        }
        else if(GW_50_SRS_RollingCounter_id050_wrongvalctr > 0)
        {
             GW_50_SRS_RollingCounter_id050_wrongvalctr--;
              // if counter becomes zero, update panel controller to zero
             if(GW_50_SRS_RollingCounter_id050_wrongvalctr == 0)
             {
                 putValue(E_pubc_GW_GW_50_SRS_RollingCounter_id050_wrongvalctr,0);
             }
        }
        else
        {
            //do nothing
        }        
        //calculate the CRC CheckSum
        update_GW_50_CRC_CheckSum();

        output(Msg_GW_50);        
    }
}

on envVar E_pubc_GW_GW_50_Range
{
    qword rawstatus = 0ll;
    qword rawValue = 0ll;    
    
    rawstatus = getvalue(this);    
    // set all the signals with min raw /max raw /init raw
    switch (rawstatus) 
    {
     case(0) :
        rawValue= 0;
        putValue(E_pubc_GW_GW_50_SRS_WarningLampStatus_Rv, rawValue);
        rawValue= 0;
        putValue(E_pubc_GW_GW_50_SRS_DriverBuckleSwitchStatus_Rv, rawValue);
        rawValue= 0;
        putValue(E_pubc_GW_GW_50_SRS_PassengerBuckleSwitchStatus_Rv, rawValue);
        rawValue= 0;
        putValue(E_pubc_GW_GW_50_SRS_CrashOutputStatus_Rv, rawValue);
        break;
     case(1) :
        rawValue= 3;
        putValue(E_pubc_GW_GW_50_SRS_WarningLampStatus_Rv, rawValue);
        rawValue= 3;
        putValue(E_pubc_GW_GW_50_SRS_DriverBuckleSwitchStatus_Rv, rawValue);
        rawValue= 3;
        putValue(E_pubc_GW_GW_50_SRS_PassengerBuckleSwitchStatus_Rv, rawValue);
        rawValue= 15;
        putValue(E_pubc_GW_GW_50_SRS_CrashOutputStatus_Rv, rawValue);
        break;
     default :
        rawValue= 0;
        putValue(E_pubc_GW_GW_50_SRS_WarningLampStatus_Rv, rawValue);
        rawValue= 0;
        putValue(E_pubc_GW_GW_50_SRS_DriverBuckleSwitchStatus_Rv, rawValue);
        rawValue= 0;
        putValue(E_pubc_GW_GW_50_SRS_PassengerBuckleSwitchStatus_Rv, rawValue);
        rawValue= 0;
        putValue(E_pubc_GW_GW_50_SRS_CrashOutputStatus_Rv, rawValue);
      break;
   }
}

on envVar E_pubc_GW_GW_50_Dlc
{
    if(getValue(E_pubc_GW_GW_50_enDlc))
    {
        Msg_GW_50.dlc =getValue(this);
    }
    else
    {
        Msg_GW_50.dlc =4;
    }
}

on envVar E_pubc_GW_GW_50_enDlc
{
    //For Messages with DLC = 8, set wrong DLC to smaller than defined DLC
    //For Messages with DLC < 8 set wrong DLC to smaller/longer than defined DLC
    if(getValue(this))
    {
        Msg_GW_50.dlc =getValue(E_pubc_GW_GW_50_Dlc);
    }
    else
    {
        Msg_GW_50.dlc =4;
    }
}

on envVar E_pubc_GW_GW_50_SRS_CrashOutputStatusCheckSum_wrongvalctr
{
    //update disturb count
    //disturb value range:(-1 = always send wrong value),( X>0 ,x is the number of Messages with wrong CHK sent)
    GW_50_SRS_CrashOutputStatusCheckSum_wrongvalctr =getValue(this);    
}
on envVar E_pubc_GW_GW_50_SRS_RollingCounter_id050_wrongvalctr
{
    //update disturb count
    //disturb value range:(-1 = always send wrong value),( X>0 ,x is the number of Messages with wrong CHK sent)
    GW_50_SRS_RollingCounter_id050_wrongvalctr =getValue(this);    
}

on envVar E_pubc_GW_GW_50_SRS_WarningLampStatus_Rv
{
    int64 rawValue = 0ll;
    float rawValue_float = 0.0;
    float phyValue = 0.0;        

    //set the signal with updated raw value
    if(getValue(E_pubc_GW_GW_50_SRS_WarningLampStatus_SetVt)==0)
    {
        rawValue = getvalue(this);
        if(chgEv_GW_50_SRS_WarningLampStatus == 0)
        {
            //type conversion to float
            rawValue_float = rawValue;        
            // raw to physical conversion
            phyValue = ((rawValue_float *1)+(0));
            putValue(E_pubc_GW_GW_50_SRS_WarningLampStatus_Pv, phyValue);
            chgEv_GW_50_SRS_WarningLampStatus = 1;
        }
        else
        {
            chgEv_GW_50_SRS_WarningLampStatus = 0;
        }    
        //update the signal value
        Msg_GW_50.SRS_WarningLampStatus=rawValue;        
    }                                                                           
}

on envVar E_pubc_GW_GW_50_SRS_WarningLampStatus_Pv
{
    int64 rawValue = 0ll;
    float phyValue = 0.0;
    
    //update the raw value with physical value 
    if(getValue(E_pubc_GW_GW_50_SRS_WarningLampStatus_SetVt)==0)
    {
        if(chgEv_GW_50_SRS_WarningLampStatus == 0)
        {
            phyValue = getvalue(this);
            // physical to raw conversion
            rawValue = ((phyValue -(0))/1);
            putValue(E_pubc_GW_GW_50_SRS_WarningLampStatus_Rv, rawValue);
            chgEv_GW_50_SRS_WarningLampStatus = 1;  
        }
        else
        {
            chgEv_GW_50_SRS_WarningLampStatus = 0;
        }
    }
}

on envVar E_pubc_GW_GW_50_SRS_WarningLampStatus_Vt
{
    qword rawValue = 0ll;
    if(getValue(E_pubc_GW_GW_50_SRS_WarningLampStatus_SetVt))
    {
        //update the signal value
        Msg_GW_50.SRS_WarningLampStatus=getValue(this);
    }
}

on envVar E_pubc_GW_GW_50_SRS_WarningLampStatus_SetVt
{
    if(getValue(E_pubc_GW_GW_50_SRS_WarningLampStatus_SetVt))
    {
        //update the signal value
        Msg_GW_50.SRS_WarningLampStatus=getvalue(E_pubc_GW_GW_50_SRS_WarningLampStatus_Vt);
    }
    else
    {
        Msg_GW_50.SRS_WarningLampStatus=getValue(E_pubc_GW_GW_50_SRS_WarningLampStatus_Rv);
    }
}
 
on envVar E_pubc_GW_GW_50_SRS_DriverBuckleSwitchStatus_Rv
{
    int64 rawValue = 0ll;
    float rawValue_float = 0.0;
    float phyValue = 0.0;        

    //set the signal with updated raw value
    if(getValue(E_pubc_GW_GW_50_SRS_DriverBuckleSwitchStatus_SetVt)==0)
    {
        rawValue = getvalue(this);
        if(chgEv_GW_50_SRS_DriverBuckleSwitchStatus == 0)
        {
            //type conversion to float
            rawValue_float = rawValue;        
            // raw to physical conversion
            phyValue = ((rawValue_float *1)+(0));
            putValue(E_pubc_GW_GW_50_SRS_DriverBuckleSwitchStatus_Pv, phyValue);
            chgEv_GW_50_SRS_DriverBuckleSwitchStatus = 1;
        }
        else
        {
            chgEv_GW_50_SRS_DriverBuckleSwitchStatus = 0;
        }    
        //update the signal value
        Msg_GW_50.SRS_DriverBuckleSwitchStatus=rawValue;        
    }                                                                           
}

on envVar E_pubc_GW_GW_50_SRS_DriverBuckleSwitchStatus_Pv
{
    int64 rawValue = 0ll;
    float phyValue = 0.0;
    
    //update the raw value with physical value 
    if(getValue(E_pubc_GW_GW_50_SRS_DriverBuckleSwitchStatus_SetVt)==0)
    {
        if(chgEv_GW_50_SRS_DriverBuckleSwitchStatus == 0)
        {
            phyValue = getvalue(this);
            // physical to raw conversion
            rawValue = ((phyValue -(0))/1);
            putValue(E_pubc_GW_GW_50_SRS_DriverBuckleSwitchStatus_Rv, rawValue);
            chgEv_GW_50_SRS_DriverBuckleSwitchStatus = 1;  
        }
        else
        {
            chgEv_GW_50_SRS_DriverBuckleSwitchStatus = 0;
        }
    }
}

on envVar E_pubc_GW_GW_50_SRS_DriverBuckleSwitchStatus_Vt
{
    qword rawValue = 0ll;
    if(getValue(E_pubc_GW_GW_50_SRS_DriverBuckleSwitchStatus_SetVt))
    {
        //update the signal value
        Msg_GW_50.SRS_DriverBuckleSwitchStatus=getValue(this);
    }
}

on envVar E_pubc_GW_GW_50_SRS_DriverBuckleSwitchStatus_SetVt
{
    if(getValue(E_pubc_GW_GW_50_SRS_DriverBuckleSwitchStatus_SetVt))
    {
        //update the signal value
        Msg_GW_50.SRS_DriverBuckleSwitchStatus=getvalue(E_pubc_GW_GW_50_SRS_DriverBuckleSwitchStatus_Vt);
    }
    else
    {
        Msg_GW_50.SRS_DriverBuckleSwitchStatus=getValue(E_pubc_GW_GW_50_SRS_DriverBuckleSwitchStatus_Rv);
    }
}
 
on envVar E_pubc_GW_GW_50_SRS_PassengerBuckleSwitchStatus_Rv
{
    int64 rawValue = 0ll;
    float rawValue_float = 0.0;
    float phyValue = 0.0;        

    //set the signal with updated raw value
    if(getValue(E_pubc_GW_GW_50_SRS_PassengerBuckleSwitchStatus_SetVt)==0)
    {
        rawValue = getvalue(this);
        if(chgEv_GW_50_SRS_PassengerBuckleSwitchStatus == 0)
        {
            //type conversion to float
            rawValue_float = rawValue;        
            // raw to physical conversion
            phyValue = ((rawValue_float *1)+(0));
            putValue(E_pubc_GW_GW_50_SRS_PassengerBuckleSwitchStatus_Pv, phyValue);
            chgEv_GW_50_SRS_PassengerBuckleSwitchStatus = 1;
        }
        else
        {
            chgEv_GW_50_SRS_PassengerBuckleSwitchStatus = 0;
        }    
        //update the signal value
        Msg_GW_50.SRS_PassengerBuckleSwitchStatus=rawValue;        
    }                                                                           
}

on envVar E_pubc_GW_GW_50_SRS_PassengerBuckleSwitchStatus_Pv
{
    int64 rawValue = 0ll;
    float phyValue = 0.0;
    
    //update the raw value with physical value 
    if(getValue(E_pubc_GW_GW_50_SRS_PassengerBuckleSwitchStatus_SetVt)==0)
    {
        if(chgEv_GW_50_SRS_PassengerBuckleSwitchStatus == 0)
        {
            phyValue = getvalue(this);
            // physical to raw conversion
            rawValue = ((phyValue -(0))/1);
            putValue(E_pubc_GW_GW_50_SRS_PassengerBuckleSwitchStatus_Rv, rawValue);
            chgEv_GW_50_SRS_PassengerBuckleSwitchStatus = 1;  
        }
        else
        {
            chgEv_GW_50_SRS_PassengerBuckleSwitchStatus = 0;
        }
    }
}

on envVar E_pubc_GW_GW_50_SRS_PassengerBuckleSwitchStatus_Vt
{
    qword rawValue = 0ll;
    if(getValue(E_pubc_GW_GW_50_SRS_PassengerBuckleSwitchStatus_SetVt))
    {
        //update the signal value
        Msg_GW_50.SRS_PassengerBuckleSwitchStatus=getValue(this);
    }
}

on envVar E_pubc_GW_GW_50_SRS_PassengerBuckleSwitchStatus_SetVt
{
    if(getValue(E_pubc_GW_GW_50_SRS_PassengerBuckleSwitchStatus_SetVt))
    {
        //update the signal value
        Msg_GW_50.SRS_PassengerBuckleSwitchStatus=getvalue(E_pubc_GW_GW_50_SRS_PassengerBuckleSwitchStatus_Vt);
    }
    else
    {
        Msg_GW_50.SRS_PassengerBuckleSwitchStatus=getValue(E_pubc_GW_GW_50_SRS_PassengerBuckleSwitchStatus_Rv);
    }
}
 
on envVar E_pubc_GW_GW_50_SRS_CrashOutputStatus_Rv
{
    int64 rawValue = 0ll;
    float rawValue_float = 0.0;
    float phyValue = 0.0;        

    //set the signal with updated raw value
    if(getValue(E_pubc_GW_GW_50_SRS_CrashOutputStatus_SetVt)==0)
    {
        rawValue = getvalue(this);
        if(chgEv_GW_50_SRS_CrashOutputStatus == 0)
        {
            //type conversion to float
            rawValue_float = rawValue;        
            // raw to physical conversion
            phyValue = ((rawValue_float *1)+(0));
            putValue(E_pubc_GW_GW_50_SRS_CrashOutputStatus_Pv, phyValue);
            chgEv_GW_50_SRS_CrashOutputStatus = 1;
        }
        else
        {
            chgEv_GW_50_SRS_CrashOutputStatus = 0;
        }    
        //update the signal value
        Msg_GW_50.SRS_CrashOutputStatus=rawValue;        
    }                                                                           
}

on envVar E_pubc_GW_GW_50_SRS_CrashOutputStatus_Pv
{
    int64 rawValue = 0ll;
    float phyValue = 0.0;
    
    //update the raw value with physical value 
    if(getValue(E_pubc_GW_GW_50_SRS_CrashOutputStatus_SetVt)==0)
    {
        if(chgEv_GW_50_SRS_CrashOutputStatus == 0)
        {
            phyValue = getvalue(this);
            // physical to raw conversion
            rawValue = ((phyValue -(0))/1);
            putValue(E_pubc_GW_GW_50_SRS_CrashOutputStatus_Rv, rawValue);
            chgEv_GW_50_SRS_CrashOutputStatus = 1;  
        }
        else
        {
            chgEv_GW_50_SRS_CrashOutputStatus = 0;
        }
    }
}

on envVar E_pubc_GW_GW_50_SRS_CrashOutputStatus_Vt
{
    qword rawValue = 0ll;
    if(getValue(E_pubc_GW_GW_50_SRS_CrashOutputStatus_SetVt))
    {
        //update the signal value
        Msg_GW_50.SRS_CrashOutputStatus=getValue(this);
    }
}

on envVar E_pubc_GW_GW_50_SRS_CrashOutputStatus_SetVt
{
    if(getValue(E_pubc_GW_GW_50_SRS_CrashOutputStatus_SetVt))
    {
        //update the signal value
        Msg_GW_50.SRS_CrashOutputStatus=getvalue(E_pubc_GW_GW_50_SRS_CrashOutputStatus_Vt);
    }
    else
    {
        Msg_GW_50.SRS_CrashOutputStatus=getValue(E_pubc_GW_GW_50_SRS_CrashOutputStatus_Rv);
    }
}
 
on envVar E_pubc_GW_GW_208_tx
{
    if(getValue(this))
    {       
        
        //update the BZ Signal
        if(GW_208_ESP_RollingCounter_208_wrongvalctr == 0)
        {
            update_GW_208_ESP_RollingCounter_208_counter();
            Msg_GW_208.ESP_RollingCounter_208= GW_208_ESP_RollingCounter_208_counter;
        }
        else if(GW_208_ESP_RollingCounter_208_wrongvalctr > 0)
        {
             GW_208_ESP_RollingCounter_208_wrongvalctr--;
              // if counter becomes zero, update panel controller to zero
             if(GW_208_ESP_RollingCounter_208_wrongvalctr == 0)
             {
                 putValue(E_pubc_GW_GW_208_ESP_RollingCounter_208_wrongvalctr,0);
             }
        }
        else
        {
            //do nothing
        }        
        //calculate the CRC CheckSum
        update_GW_208_CRC_CheckSum();

        output(Msg_GW_208);        
    }
}

on envVar E_pubc_GW_GW_208_Range
{
    qword rawstatus = 0ll;
    qword rawValue = 0ll;    
    
    rawstatus = getvalue(this);    
    // set all the signals with min raw /max raw /init raw
    switch (rawstatus) 
    {
     case(0) :
        rawValue= 0;
        putValue(E_pubc_GW_GW_208_Wheel_Speed_RL_Data_Rv, rawValue);
        rawValue= 0;
        putValue(E_pubc_GW_GW_208_Wheel_Speed_RR_Valid_Data_Rv, rawValue);
        rawValue= 0;
        putValue(E_pubc_GW_GW_208_Wheel_Speed_RL_Direction_Rv, rawValue);
        rawValue= 0;
        putValue(E_pubc_GW_GW_208_Wheel_Speed_RL_Valid_Data_Rv, rawValue);
        rawValue= 0;
        putValue(E_pubc_GW_GW_208_Wheel_Speed_RR_Data_Rv, rawValue);
        rawValue= 0;
        putValue(E_pubc_GW_GW_208_Wheel_Speed_RR_Direction_Rv, rawValue);
        break;
     case(1) :
        rawValue= 6400;
        putValue(E_pubc_GW_GW_208_Wheel_Speed_RL_Data_Rv, rawValue);
        rawValue= 1;
        putValue(E_pubc_GW_GW_208_Wheel_Speed_RR_Valid_Data_Rv, rawValue);
        rawValue= 3;
        putValue(E_pubc_GW_GW_208_Wheel_Speed_RL_Direction_Rv, rawValue);
        rawValue= 1;
        putValue(E_pubc_GW_GW_208_Wheel_Speed_RL_Valid_Data_Rv, rawValue);
        rawValue= 6400;
        putValue(E_pubc_GW_GW_208_Wheel_Speed_RR_Data_Rv, rawValue);
        rawValue= 3;
        putValue(E_pubc_GW_GW_208_Wheel_Speed_RR_Direction_Rv, rawValue);
        break;
     default :
        rawValue= 0;
        putValue(E_pubc_GW_GW_208_Wheel_Speed_RL_Data_Rv, rawValue);
        rawValue= 0;
        putValue(E_pubc_GW_GW_208_Wheel_Speed_RR_Valid_Data_Rv, rawValue);
        rawValue= 0;
        putValue(E_pubc_GW_GW_208_Wheel_Speed_RL_Direction_Rv, rawValue);
        rawValue= 0;
        putValue(E_pubc_GW_GW_208_Wheel_Speed_RL_Valid_Data_Rv, rawValue);
        rawValue= 0;
        putValue(E_pubc_GW_GW_208_Wheel_Speed_RR_Data_Rv, rawValue);
        rawValue= 0;
        putValue(E_pubc_GW_GW_208_Wheel_Speed_RR_Direction_Rv, rawValue);
      break;
   }
}

on envVar E_pubc_GW_GW_208_Dlc
{
    if(getValue(E_pubc_GW_GW_208_enDlc))
    {
        Msg_GW_208.dlc =getValue(this);
    }
    else
    {
        Msg_GW_208.dlc =8;
    }
}

on envVar E_pubc_GW_GW_208_enDlc
{
    //For Messages with DLC = 8, set wrong DLC to smaller than defined DLC
    //For Messages with DLC < 8 set wrong DLC to smaller/longer than defined DLC
    if(getValue(this))
    {
        Msg_GW_208.dlc =getValue(E_pubc_GW_GW_208_Dlc);
    }
    else
    {
        Msg_GW_208.dlc =8;
    }
}

on envVar E_pubc_GW_GW_208_ESP_CRCCheck_208_wrongvalctr
{
    //update disturb count
    //disturb value range:(-1 = always send wrong value),( X>0 ,x is the number of Messages with wrong CHK sent)
    GW_208_ESP_CRCCheck_208_wrongvalctr =getValue(this);    
}
on envVar E_pubc_GW_GW_208_ESP_RollingCounter_208_wrongvalctr
{
    //update disturb count
    //disturb value range:(-1 = always send wrong value),( X>0 ,x is the number of Messages with wrong CHK sent)
    GW_208_ESP_RollingCounter_208_wrongvalctr =getValue(this);    
}

on envVar E_pubc_GW_GW_208_Wheel_Speed_RL_Data_Rv
{
    int64 rawValue = 0ll;
    float rawValue_float = 0.0;
    float phyValue = 0.0;        

    //set the signal with updated raw value
    {
        rawValue = getvalue(this);
        if(chgEv_GW_208_Wheel_Speed_RL_Data == 0)
        {
            //type conversion to float
            rawValue_float = rawValue;        
            // raw to physical conversion
            phyValue = ((rawValue_float *0.05625)+(0));
            putValue(E_pubc_GW_GW_208_Wheel_Speed_RL_Data_Pv, phyValue);
            chgEv_GW_208_Wheel_Speed_RL_Data = 1;
        }
        else
        {
            chgEv_GW_208_Wheel_Speed_RL_Data = 0;
        }    
        //update the signal value
        Msg_GW_208.Wheel_Speed_RL_Data=rawValue;        
    }                                                                           
}

on envVar E_pubc_GW_GW_208_Wheel_Speed_RL_Data_Pv
{
    int64 rawValue = 0ll;
    float phyValue = 0.0;
    
    //update the raw value with physical value 
    {
        if(chgEv_GW_208_Wheel_Speed_RL_Data == 0)
        {
            phyValue = getvalue(this);
            // physical to raw conversion
            rawValue = ((phyValue -(0))/0.05625);
            putValue(E_pubc_GW_GW_208_Wheel_Speed_RL_Data_Rv, rawValue);
            chgEv_GW_208_Wheel_Speed_RL_Data = 1;  
        }
        else
        {
            chgEv_GW_208_Wheel_Speed_RL_Data = 0;
        }
    }
}


 
on envVar E_pubc_GW_GW_208_Wheel_Speed_RR_Valid_Data_Rv
{
    int64 rawValue = 0ll;
    float rawValue_float = 0.0;
    float phyValue = 0.0;        

    //set the signal with updated raw value
    if(getValue(E_pubc_GW_GW_208_Wheel_Speed_RR_Valid_Data_SetVt)==0)
    {
        rawValue = getvalue(this);
        if(chgEv_GW_208_Wheel_Speed_RR_Valid_Data == 0)
        {
            //type conversion to float
            rawValue_float = rawValue;        
            // raw to physical conversion
            phyValue = ((rawValue_float *1)+(0));
            putValue(E_pubc_GW_GW_208_Wheel_Speed_RR_Valid_Data_Pv, phyValue);
            chgEv_GW_208_Wheel_Speed_RR_Valid_Data = 1;
        }
        else
        {
            chgEv_GW_208_Wheel_Speed_RR_Valid_Data = 0;
        }    
        //update the signal value
        Msg_GW_208.Wheel_Speed_RR_Valid_Data=rawValue;        
    }                                                                           
}

on envVar E_pubc_GW_GW_208_Wheel_Speed_RR_Valid_Data_Pv
{
    int64 rawValue = 0ll;
    float phyValue = 0.0;
    
    //update the raw value with physical value 
    if(getValue(E_pubc_GW_GW_208_Wheel_Speed_RR_Valid_Data_SetVt)==0)
    {
        if(chgEv_GW_208_Wheel_Speed_RR_Valid_Data == 0)
        {
            phyValue = getvalue(this);
            // physical to raw conversion
            rawValue = ((phyValue -(0))/1);
            putValue(E_pubc_GW_GW_208_Wheel_Speed_RR_Valid_Data_Rv, rawValue);
            chgEv_GW_208_Wheel_Speed_RR_Valid_Data = 1;  
        }
        else
        {
            chgEv_GW_208_Wheel_Speed_RR_Valid_Data = 0;
        }
    }
}

on envVar E_pubc_GW_GW_208_Wheel_Speed_RR_Valid_Data_Vt
{
    qword rawValue = 0ll;
    if(getValue(E_pubc_GW_GW_208_Wheel_Speed_RR_Valid_Data_SetVt))
    {
        //update the signal value
        Msg_GW_208.Wheel_Speed_RR_Valid_Data=getValue(this);
    }
}

on envVar E_pubc_GW_GW_208_Wheel_Speed_RR_Valid_Data_SetVt
{
    if(getValue(E_pubc_GW_GW_208_Wheel_Speed_RR_Valid_Data_SetVt))
    {
        //update the signal value
        Msg_GW_208.Wheel_Speed_RR_Valid_Data=getvalue(E_pubc_GW_GW_208_Wheel_Speed_RR_Valid_Data_Vt);
    }
    else
    {
        Msg_GW_208.Wheel_Speed_RR_Valid_Data=getValue(E_pubc_GW_GW_208_Wheel_Speed_RR_Valid_Data_Rv);
    }
}
 
on envVar E_pubc_GW_GW_208_Wheel_Speed_RL_Direction_Rv
{
    int64 rawValue = 0ll;
    float rawValue_float = 0.0;
    float phyValue = 0.0;        

    //set the signal with updated raw value
    if(getValue(E_pubc_GW_GW_208_Wheel_Speed_RL_Direction_SetVt)==0)
    {
        rawValue = getvalue(this);
        if(chgEv_GW_208_Wheel_Speed_RL_Direction == 0)
        {
            //type conversion to float
            rawValue_float = rawValue;        
            // raw to physical conversion
            phyValue = ((rawValue_float *1)+(0));
            putValue(E_pubc_GW_GW_208_Wheel_Speed_RL_Direction_Pv, phyValue);
            chgEv_GW_208_Wheel_Speed_RL_Direction = 1;
        }
        else
        {
            chgEv_GW_208_Wheel_Speed_RL_Direction = 0;
        }    
        //update the signal value
        Msg_GW_208.Wheel_Speed_RL_Direction=rawValue;        
    }                                                                           
}

on envVar E_pubc_GW_GW_208_Wheel_Speed_RL_Direction_Pv
{
    int64 rawValue = 0ll;
    float phyValue = 0.0;
    
    //update the raw value with physical value 
    if(getValue(E_pubc_GW_GW_208_Wheel_Speed_RL_Direction_SetVt)==0)
    {
        if(chgEv_GW_208_Wheel_Speed_RL_Direction == 0)
        {
            phyValue = getvalue(this);
            // physical to raw conversion
            rawValue = ((phyValue -(0))/1);
            putValue(E_pubc_GW_GW_208_Wheel_Speed_RL_Direction_Rv, rawValue);
            chgEv_GW_208_Wheel_Speed_RL_Direction = 1;  
        }
        else
        {
            chgEv_GW_208_Wheel_Speed_RL_Direction = 0;
        }
    }
}

on envVar E_pubc_GW_GW_208_Wheel_Speed_RL_Direction_Vt
{
    qword rawValue = 0ll;
    if(getValue(E_pubc_GW_GW_208_Wheel_Speed_RL_Direction_SetVt))
    {
        //update the signal value
        Msg_GW_208.Wheel_Speed_RL_Direction=getValue(this);
    }
}

on envVar E_pubc_GW_GW_208_Wheel_Speed_RL_Direction_SetVt
{
    if(getValue(E_pubc_GW_GW_208_Wheel_Speed_RL_Direction_SetVt))
    {
        //update the signal value
        Msg_GW_208.Wheel_Speed_RL_Direction=getvalue(E_pubc_GW_GW_208_Wheel_Speed_RL_Direction_Vt);
    }
    else
    {
        Msg_GW_208.Wheel_Speed_RL_Direction=getValue(E_pubc_GW_GW_208_Wheel_Speed_RL_Direction_Rv);
    }
}
 
on envVar E_pubc_GW_GW_208_Wheel_Speed_RL_Valid_Data_Rv
{
    int64 rawValue = 0ll;
    float rawValue_float = 0.0;
    float phyValue = 0.0;        

    //set the signal with updated raw value
    if(getValue(E_pubc_GW_GW_208_Wheel_Speed_RL_Valid_Data_SetVt)==0)
    {
        rawValue = getvalue(this);
        if(chgEv_GW_208_Wheel_Speed_RL_Valid_Data == 0)
        {
            //type conversion to float
            rawValue_float = rawValue;        
            // raw to physical conversion
            phyValue = ((rawValue_float *1)+(0));
            putValue(E_pubc_GW_GW_208_Wheel_Speed_RL_Valid_Data_Pv, phyValue);
            chgEv_GW_208_Wheel_Speed_RL_Valid_Data = 1;
        }
        else
        {
            chgEv_GW_208_Wheel_Speed_RL_Valid_Data = 0;
        }    
        //update the signal value
        Msg_GW_208.Wheel_Speed_RL_Valid_Data=rawValue;        
    }                                                                           
}

on envVar E_pubc_GW_GW_208_Wheel_Speed_RL_Valid_Data_Pv
{
    int64 rawValue = 0ll;
    float phyValue = 0.0;
    
    //update the raw value with physical value 
    if(getValue(E_pubc_GW_GW_208_Wheel_Speed_RL_Valid_Data_SetVt)==0)
    {
        if(chgEv_GW_208_Wheel_Speed_RL_Valid_Data == 0)
        {
            phyValue = getvalue(this);
            // physical to raw conversion
            rawValue = ((phyValue -(0))/1);
            putValue(E_pubc_GW_GW_208_Wheel_Speed_RL_Valid_Data_Rv, rawValue);
            chgEv_GW_208_Wheel_Speed_RL_Valid_Data = 1;  
        }
        else
        {
            chgEv_GW_208_Wheel_Speed_RL_Valid_Data = 0;
        }
    }
}

on envVar E_pubc_GW_GW_208_Wheel_Speed_RL_Valid_Data_Vt
{
    qword rawValue = 0ll;
    if(getValue(E_pubc_GW_GW_208_Wheel_Speed_RL_Valid_Data_SetVt))
    {
        //update the signal value
        Msg_GW_208.Wheel_Speed_RL_Valid_Data=getValue(this);
    }
}

on envVar E_pubc_GW_GW_208_Wheel_Speed_RL_Valid_Data_SetVt
{
    if(getValue(E_pubc_GW_GW_208_Wheel_Speed_RL_Valid_Data_SetVt))
    {
        //update the signal value
        Msg_GW_208.Wheel_Speed_RL_Valid_Data=getvalue(E_pubc_GW_GW_208_Wheel_Speed_RL_Valid_Data_Vt);
    }
    else
    {
        Msg_GW_208.Wheel_Speed_RL_Valid_Data=getValue(E_pubc_GW_GW_208_Wheel_Speed_RL_Valid_Data_Rv);
    }
}
 
on envVar E_pubc_GW_GW_208_Wheel_Speed_RR_Data_Rv
{
    int64 rawValue = 0ll;
    float rawValue_float = 0.0;
    float phyValue = 0.0;        

    //set the signal with updated raw value
    {
        rawValue = getvalue(this);
        if(chgEv_GW_208_Wheel_Speed_RR_Data == 0)
        {
            //type conversion to float
            rawValue_float = rawValue;        
            // raw to physical conversion
            phyValue = ((rawValue_float *0.05625)+(0));
            putValue(E_pubc_GW_GW_208_Wheel_Speed_RR_Data_Pv, phyValue);
            chgEv_GW_208_Wheel_Speed_RR_Data = 1;
        }
        else
        {
            chgEv_GW_208_Wheel_Speed_RR_Data = 0;
        }    
        //update the signal value
        Msg_GW_208.Wheel_Speed_RR_Data=rawValue;        
    }                                                                           
}

on envVar E_pubc_GW_GW_208_Wheel_Speed_RR_Data_Pv
{
    int64 rawValue = 0ll;
    float phyValue = 0.0;
    
    //update the raw value with physical value 
    {
        if(chgEv_GW_208_Wheel_Speed_RR_Data == 0)
        {
            phyValue = getvalue(this);
            // physical to raw conversion
            rawValue = ((phyValue -(0))/0.05625);
            putValue(E_pubc_GW_GW_208_Wheel_Speed_RR_Data_Rv, rawValue);
            chgEv_GW_208_Wheel_Speed_RR_Data = 1;  
        }
        else
        {
            chgEv_GW_208_Wheel_Speed_RR_Data = 0;
        }
    }
}


 
on envVar E_pubc_GW_GW_208_Wheel_Speed_RR_Direction_Rv
{
    int64 rawValue = 0ll;
    float rawValue_float = 0.0;
    float phyValue = 0.0;        

    //set the signal with updated raw value
    if(getValue(E_pubc_GW_GW_208_Wheel_Speed_RR_Direction_SetVt)==0)
    {
        rawValue = getvalue(this);
        if(chgEv_GW_208_Wheel_Speed_RR_Direction == 0)
        {
            //type conversion to float
            rawValue_float = rawValue;        
            // raw to physical conversion
            phyValue = ((rawValue_float *1)+(0));
            putValue(E_pubc_GW_GW_208_Wheel_Speed_RR_Direction_Pv, phyValue);
            chgEv_GW_208_Wheel_Speed_RR_Direction = 1;
        }
        else
        {
            chgEv_GW_208_Wheel_Speed_RR_Direction = 0;
        }    
        //update the signal value
        Msg_GW_208.Wheel_Speed_RR_Direction=rawValue;        
    }                                                                           
}

on envVar E_pubc_GW_GW_208_Wheel_Speed_RR_Direction_Pv
{
    int64 rawValue = 0ll;
    float phyValue = 0.0;
    
    //update the raw value with physical value 
    if(getValue(E_pubc_GW_GW_208_Wheel_Speed_RR_Direction_SetVt)==0)
    {
        if(chgEv_GW_208_Wheel_Speed_RR_Direction == 0)
        {
            phyValue = getvalue(this);
            // physical to raw conversion
            rawValue = ((phyValue -(0))/1);
            putValue(E_pubc_GW_GW_208_Wheel_Speed_RR_Direction_Rv, rawValue);
            chgEv_GW_208_Wheel_Speed_RR_Direction = 1;  
        }
        else
        {
            chgEv_GW_208_Wheel_Speed_RR_Direction = 0;
        }
    }
}

on envVar E_pubc_GW_GW_208_Wheel_Speed_RR_Direction_Vt
{
    qword rawValue = 0ll;
    if(getValue(E_pubc_GW_GW_208_Wheel_Speed_RR_Direction_SetVt))
    {
        //update the signal value
        Msg_GW_208.Wheel_Speed_RR_Direction=getValue(this);
    }
}

on envVar E_pubc_GW_GW_208_Wheel_Speed_RR_Direction_SetVt
{
    if(getValue(E_pubc_GW_GW_208_Wheel_Speed_RR_Direction_SetVt))
    {
        //update the signal value
        Msg_GW_208.Wheel_Speed_RR_Direction=getvalue(E_pubc_GW_GW_208_Wheel_Speed_RR_Direction_Vt);
    }
    else
    {
        Msg_GW_208.Wheel_Speed_RR_Direction=getValue(E_pubc_GW_GW_208_Wheel_Speed_RR_Direction_Rv);
    }
}
 
on envVar E_pubc_GW_GW_24F_tx
{
    if(getValue(this))
    {       
        
        //update the BZ Signal
        if(GW_24F_EPS_RollingCounter_24F_wrongvalctr == 0)
        {
            update_GW_24F_EPS_RollingCounter_24F_counter();
            Msg_GW_24F.EPS_RollingCounter_24F= GW_24F_EPS_RollingCounter_24F_counter;
        }
        else if(GW_24F_EPS_RollingCounter_24F_wrongvalctr > 0)
        {
             GW_24F_EPS_RollingCounter_24F_wrongvalctr--;
              // if counter becomes zero, update panel controller to zero
             if(GW_24F_EPS_RollingCounter_24F_wrongvalctr == 0)
             {
                 putValue(E_pubc_GW_GW_24F_EPS_RollingCounter_24F_wrongvalctr,0);
             }
        }
        else
        {
            //do nothing
        }        
        //calculate the CRC CheckSum
        update_GW_24F_CRC_CheckSum();

        output(Msg_GW_24F);        
    }
}

on envVar E_pubc_GW_GW_24F_Range
{
    qword rawstatus = 0ll;
    qword rawValue = 0ll;    
    
    rawstatus = getvalue(this);    
    // set all the signals with min raw /max raw /init raw
    switch (rawstatus) 
    {
     case(0) :
        rawValue= 0;
        putValue(E_pubc_GW_GW_24F_EPS_TorqueAssistMode_Rv, rawValue);
        rawValue= 0;
        putValue(E_pubc_GW_GW_24F_EPS_IACC_abortreason_Rv, rawValue);
        rawValue= 0;
        putValue(E_pubc_GW_GW_24F_EPS_ConcussAvailabilityStatus_Rv, rawValue);
        break;
     case(1) :
        rawValue= 3;
        putValue(E_pubc_GW_GW_24F_EPS_TorqueAssistMode_Rv, rawValue);
        rawValue= 7;
        putValue(E_pubc_GW_GW_24F_EPS_IACC_abortreason_Rv, rawValue);
        rawValue= 3;
        putValue(E_pubc_GW_GW_24F_EPS_ConcussAvailabilityStatus_Rv, rawValue);
        break;
     default :
        rawValue= 0;
        putValue(E_pubc_GW_GW_24F_EPS_TorqueAssistMode_Rv, rawValue);
        rawValue= 0;
        putValue(E_pubc_GW_GW_24F_EPS_IACC_abortreason_Rv, rawValue);
        rawValue= 0;
        putValue(E_pubc_GW_GW_24F_EPS_ConcussAvailabilityStatus_Rv, rawValue);
      break;
   }
}

on envVar E_pubc_GW_GW_24F_Dlc
{
    if(getValue(E_pubc_GW_GW_24F_enDlc))
    {
        Msg_GW_24F.dlc =getValue(this);
    }
    else
    {
        Msg_GW_24F.dlc =8;
    }
}

on envVar E_pubc_GW_GW_24F_enDlc
{
    //For Messages with DLC = 8, set wrong DLC to smaller than defined DLC
    //For Messages with DLC < 8 set wrong DLC to smaller/longer than defined DLC
    if(getValue(this))
    {
        Msg_GW_24F.dlc =getValue(E_pubc_GW_GW_24F_Dlc);
    }
    else
    {
        Msg_GW_24F.dlc =8;
    }
}

on envVar E_pubc_GW_GW_24F_EPS_CRCCheck_24F_wrongvalctr
{
    //update disturb count
    //disturb value range:(-1 = always send wrong value),( X>0 ,x is the number of Messages with wrong CHK sent)
    GW_24F_EPS_CRCCheck_24F_wrongvalctr =getValue(this);    
}
on envVar E_pubc_GW_GW_24F_EPS_RollingCounter_24F_wrongvalctr
{
    //update disturb count
    //disturb value range:(-1 = always send wrong value),( X>0 ,x is the number of Messages with wrong CHK sent)
    GW_24F_EPS_RollingCounter_24F_wrongvalctr =getValue(this);    
}

on envVar E_pubc_GW_GW_24F_EPS_TorqueAssistMode_Rv
{
    int64 rawValue = 0ll;
    float rawValue_float = 0.0;
    float phyValue = 0.0;        

    //set the signal with updated raw value
    if(getValue(E_pubc_GW_GW_24F_EPS_TorqueAssistMode_SetVt)==0)
    {
        rawValue = getvalue(this);
        if(chgEv_GW_24F_EPS_TorqueAssistMode == 0)
        {
            //type conversion to float
            rawValue_float = rawValue;        
            // raw to physical conversion
            phyValue = ((rawValue_float *1)+(0));
            putValue(E_pubc_GW_GW_24F_EPS_TorqueAssistMode_Pv, phyValue);
            chgEv_GW_24F_EPS_TorqueAssistMode = 1;
        }
        else
        {
            chgEv_GW_24F_EPS_TorqueAssistMode = 0;
        }    
        //update the signal value
        Msg_GW_24F.EPS_TorqueAssistMode=rawValue;        
    }                                                                           
}

on envVar E_pubc_GW_GW_24F_EPS_TorqueAssistMode_Pv
{
    int64 rawValue = 0ll;
    float phyValue = 0.0;
    
    //update the raw value with physical value 
    if(getValue(E_pubc_GW_GW_24F_EPS_TorqueAssistMode_SetVt)==0)
    {
        if(chgEv_GW_24F_EPS_TorqueAssistMode == 0)
        {
            phyValue = getvalue(this);
            // physical to raw conversion
            rawValue = ((phyValue -(0))/1);
            putValue(E_pubc_GW_GW_24F_EPS_TorqueAssistMode_Rv, rawValue);
            chgEv_GW_24F_EPS_TorqueAssistMode = 1;  
        }
        else
        {
            chgEv_GW_24F_EPS_TorqueAssistMode = 0;
        }
    }
}

on envVar E_pubc_GW_GW_24F_EPS_TorqueAssistMode_Vt
{
    qword rawValue = 0ll;
    if(getValue(E_pubc_GW_GW_24F_EPS_TorqueAssistMode_SetVt))
    {
        //update the signal value
        Msg_GW_24F.EPS_TorqueAssistMode=getValue(this);
    }
}

on envVar E_pubc_GW_GW_24F_EPS_TorqueAssistMode_SetVt
{
    if(getValue(E_pubc_GW_GW_24F_EPS_TorqueAssistMode_SetVt))
    {
        //update the signal value
        Msg_GW_24F.EPS_TorqueAssistMode=getvalue(E_pubc_GW_GW_24F_EPS_TorqueAssistMode_Vt);
    }
    else
    {
        Msg_GW_24F.EPS_TorqueAssistMode=getValue(E_pubc_GW_GW_24F_EPS_TorqueAssistMode_Rv);
    }
}
 
on envVar E_pubc_GW_GW_24F_EPS_IACC_abortreason_Rv
{
    int64 rawValue = 0ll;
    float rawValue_float = 0.0;
    float phyValue = 0.0;        

    //set the signal with updated raw value
    if(getValue(E_pubc_GW_GW_24F_EPS_IACC_abortreason_SetVt)==0)
    {
        rawValue = getvalue(this);
        if(chgEv_GW_24F_EPS_IACC_abortreason == 0)
        {
            //type conversion to float
            rawValue_float = rawValue;        
            // raw to physical conversion
            phyValue = ((rawValue_float *1)+(0));
            putValue(E_pubc_GW_GW_24F_EPS_IACC_abortreason_Pv, phyValue);
            chgEv_GW_24F_EPS_IACC_abortreason = 1;
        }
        else
        {
            chgEv_GW_24F_EPS_IACC_abortreason = 0;
        }    
        //update the signal value
        Msg_GW_24F.EPS_IACC_abortreason=rawValue;        
    }                                                                           
}

on envVar E_pubc_GW_GW_24F_EPS_IACC_abortreason_Pv
{
    int64 rawValue = 0ll;
    float phyValue = 0.0;
    
    //update the raw value with physical value 
    if(getValue(E_pubc_GW_GW_24F_EPS_IACC_abortreason_SetVt)==0)
    {
        if(chgEv_GW_24F_EPS_IACC_abortreason == 0)
        {
            phyValue = getvalue(this);
            // physical to raw conversion
            rawValue = ((phyValue -(0))/1);
            putValue(E_pubc_GW_GW_24F_EPS_IACC_abortreason_Rv, rawValue);
            chgEv_GW_24F_EPS_IACC_abortreason = 1;  
        }
        else
        {
            chgEv_GW_24F_EPS_IACC_abortreason = 0;
        }
    }
}

on envVar E_pubc_GW_GW_24F_EPS_IACC_abortreason_Vt
{
    qword rawValue = 0ll;
    if(getValue(E_pubc_GW_GW_24F_EPS_IACC_abortreason_SetVt))
    {
        //update the signal value
        Msg_GW_24F.EPS_IACC_abortreason=getValue(this);
    }
}

on envVar E_pubc_GW_GW_24F_EPS_IACC_abortreason_SetVt
{
    if(getValue(E_pubc_GW_GW_24F_EPS_IACC_abortreason_SetVt))
    {
        //update the signal value
        Msg_GW_24F.EPS_IACC_abortreason=getvalue(E_pubc_GW_GW_24F_EPS_IACC_abortreason_Vt);
    }
    else
    {
        Msg_GW_24F.EPS_IACC_abortreason=getValue(E_pubc_GW_GW_24F_EPS_IACC_abortreason_Rv);
    }
}
 
on envVar E_pubc_GW_GW_24F_EPS_ConcussAvailabilityStatus_Rv
{
    int64 rawValue = 0ll;
    float rawValue_float = 0.0;
    float phyValue = 0.0;        

    //set the signal with updated raw value
    if(getValue(E_pubc_GW_GW_24F_EPS_ConcussAvailabilityStatus_SetVt)==0)
    {
        rawValue = getvalue(this);
        if(chgEv_GW_24F_EPS_ConcussAvailabilityStatus == 0)
        {
            //type conversion to float
            rawValue_float = rawValue;        
            // raw to physical conversion
            phyValue = ((rawValue_float *1)+(0));
            putValue(E_pubc_GW_GW_24F_EPS_ConcussAvailabilityStatus_Pv, phyValue);
            chgEv_GW_24F_EPS_ConcussAvailabilityStatus = 1;
        }
        else
        {
            chgEv_GW_24F_EPS_ConcussAvailabilityStatus = 0;
        }    
        //update the signal value
        Msg_GW_24F.EPS_ConcussAvailabilityStatus=rawValue;        
    }                                                                           
}

on envVar E_pubc_GW_GW_24F_EPS_ConcussAvailabilityStatus_Pv
{
    int64 rawValue = 0ll;
    float phyValue = 0.0;
    
    //update the raw value with physical value 
    if(getValue(E_pubc_GW_GW_24F_EPS_ConcussAvailabilityStatus_SetVt)==0)
    {
        if(chgEv_GW_24F_EPS_ConcussAvailabilityStatus == 0)
        {
            phyValue = getvalue(this);
            // physical to raw conversion
            rawValue = ((phyValue -(0))/1);
            putValue(E_pubc_GW_GW_24F_EPS_ConcussAvailabilityStatus_Rv, rawValue);
            chgEv_GW_24F_EPS_ConcussAvailabilityStatus = 1;  
        }
        else
        {
            chgEv_GW_24F_EPS_ConcussAvailabilityStatus = 0;
        }
    }
}

on envVar E_pubc_GW_GW_24F_EPS_ConcussAvailabilityStatus_Vt
{
    qword rawValue = 0ll;
    if(getValue(E_pubc_GW_GW_24F_EPS_ConcussAvailabilityStatus_SetVt))
    {
        //update the signal value
        Msg_GW_24F.EPS_ConcussAvailabilityStatus=getValue(this);
    }
}

on envVar E_pubc_GW_GW_24F_EPS_ConcussAvailabilityStatus_SetVt
{
    if(getValue(E_pubc_GW_GW_24F_EPS_ConcussAvailabilityStatus_SetVt))
    {
        //update the signal value
        Msg_GW_24F.EPS_ConcussAvailabilityStatus=getvalue(E_pubc_GW_GW_24F_EPS_ConcussAvailabilityStatus_Vt);
    }
    else
    {
        Msg_GW_24F.EPS_ConcussAvailabilityStatus=getValue(E_pubc_GW_GW_24F_EPS_ConcussAvailabilityStatus_Rv);
    }
}
 
on envVar E_pubc_GW_GW_258_tx
{
    if(getValue(this))
    {       
        
        //update the BZ Signal
        if(GW_258_ESP_RollingCounter_258_wrongvalctr == 0)
        {
            update_GW_258_ESP_RollingCounter_258_counter();
            Msg_GW_258.ESP_RollingCounter_258= GW_258_ESP_RollingCounter_258_counter;
        }
        else if(GW_258_ESP_RollingCounter_258_wrongvalctr > 0)
        {
             GW_258_ESP_RollingCounter_258_wrongvalctr--;
              // if counter becomes zero, update panel controller to zero
             if(GW_258_ESP_RollingCounter_258_wrongvalctr == 0)
             {
                 putValue(E_pubc_GW_GW_258_ESP_RollingCounter_258_wrongvalctr,0);
             }
        }
        else
        {
            //do nothing
        }        
        //calculate the CRC CheckSum
        update_GW_258_CRC_CheckSum();

        output(Msg_GW_258);        
    }
}

on envVar E_pubc_GW_GW_258_Range
{
    qword rawstatus = 0ll;
    qword rawValue = 0ll;    
    
    rawstatus = getvalue(this);    
    // set all the signals with min raw /max raw /init raw
    switch (rawstatus) 
    {
     case(0) :
        rawValue= 0;
        putValue(E_pubc_GW_GW_258_Wheel_Speed_RR_Pulse_Rv, rawValue);
        rawValue= 0;
        putValue(E_pubc_GW_GW_258_ESP_MasCylBrakePressureValid_Rv, rawValue);
        rawValue= 0;
        putValue(E_pubc_GW_GW_258_Wheel_Speed_RL_Pulse_Rv, rawValue);
        rawValue= 0;
        putValue(E_pubc_GW_GW_258_Wheel_Speed_FL_Pulse_Rv, rawValue);
        rawValue= 0;
        putValue(E_pubc_GW_GW_258_Wheel_Speed_FR_Pulse_Rv, rawValue);
        rawValue= 0;
        putValue(E_pubc_GW_GW_258_ESP_MasCylBrakePressure_Rv, rawValue);
        break;
     case(1) :
        rawValue= 254;
        putValue(E_pubc_GW_GW_258_Wheel_Speed_RR_Pulse_Rv, rawValue);
        rawValue= 1;
        putValue(E_pubc_GW_GW_258_ESP_MasCylBrakePressureValid_Rv, rawValue);
        rawValue= 254;
        putValue(E_pubc_GW_GW_258_Wheel_Speed_RL_Pulse_Rv, rawValue);
        rawValue= 254;
        putValue(E_pubc_GW_GW_258_Wheel_Speed_FL_Pulse_Rv, rawValue);
        rawValue= 254;
        putValue(E_pubc_GW_GW_258_Wheel_Speed_FR_Pulse_Rv, rawValue);
        rawValue= 2500;
        putValue(E_pubc_GW_GW_258_ESP_MasCylBrakePressure_Rv, rawValue);
        break;
     default :
        rawValue= 0;
        putValue(E_pubc_GW_GW_258_Wheel_Speed_RR_Pulse_Rv, rawValue);
        rawValue= 0;
        putValue(E_pubc_GW_GW_258_ESP_MasCylBrakePressureValid_Rv, rawValue);
        rawValue= 0;
        putValue(E_pubc_GW_GW_258_Wheel_Speed_RL_Pulse_Rv, rawValue);
        rawValue= 0;
        putValue(E_pubc_GW_GW_258_Wheel_Speed_FL_Pulse_Rv, rawValue);
        rawValue= 0;
        putValue(E_pubc_GW_GW_258_Wheel_Speed_FR_Pulse_Rv, rawValue);
        rawValue= 0;
        putValue(E_pubc_GW_GW_258_ESP_MasCylBrakePressure_Rv, rawValue);
      break;
   }
}

on envVar E_pubc_GW_GW_258_Dlc
{
    if(getValue(E_pubc_GW_GW_258_enDlc))
    {
        Msg_GW_258.dlc =getValue(this);
    }
    else
    {
        Msg_GW_258.dlc =8;
    }
}

on envVar E_pubc_GW_GW_258_enDlc
{
    //For Messages with DLC = 8, set wrong DLC to smaller than defined DLC
    //For Messages with DLC < 8 set wrong DLC to smaller/longer than defined DLC
    if(getValue(this))
    {
        Msg_GW_258.dlc =getValue(E_pubc_GW_GW_258_Dlc);
    }
    else
    {
        Msg_GW_258.dlc =8;
    }
}

on envVar E_pubc_GW_GW_258_ESP_CRCCheck_258_wrongvalctr
{
    //update disturb count
    //disturb value range:(-1 = always send wrong value),( X>0 ,x is the number of Messages with wrong CHK sent)
    GW_258_ESP_CRCCheck_258_wrongvalctr =getValue(this);    
}
on envVar E_pubc_GW_GW_258_ESP_RollingCounter_258_wrongvalctr
{
    //update disturb count
    //disturb value range:(-1 = always send wrong value),( X>0 ,x is the number of Messages with wrong CHK sent)
    GW_258_ESP_RollingCounter_258_wrongvalctr =getValue(this);    
}

on envVar E_pubc_GW_GW_258_Wheel_Speed_RR_Pulse_Rv
{
    int64 rawValue = 0ll;
    float rawValue_float = 0.0;
    float phyValue = 0.0;        

    //set the signal with updated raw value
    {
        rawValue = getvalue(this);
        if(chgEv_GW_258_Wheel_Speed_RR_Pulse == 0)
        {
            //type conversion to float
            rawValue_float = rawValue;        
            // raw to physical conversion
            phyValue = ((rawValue_float *1)+(0));
            putValue(E_pubc_GW_GW_258_Wheel_Speed_RR_Pulse_Pv, phyValue);
            chgEv_GW_258_Wheel_Speed_RR_Pulse = 1;
        }
        else
        {
            chgEv_GW_258_Wheel_Speed_RR_Pulse = 0;
        }    
        //update the signal value
        Msg_GW_258.Wheel_Speed_RR_Pulse=rawValue;        
    }                                                                           
}

on envVar E_pubc_GW_GW_258_Wheel_Speed_RR_Pulse_Pv
{
    int64 rawValue = 0ll;
    float phyValue = 0.0;
    
    //update the raw value with physical value 
    {
        if(chgEv_GW_258_Wheel_Speed_RR_Pulse == 0)
        {
            phyValue = getvalue(this);
            // physical to raw conversion
            rawValue = ((phyValue -(0))/1);
            putValue(E_pubc_GW_GW_258_Wheel_Speed_RR_Pulse_Rv, rawValue);
            chgEv_GW_258_Wheel_Speed_RR_Pulse = 1;  
        }
        else
        {
            chgEv_GW_258_Wheel_Speed_RR_Pulse = 0;
        }
    }
}


 
on envVar E_pubc_GW_GW_258_ESP_MasCylBrakePressureValid_Rv
{
    int64 rawValue = 0ll;
    float rawValue_float = 0.0;
    float phyValue = 0.0;        

    //set the signal with updated raw value
    if(getValue(E_pubc_GW_GW_258_ESP_MasCylBrakePressureValid_SetVt)==0)
    {
        rawValue = getvalue(this);
        if(chgEv_GW_258_ESP_MasCylBrakePressureValid == 0)
        {
            //type conversion to float
            rawValue_float = rawValue;        
            // raw to physical conversion
            phyValue = ((rawValue_float *1)+(0));
            putValue(E_pubc_GW_GW_258_ESP_MasCylBrakePressureValid_Pv, phyValue);
            chgEv_GW_258_ESP_MasCylBrakePressureValid = 1;
        }
        else
        {
            chgEv_GW_258_ESP_MasCylBrakePressureValid = 0;
        }    
        //update the signal value
        Msg_GW_258.ESP_MasCylBrakePressureValid=rawValue;        
    }                                                                           
}

on envVar E_pubc_GW_GW_258_ESP_MasCylBrakePressureValid_Pv
{
    int64 rawValue = 0ll;
    float phyValue = 0.0;
    
    //update the raw value with physical value 
    if(getValue(E_pubc_GW_GW_258_ESP_MasCylBrakePressureValid_SetVt)==0)
    {
        if(chgEv_GW_258_ESP_MasCylBrakePressureValid == 0)
        {
            phyValue = getvalue(this);
            // physical to raw conversion
            rawValue = ((phyValue -(0))/1);
            putValue(E_pubc_GW_GW_258_ESP_MasCylBrakePressureValid_Rv, rawValue);
            chgEv_GW_258_ESP_MasCylBrakePressureValid = 1;  
        }
        else
        {
            chgEv_GW_258_ESP_MasCylBrakePressureValid = 0;
        }
    }
}

on envVar E_pubc_GW_GW_258_ESP_MasCylBrakePressureValid_Vt
{
    qword rawValue = 0ll;
    if(getValue(E_pubc_GW_GW_258_ESP_MasCylBrakePressureValid_SetVt))
    {
        //update the signal value
        Msg_GW_258.ESP_MasCylBrakePressureValid=getValue(this);
    }
}

on envVar E_pubc_GW_GW_258_ESP_MasCylBrakePressureValid_SetVt
{
    if(getValue(E_pubc_GW_GW_258_ESP_MasCylBrakePressureValid_SetVt))
    {
        //update the signal value
        Msg_GW_258.ESP_MasCylBrakePressureValid=getvalue(E_pubc_GW_GW_258_ESP_MasCylBrakePressureValid_Vt);
    }
    else
    {
        Msg_GW_258.ESP_MasCylBrakePressureValid=getValue(E_pubc_GW_GW_258_ESP_MasCylBrakePressureValid_Rv);
    }
}
 
on envVar E_pubc_GW_GW_258_Wheel_Speed_RL_Pulse_Rv
{
    int64 rawValue = 0ll;
    float rawValue_float = 0.0;
    float phyValue = 0.0;        

    //set the signal with updated raw value
    {
        rawValue = getvalue(this);
        if(chgEv_GW_258_Wheel_Speed_RL_Pulse == 0)
        {
            //type conversion to float
            rawValue_float = rawValue;        
            // raw to physical conversion
            phyValue = ((rawValue_float *1)+(0));
            putValue(E_pubc_GW_GW_258_Wheel_Speed_RL_Pulse_Pv, phyValue);
            chgEv_GW_258_Wheel_Speed_RL_Pulse = 1;
        }
        else
        {
            chgEv_GW_258_Wheel_Speed_RL_Pulse = 0;
        }    
        //update the signal value
        Msg_GW_258.Wheel_Speed_RL_Pulse=rawValue;        
    }                                                                           
}

on envVar E_pubc_GW_GW_258_Wheel_Speed_RL_Pulse_Pv
{
    int64 rawValue = 0ll;
    float phyValue = 0.0;
    
    //update the raw value with physical value 
    {
        if(chgEv_GW_258_Wheel_Speed_RL_Pulse == 0)
        {
            phyValue = getvalue(this);
            // physical to raw conversion
            rawValue = ((phyValue -(0))/1);
            putValue(E_pubc_GW_GW_258_Wheel_Speed_RL_Pulse_Rv, rawValue);
            chgEv_GW_258_Wheel_Speed_RL_Pulse = 1;  
        }
        else
        {
            chgEv_GW_258_Wheel_Speed_RL_Pulse = 0;
        }
    }
}


 
on envVar E_pubc_GW_GW_258_Wheel_Speed_FL_Pulse_Rv
{
    int64 rawValue = 0ll;
    float rawValue_float = 0.0;
    float phyValue = 0.0;        

    //set the signal with updated raw value
    {
        rawValue = getvalue(this);
        if(chgEv_GW_258_Wheel_Speed_FL_Pulse == 0)
        {
            //type conversion to float
            rawValue_float = rawValue;        
            // raw to physical conversion
            phyValue = ((rawValue_float *1)+(0));
            putValue(E_pubc_GW_GW_258_Wheel_Speed_FL_Pulse_Pv, phyValue);
            chgEv_GW_258_Wheel_Speed_FL_Pulse = 1;
        }
        else
        {
            chgEv_GW_258_Wheel_Speed_FL_Pulse = 0;
        }    
        //update the signal value
        Msg_GW_258.Wheel_Speed_FL_Pulse=rawValue;        
    }                                                                           
}

on envVar E_pubc_GW_GW_258_Wheel_Speed_FL_Pulse_Pv
{
    int64 rawValue = 0ll;
    float phyValue = 0.0;
    
    //update the raw value with physical value 
    {
        if(chgEv_GW_258_Wheel_Speed_FL_Pulse == 0)
        {
            phyValue = getvalue(this);
            // physical to raw conversion
            rawValue = ((phyValue -(0))/1);
            putValue(E_pubc_GW_GW_258_Wheel_Speed_FL_Pulse_Rv, rawValue);
            chgEv_GW_258_Wheel_Speed_FL_Pulse = 1;  
        }
        else
        {
            chgEv_GW_258_Wheel_Speed_FL_Pulse = 0;
        }
    }
}


 
on envVar E_pubc_GW_GW_258_Wheel_Speed_FR_Pulse_Rv
{
    int64 rawValue = 0ll;
    float rawValue_float = 0.0;
    float phyValue = 0.0;        

    //set the signal with updated raw value
    {
        rawValue = getvalue(this);
        if(chgEv_GW_258_Wheel_Speed_FR_Pulse == 0)
        {
            //type conversion to float
            rawValue_float = rawValue;        
            // raw to physical conversion
            phyValue = ((rawValue_float *1)+(0));
            putValue(E_pubc_GW_GW_258_Wheel_Speed_FR_Pulse_Pv, phyValue);
            chgEv_GW_258_Wheel_Speed_FR_Pulse = 1;
        }
        else
        {
            chgEv_GW_258_Wheel_Speed_FR_Pulse = 0;
        }    
        //update the signal value
        Msg_GW_258.Wheel_Speed_FR_Pulse=rawValue;        
    }                                                                           
}

on envVar E_pubc_GW_GW_258_Wheel_Speed_FR_Pulse_Pv
{
    int64 rawValue = 0ll;
    float phyValue = 0.0;
    
    //update the raw value with physical value 
    {
        if(chgEv_GW_258_Wheel_Speed_FR_Pulse == 0)
        {
            phyValue = getvalue(this);
            // physical to raw conversion
            rawValue = ((phyValue -(0))/1);
            putValue(E_pubc_GW_GW_258_Wheel_Speed_FR_Pulse_Rv, rawValue);
            chgEv_GW_258_Wheel_Speed_FR_Pulse = 1;  
        }
        else
        {
            chgEv_GW_258_Wheel_Speed_FR_Pulse = 0;
        }
    }
}


 
on envVar E_pubc_GW_GW_258_ESP_MasCylBrakePressure_Rv
{
    int64 rawValue = 0ll;
    float rawValue_float = 0.0;
    float phyValue = 0.0;        

    //set the signal with updated raw value
    {
        rawValue = getvalue(this);
        if(chgEv_GW_258_ESP_MasCylBrakePressure == 0)
        {
            //type conversion to float
            rawValue_float = rawValue;        
            // raw to physical conversion
            phyValue = ((rawValue_float *0.1)+(0));
            putValue(E_pubc_GW_GW_258_ESP_MasCylBrakePressure_Pv, phyValue);
            chgEv_GW_258_ESP_MasCylBrakePressure = 1;
        }
        else
        {
            chgEv_GW_258_ESP_MasCylBrakePressure = 0;
        }    
        //update the signal value
        Msg_GW_258.ESP_MasCylBrakePressure=rawValue;        
    }                                                                           
}

on envVar E_pubc_GW_GW_258_ESP_MasCylBrakePressure_Pv
{
    int64 rawValue = 0ll;
    float phyValue = 0.0;
    
    //update the raw value with physical value 
    {
        if(chgEv_GW_258_ESP_MasCylBrakePressure == 0)
        {
            phyValue = getvalue(this);
            // physical to raw conversion
            rawValue = ((phyValue -(0))/0.1);
            putValue(E_pubc_GW_GW_258_ESP_MasCylBrakePressure_Rv, rawValue);
            chgEv_GW_258_ESP_MasCylBrakePressure = 1;  
        }
        else
        {
            chgEv_GW_258_ESP_MasCylBrakePressure = 0;
        }
    }
}


 
on envVar E_pubc_GW_GW_277_tx
{
    if(getValue(this))
    {       
        
        //update the BZ Signal
        if(GW_277_ESP_RollingCounter_277_wrongvalctr == 0)
        {
            update_GW_277_ESP_RollingCounter_277_counter();
            Msg_GW_277.ESP_RollingCounter_277= GW_277_ESP_RollingCounter_277_counter;
        }
        else if(GW_277_ESP_RollingCounter_277_wrongvalctr > 0)
        {
             GW_277_ESP_RollingCounter_277_wrongvalctr--;
              // if counter becomes zero, update panel controller to zero
             if(GW_277_ESP_RollingCounter_277_wrongvalctr == 0)
             {
                 putValue(E_pubc_GW_GW_277_ESP_RollingCounter_277_wrongvalctr,0);
             }
        }
        else
        {
            //do nothing
        }        
        //calculate the CRC CheckSum
        update_GW_277_CRC_CheckSum();

        output(Msg_GW_277);        
    }
}

on envVar E_pubc_GW_GW_277_Range
{
    qword rawstatus = 0ll;
    qword rawValue = 0ll;    
    
    rawstatus = getvalue(this);    
    // set all the signals with min raw /max raw /init raw
    switch (rawstatus) 
    {
     case(0) :
        rawValue= 0;
        putValue(E_pubc_GW_GW_277_ESP_TCSActive_Rv, rawValue);
        rawValue= 0;
        putValue(E_pubc_GW_GW_277_ESP_VDCActive_Rv, rawValue);
        rawValue= 0;
        putValue(E_pubc_GW_GW_277_ESP_BrakeForce_Rv, rawValue);
        rawValue= 0;
        putValue(E_pubc_GW_GW_277_ESP_OnlyABSActive_Rv, rawValue);
        rawValue= 0;
        putValue(E_pubc_GW_GW_277_ESP_VehicleStandstill_Rv, rawValue);
        break;
     case(1) :
        rawValue= 1;
        putValue(E_pubc_GW_GW_277_ESP_TCSActive_Rv, rawValue);
        rawValue= 1;
        putValue(E_pubc_GW_GW_277_ESP_VDCActive_Rv, rawValue);
        rawValue= 1;
        putValue(E_pubc_GW_GW_277_ESP_BrakeForce_Rv, rawValue);
        rawValue= 1;
        putValue(E_pubc_GW_GW_277_ESP_OnlyABSActive_Rv, rawValue);
        rawValue= 1;
        putValue(E_pubc_GW_GW_277_ESP_VehicleStandstill_Rv, rawValue);
        break;
     default :
        rawValue= 0;
        putValue(E_pubc_GW_GW_277_ESP_TCSActive_Rv, rawValue);
        rawValue= 0;
        putValue(E_pubc_GW_GW_277_ESP_VDCActive_Rv, rawValue);
        rawValue= 0;
        putValue(E_pubc_GW_GW_277_ESP_BrakeForce_Rv, rawValue);
        rawValue= 0;
        putValue(E_pubc_GW_GW_277_ESP_OnlyABSActive_Rv, rawValue);
        rawValue= 0;
        putValue(E_pubc_GW_GW_277_ESP_VehicleStandstill_Rv, rawValue);
      break;
   }
}

on envVar E_pubc_GW_GW_277_Dlc
{
    if(getValue(E_pubc_GW_GW_277_enDlc))
    {
        Msg_GW_277.dlc =getValue(this);
    }
    else
    {
        Msg_GW_277.dlc =8;
    }
}

on envVar E_pubc_GW_GW_277_enDlc
{
    //For Messages with DLC = 8, set wrong DLC to smaller than defined DLC
    //For Messages with DLC < 8 set wrong DLC to smaller/longer than defined DLC
    if(getValue(this))
    {
        Msg_GW_277.dlc =getValue(E_pubc_GW_GW_277_Dlc);
    }
    else
    {
        Msg_GW_277.dlc =8;
    }
}

on envVar E_pubc_GW_GW_277_ESP_CRCCheck_277_wrongvalctr
{
    //update disturb count
    //disturb value range:(-1 = always send wrong value),( X>0 ,x is the number of Messages with wrong CHK sent)
    GW_277_ESP_CRCCheck_277_wrongvalctr =getValue(this);    
}
on envVar E_pubc_GW_GW_277_ESP_RollingCounter_277_wrongvalctr
{
    //update disturb count
    //disturb value range:(-1 = always send wrong value),( X>0 ,x is the number of Messages with wrong CHK sent)
    GW_277_ESP_RollingCounter_277_wrongvalctr =getValue(this);    
}

on envVar E_pubc_GW_GW_277_ESP_TCSActive_Rv
{
    int64 rawValue = 0ll;
    float rawValue_float = 0.0;
    float phyValue = 0.0;        

    //set the signal with updated raw value
    if(getValue(E_pubc_GW_GW_277_ESP_TCSActive_SetVt)==0)
    {
        rawValue = getvalue(this);
        if(chgEv_GW_277_ESP_TCSActive == 0)
        {
            //type conversion to float
            rawValue_float = rawValue;        
            // raw to physical conversion
            phyValue = ((rawValue_float *1)+(0));
            putValue(E_pubc_GW_GW_277_ESP_TCSActive_Pv, phyValue);
            chgEv_GW_277_ESP_TCSActive = 1;
        }
        else
        {
            chgEv_GW_277_ESP_TCSActive = 0;
        }    
        //update the signal value
        Msg_GW_277.ESP_TCSActive=rawValue;        
    }                                                                           
}

on envVar E_pubc_GW_GW_277_ESP_TCSActive_Pv
{
    int64 rawValue = 0ll;
    float phyValue = 0.0;
    
    //update the raw value with physical value 
    if(getValue(E_pubc_GW_GW_277_ESP_TCSActive_SetVt)==0)
    {
        if(chgEv_GW_277_ESP_TCSActive == 0)
        {
            phyValue = getvalue(this);
            // physical to raw conversion
            rawValue = ((phyValue -(0))/1);
            putValue(E_pubc_GW_GW_277_ESP_TCSActive_Rv, rawValue);
            chgEv_GW_277_ESP_TCSActive = 1;  
        }
        else
        {
            chgEv_GW_277_ESP_TCSActive = 0;
        }
    }
}

on envVar E_pubc_GW_GW_277_ESP_TCSActive_Vt
{
    qword rawValue = 0ll;
    if(getValue(E_pubc_GW_GW_277_ESP_TCSActive_SetVt))
    {
        //update the signal value
        Msg_GW_277.ESP_TCSActive=getValue(this);
    }
}

on envVar E_pubc_GW_GW_277_ESP_TCSActive_SetVt
{
    if(getValue(E_pubc_GW_GW_277_ESP_TCSActive_SetVt))
    {
        //update the signal value
        Msg_GW_277.ESP_TCSActive=getvalue(E_pubc_GW_GW_277_ESP_TCSActive_Vt);
    }
    else
    {
        Msg_GW_277.ESP_TCSActive=getValue(E_pubc_GW_GW_277_ESP_TCSActive_Rv);
    }
}
 
on envVar E_pubc_GW_GW_277_ESP_VDCActive_Rv
{
    int64 rawValue = 0ll;
    float rawValue_float = 0.0;
    float phyValue = 0.0;        

    //set the signal with updated raw value
    if(getValue(E_pubc_GW_GW_277_ESP_VDCActive_SetVt)==0)
    {
        rawValue = getvalue(this);
        if(chgEv_GW_277_ESP_VDCActive == 0)
        {
            //type conversion to float
            rawValue_float = rawValue;        
            // raw to physical conversion
            phyValue = ((rawValue_float *1)+(0));
            putValue(E_pubc_GW_GW_277_ESP_VDCActive_Pv, phyValue);
            chgEv_GW_277_ESP_VDCActive = 1;
        }
        else
        {
            chgEv_GW_277_ESP_VDCActive = 0;
        }    
        //update the signal value
        Msg_GW_277.ESP_VDCActive=rawValue;        
    }                                                                           
}

on envVar E_pubc_GW_GW_277_ESP_VDCActive_Pv
{
    int64 rawValue = 0ll;
    float phyValue = 0.0;
    
    //update the raw value with physical value 
    if(getValue(E_pubc_GW_GW_277_ESP_VDCActive_SetVt)==0)
    {
        if(chgEv_GW_277_ESP_VDCActive == 0)
        {
            phyValue = getvalue(this);
            // physical to raw conversion
            rawValue = ((phyValue -(0))/1);
            putValue(E_pubc_GW_GW_277_ESP_VDCActive_Rv, rawValue);
            chgEv_GW_277_ESP_VDCActive = 1;  
        }
        else
        {
            chgEv_GW_277_ESP_VDCActive = 0;
        }
    }
}

on envVar E_pubc_GW_GW_277_ESP_VDCActive_Vt
{
    qword rawValue = 0ll;
    if(getValue(E_pubc_GW_GW_277_ESP_VDCActive_SetVt))
    {
        //update the signal value
        Msg_GW_277.ESP_VDCActive=getValue(this);
    }
}

on envVar E_pubc_GW_GW_277_ESP_VDCActive_SetVt
{
    if(getValue(E_pubc_GW_GW_277_ESP_VDCActive_SetVt))
    {
        //update the signal value
        Msg_GW_277.ESP_VDCActive=getvalue(E_pubc_GW_GW_277_ESP_VDCActive_Vt);
    }
    else
    {
        Msg_GW_277.ESP_VDCActive=getValue(E_pubc_GW_GW_277_ESP_VDCActive_Rv);
    }
}
 
on envVar E_pubc_GW_GW_277_ESP_BrakeForce_Rv
{
    int64 rawValue = 0ll;
    float rawValue_float = 0.0;
    float phyValue = 0.0;        

    //set the signal with updated raw value
    if(getValue(E_pubc_GW_GW_277_ESP_BrakeForce_SetVt)==0)
    {
        rawValue = getvalue(this);
        if(chgEv_GW_277_ESP_BrakeForce == 0)
        {
            //type conversion to float
            rawValue_float = rawValue;        
            // raw to physical conversion
            phyValue = ((rawValue_float *1)+(0));
            putValue(E_pubc_GW_GW_277_ESP_BrakeForce_Pv, phyValue);
            chgEv_GW_277_ESP_BrakeForce = 1;
        }
        else
        {
            chgEv_GW_277_ESP_BrakeForce = 0;
        }    
        //update the signal value
        Msg_GW_277.ESP_BrakeForce=rawValue;        
    }                                                                           
}

on envVar E_pubc_GW_GW_277_ESP_BrakeForce_Pv
{
    int64 rawValue = 0ll;
    float phyValue = 0.0;
    
    //update the raw value with physical value 
    if(getValue(E_pubc_GW_GW_277_ESP_BrakeForce_SetVt)==0)
    {
        if(chgEv_GW_277_ESP_BrakeForce == 0)
        {
            phyValue = getvalue(this);
            // physical to raw conversion
            rawValue = ((phyValue -(0))/1);
            putValue(E_pubc_GW_GW_277_ESP_BrakeForce_Rv, rawValue);
            chgEv_GW_277_ESP_BrakeForce = 1;  
        }
        else
        {
            chgEv_GW_277_ESP_BrakeForce = 0;
        }
    }
}

on envVar E_pubc_GW_GW_277_ESP_BrakeForce_Vt
{
    qword rawValue = 0ll;
    if(getValue(E_pubc_GW_GW_277_ESP_BrakeForce_SetVt))
    {
        //update the signal value
        Msg_GW_277.ESP_BrakeForce=getValue(this);
    }
}

on envVar E_pubc_GW_GW_277_ESP_BrakeForce_SetVt
{
    if(getValue(E_pubc_GW_GW_277_ESP_BrakeForce_SetVt))
    {
        //update the signal value
        Msg_GW_277.ESP_BrakeForce=getvalue(E_pubc_GW_GW_277_ESP_BrakeForce_Vt);
    }
    else
    {
        Msg_GW_277.ESP_BrakeForce=getValue(E_pubc_GW_GW_277_ESP_BrakeForce_Rv);
    }
}
 
on envVar E_pubc_GW_GW_277_ESP_OnlyABSActive_Rv
{
    int64 rawValue = 0ll;
    float rawValue_float = 0.0;
    float phyValue = 0.0;        

    //set the signal with updated raw value
    if(getValue(E_pubc_GW_GW_277_ESP_OnlyABSActive_SetVt)==0)
    {
        rawValue = getvalue(this);
        if(chgEv_GW_277_ESP_OnlyABSActive == 0)
        {
            //type conversion to float
            rawValue_float = rawValue;        
            // raw to physical conversion
            phyValue = ((rawValue_float *1)+(0));
            putValue(E_pubc_GW_GW_277_ESP_OnlyABSActive_Pv, phyValue);
            chgEv_GW_277_ESP_OnlyABSActive = 1;
        }
        else
        {
            chgEv_GW_277_ESP_OnlyABSActive = 0;
        }    
        //update the signal value
        Msg_GW_277.ESP_OnlyABSActive=rawValue;        
    }                                                                           
}

on envVar E_pubc_GW_GW_277_ESP_OnlyABSActive_Pv
{
    int64 rawValue = 0ll;
    float phyValue = 0.0;
    
    //update the raw value with physical value 
    if(getValue(E_pubc_GW_GW_277_ESP_OnlyABSActive_SetVt)==0)
    {
        if(chgEv_GW_277_ESP_OnlyABSActive == 0)
        {
            phyValue = getvalue(this);
            // physical to raw conversion
            rawValue = ((phyValue -(0))/1);
            putValue(E_pubc_GW_GW_277_ESP_OnlyABSActive_Rv, rawValue);
            chgEv_GW_277_ESP_OnlyABSActive = 1;  
        }
        else
        {
            chgEv_GW_277_ESP_OnlyABSActive = 0;
        }
    }
}

on envVar E_pubc_GW_GW_277_ESP_OnlyABSActive_Vt
{
    qword rawValue = 0ll;
    if(getValue(E_pubc_GW_GW_277_ESP_OnlyABSActive_SetVt))
    {
        //update the signal value
        Msg_GW_277.ESP_OnlyABSActive=getValue(this);
    }
}

on envVar E_pubc_GW_GW_277_ESP_OnlyABSActive_SetVt
{
    if(getValue(E_pubc_GW_GW_277_ESP_OnlyABSActive_SetVt))
    {
        //update the signal value
        Msg_GW_277.ESP_OnlyABSActive=getvalue(E_pubc_GW_GW_277_ESP_OnlyABSActive_Vt);
    }
    else
    {
        Msg_GW_277.ESP_OnlyABSActive=getValue(E_pubc_GW_GW_277_ESP_OnlyABSActive_Rv);
    }
}
 
on envVar E_pubc_GW_GW_277_ESP_VehicleStandstill_Rv
{
    int64 rawValue = 0ll;
    float rawValue_float = 0.0;
    float phyValue = 0.0;        

    //set the signal with updated raw value
    if(getValue(E_pubc_GW_GW_277_ESP_VehicleStandstill_SetVt)==0)
    {
        rawValue = getvalue(this);
        if(chgEv_GW_277_ESP_VehicleStandstill == 0)
        {
            //type conversion to float
            rawValue_float = rawValue;        
            // raw to physical conversion
            phyValue = ((rawValue_float *1)+(0));
            putValue(E_pubc_GW_GW_277_ESP_VehicleStandstill_Pv, phyValue);
            chgEv_GW_277_ESP_VehicleStandstill = 1;
        }
        else
        {
            chgEv_GW_277_ESP_VehicleStandstill = 0;
        }    
        //update the signal value
        Msg_GW_277.ESP_VehicleStandstill=rawValue;        
    }                                                                           
}

on envVar E_pubc_GW_GW_277_ESP_VehicleStandstill_Pv
{
    int64 rawValue = 0ll;
    float phyValue = 0.0;
    
    //update the raw value with physical value 
    if(getValue(E_pubc_GW_GW_277_ESP_VehicleStandstill_SetVt)==0)
    {
        if(chgEv_GW_277_ESP_VehicleStandstill == 0)
        {
            phyValue = getvalue(this);
            // physical to raw conversion
            rawValue = ((phyValue -(0))/1);
            putValue(E_pubc_GW_GW_277_ESP_VehicleStandstill_Rv, rawValue);
            chgEv_GW_277_ESP_VehicleStandstill = 1;  
        }
        else
        {
            chgEv_GW_277_ESP_VehicleStandstill = 0;
        }
    }
}

on envVar E_pubc_GW_GW_277_ESP_VehicleStandstill_Vt
{
    qword rawValue = 0ll;
    if(getValue(E_pubc_GW_GW_277_ESP_VehicleStandstill_SetVt))
    {
        //update the signal value
        Msg_GW_277.ESP_VehicleStandstill=getValue(this);
    }
}

on envVar E_pubc_GW_GW_277_ESP_VehicleStandstill_SetVt
{
    if(getValue(E_pubc_GW_GW_277_ESP_VehicleStandstill_SetVt))
    {
        //update the signal value
        Msg_GW_277.ESP_VehicleStandstill=getvalue(E_pubc_GW_GW_277_ESP_VehicleStandstill_Vt);
    }
    else
    {
        Msg_GW_277.ESP_VehicleStandstill=getValue(E_pubc_GW_GW_277_ESP_VehicleStandstill_Rv);
    }
}
 
on envVar E_pubc_GW_GW_356_tx
{
    if(getValue(this))
    {       
        
        //update the BZ Signal
        if(GW_356_IMS_RollingCounter_356_wrongvalctr == 0)
        {
            update_GW_356_IMS_RollingCounter_356_counter();
            Msg_GW_356.IMS_RollingCounter_356= GW_356_IMS_RollingCounter_356_counter;
        }
        else if(GW_356_IMS_RollingCounter_356_wrongvalctr > 0)
        {
             GW_356_IMS_RollingCounter_356_wrongvalctr--;
              // if counter becomes zero, update panel controller to zero
             if(GW_356_IMS_RollingCounter_356_wrongvalctr == 0)
             {
                 putValue(E_pubc_GW_GW_356_IMS_RollingCounter_356_wrongvalctr,0);
             }
        }
        else
        {
            //do nothing
        }        
        //calculate the CRC CheckSum
        update_GW_356_CRC_CheckSum();

        output(Msg_GW_356);        
    }
}

on envVar E_pubc_GW_GW_356_Range
{
    qword rawstatus = 0ll;
    qword rawValue = 0ll;    
    
    rawstatus = getvalue(this);    
    // set all the signals with min raw /max raw /init raw
    switch (rawstatus) 
    {
     case(0) :
        rawValue= 0;
        putValue(E_pubc_GW_GW_356_IMS_DistractionStatus_Rv, rawValue);
        rawValue= 0;
        putValue(E_pubc_GW_GW_356_IMS_IMSStatus_Rv, rawValue);
        rawValue= 0;
        putValue(E_pubc_GW_GW_356_IMS_DriverEyesFovArea_Rv, rawValue);
        rawValue= 0;
        putValue(E_pubc_GW_GW_356_IMS_DriverEyeClosestatus_Rv, rawValue);
        rawValue= 0;
        putValue(E_pubc_GW_GW_356_IMS_DriverEyeDetect_Rv, rawValue);
        rawValue= 0;
        putValue(E_pubc_GW_GW_356_IMS_DriverEyeConfidence_Rv, rawValue);
        rawValue= 0;
        putValue(E_pubc_GW_GW_356_IMS_PhoneCallSts_Rv, rawValue);
        rawValue= 0;
        putValue(E_pubc_GW_GW_356_IMS_DrowsinessStatus_Rv, rawValue);
        rawValue= 0;
        putValue(E_pubc_GW_GW_356_IMS_EyeGazeStatus_Rv, rawValue);
        rawValue= 0;
        putValue(E_pubc_GW_GW_356_IMS_EyeDetectSatus_Rv, rawValue);
        rawValue= 0;
        putValue(E_pubc_GW_GW_356_IMS_DriverHeadDetect_Rv, rawValue);
        break;
     case(1) :
        rawValue= 3;
        putValue(E_pubc_GW_GW_356_IMS_DistractionStatus_Rv, rawValue);
        rawValue= 7;
        putValue(E_pubc_GW_GW_356_IMS_IMSStatus_Rv, rawValue);
        rawValue= 15;
        putValue(E_pubc_GW_GW_356_IMS_DriverEyesFovArea_Rv, rawValue);
        rawValue= 7;
        putValue(E_pubc_GW_GW_356_IMS_DriverEyeClosestatus_Rv, rawValue);
        rawValue= 3;
        putValue(E_pubc_GW_GW_356_IMS_DriverEyeDetect_Rv, rawValue);
        rawValue= 255;
        putValue(E_pubc_GW_GW_356_IMS_DriverEyeConfidence_Rv, rawValue);
        rawValue= 1;
        putValue(E_pubc_GW_GW_356_IMS_PhoneCallSts_Rv, rawValue);
        rawValue= 7;
        putValue(E_pubc_GW_GW_356_IMS_DrowsinessStatus_Rv, rawValue);
        rawValue= 150;
        putValue(E_pubc_GW_GW_356_IMS_EyeGazeStatus_Rv, rawValue);
        rawValue= 100;
        putValue(E_pubc_GW_GW_356_IMS_EyeDetectSatus_Rv, rawValue);
        rawValue= 3;
        putValue(E_pubc_GW_GW_356_IMS_DriverHeadDetect_Rv, rawValue);
        break;
     default :
        rawValue= 0;
        putValue(E_pubc_GW_GW_356_IMS_DistractionStatus_Rv, rawValue);
        rawValue= 0;
        putValue(E_pubc_GW_GW_356_IMS_IMSStatus_Rv, rawValue);
        rawValue= 0;
        putValue(E_pubc_GW_GW_356_IMS_DriverEyesFovArea_Rv, rawValue);
        rawValue= 0;
        putValue(E_pubc_GW_GW_356_IMS_DriverEyeClosestatus_Rv, rawValue);
        rawValue= 0;
        putValue(E_pubc_GW_GW_356_IMS_DriverEyeDetect_Rv, rawValue);
        rawValue= 0;
        putValue(E_pubc_GW_GW_356_IMS_DriverEyeConfidence_Rv, rawValue);
        rawValue= 0;
        putValue(E_pubc_GW_GW_356_IMS_PhoneCallSts_Rv, rawValue);
        rawValue= 0;
        putValue(E_pubc_GW_GW_356_IMS_DrowsinessStatus_Rv, rawValue);
        rawValue= 0;
        putValue(E_pubc_GW_GW_356_IMS_EyeGazeStatus_Rv, rawValue);
        rawValue= 0;
        putValue(E_pubc_GW_GW_356_IMS_EyeDetectSatus_Rv, rawValue);
        rawValue= 0;
        putValue(E_pubc_GW_GW_356_IMS_DriverHeadDetect_Rv, rawValue);
      break;
   }
}

on envVar E_pubc_GW_GW_356_Dlc
{
    if(getValue(E_pubc_GW_GW_356_enDlc))
    {
        Msg_GW_356.dlc =getValue(this);
    }
    else
    {
        Msg_GW_356.dlc =8;
    }
}

on envVar E_pubc_GW_GW_356_enDlc
{
    //For Messages with DLC = 8, set wrong DLC to smaller than defined DLC
    //For Messages with DLC < 8 set wrong DLC to smaller/longer than defined DLC
    if(getValue(this))
    {
        Msg_GW_356.dlc =getValue(E_pubc_GW_GW_356_Dlc);
    }
    else
    {
        Msg_GW_356.dlc =8;
    }
}

on envVar E_pubc_GW_GW_356_IMS_CRCCheck_356_wrongvalctr
{
    //update disturb count
    //disturb value range:(-1 = always send wrong value),( X>0 ,x is the number of Messages with wrong CHK sent)
    GW_356_IMS_CRCCheck_356_wrongvalctr =getValue(this);    
}
on envVar E_pubc_GW_GW_356_IMS_RollingCounter_356_wrongvalctr
{
    //update disturb count
    //disturb value range:(-1 = always send wrong value),( X>0 ,x is the number of Messages with wrong CHK sent)
    GW_356_IMS_RollingCounter_356_wrongvalctr =getValue(this);    
}

on envVar E_pubc_GW_GW_356_IMS_DistractionStatus_Rv
{
    int64 rawValue = 0ll;
    float rawValue_float = 0.0;
    float phyValue = 0.0;        

    //set the signal with updated raw value
    if(getValue(E_pubc_GW_GW_356_IMS_DistractionStatus_SetVt)==0)
    {
        rawValue = getvalue(this);
        if(chgEv_GW_356_IMS_DistractionStatus == 0)
        {
            //type conversion to float
            rawValue_float = rawValue;        
            // raw to physical conversion
            phyValue = ((rawValue_float *1)+(0));
            putValue(E_pubc_GW_GW_356_IMS_DistractionStatus_Pv, phyValue);
            chgEv_GW_356_IMS_DistractionStatus = 1;
        }
        else
        {
            chgEv_GW_356_IMS_DistractionStatus = 0;
        }    
        //update the signal value
        Msg_GW_356.IMS_DistractionStatus=rawValue;        
    }                                                                           
}

on envVar E_pubc_GW_GW_356_IMS_DistractionStatus_Pv
{
    int64 rawValue = 0ll;
    float phyValue = 0.0;
    
    //update the raw value with physical value 
    if(getValue(E_pubc_GW_GW_356_IMS_DistractionStatus_SetVt)==0)
    {
        if(chgEv_GW_356_IMS_DistractionStatus == 0)
        {
            phyValue = getvalue(this);
            // physical to raw conversion
            rawValue = ((phyValue -(0))/1);
            putValue(E_pubc_GW_GW_356_IMS_DistractionStatus_Rv, rawValue);
            chgEv_GW_356_IMS_DistractionStatus = 1;  
        }
        else
        {
            chgEv_GW_356_IMS_DistractionStatus = 0;
        }
    }
}

on envVar E_pubc_GW_GW_356_IMS_DistractionStatus_Vt
{
    qword rawValue = 0ll;
    if(getValue(E_pubc_GW_GW_356_IMS_DistractionStatus_SetVt))
    {
        //update the signal value
        Msg_GW_356.IMS_DistractionStatus=getValue(this);
    }
}

on envVar E_pubc_GW_GW_356_IMS_DistractionStatus_SetVt
{
    if(getValue(E_pubc_GW_GW_356_IMS_DistractionStatus_SetVt))
    {
        //update the signal value
        Msg_GW_356.IMS_DistractionStatus=getvalue(E_pubc_GW_GW_356_IMS_DistractionStatus_Vt);
    }
    else
    {
        Msg_GW_356.IMS_DistractionStatus=getValue(E_pubc_GW_GW_356_IMS_DistractionStatus_Rv);
    }
}
 
on envVar E_pubc_GW_GW_356_IMS_IMSStatus_Rv
{
    int64 rawValue = 0ll;
    float rawValue_float = 0.0;
    float phyValue = 0.0;        

    //set the signal with updated raw value
    if(getValue(E_pubc_GW_GW_356_IMS_IMSStatus_SetVt)==0)
    {
        rawValue = getvalue(this);
        if(chgEv_GW_356_IMS_IMSStatus == 0)
        {
            //type conversion to float
            rawValue_float = rawValue;        
            // raw to physical conversion
            phyValue = ((rawValue_float *1)+(0));
            putValue(E_pubc_GW_GW_356_IMS_IMSStatus_Pv, phyValue);
            chgEv_GW_356_IMS_IMSStatus = 1;
        }
        else
        {
            chgEv_GW_356_IMS_IMSStatus = 0;
        }    
        //update the signal value
        Msg_GW_356.IMS_IMSStatus=rawValue;        
    }                                                                           
}

on envVar E_pubc_GW_GW_356_IMS_IMSStatus_Pv
{
    int64 rawValue = 0ll;
    float phyValue = 0.0;
    
    //update the raw value with physical value 
    if(getValue(E_pubc_GW_GW_356_IMS_IMSStatus_SetVt)==0)
    {
        if(chgEv_GW_356_IMS_IMSStatus == 0)
        {
            phyValue = getvalue(this);
            // physical to raw conversion
            rawValue = ((phyValue -(0))/1);
            putValue(E_pubc_GW_GW_356_IMS_IMSStatus_Rv, rawValue);
            chgEv_GW_356_IMS_IMSStatus = 1;  
        }
        else
        {
            chgEv_GW_356_IMS_IMSStatus = 0;
        }
    }
}

on envVar E_pubc_GW_GW_356_IMS_IMSStatus_Vt
{
    qword rawValue = 0ll;
    if(getValue(E_pubc_GW_GW_356_IMS_IMSStatus_SetVt))
    {
        //update the signal value
        Msg_GW_356.IMS_IMSStatus=getValue(this);
    }
}

on envVar E_pubc_GW_GW_356_IMS_IMSStatus_SetVt
{
    if(getValue(E_pubc_GW_GW_356_IMS_IMSStatus_SetVt))
    {
        //update the signal value
        Msg_GW_356.IMS_IMSStatus=getvalue(E_pubc_GW_GW_356_IMS_IMSStatus_Vt);
    }
    else
    {
        Msg_GW_356.IMS_IMSStatus=getValue(E_pubc_GW_GW_356_IMS_IMSStatus_Rv);
    }
}
 
on envVar E_pubc_GW_GW_356_IMS_DriverEyesFovArea_Rv
{
    int64 rawValue = 0ll;
    float rawValue_float = 0.0;
    float phyValue = 0.0;        

    //set the signal with updated raw value
    if(getValue(E_pubc_GW_GW_356_IMS_DriverEyesFovArea_SetVt)==0)
    {
        rawValue = getvalue(this);
        if(chgEv_GW_356_IMS_DriverEyesFovArea == 0)
        {
            //type conversion to float
            rawValue_float = rawValue;        
            // raw to physical conversion
            phyValue = ((rawValue_float *1)+(0));
            putValue(E_pubc_GW_GW_356_IMS_DriverEyesFovArea_Pv, phyValue);
            chgEv_GW_356_IMS_DriverEyesFovArea = 1;
        }
        else
        {
            chgEv_GW_356_IMS_DriverEyesFovArea = 0;
        }    
        //update the signal value
        Msg_GW_356.IMS_DriverEyesFovArea=rawValue;        
    }                                                                           
}

on envVar E_pubc_GW_GW_356_IMS_DriverEyesFovArea_Pv
{
    int64 rawValue = 0ll;
    float phyValue = 0.0;
    
    //update the raw value with physical value 
    if(getValue(E_pubc_GW_GW_356_IMS_DriverEyesFovArea_SetVt)==0)
    {
        if(chgEv_GW_356_IMS_DriverEyesFovArea == 0)
        {
            phyValue = getvalue(this);
            // physical to raw conversion
            rawValue = ((phyValue -(0))/1);
            putValue(E_pubc_GW_GW_356_IMS_DriverEyesFovArea_Rv, rawValue);
            chgEv_GW_356_IMS_DriverEyesFovArea = 1;  
        }
        else
        {
            chgEv_GW_356_IMS_DriverEyesFovArea = 0;
        }
    }
}

on envVar E_pubc_GW_GW_356_IMS_DriverEyesFovArea_Vt
{
    qword rawValue = 0ll;
    if(getValue(E_pubc_GW_GW_356_IMS_DriverEyesFovArea_SetVt))
    {
        //update the signal value
        Msg_GW_356.IMS_DriverEyesFovArea=getValue(this);
    }
}

on envVar E_pubc_GW_GW_356_IMS_DriverEyesFovArea_SetVt
{
    if(getValue(E_pubc_GW_GW_356_IMS_DriverEyesFovArea_SetVt))
    {
        //update the signal value
        Msg_GW_356.IMS_DriverEyesFovArea=getvalue(E_pubc_GW_GW_356_IMS_DriverEyesFovArea_Vt);
    }
    else
    {
        Msg_GW_356.IMS_DriverEyesFovArea=getValue(E_pubc_GW_GW_356_IMS_DriverEyesFovArea_Rv);
    }
}
 
on envVar E_pubc_GW_GW_356_IMS_DriverEyeClosestatus_Rv
{
    int64 rawValue = 0ll;
    float rawValue_float = 0.0;
    float phyValue = 0.0;        

    //set the signal with updated raw value
    if(getValue(E_pubc_GW_GW_356_IMS_DriverEyeClosestatus_SetVt)==0)
    {
        rawValue = getvalue(this);
        if(chgEv_GW_356_IMS_DriverEyeClosestatus == 0)
        {
            //type conversion to float
            rawValue_float = rawValue;        
            // raw to physical conversion
            phyValue = ((rawValue_float *1)+(0));
            putValue(E_pubc_GW_GW_356_IMS_DriverEyeClosestatus_Pv, phyValue);
            chgEv_GW_356_IMS_DriverEyeClosestatus = 1;
        }
        else
        {
            chgEv_GW_356_IMS_DriverEyeClosestatus = 0;
        }    
        //update the signal value
        Msg_GW_356.IMS_DriverEyeClosestatus=rawValue;        
    }                                                                           
}

on envVar E_pubc_GW_GW_356_IMS_DriverEyeClosestatus_Pv
{
    int64 rawValue = 0ll;
    float phyValue = 0.0;
    
    //update the raw value with physical value 
    if(getValue(E_pubc_GW_GW_356_IMS_DriverEyeClosestatus_SetVt)==0)
    {
        if(chgEv_GW_356_IMS_DriverEyeClosestatus == 0)
        {
            phyValue = getvalue(this);
            // physical to raw conversion
            rawValue = ((phyValue -(0))/1);
            putValue(E_pubc_GW_GW_356_IMS_DriverEyeClosestatus_Rv, rawValue);
            chgEv_GW_356_IMS_DriverEyeClosestatus = 1;  
        }
        else
        {
            chgEv_GW_356_IMS_DriverEyeClosestatus = 0;
        }
    }
}

on envVar E_pubc_GW_GW_356_IMS_DriverEyeClosestatus_Vt
{
    qword rawValue = 0ll;
    if(getValue(E_pubc_GW_GW_356_IMS_DriverEyeClosestatus_SetVt))
    {
        //update the signal value
        Msg_GW_356.IMS_DriverEyeClosestatus=getValue(this);
    }
}

on envVar E_pubc_GW_GW_356_IMS_DriverEyeClosestatus_SetVt
{
    if(getValue(E_pubc_GW_GW_356_IMS_DriverEyeClosestatus_SetVt))
    {
        //update the signal value
        Msg_GW_356.IMS_DriverEyeClosestatus=getvalue(E_pubc_GW_GW_356_IMS_DriverEyeClosestatus_Vt);
    }
    else
    {
        Msg_GW_356.IMS_DriverEyeClosestatus=getValue(E_pubc_GW_GW_356_IMS_DriverEyeClosestatus_Rv);
    }
}
 
on envVar E_pubc_GW_GW_356_IMS_DriverEyeDetect_Rv
{
    int64 rawValue = 0ll;
    float rawValue_float = 0.0;
    float phyValue = 0.0;        

    //set the signal with updated raw value
    if(getValue(E_pubc_GW_GW_356_IMS_DriverEyeDetect_SetVt)==0)
    {
        rawValue = getvalue(this);
        if(chgEv_GW_356_IMS_DriverEyeDetect == 0)
        {
            //type conversion to float
            rawValue_float = rawValue;        
            // raw to physical conversion
            phyValue = ((rawValue_float *1)+(0));
            putValue(E_pubc_GW_GW_356_IMS_DriverEyeDetect_Pv, phyValue);
            chgEv_GW_356_IMS_DriverEyeDetect = 1;
        }
        else
        {
            chgEv_GW_356_IMS_DriverEyeDetect = 0;
        }    
        //update the signal value
        Msg_GW_356.IMS_DriverEyeDetect=rawValue;        
    }                                                                           
}

on envVar E_pubc_GW_GW_356_IMS_DriverEyeDetect_Pv
{
    int64 rawValue = 0ll;
    float phyValue = 0.0;
    
    //update the raw value with physical value 
    if(getValue(E_pubc_GW_GW_356_IMS_DriverEyeDetect_SetVt)==0)
    {
        if(chgEv_GW_356_IMS_DriverEyeDetect == 0)
        {
            phyValue = getvalue(this);
            // physical to raw conversion
            rawValue = ((phyValue -(0))/1);
            putValue(E_pubc_GW_GW_356_IMS_DriverEyeDetect_Rv, rawValue);
            chgEv_GW_356_IMS_DriverEyeDetect = 1;  
        }
        else
        {
            chgEv_GW_356_IMS_DriverEyeDetect = 0;
        }
    }
}

on envVar E_pubc_GW_GW_356_IMS_DriverEyeDetect_Vt
{
    qword rawValue = 0ll;
    if(getValue(E_pubc_GW_GW_356_IMS_DriverEyeDetect_SetVt))
    {
        //update the signal value
        Msg_GW_356.IMS_DriverEyeDetect=getValue(this);
    }
}

on envVar E_pubc_GW_GW_356_IMS_DriverEyeDetect_SetVt
{
    if(getValue(E_pubc_GW_GW_356_IMS_DriverEyeDetect_SetVt))
    {
        //update the signal value
        Msg_GW_356.IMS_DriverEyeDetect=getvalue(E_pubc_GW_GW_356_IMS_DriverEyeDetect_Vt);
    }
    else
    {
        Msg_GW_356.IMS_DriverEyeDetect=getValue(E_pubc_GW_GW_356_IMS_DriverEyeDetect_Rv);
    }
}
 
on envVar E_pubc_GW_GW_356_IMS_DriverEyeConfidence_Rv
{
    int64 rawValue = 0ll;
    float rawValue_float = 0.0;
    float phyValue = 0.0;        

    //set the signal with updated raw value
    if(getValue(E_pubc_GW_GW_356_IMS_DriverEyeConfidence_SetVt)==0)
    {
        rawValue = getvalue(this);
        if(chgEv_GW_356_IMS_DriverEyeConfidence == 0)
        {
            //type conversion to float
            rawValue_float = rawValue;        
            // raw to physical conversion
            phyValue = ((rawValue_float *1)+(0));
            putValue(E_pubc_GW_GW_356_IMS_DriverEyeConfidence_Pv, phyValue);
            chgEv_GW_356_IMS_DriverEyeConfidence = 1;
        }
        else
        {
            chgEv_GW_356_IMS_DriverEyeConfidence = 0;
        }    
        //update the signal value
        Msg_GW_356.IMS_DriverEyeConfidence=rawValue;        
    }                                                                           
}

on envVar E_pubc_GW_GW_356_IMS_DriverEyeConfidence_Pv
{
    int64 rawValue = 0ll;
    float phyValue = 0.0;
    
    //update the raw value with physical value 
    if(getValue(E_pubc_GW_GW_356_IMS_DriverEyeConfidence_SetVt)==0)
    {
        if(chgEv_GW_356_IMS_DriverEyeConfidence == 0)
        {
            phyValue = getvalue(this);
            // physical to raw conversion
            rawValue = ((phyValue -(0))/1);
            putValue(E_pubc_GW_GW_356_IMS_DriverEyeConfidence_Rv, rawValue);
            chgEv_GW_356_IMS_DriverEyeConfidence = 1;  
        }
        else
        {
            chgEv_GW_356_IMS_DriverEyeConfidence = 0;
        }
    }
}

on envVar E_pubc_GW_GW_356_IMS_DriverEyeConfidence_Vt
{
    qword rawValue = 0ll;
    if(getValue(E_pubc_GW_GW_356_IMS_DriverEyeConfidence_SetVt))
    {
        //update the signal value
        Msg_GW_356.IMS_DriverEyeConfidence=getValue(this);
    }
}

on envVar E_pubc_GW_GW_356_IMS_DriverEyeConfidence_SetVt
{
    if(getValue(E_pubc_GW_GW_356_IMS_DriverEyeConfidence_SetVt))
    {
        //update the signal value
        Msg_GW_356.IMS_DriverEyeConfidence=getvalue(E_pubc_GW_GW_356_IMS_DriverEyeConfidence_Vt);
    }
    else
    {
        Msg_GW_356.IMS_DriverEyeConfidence=getValue(E_pubc_GW_GW_356_IMS_DriverEyeConfidence_Rv);
    }
}
 
on envVar E_pubc_GW_GW_356_IMS_PhoneCallSts_Rv
{
    int64 rawValue = 0ll;
    float rawValue_float = 0.0;
    float phyValue = 0.0;        

    //set the signal with updated raw value
    if(getValue(E_pubc_GW_GW_356_IMS_PhoneCallSts_SetVt)==0)
    {
        rawValue = getvalue(this);
        if(chgEv_GW_356_IMS_PhoneCallSts == 0)
        {
            //type conversion to float
            rawValue_float = rawValue;        
            // raw to physical conversion
            phyValue = ((rawValue_float *1)+(0));
            putValue(E_pubc_GW_GW_356_IMS_PhoneCallSts_Pv, phyValue);
            chgEv_GW_356_IMS_PhoneCallSts = 1;
        }
        else
        {
            chgEv_GW_356_IMS_PhoneCallSts = 0;
        }    
        //update the signal value
        Msg_GW_356.IMS_PhoneCallSts=rawValue;        
    }                                                                           
}

on envVar E_pubc_GW_GW_356_IMS_PhoneCallSts_Pv
{
    int64 rawValue = 0ll;
    float phyValue = 0.0;
    
    //update the raw value with physical value 
    if(getValue(E_pubc_GW_GW_356_IMS_PhoneCallSts_SetVt)==0)
    {
        if(chgEv_GW_356_IMS_PhoneCallSts == 0)
        {
            phyValue = getvalue(this);
            // physical to raw conversion
            rawValue = ((phyValue -(0))/1);
            putValue(E_pubc_GW_GW_356_IMS_PhoneCallSts_Rv, rawValue);
            chgEv_GW_356_IMS_PhoneCallSts = 1;  
        }
        else
        {
            chgEv_GW_356_IMS_PhoneCallSts = 0;
        }
    }
}

on envVar E_pubc_GW_GW_356_IMS_PhoneCallSts_Vt
{
    qword rawValue = 0ll;
    if(getValue(E_pubc_GW_GW_356_IMS_PhoneCallSts_SetVt))
    {
        //update the signal value
        Msg_GW_356.IMS_PhoneCallSts=getValue(this);
    }
}

on envVar E_pubc_GW_GW_356_IMS_PhoneCallSts_SetVt
{
    if(getValue(E_pubc_GW_GW_356_IMS_PhoneCallSts_SetVt))
    {
        //update the signal value
        Msg_GW_356.IMS_PhoneCallSts=getvalue(E_pubc_GW_GW_356_IMS_PhoneCallSts_Vt);
    }
    else
    {
        Msg_GW_356.IMS_PhoneCallSts=getValue(E_pubc_GW_GW_356_IMS_PhoneCallSts_Rv);
    }
}
 
on envVar E_pubc_GW_GW_356_IMS_DrowsinessStatus_Rv
{
    int64 rawValue = 0ll;
    float rawValue_float = 0.0;
    float phyValue = 0.0;        

    //set the signal with updated raw value
    if(getValue(E_pubc_GW_GW_356_IMS_DrowsinessStatus_SetVt)==0)
    {
        rawValue = getvalue(this);
        if(chgEv_GW_356_IMS_DrowsinessStatus == 0)
        {
            //type conversion to float
            rawValue_float = rawValue;        
            // raw to physical conversion
            phyValue = ((rawValue_float *1)+(0));
            putValue(E_pubc_GW_GW_356_IMS_DrowsinessStatus_Pv, phyValue);
            chgEv_GW_356_IMS_DrowsinessStatus = 1;
        }
        else
        {
            chgEv_GW_356_IMS_DrowsinessStatus = 0;
        }    
        //update the signal value
        Msg_GW_356.IMS_DrowsinessStatus=rawValue;        
    }                                                                           
}

on envVar E_pubc_GW_GW_356_IMS_DrowsinessStatus_Pv
{
    int64 rawValue = 0ll;
    float phyValue = 0.0;
    
    //update the raw value with physical value 
    if(getValue(E_pubc_GW_GW_356_IMS_DrowsinessStatus_SetVt)==0)
    {
        if(chgEv_GW_356_IMS_DrowsinessStatus == 0)
        {
            phyValue = getvalue(this);
            // physical to raw conversion
            rawValue = ((phyValue -(0))/1);
            putValue(E_pubc_GW_GW_356_IMS_DrowsinessStatus_Rv, rawValue);
            chgEv_GW_356_IMS_DrowsinessStatus = 1;  
        }
        else
        {
            chgEv_GW_356_IMS_DrowsinessStatus = 0;
        }
    }
}

on envVar E_pubc_GW_GW_356_IMS_DrowsinessStatus_Vt
{
    qword rawValue = 0ll;
    if(getValue(E_pubc_GW_GW_356_IMS_DrowsinessStatus_SetVt))
    {
        //update the signal value
        Msg_GW_356.IMS_DrowsinessStatus=getValue(this);
    }
}

on envVar E_pubc_GW_GW_356_IMS_DrowsinessStatus_SetVt
{
    if(getValue(E_pubc_GW_GW_356_IMS_DrowsinessStatus_SetVt))
    {
        //update the signal value
        Msg_GW_356.IMS_DrowsinessStatus=getvalue(E_pubc_GW_GW_356_IMS_DrowsinessStatus_Vt);
    }
    else
    {
        Msg_GW_356.IMS_DrowsinessStatus=getValue(E_pubc_GW_GW_356_IMS_DrowsinessStatus_Rv);
    }
}
 
on envVar E_pubc_GW_GW_356_IMS_EyeGazeStatus_Rv
{
    int64 rawValue = 0ll;
    float rawValue_float = 0.0;
    float phyValue = 0.0;        

    //set the signal with updated raw value
    if(getValue(E_pubc_GW_GW_356_IMS_EyeGazeStatus_SetVt)==0)
    {
        rawValue = getvalue(this);
        if(chgEv_GW_356_IMS_EyeGazeStatus == 0)
        {
            //type conversion to float
            rawValue_float = rawValue;        
            // raw to physical conversion
            phyValue = ((rawValue_float *1)+(-75));
            putValue(E_pubc_GW_GW_356_IMS_EyeGazeStatus_Pv, phyValue);
            chgEv_GW_356_IMS_EyeGazeStatus = 1;
        }
        else
        {
            chgEv_GW_356_IMS_EyeGazeStatus = 0;
        }    
        //update the signal value
        Msg_GW_356.IMS_EyeGazeStatus=rawValue;        
    }                                                                           
}

on envVar E_pubc_GW_GW_356_IMS_EyeGazeStatus_Pv
{
    int64 rawValue = 0ll;
    float phyValue = 0.0;
    
    //update the raw value with physical value 
    if(getValue(E_pubc_GW_GW_356_IMS_EyeGazeStatus_SetVt)==0)
    {
        if(chgEv_GW_356_IMS_EyeGazeStatus == 0)
        {
            phyValue = getvalue(this);
            // physical to raw conversion
            rawValue = ((phyValue -(-75))/1);
            putValue(E_pubc_GW_GW_356_IMS_EyeGazeStatus_Rv, rawValue);
            chgEv_GW_356_IMS_EyeGazeStatus = 1;  
        }
        else
        {
            chgEv_GW_356_IMS_EyeGazeStatus = 0;
        }
    }
}

on envVar E_pubc_GW_GW_356_IMS_EyeGazeStatus_Vt
{
    qword rawValue = 0ll;
    if(getValue(E_pubc_GW_GW_356_IMS_EyeGazeStatus_SetVt))
    {
        //update the signal value
        Msg_GW_356.IMS_EyeGazeStatus=getValue(this);
    }
}

on envVar E_pubc_GW_GW_356_IMS_EyeGazeStatus_SetVt
{
    if(getValue(E_pubc_GW_GW_356_IMS_EyeGazeStatus_SetVt))
    {
        //update the signal value
        Msg_GW_356.IMS_EyeGazeStatus=getvalue(E_pubc_GW_GW_356_IMS_EyeGazeStatus_Vt);
    }
    else
    {
        Msg_GW_356.IMS_EyeGazeStatus=getValue(E_pubc_GW_GW_356_IMS_EyeGazeStatus_Rv);
    }
}
 
on envVar E_pubc_GW_GW_356_IMS_EyeDetectSatus_Rv
{
    int64 rawValue = 0ll;
    float rawValue_float = 0.0;
    float phyValue = 0.0;        

    //set the signal with updated raw value
    if(getValue(E_pubc_GW_GW_356_IMS_EyeDetectSatus_SetVt)==0)
    {
        rawValue = getvalue(this);
        if(chgEv_GW_356_IMS_EyeDetectSatus == 0)
        {
            //type conversion to float
            rawValue_float = rawValue;        
            // raw to physical conversion
            phyValue = ((rawValue_float *1)+(0));
            putValue(E_pubc_GW_GW_356_IMS_EyeDetectSatus_Pv, phyValue);
            chgEv_GW_356_IMS_EyeDetectSatus = 1;
        }
        else
        {
            chgEv_GW_356_IMS_EyeDetectSatus = 0;
        }    
        //update the signal value
        Msg_GW_356.IMS_EyeDetectSatus=rawValue;        
    }                                                                           
}

on envVar E_pubc_GW_GW_356_IMS_EyeDetectSatus_Pv
{
    int64 rawValue = 0ll;
    float phyValue = 0.0;
    
    //update the raw value with physical value 
    if(getValue(E_pubc_GW_GW_356_IMS_EyeDetectSatus_SetVt)==0)
    {
        if(chgEv_GW_356_IMS_EyeDetectSatus == 0)
        {
            phyValue = getvalue(this);
            // physical to raw conversion
            rawValue = ((phyValue -(0))/1);
            putValue(E_pubc_GW_GW_356_IMS_EyeDetectSatus_Rv, rawValue);
            chgEv_GW_356_IMS_EyeDetectSatus = 1;  
        }
        else
        {
            chgEv_GW_356_IMS_EyeDetectSatus = 0;
        }
    }
}

on envVar E_pubc_GW_GW_356_IMS_EyeDetectSatus_Vt
{
    qword rawValue = 0ll;
    if(getValue(E_pubc_GW_GW_356_IMS_EyeDetectSatus_SetVt))
    {
        //update the signal value
        Msg_GW_356.IMS_EyeDetectSatus=getValue(this);
    }
}

on envVar E_pubc_GW_GW_356_IMS_EyeDetectSatus_SetVt
{
    if(getValue(E_pubc_GW_GW_356_IMS_EyeDetectSatus_SetVt))
    {
        //update the signal value
        Msg_GW_356.IMS_EyeDetectSatus=getvalue(E_pubc_GW_GW_356_IMS_EyeDetectSatus_Vt);
    }
    else
    {
        Msg_GW_356.IMS_EyeDetectSatus=getValue(E_pubc_GW_GW_356_IMS_EyeDetectSatus_Rv);
    }
}
 
on envVar E_pubc_GW_GW_356_IMS_DriverHeadDetect_Rv
{
    int64 rawValue = 0ll;
    float rawValue_float = 0.0;
    float phyValue = 0.0;        

    //set the signal with updated raw value
    if(getValue(E_pubc_GW_GW_356_IMS_DriverHeadDetect_SetVt)==0)
    {
        rawValue = getvalue(this);
        if(chgEv_GW_356_IMS_DriverHeadDetect == 0)
        {
            //type conversion to float
            rawValue_float = rawValue;        
            // raw to physical conversion
            phyValue = ((rawValue_float *1)+(0));
            putValue(E_pubc_GW_GW_356_IMS_DriverHeadDetect_Pv, phyValue);
            chgEv_GW_356_IMS_DriverHeadDetect = 1;
        }
        else
        {
            chgEv_GW_356_IMS_DriverHeadDetect = 0;
        }    
        //update the signal value
        Msg_GW_356.IMS_DriverHeadDetect=rawValue;        
    }                                                                           
}

on envVar E_pubc_GW_GW_356_IMS_DriverHeadDetect_Pv
{
    int64 rawValue = 0ll;
    float phyValue = 0.0;
    
    //update the raw value with physical value 
    if(getValue(E_pubc_GW_GW_356_IMS_DriverHeadDetect_SetVt)==0)
    {
        if(chgEv_GW_356_IMS_DriverHeadDetect == 0)
        {
            phyValue = getvalue(this);
            // physical to raw conversion
            rawValue = ((phyValue -(0))/1);
            putValue(E_pubc_GW_GW_356_IMS_DriverHeadDetect_Rv, rawValue);
            chgEv_GW_356_IMS_DriverHeadDetect = 1;  
        }
        else
        {
            chgEv_GW_356_IMS_DriverHeadDetect = 0;
        }
    }
}

on envVar E_pubc_GW_GW_356_IMS_DriverHeadDetect_Vt
{
    qword rawValue = 0ll;
    if(getValue(E_pubc_GW_GW_356_IMS_DriverHeadDetect_SetVt))
    {
        //update the signal value
        Msg_GW_356.IMS_DriverHeadDetect=getValue(this);
    }
}

on envVar E_pubc_GW_GW_356_IMS_DriverHeadDetect_SetVt
{
    if(getValue(E_pubc_GW_GW_356_IMS_DriverHeadDetect_SetVt))
    {
        //update the signal value
        Msg_GW_356.IMS_DriverHeadDetect=getvalue(E_pubc_GW_GW_356_IMS_DriverHeadDetect_Vt);
    }
    else
    {
        Msg_GW_356.IMS_DriverHeadDetect=getValue(E_pubc_GW_GW_356_IMS_DriverHeadDetect_Rv);
    }
}
 
on envVar E_pubc_GW_GW_500_tx
{
    if(getValue(this))
    {       
        

        output(Msg_GW_500);        
    }
}

on envVar E_pubc_GW_GW_500_Range
{
    qword rawstatus = 0ll;
    qword rawValue = 0ll;    
    
    rawstatus = getvalue(this);    
    // set all the signals with min raw /max raw /init raw
    switch (rawstatus) 
    {
     case(0) :
        rawValue= 44217727;
        putValue(E_pubc_GW_GW_500_HU_CurrentLocationLatitude_Rv, rawValue);
        rawValue= 88435455;
        putValue(E_pubc_GW_GW_500_HU_CurrentLocationLongitude_Rv, rawValue);
        rawValue= 0;
        putValue(E_pubc_GW_GW_500_HU_CurrentLocationValid_Rv, rawValue);
        break;
     case(1) :
        rawValue= 224217727;
        putValue(E_pubc_GW_GW_500_HU_CurrentLocationLatitude_Rv, rawValue);
        rawValue= 448435455;
        putValue(E_pubc_GW_GW_500_HU_CurrentLocationLongitude_Rv, rawValue);
        rawValue= 1;
        putValue(E_pubc_GW_GW_500_HU_CurrentLocationValid_Rv, rawValue);
        break;
     default :
        rawValue= 44217727;
        putValue(E_pubc_GW_GW_500_HU_CurrentLocationLatitude_Rv, rawValue);
        rawValue= 88435455;
        putValue(E_pubc_GW_GW_500_HU_CurrentLocationLongitude_Rv, rawValue);
        rawValue= 0;
        putValue(E_pubc_GW_GW_500_HU_CurrentLocationValid_Rv, rawValue);
      break;
   }
}

on envVar E_pubc_GW_GW_500_Dlc
{
    if(getValue(E_pubc_GW_GW_500_enDlc))
    {
        Msg_GW_500.dlc =getValue(this);
    }
    else
    {
        Msg_GW_500.dlc =8;
    }
}

on envVar E_pubc_GW_GW_500_enDlc
{
    //For Messages with DLC = 8, set wrong DLC to smaller than defined DLC
    //For Messages with DLC < 8 set wrong DLC to smaller/longer than defined DLC
    if(getValue(this))
    {
        Msg_GW_500.dlc =getValue(E_pubc_GW_GW_500_Dlc);
    }
    else
    {
        Msg_GW_500.dlc =8;
    }
}


on envVar E_pubc_GW_GW_500_HU_CurrentLocationLatitude_Rv
{
    int64 rawValue = 0ll;
    float rawValue_float = 0.0;
    float phyValue = 0.0;        

    //set the signal with updated raw value
    {
        rawValue = getvalue(this);
        if(chgEv_GW_500_HU_CurrentLocationLatitude == 0)
        {
            //type conversion to float
            rawValue_float = rawValue;        
            // raw to physical conversion
            phyValue = ((rawValue_float *1e-006)+(-134.217727));
            putValue(E_pubc_GW_GW_500_HU_CurrentLocationLatitude_Pv, phyValue);
            chgEv_GW_500_HU_CurrentLocationLatitude = 1;
        }
        else
        {
            chgEv_GW_500_HU_CurrentLocationLatitude = 0;
        }    
        //update the signal value
        Msg_GW_500.HU_CurrentLocationLatitude=rawValue;        
    }                                                                           
}

on envVar E_pubc_GW_GW_500_HU_CurrentLocationLatitude_Pv
{
    int64 rawValue = 0ll;
    float phyValue = 0.0;
    
    //update the raw value with physical value 
    {
        if(chgEv_GW_500_HU_CurrentLocationLatitude == 0)
        {
            phyValue = getvalue(this);
            // physical to raw conversion
            rawValue = ((phyValue -(-134.217727))/1e-006);
            putValue(E_pubc_GW_GW_500_HU_CurrentLocationLatitude_Rv, rawValue);
            chgEv_GW_500_HU_CurrentLocationLatitude = 1;  
        }
        else
        {
            chgEv_GW_500_HU_CurrentLocationLatitude = 0;
        }
    }
}


 
on envVar E_pubc_GW_GW_500_HU_CurrentLocationLongitude_Rv
{
    int64 rawValue = 0ll;
    float rawValue_float = 0.0;
    float phyValue = 0.0;        

    //set the signal with updated raw value
    {
        rawValue = getvalue(this);
        if(chgEv_GW_500_HU_CurrentLocationLongitude == 0)
        {
            //type conversion to float
            rawValue_float = rawValue;        
            // raw to physical conversion
            phyValue = ((rawValue_float *1e-006)+(-268.435455));
            putValue(E_pubc_GW_GW_500_HU_CurrentLocationLongitude_Pv, phyValue);
            chgEv_GW_500_HU_CurrentLocationLongitude = 1;
        }
        else
        {
            chgEv_GW_500_HU_CurrentLocationLongitude = 0;
        }    
        //update the signal value
        Msg_GW_500.HU_CurrentLocationLongitude=rawValue;        
    }                                                                           
}

on envVar E_pubc_GW_GW_500_HU_CurrentLocationLongitude_Pv
{
    int64 rawValue = 0ll;
    float phyValue = 0.0;
    
    //update the raw value with physical value 
    {
        if(chgEv_GW_500_HU_CurrentLocationLongitude == 0)
        {
            phyValue = getvalue(this);
            // physical to raw conversion
            rawValue = ((phyValue -(-268.435455))/1e-006);
            putValue(E_pubc_GW_GW_500_HU_CurrentLocationLongitude_Rv, rawValue);
            chgEv_GW_500_HU_CurrentLocationLongitude = 1;  
        }
        else
        {
            chgEv_GW_500_HU_CurrentLocationLongitude = 0;
        }
    }
}


 
on envVar E_pubc_GW_GW_500_HU_CurrentLocationValid_Rv
{
    int64 rawValue = 0ll;
    float rawValue_float = 0.0;
    float phyValue = 0.0;        

    //set the signal with updated raw value
    if(getValue(E_pubc_GW_GW_500_HU_CurrentLocationValid_SetVt)==0)
    {
        rawValue = getvalue(this);
        if(chgEv_GW_500_HU_CurrentLocationValid == 0)
        {
            //type conversion to float
            rawValue_float = rawValue;        
            // raw to physical conversion
            phyValue = ((rawValue_float *1)+(0));
            putValue(E_pubc_GW_GW_500_HU_CurrentLocationValid_Pv, phyValue);
            chgEv_GW_500_HU_CurrentLocationValid = 1;
        }
        else
        {
            chgEv_GW_500_HU_CurrentLocationValid = 0;
        }    
        //update the signal value
        Msg_GW_500.HU_CurrentLocationValid=rawValue;        
    }                                                                           
}

on envVar E_pubc_GW_GW_500_HU_CurrentLocationValid_Pv
{
    int64 rawValue = 0ll;
    float phyValue = 0.0;
    
    //update the raw value with physical value 
    if(getValue(E_pubc_GW_GW_500_HU_CurrentLocationValid_SetVt)==0)
    {
        if(chgEv_GW_500_HU_CurrentLocationValid == 0)
        {
            phyValue = getvalue(this);
            // physical to raw conversion
            rawValue = ((phyValue -(0))/1);
            putValue(E_pubc_GW_GW_500_HU_CurrentLocationValid_Rv, rawValue);
            chgEv_GW_500_HU_CurrentLocationValid = 1;  
        }
        else
        {
            chgEv_GW_500_HU_CurrentLocationValid = 0;
        }
    }
}

on envVar E_pubc_GW_GW_500_HU_CurrentLocationValid_Vt
{
    qword rawValue = 0ll;
    if(getValue(E_pubc_GW_GW_500_HU_CurrentLocationValid_SetVt))
    {
        //update the signal value
        Msg_GW_500.HU_CurrentLocationValid=getValue(this);
    }
}

on envVar E_pubc_GW_GW_500_HU_CurrentLocationValid_SetVt
{
    if(getValue(E_pubc_GW_GW_500_HU_CurrentLocationValid_SetVt))
    {
        //update the signal value
        Msg_GW_500.HU_CurrentLocationValid=getvalue(E_pubc_GW_GW_500_HU_CurrentLocationValid_Vt);
    }
    else
    {
        Msg_GW_500.HU_CurrentLocationValid=getValue(E_pubc_GW_GW_500_HU_CurrentLocationValid_Rv);
    }
}
 
on envVar E_pubc_GW_GW_501_tx
{
    if(getValue(this))
    {       
        

        output(Msg_GW_501);        
    }
}

on envVar E_pubc_GW_GW_501_Range
{
    qword rawstatus = 0ll;
    qword rawValue = 0ll;    
    
    rawstatus = getvalue(this);    
    // set all the signals with min raw /max raw /init raw
    switch (rawstatus) 
    {
     case(0) :
        rawValue= 0;
        putValue(E_pubc_GW_GW_501_HU_LocalTimeSecond_Rv, rawValue);
        rawValue= 1;
        putValue(E_pubc_GW_GW_501_HU_LocalTimeMonth_Rv, rawValue);
        rawValue= 0;
        putValue(E_pubc_GW_GW_501_HU_LocalTimeHour_Rv, rawValue);
        rawValue= 1;
        putValue(E_pubc_GW_GW_501_HU_LocalTimeDate_Rv, rawValue);
        rawValue= 0;
        putValue(E_pubc_GW_GW_501_HU_LocalTimeMinute_Rv, rawValue);
        rawValue= 0;
        putValue(E_pubc_GW_GW_501_HU_LocalTimeYear_Rv, rawValue);
        rawValue= 0;
        putValue(E_pubc_GW_GW_501_HU_LocalTimeValid_Rv, rawValue);
        break;
     case(1) :
        rawValue= 59;
        putValue(E_pubc_GW_GW_501_HU_LocalTimeSecond_Rv, rawValue);
        rawValue= 12;
        putValue(E_pubc_GW_GW_501_HU_LocalTimeMonth_Rv, rawValue);
        rawValue= 23;
        putValue(E_pubc_GW_GW_501_HU_LocalTimeHour_Rv, rawValue);
        rawValue= 31;
        putValue(E_pubc_GW_GW_501_HU_LocalTimeDate_Rv, rawValue);
        rawValue= 59;
        putValue(E_pubc_GW_GW_501_HU_LocalTimeMinute_Rv, rawValue);
        rawValue= 255;
        putValue(E_pubc_GW_GW_501_HU_LocalTimeYear_Rv, rawValue);
        rawValue= 1;
        putValue(E_pubc_GW_GW_501_HU_LocalTimeValid_Rv, rawValue);
        break;
     default :
        rawValue= 0;
        putValue(E_pubc_GW_GW_501_HU_LocalTimeSecond_Rv, rawValue);
        rawValue= 1;
        putValue(E_pubc_GW_GW_501_HU_LocalTimeMonth_Rv, rawValue);
        rawValue= 0;
        putValue(E_pubc_GW_GW_501_HU_LocalTimeHour_Rv, rawValue);
        rawValue= 1;
        putValue(E_pubc_GW_GW_501_HU_LocalTimeDate_Rv, rawValue);
        rawValue= 0;
        putValue(E_pubc_GW_GW_501_HU_LocalTimeMinute_Rv, rawValue);
        rawValue= 0;
        putValue(E_pubc_GW_GW_501_HU_LocalTimeYear_Rv, rawValue);
        rawValue= 0;
        putValue(E_pubc_GW_GW_501_HU_LocalTimeValid_Rv, rawValue);
      break;
   }
}

on envVar E_pubc_GW_GW_501_Dlc
{
    if(getValue(E_pubc_GW_GW_501_enDlc))
    {
        Msg_GW_501.dlc =getValue(this);
    }
    else
    {
        Msg_GW_501.dlc =8;
    }
}

on envVar E_pubc_GW_GW_501_enDlc
{
    //For Messages with DLC = 8, set wrong DLC to smaller than defined DLC
    //For Messages with DLC < 8 set wrong DLC to smaller/longer than defined DLC
    if(getValue(this))
    {
        Msg_GW_501.dlc =getValue(E_pubc_GW_GW_501_Dlc);
    }
    else
    {
        Msg_GW_501.dlc =8;
    }
}


on envVar E_pubc_GW_GW_501_HU_LocalTimeSecond_Rv
{
    int64 rawValue = 0ll;
    float rawValue_float = 0.0;
    float phyValue = 0.0;        

    //set the signal with updated raw value
    {
        rawValue = getvalue(this);
        if(chgEv_GW_501_HU_LocalTimeSecond == 0)
        {
            //type conversion to float
            rawValue_float = rawValue;        
            // raw to physical conversion
            phyValue = ((rawValue_float *1)+(0));
            putValue(E_pubc_GW_GW_501_HU_LocalTimeSecond_Pv, phyValue);
            chgEv_GW_501_HU_LocalTimeSecond = 1;
        }
        else
        {
            chgEv_GW_501_HU_LocalTimeSecond = 0;
        }    
        //update the signal value
        Msg_GW_501.HU_LocalTimeSecond=rawValue;        
    }                                                                           
}

on envVar E_pubc_GW_GW_501_HU_LocalTimeSecond_Pv
{
    int64 rawValue = 0ll;
    float phyValue = 0.0;
    
    //update the raw value with physical value 
    {
        if(chgEv_GW_501_HU_LocalTimeSecond == 0)
        {
            phyValue = getvalue(this);
            // physical to raw conversion
            rawValue = ((phyValue -(0))/1);
            putValue(E_pubc_GW_GW_501_HU_LocalTimeSecond_Rv, rawValue);
            chgEv_GW_501_HU_LocalTimeSecond = 1;  
        }
        else
        {
            chgEv_GW_501_HU_LocalTimeSecond = 0;
        }
    }
}


 
on envVar E_pubc_GW_GW_501_HU_LocalTimeMonth_Rv
{
    int64 rawValue = 0ll;
    float rawValue_float = 0.0;
    float phyValue = 0.0;        

    //set the signal with updated raw value
    {
        rawValue = getvalue(this);
        if(chgEv_GW_501_HU_LocalTimeMonth == 0)
        {
            //type conversion to float
            rawValue_float = rawValue;        
            // raw to physical conversion
            phyValue = ((rawValue_float *1)+(0));
            putValue(E_pubc_GW_GW_501_HU_LocalTimeMonth_Pv, phyValue);
            chgEv_GW_501_HU_LocalTimeMonth = 1;
        }
        else
        {
            chgEv_GW_501_HU_LocalTimeMonth = 0;
        }    
        //update the signal value
        Msg_GW_501.HU_LocalTimeMonth=rawValue;        
    }                                                                           
}

on envVar E_pubc_GW_GW_501_HU_LocalTimeMonth_Pv
{
    int64 rawValue = 0ll;
    float phyValue = 0.0;
    
    //update the raw value with physical value 
    {
        if(chgEv_GW_501_HU_LocalTimeMonth == 0)
        {
            phyValue = getvalue(this);
            // physical to raw conversion
            rawValue = ((phyValue -(0))/1);
            putValue(E_pubc_GW_GW_501_HU_LocalTimeMonth_Rv, rawValue);
            chgEv_GW_501_HU_LocalTimeMonth = 1;  
        }
        else
        {
            chgEv_GW_501_HU_LocalTimeMonth = 0;
        }
    }
}


 
on envVar E_pubc_GW_GW_501_HU_LocalTimeHour_Rv
{
    int64 rawValue = 0ll;
    float rawValue_float = 0.0;
    float phyValue = 0.0;        

    //set the signal with updated raw value
    {
        rawValue = getvalue(this);
        if(chgEv_GW_501_HU_LocalTimeHour == 0)
        {
            //type conversion to float
            rawValue_float = rawValue;        
            // raw to physical conversion
            phyValue = ((rawValue_float *1)+(0));
            putValue(E_pubc_GW_GW_501_HU_LocalTimeHour_Pv, phyValue);
            chgEv_GW_501_HU_LocalTimeHour = 1;
        }
        else
        {
            chgEv_GW_501_HU_LocalTimeHour = 0;
        }    
        //update the signal value
        Msg_GW_501.HU_LocalTimeHour=rawValue;        
    }                                                                           
}

on envVar E_pubc_GW_GW_501_HU_LocalTimeHour_Pv
{
    int64 rawValue = 0ll;
    float phyValue = 0.0;
    
    //update the raw value with physical value 
    {
        if(chgEv_GW_501_HU_LocalTimeHour == 0)
        {
            phyValue = getvalue(this);
            // physical to raw conversion
            rawValue = ((phyValue -(0))/1);
            putValue(E_pubc_GW_GW_501_HU_LocalTimeHour_Rv, rawValue);
            chgEv_GW_501_HU_LocalTimeHour = 1;  
        }
        else
        {
            chgEv_GW_501_HU_LocalTimeHour = 0;
        }
    }
}


 
on envVar E_pubc_GW_GW_501_HU_LocalTimeDate_Rv
{
    int64 rawValue = 0ll;
    float rawValue_float = 0.0;
    float phyValue = 0.0;        

    //set the signal with updated raw value
    {
        rawValue = getvalue(this);
        if(chgEv_GW_501_HU_LocalTimeDate == 0)
        {
            //type conversion to float
            rawValue_float = rawValue;        
            // raw to physical conversion
            phyValue = ((rawValue_float *1)+(0));
            putValue(E_pubc_GW_GW_501_HU_LocalTimeDate_Pv, phyValue);
            chgEv_GW_501_HU_LocalTimeDate = 1;
        }
        else
        {
            chgEv_GW_501_HU_LocalTimeDate = 0;
        }    
        //update the signal value
        Msg_GW_501.HU_LocalTimeDate=rawValue;        
    }                                                                           
}

on envVar E_pubc_GW_GW_501_HU_LocalTimeDate_Pv
{
    int64 rawValue = 0ll;
    float phyValue = 0.0;
    
    //update the raw value with physical value 
    {
        if(chgEv_GW_501_HU_LocalTimeDate == 0)
        {
            phyValue = getvalue(this);
            // physical to raw conversion
            rawValue = ((phyValue -(0))/1);
            putValue(E_pubc_GW_GW_501_HU_LocalTimeDate_Rv, rawValue);
            chgEv_GW_501_HU_LocalTimeDate = 1;  
        }
        else
        {
            chgEv_GW_501_HU_LocalTimeDate = 0;
        }
    }
}


 
on envVar E_pubc_GW_GW_501_HU_LocalTimeMinute_Rv
{
    int64 rawValue = 0ll;
    float rawValue_float = 0.0;
    float phyValue = 0.0;        

    //set the signal with updated raw value
    {
        rawValue = getvalue(this);
        if(chgEv_GW_501_HU_LocalTimeMinute == 0)
        {
            //type conversion to float
            rawValue_float = rawValue;        
            // raw to physical conversion
            phyValue = ((rawValue_float *1)+(0));
            putValue(E_pubc_GW_GW_501_HU_LocalTimeMinute_Pv, phyValue);
            chgEv_GW_501_HU_LocalTimeMinute = 1;
        }
        else
        {
            chgEv_GW_501_HU_LocalTimeMinute = 0;
        }    
        //update the signal value
        Msg_GW_501.HU_LocalTimeMinute=rawValue;        
    }                                                                           
}

on envVar E_pubc_GW_GW_501_HU_LocalTimeMinute_Pv
{
    int64 rawValue = 0ll;
    float phyValue = 0.0;
    
    //update the raw value with physical value 
    {
        if(chgEv_GW_501_HU_LocalTimeMinute == 0)
        {
            phyValue = getvalue(this);
            // physical to raw conversion
            rawValue = ((phyValue -(0))/1);
            putValue(E_pubc_GW_GW_501_HU_LocalTimeMinute_Rv, rawValue);
            chgEv_GW_501_HU_LocalTimeMinute = 1;  
        }
        else
        {
            chgEv_GW_501_HU_LocalTimeMinute = 0;
        }
    }
}


 
on envVar E_pubc_GW_GW_501_HU_LocalTimeYear_Rv
{
    int64 rawValue = 0ll;
    float rawValue_float = 0.0;
    float phyValue = 0.0;        

    //set the signal with updated raw value
    {
        rawValue = getvalue(this);
        if(chgEv_GW_501_HU_LocalTimeYear == 0)
        {
            //type conversion to float
            rawValue_float = rawValue;        
            // raw to physical conversion
            phyValue = ((rawValue_float *1)+(2013));
            putValue(E_pubc_GW_GW_501_HU_LocalTimeYear_Pv, phyValue);
            chgEv_GW_501_HU_LocalTimeYear = 1;
        }
        else
        {
            chgEv_GW_501_HU_LocalTimeYear = 0;
        }    
        //update the signal value
        Msg_GW_501.HU_LocalTimeYear=rawValue;        
    }                                                                           
}

on envVar E_pubc_GW_GW_501_HU_LocalTimeYear_Pv
{
    int64 rawValue = 0ll;
    float phyValue = 0.0;
    
    //update the raw value with physical value 
    {
        if(chgEv_GW_501_HU_LocalTimeYear == 0)
        {
            phyValue = getvalue(this);
            // physical to raw conversion
            rawValue = ((phyValue -(2013))/1);
            putValue(E_pubc_GW_GW_501_HU_LocalTimeYear_Rv, rawValue);
            chgEv_GW_501_HU_LocalTimeYear = 1;  
        }
        else
        {
            chgEv_GW_501_HU_LocalTimeYear = 0;
        }
    }
}


 
on envVar E_pubc_GW_GW_501_HU_LocalTimeValid_Rv
{
    int64 rawValue = 0ll;
    float rawValue_float = 0.0;
    float phyValue = 0.0;        

    //set the signal with updated raw value
    if(getValue(E_pubc_GW_GW_501_HU_LocalTimeValid_SetVt)==0)
    {
        rawValue = getvalue(this);
        if(chgEv_GW_501_HU_LocalTimeValid == 0)
        {
            //type conversion to float
            rawValue_float = rawValue;        
            // raw to physical conversion
            phyValue = ((rawValue_float *1)+(0));
            putValue(E_pubc_GW_GW_501_HU_LocalTimeValid_Pv, phyValue);
            chgEv_GW_501_HU_LocalTimeValid = 1;
        }
        else
        {
            chgEv_GW_501_HU_LocalTimeValid = 0;
        }    
        //update the signal value
        Msg_GW_501.HU_LocalTimeValid=rawValue;        
    }                                                                           
}

on envVar E_pubc_GW_GW_501_HU_LocalTimeValid_Pv
{
    int64 rawValue = 0ll;
    float phyValue = 0.0;
    
    //update the raw value with physical value 
    if(getValue(E_pubc_GW_GW_501_HU_LocalTimeValid_SetVt)==0)
    {
        if(chgEv_GW_501_HU_LocalTimeValid == 0)
        {
            phyValue = getvalue(this);
            // physical to raw conversion
            rawValue = ((phyValue -(0))/1);
            putValue(E_pubc_GW_GW_501_HU_LocalTimeValid_Rv, rawValue);
            chgEv_GW_501_HU_LocalTimeValid = 1;  
        }
        else
        {
            chgEv_GW_501_HU_LocalTimeValid = 0;
        }
    }
}

on envVar E_pubc_GW_GW_501_HU_LocalTimeValid_Vt
{
    qword rawValue = 0ll;
    if(getValue(E_pubc_GW_GW_501_HU_LocalTimeValid_SetVt))
    {
        //update the signal value
        Msg_GW_501.HU_LocalTimeValid=getValue(this);
    }
}

on envVar E_pubc_GW_GW_501_HU_LocalTimeValid_SetVt
{
    if(getValue(E_pubc_GW_GW_501_HU_LocalTimeValid_SetVt))
    {
        //update the signal value
        Msg_GW_501.HU_LocalTimeValid=getvalue(E_pubc_GW_GW_501_HU_LocalTimeValid_Vt);
    }
    else
    {
        Msg_GW_501.HU_LocalTimeValid=getValue(E_pubc_GW_GW_501_HU_LocalTimeValid_Rv);
    }
}
 
on envVar E_pubc_GW_GW_278_tx
{
    if(getValue(this))
    {       
        
        //update the BZ Signal
        if(GW_278_ESP_RollingCounter_278_wrongvalctr == 0)
        {
            update_GW_278_ESP_RollingCounter_278_counter();
            Msg_GW_278.ESP_RollingCounter_278= GW_278_ESP_RollingCounter_278_counter;
        }
        else if(GW_278_ESP_RollingCounter_278_wrongvalctr > 0)
        {
             GW_278_ESP_RollingCounter_278_wrongvalctr--;
              // if counter becomes zero, update panel controller to zero
             if(GW_278_ESP_RollingCounter_278_wrongvalctr == 0)
             {
                 putValue(E_pubc_GW_GW_278_ESP_RollingCounter_278_wrongvalctr,0);
             }
        }
        else
        {
            //do nothing
        }        
        //calculate the CRC CheckSum
        update_GW_278_CRC_CheckSum();

        output(Msg_GW_278);        
    }
}

on envVar E_pubc_GW_GW_278_Range
{
    qword rawstatus = 0ll;
    qword rawValue = 0ll;    
    
    rawstatus = getvalue(this);    
    // set all the signals with min raw /max raw /init raw
    switch (rawstatus) 
    {
     case(0) :
        rawValue= 0;
        putValue(E_pubc_GW_GW_278_ESP_LongAccel_Rv, rawValue);
        rawValue= 0;
        putValue(E_pubc_GW_GW_278_ESP_YawRateValid_Rv, rawValue);
        rawValue= 0;
        putValue(E_pubc_GW_GW_278_ESP_YawRate_Rv, rawValue);
        rawValue= 0;
        putValue(E_pubc_GW_GW_278_ESP_LatAccel_Rv, rawValue);
        break;
     case(1) :
        rawValue= 1021;
        putValue(E_pubc_GW_GW_278_ESP_LongAccel_Rv, rawValue);
        rawValue= 1;
        putValue(E_pubc_GW_GW_278_ESP_YawRateValid_Rv, rawValue);
        rawValue= 16381;
        putValue(E_pubc_GW_GW_278_ESP_YawRate_Rv, rawValue);
        rawValue= 253;
        putValue(E_pubc_GW_GW_278_ESP_LatAccel_Rv, rawValue);
        break;
     default :
        rawValue= 0;
        putValue(E_pubc_GW_GW_278_ESP_LongAccel_Rv, rawValue);
        rawValue= 0;
        putValue(E_pubc_GW_GW_278_ESP_YawRateValid_Rv, rawValue);
        rawValue= 0;
        putValue(E_pubc_GW_GW_278_ESP_YawRate_Rv, rawValue);
        rawValue= 0;
        putValue(E_pubc_GW_GW_278_ESP_LatAccel_Rv, rawValue);
      break;
   }
}

on envVar E_pubc_GW_GW_278_Dlc
{
    if(getValue(E_pubc_GW_GW_278_enDlc))
    {
        Msg_GW_278.dlc =getValue(this);
    }
    else
    {
        Msg_GW_278.dlc =8;
    }
}

on envVar E_pubc_GW_GW_278_enDlc
{
    //For Messages with DLC = 8, set wrong DLC to smaller than defined DLC
    //For Messages with DLC < 8 set wrong DLC to smaller/longer than defined DLC
    if(getValue(this))
    {
        Msg_GW_278.dlc =getValue(E_pubc_GW_GW_278_Dlc);
    }
    else
    {
        Msg_GW_278.dlc =8;
    }
}

on envVar E_pubc_GW_GW_278_ESP_CRCCheck_278_wrongvalctr
{
    //update disturb count
    //disturb value range:(-1 = always send wrong value),( X>0 ,x is the number of Messages with wrong CHK sent)
    GW_278_ESP_CRCCheck_278_wrongvalctr =getValue(this);    
}
on envVar E_pubc_GW_GW_278_ESP_RollingCounter_278_wrongvalctr
{
    //update disturb count
    //disturb value range:(-1 = always send wrong value),( X>0 ,x is the number of Messages with wrong CHK sent)
    GW_278_ESP_RollingCounter_278_wrongvalctr =getValue(this);    
}

on envVar E_pubc_GW_GW_278_ESP_LongAccel_Rv
{
    int64 rawValue = 0ll;
    float rawValue_float = 0.0;
    float phyValue = 0.0;        

    //set the signal with updated raw value
    {
        rawValue = getvalue(this);
        if(chgEv_GW_278_ESP_LongAccel == 0)
        {
            //type conversion to float
            rawValue_float = rawValue;        
            // raw to physical conversion
            phyValue = ((rawValue_float *0.03125)+(-16));
            putValue(E_pubc_GW_GW_278_ESP_LongAccel_Pv, phyValue);
            chgEv_GW_278_ESP_LongAccel = 1;
        }
        else
        {
            chgEv_GW_278_ESP_LongAccel = 0;
        }    
        //update the signal value
        Msg_GW_278.ESP_LongAccel=rawValue;        
    }                                                                           
}

on envVar E_pubc_GW_GW_278_ESP_LongAccel_Pv
{
    int64 rawValue = 0ll;
    float phyValue = 0.0;
    
    //update the raw value with physical value 
    {
        if(chgEv_GW_278_ESP_LongAccel == 0)
        {
            phyValue = getvalue(this);
            // physical to raw conversion
            rawValue = ((phyValue -(-16))/0.03125);
            putValue(E_pubc_GW_GW_278_ESP_LongAccel_Rv, rawValue);
            chgEv_GW_278_ESP_LongAccel = 1;  
        }
        else
        {
            chgEv_GW_278_ESP_LongAccel = 0;
        }
    }
}


 
on envVar E_pubc_GW_GW_278_ESP_YawRateValid_Rv
{
    int64 rawValue = 0ll;
    float rawValue_float = 0.0;
    float phyValue = 0.0;        

    //set the signal with updated raw value
    if(getValue(E_pubc_GW_GW_278_ESP_YawRateValid_SetVt)==0)
    {
        rawValue = getvalue(this);
        if(chgEv_GW_278_ESP_YawRateValid == 0)
        {
            //type conversion to float
            rawValue_float = rawValue;        
            // raw to physical conversion
            phyValue = ((rawValue_float *1)+(0));
            putValue(E_pubc_GW_GW_278_ESP_YawRateValid_Pv, phyValue);
            chgEv_GW_278_ESP_YawRateValid = 1;
        }
        else
        {
            chgEv_GW_278_ESP_YawRateValid = 0;
        }    
        //update the signal value
        Msg_GW_278.ESP_YawRateValid=rawValue;        
    }                                                                           
}

on envVar E_pubc_GW_GW_278_ESP_YawRateValid_Pv
{
    int64 rawValue = 0ll;
    float phyValue = 0.0;
    
    //update the raw value with physical value 
    if(getValue(E_pubc_GW_GW_278_ESP_YawRateValid_SetVt)==0)
    {
        if(chgEv_GW_278_ESP_YawRateValid == 0)
        {
            phyValue = getvalue(this);
            // physical to raw conversion
            rawValue = ((phyValue -(0))/1);
            putValue(E_pubc_GW_GW_278_ESP_YawRateValid_Rv, rawValue);
            chgEv_GW_278_ESP_YawRateValid = 1;  
        }
        else
        {
            chgEv_GW_278_ESP_YawRateValid = 0;
        }
    }
}

on envVar E_pubc_GW_GW_278_ESP_YawRateValid_Vt
{
    qword rawValue = 0ll;
    if(getValue(E_pubc_GW_GW_278_ESP_YawRateValid_SetVt))
    {
        //update the signal value
        Msg_GW_278.ESP_YawRateValid=getValue(this);
    }
}

on envVar E_pubc_GW_GW_278_ESP_YawRateValid_SetVt
{
    if(getValue(E_pubc_GW_GW_278_ESP_YawRateValid_SetVt))
    {
        //update the signal value
        Msg_GW_278.ESP_YawRateValid=getvalue(E_pubc_GW_GW_278_ESP_YawRateValid_Vt);
    }
    else
    {
        Msg_GW_278.ESP_YawRateValid=getValue(E_pubc_GW_GW_278_ESP_YawRateValid_Rv);
    }
}
 
on envVar E_pubc_GW_GW_278_ESP_YawRate_Rv
{
    int64 rawValue = 0ll;
    float rawValue_float = 0.0;
    float phyValue = 0.0;        

    //set the signal with updated raw value
    {
        rawValue = getvalue(this);
        if(chgEv_GW_278_ESP_YawRate == 0)
        {
            //type conversion to float
            rawValue_float = rawValue;        
            // raw to physical conversion
            phyValue = ((rawValue_float *0.01)+(-81.91));
            putValue(E_pubc_GW_GW_278_ESP_YawRate_Pv, phyValue);
            chgEv_GW_278_ESP_YawRate = 1;
        }
        else
        {
            chgEv_GW_278_ESP_YawRate = 0;
        }    
        //update the signal value
        Msg_GW_278.ESP_YawRate=rawValue;        
    }                                                                           
}

on envVar E_pubc_GW_GW_278_ESP_YawRate_Pv
{
    int64 rawValue = 0ll;
    float phyValue = 0.0;
    
    //update the raw value with physical value 
    {
        if(chgEv_GW_278_ESP_YawRate == 0)
        {
            phyValue = getvalue(this);
            // physical to raw conversion
            rawValue = ((phyValue -(-81.91))/0.01);
            putValue(E_pubc_GW_GW_278_ESP_YawRate_Rv, rawValue);
            chgEv_GW_278_ESP_YawRate = 1;  
        }
        else
        {
            chgEv_GW_278_ESP_YawRate = 0;
        }
    }
}


 
on envVar E_pubc_GW_GW_278_ESP_LatAccel_Rv
{
    int64 rawValue = 0ll;
    float rawValue_float = 0.0;
    float phyValue = 0.0;        

    //set the signal with updated raw value
    {
        rawValue = getvalue(this);
        if(chgEv_GW_278_ESP_LatAccel == 0)
        {
            //type conversion to float
            rawValue_float = rawValue;        
            // raw to physical conversion
            phyValue = ((rawValue_float *0.1)+(-12.7));
            putValue(E_pubc_GW_GW_278_ESP_LatAccel_Pv, phyValue);
            chgEv_GW_278_ESP_LatAccel = 1;
        }
        else
        {
            chgEv_GW_278_ESP_LatAccel = 0;
        }    
        //update the signal value
        Msg_GW_278.ESP_LatAccel=rawValue;        
    }                                                                           
}

on envVar E_pubc_GW_GW_278_ESP_LatAccel_Pv
{
    int64 rawValue = 0ll;
    float phyValue = 0.0;
    
    //update the raw value with physical value 
    {
        if(chgEv_GW_278_ESP_LatAccel == 0)
        {
            phyValue = getvalue(this);
            // physical to raw conversion
            rawValue = ((phyValue -(-12.7))/0.1);
            putValue(E_pubc_GW_GW_278_ESP_LatAccel_Rv, rawValue);
            chgEv_GW_278_ESP_LatAccel = 1;  
        }
        else
        {
            chgEv_GW_278_ESP_LatAccel = 0;
        }
    }
}


 
on envVar E_pubc_GW_GW_3C7_tx
{
    if(getValue(this))
    {       
        
        //update the BZ Signal
        if(GW_3C7_HU_RollingCounter_3C7_wrongvalctr == 0)
        {
            update_GW_3C7_HU_RollingCounter_3C7_counter();
            Msg_GW_3C7.HU_RollingCounter_3C7= GW_3C7_HU_RollingCounter_3C7_counter;
        }
        else if(GW_3C7_HU_RollingCounter_3C7_wrongvalctr > 0)
        {
             GW_3C7_HU_RollingCounter_3C7_wrongvalctr--;
              // if counter becomes zero, update panel controller to zero
             if(GW_3C7_HU_RollingCounter_3C7_wrongvalctr == 0)
             {
                 putValue(E_pubc_GW_GW_3C7_HU_RollingCounter_3C7_wrongvalctr,0);
             }
        }
        else
        {
            //do nothing
        }        
        //calculate the CRC CheckSum
        update_GW_3C7_CRC_CheckSum();

        output(Msg_GW_3C7);        
    }
}

on envVar E_pubc_GW_GW_3C7_Range
{
    qword rawstatus = 0ll;
    qword rawValue = 0ll;    
    
    rawstatus = getvalue(this);    
    // set all the signals with min raw /max raw /init raw
    switch (rawstatus) 
    {
     case(0) :
        rawValue= 0;
        putValue(E_pubc_GW_GW_3C7_HU_RoadCurvature_400m_Rv, rawValue);
        rawValue= 0;
        putValue(E_pubc_GW_GW_3C7_HU_RoadCurvature_600m_Rv, rawValue);
        rawValue= 0;
        putValue(E_pubc_GW_GW_3C7_HU_SlopeGradient_300m_Rv, rawValue);
        rawValue= 0;
        putValue(E_pubc_GW_GW_3C7_HU_RoadCurvature_100m_Rv, rawValue);
        rawValue= 0;
        putValue(E_pubc_GW_GW_3C7_HU_RoadCurvature_300m_Rv, rawValue);
        rawValue= 0;
        putValue(E_pubc_GW_GW_3C7_HU_MapMatchStatus_Rv, rawValue);
        break;
     case(1) :
        rawValue= 1023;
        putValue(E_pubc_GW_GW_3C7_HU_RoadCurvature_400m_Rv, rawValue);
        rawValue= 1023;
        putValue(E_pubc_GW_GW_3C7_HU_RoadCurvature_600m_Rv, rawValue);
        rawValue= 1022;
        putValue(E_pubc_GW_GW_3C7_HU_SlopeGradient_300m_Rv, rawValue);
        rawValue= 1023;
        putValue(E_pubc_GW_GW_3C7_HU_RoadCurvature_100m_Rv, rawValue);
        rawValue= 1023;
        putValue(E_pubc_GW_GW_3C7_HU_RoadCurvature_300m_Rv, rawValue);
        rawValue= 3;
        putValue(E_pubc_GW_GW_3C7_HU_MapMatchStatus_Rv, rawValue);
        break;
     default :
        rawValue= 0;
        putValue(E_pubc_GW_GW_3C7_HU_RoadCurvature_400m_Rv, rawValue);
        rawValue= 0;
        putValue(E_pubc_GW_GW_3C7_HU_RoadCurvature_600m_Rv, rawValue);
        rawValue= 0;
        putValue(E_pubc_GW_GW_3C7_HU_SlopeGradient_300m_Rv, rawValue);
        rawValue= 0;
        putValue(E_pubc_GW_GW_3C7_HU_RoadCurvature_100m_Rv, rawValue);
        rawValue= 0;
        putValue(E_pubc_GW_GW_3C7_HU_RoadCurvature_300m_Rv, rawValue);
        rawValue= 0;
        putValue(E_pubc_GW_GW_3C7_HU_MapMatchStatus_Rv, rawValue);
      break;
   }
}

on envVar E_pubc_GW_GW_3C7_Dlc
{
    if(getValue(E_pubc_GW_GW_3C7_enDlc))
    {
        Msg_GW_3C7.dlc =getValue(this);
    }
    else
    {
        Msg_GW_3C7.dlc =8;
    }
}

on envVar E_pubc_GW_GW_3C7_enDlc
{
    //For Messages with DLC = 8, set wrong DLC to smaller than defined DLC
    //For Messages with DLC < 8 set wrong DLC to smaller/longer than defined DLC
    if(getValue(this))
    {
        Msg_GW_3C7.dlc =getValue(E_pubc_GW_GW_3C7_Dlc);
    }
    else
    {
        Msg_GW_3C7.dlc =8;
    }
}

on envVar E_pubc_GW_GW_3C7_HU_CRCCheck_3C7_wrongvalctr
{
    //update disturb count
    //disturb value range:(-1 = always send wrong value),( X>0 ,x is the number of Messages with wrong CHK sent)
    GW_3C7_HU_CRCCheck_3C7_wrongvalctr =getValue(this);    
}
on envVar E_pubc_GW_GW_3C7_HU_RollingCounter_3C7_wrongvalctr
{
    //update disturb count
    //disturb value range:(-1 = always send wrong value),( X>0 ,x is the number of Messages with wrong CHK sent)
    GW_3C7_HU_RollingCounter_3C7_wrongvalctr =getValue(this);    
}

on envVar E_pubc_GW_GW_3C7_HU_RoadCurvature_400m_Rv
{
    int64 rawValue = 0ll;
    float rawValue_float = 0.0;
    float phyValue = 0.0;        

    //set the signal with updated raw value
    if(getValue(E_pubc_GW_GW_3C7_HU_RoadCurvature_400m_SetVt)==0)
    {
        rawValue = getvalue(this);
        if(chgEv_GW_3C7_HU_RoadCurvature_400m == 0)
        {
            //type conversion to float
            rawValue_float = rawValue;        
            // raw to physical conversion
            phyValue = ((rawValue_float *1)+(0));
            putValue(E_pubc_GW_GW_3C7_HU_RoadCurvature_400m_Pv, phyValue);
            chgEv_GW_3C7_HU_RoadCurvature_400m = 1;
        }
        else
        {
            chgEv_GW_3C7_HU_RoadCurvature_400m = 0;
        }    
        //update the signal value
        Msg_GW_3C7.HU_RoadCurvature_400m=rawValue;        
    }                                                                           
}

on envVar E_pubc_GW_GW_3C7_HU_RoadCurvature_400m_Pv
{
    int64 rawValue = 0ll;
    float phyValue = 0.0;
    
    //update the raw value with physical value 
    if(getValue(E_pubc_GW_GW_3C7_HU_RoadCurvature_400m_SetVt)==0)
    {
        if(chgEv_GW_3C7_HU_RoadCurvature_400m == 0)
        {
            phyValue = getvalue(this);
            // physical to raw conversion
            rawValue = ((phyValue -(0))/1);
            putValue(E_pubc_GW_GW_3C7_HU_RoadCurvature_400m_Rv, rawValue);
            chgEv_GW_3C7_HU_RoadCurvature_400m = 1;  
        }
        else
        {
            chgEv_GW_3C7_HU_RoadCurvature_400m = 0;
        }
    }
}

on envVar E_pubc_GW_GW_3C7_HU_RoadCurvature_400m_Vt
{
    qword rawValue = 0ll;
    if(getValue(E_pubc_GW_GW_3C7_HU_RoadCurvature_400m_SetVt))
    {
        //update the signal value
        Msg_GW_3C7.HU_RoadCurvature_400m=getValue(this);
    }
}

on envVar E_pubc_GW_GW_3C7_HU_RoadCurvature_400m_SetVt
{
    if(getValue(E_pubc_GW_GW_3C7_HU_RoadCurvature_400m_SetVt))
    {
        //update the signal value
        Msg_GW_3C7.HU_RoadCurvature_400m=getvalue(E_pubc_GW_GW_3C7_HU_RoadCurvature_400m_Vt);
    }
    else
    {
        Msg_GW_3C7.HU_RoadCurvature_400m=getValue(E_pubc_GW_GW_3C7_HU_RoadCurvature_400m_Rv);
    }
}
 
on envVar E_pubc_GW_GW_3C7_HU_RoadCurvature_600m_Rv
{
    int64 rawValue = 0ll;
    float rawValue_float = 0.0;
    float phyValue = 0.0;        

    //set the signal with updated raw value
    if(getValue(E_pubc_GW_GW_3C7_HU_RoadCurvature_600m_SetVt)==0)
    {
        rawValue = getvalue(this);
        if(chgEv_GW_3C7_HU_RoadCurvature_600m == 0)
        {
            //type conversion to float
            rawValue_float = rawValue;        
            // raw to physical conversion
            phyValue = ((rawValue_float *1)+(0));
            putValue(E_pubc_GW_GW_3C7_HU_RoadCurvature_600m_Pv, phyValue);
            chgEv_GW_3C7_HU_RoadCurvature_600m = 1;
        }
        else
        {
            chgEv_GW_3C7_HU_RoadCurvature_600m = 0;
        }    
        //update the signal value
        Msg_GW_3C7.HU_RoadCurvature_600m=rawValue;        
    }                                                                           
}

on envVar E_pubc_GW_GW_3C7_HU_RoadCurvature_600m_Pv
{
    int64 rawValue = 0ll;
    float phyValue = 0.0;
    
    //update the raw value with physical value 
    if(getValue(E_pubc_GW_GW_3C7_HU_RoadCurvature_600m_SetVt)==0)
    {
        if(chgEv_GW_3C7_HU_RoadCurvature_600m == 0)
        {
            phyValue = getvalue(this);
            // physical to raw conversion
            rawValue = ((phyValue -(0))/1);
            putValue(E_pubc_GW_GW_3C7_HU_RoadCurvature_600m_Rv, rawValue);
            chgEv_GW_3C7_HU_RoadCurvature_600m = 1;  
        }
        else
        {
            chgEv_GW_3C7_HU_RoadCurvature_600m = 0;
        }
    }
}

on envVar E_pubc_GW_GW_3C7_HU_RoadCurvature_600m_Vt
{
    qword rawValue = 0ll;
    if(getValue(E_pubc_GW_GW_3C7_HU_RoadCurvature_600m_SetVt))
    {
        //update the signal value
        Msg_GW_3C7.HU_RoadCurvature_600m=getValue(this);
    }
}

on envVar E_pubc_GW_GW_3C7_HU_RoadCurvature_600m_SetVt
{
    if(getValue(E_pubc_GW_GW_3C7_HU_RoadCurvature_600m_SetVt))
    {
        //update the signal value
        Msg_GW_3C7.HU_RoadCurvature_600m=getvalue(E_pubc_GW_GW_3C7_HU_RoadCurvature_600m_Vt);
    }
    else
    {
        Msg_GW_3C7.HU_RoadCurvature_600m=getValue(E_pubc_GW_GW_3C7_HU_RoadCurvature_600m_Rv);
    }
}
 
on envVar E_pubc_GW_GW_3C7_HU_SlopeGradient_300m_Rv
{
    int64 rawValue = 0ll;
    float rawValue_float = 0.0;
    float phyValue = 0.0;        

    //set the signal with updated raw value
    if(getValue(E_pubc_GW_GW_3C7_HU_SlopeGradient_300m_SetVt)==0)
    {
        rawValue = getvalue(this);
        if(chgEv_GW_3C7_HU_SlopeGradient_300m == 0)
        {
            //type conversion to float
            rawValue_float = rawValue;        
            // raw to physical conversion
            phyValue = ((rawValue_float *0.1)+(-51.1));
            putValue(E_pubc_GW_GW_3C7_HU_SlopeGradient_300m_Pv, phyValue);
            chgEv_GW_3C7_HU_SlopeGradient_300m = 1;
        }
        else
        {
            chgEv_GW_3C7_HU_SlopeGradient_300m = 0;
        }    
        //update the signal value
        Msg_GW_3C7.HU_SlopeGradient_300m=rawValue;        
    }                                                                           
}

on envVar E_pubc_GW_GW_3C7_HU_SlopeGradient_300m_Pv
{
    int64 rawValue = 0ll;
    float phyValue = 0.0;
    
    //update the raw value with physical value 
    if(getValue(E_pubc_GW_GW_3C7_HU_SlopeGradient_300m_SetVt)==0)
    {
        if(chgEv_GW_3C7_HU_SlopeGradient_300m == 0)
        {
            phyValue = getvalue(this);
            // physical to raw conversion
            rawValue = ((phyValue -(-51.1))/0.1);
            putValue(E_pubc_GW_GW_3C7_HU_SlopeGradient_300m_Rv, rawValue);
            chgEv_GW_3C7_HU_SlopeGradient_300m = 1;  
        }
        else
        {
            chgEv_GW_3C7_HU_SlopeGradient_300m = 0;
        }
    }
}

on envVar E_pubc_GW_GW_3C7_HU_SlopeGradient_300m_Vt
{
    qword rawValue = 0ll;
    if(getValue(E_pubc_GW_GW_3C7_HU_SlopeGradient_300m_SetVt))
    {
        //update the signal value
        Msg_GW_3C7.HU_SlopeGradient_300m=getValue(this);
    }
}

on envVar E_pubc_GW_GW_3C7_HU_SlopeGradient_300m_SetVt
{
    if(getValue(E_pubc_GW_GW_3C7_HU_SlopeGradient_300m_SetVt))
    {
        //update the signal value
        Msg_GW_3C7.HU_SlopeGradient_300m=getvalue(E_pubc_GW_GW_3C7_HU_SlopeGradient_300m_Vt);
    }
    else
    {
        Msg_GW_3C7.HU_SlopeGradient_300m=getValue(E_pubc_GW_GW_3C7_HU_SlopeGradient_300m_Rv);
    }
}
 
on envVar E_pubc_GW_GW_3C7_HU_RoadCurvature_100m_Rv
{
    int64 rawValue = 0ll;
    float rawValue_float = 0.0;
    float phyValue = 0.0;        

    //set the signal with updated raw value
    if(getValue(E_pubc_GW_GW_3C7_HU_RoadCurvature_100m_SetVt)==0)
    {
        rawValue = getvalue(this);
        if(chgEv_GW_3C7_HU_RoadCurvature_100m == 0)
        {
            //type conversion to float
            rawValue_float = rawValue;        
            // raw to physical conversion
            phyValue = ((rawValue_float *1)+(0));
            putValue(E_pubc_GW_GW_3C7_HU_RoadCurvature_100m_Pv, phyValue);
            chgEv_GW_3C7_HU_RoadCurvature_100m = 1;
        }
        else
        {
            chgEv_GW_3C7_HU_RoadCurvature_100m = 0;
        }    
        //update the signal value
        Msg_GW_3C7.HU_RoadCurvature_100m=rawValue;        
    }                                                                           
}

on envVar E_pubc_GW_GW_3C7_HU_RoadCurvature_100m_Pv
{
    int64 rawValue = 0ll;
    float phyValue = 0.0;
    
    //update the raw value with physical value 
    if(getValue(E_pubc_GW_GW_3C7_HU_RoadCurvature_100m_SetVt)==0)
    {
        if(chgEv_GW_3C7_HU_RoadCurvature_100m == 0)
        {
            phyValue = getvalue(this);
            // physical to raw conversion
            rawValue = ((phyValue -(0))/1);
            putValue(E_pubc_GW_GW_3C7_HU_RoadCurvature_100m_Rv, rawValue);
            chgEv_GW_3C7_HU_RoadCurvature_100m = 1;  
        }
        else
        {
            chgEv_GW_3C7_HU_RoadCurvature_100m = 0;
        }
    }
}

on envVar E_pubc_GW_GW_3C7_HU_RoadCurvature_100m_Vt
{
    qword rawValue = 0ll;
    if(getValue(E_pubc_GW_GW_3C7_HU_RoadCurvature_100m_SetVt))
    {
        //update the signal value
        Msg_GW_3C7.HU_RoadCurvature_100m=getValue(this);
    }
}

on envVar E_pubc_GW_GW_3C7_HU_RoadCurvature_100m_SetVt
{
    if(getValue(E_pubc_GW_GW_3C7_HU_RoadCurvature_100m_SetVt))
    {
        //update the signal value
        Msg_GW_3C7.HU_RoadCurvature_100m=getvalue(E_pubc_GW_GW_3C7_HU_RoadCurvature_100m_Vt);
    }
    else
    {
        Msg_GW_3C7.HU_RoadCurvature_100m=getValue(E_pubc_GW_GW_3C7_HU_RoadCurvature_100m_Rv);
    }
}
 
on envVar E_pubc_GW_GW_3C7_HU_RoadCurvature_300m_Rv
{
    int64 rawValue = 0ll;
    float rawValue_float = 0.0;
    float phyValue = 0.0;        

    //set the signal with updated raw value
    if(getValue(E_pubc_GW_GW_3C7_HU_RoadCurvature_300m_SetVt)==0)
    {
        rawValue = getvalue(this);
        if(chgEv_GW_3C7_HU_RoadCurvature_300m == 0)
        {
            //type conversion to float
            rawValue_float = rawValue;        
            // raw to physical conversion
            phyValue = ((rawValue_float *1)+(0));
            putValue(E_pubc_GW_GW_3C7_HU_RoadCurvature_300m_Pv, phyValue);
            chgEv_GW_3C7_HU_RoadCurvature_300m = 1;
        }
        else
        {
            chgEv_GW_3C7_HU_RoadCurvature_300m = 0;
        }    
        //update the signal value
        Msg_GW_3C7.HU_RoadCurvature_300m=rawValue;        
    }                                                                           
}

on envVar E_pubc_GW_GW_3C7_HU_RoadCurvature_300m_Pv
{
    int64 rawValue = 0ll;
    float phyValue = 0.0;
    
    //update the raw value with physical value 
    if(getValue(E_pubc_GW_GW_3C7_HU_RoadCurvature_300m_SetVt)==0)
    {
        if(chgEv_GW_3C7_HU_RoadCurvature_300m == 0)
        {
            phyValue = getvalue(this);
            // physical to raw conversion
            rawValue = ((phyValue -(0))/1);
            putValue(E_pubc_GW_GW_3C7_HU_RoadCurvature_300m_Rv, rawValue);
            chgEv_GW_3C7_HU_RoadCurvature_300m = 1;  
        }
        else
        {
            chgEv_GW_3C7_HU_RoadCurvature_300m = 0;
        }
    }
}

on envVar E_pubc_GW_GW_3C7_HU_RoadCurvature_300m_Vt
{
    qword rawValue = 0ll;
    if(getValue(E_pubc_GW_GW_3C7_HU_RoadCurvature_300m_SetVt))
    {
        //update the signal value
        Msg_GW_3C7.HU_RoadCurvature_300m=getValue(this);
    }
}

on envVar E_pubc_GW_GW_3C7_HU_RoadCurvature_300m_SetVt
{
    if(getValue(E_pubc_GW_GW_3C7_HU_RoadCurvature_300m_SetVt))
    {
        //update the signal value
        Msg_GW_3C7.HU_RoadCurvature_300m=getvalue(E_pubc_GW_GW_3C7_HU_RoadCurvature_300m_Vt);
    }
    else
    {
        Msg_GW_3C7.HU_RoadCurvature_300m=getValue(E_pubc_GW_GW_3C7_HU_RoadCurvature_300m_Rv);
    }
}
 
on envVar E_pubc_GW_GW_3C7_HU_MapMatchStatus_Rv
{
    int64 rawValue = 0ll;
    float rawValue_float = 0.0;
    float phyValue = 0.0;        

    //set the signal with updated raw value
    if(getValue(E_pubc_GW_GW_3C7_HU_MapMatchStatus_SetVt)==0)
    {
        rawValue = getvalue(this);
        if(chgEv_GW_3C7_HU_MapMatchStatus == 0)
        {
            //type conversion to float
            rawValue_float = rawValue;        
            // raw to physical conversion
            phyValue = ((rawValue_float *1)+(0));
            putValue(E_pubc_GW_GW_3C7_HU_MapMatchStatus_Pv, phyValue);
            chgEv_GW_3C7_HU_MapMatchStatus = 1;
        }
        else
        {
            chgEv_GW_3C7_HU_MapMatchStatus = 0;
        }    
        //update the signal value
        Msg_GW_3C7.HU_MapMatchStatus=rawValue;        
    }                                                                           
}

on envVar E_pubc_GW_GW_3C7_HU_MapMatchStatus_Pv
{
    int64 rawValue = 0ll;
    float phyValue = 0.0;
    
    //update the raw value with physical value 
    if(getValue(E_pubc_GW_GW_3C7_HU_MapMatchStatus_SetVt)==0)
    {
        if(chgEv_GW_3C7_HU_MapMatchStatus == 0)
        {
            phyValue = getvalue(this);
            // physical to raw conversion
            rawValue = ((phyValue -(0))/1);
            putValue(E_pubc_GW_GW_3C7_HU_MapMatchStatus_Rv, rawValue);
            chgEv_GW_3C7_HU_MapMatchStatus = 1;  
        }
        else
        {
            chgEv_GW_3C7_HU_MapMatchStatus = 0;
        }
    }
}

on envVar E_pubc_GW_GW_3C7_HU_MapMatchStatus_Vt
{
    qword rawValue = 0ll;
    if(getValue(E_pubc_GW_GW_3C7_HU_MapMatchStatus_SetVt))
    {
        //update the signal value
        Msg_GW_3C7.HU_MapMatchStatus=getValue(this);
    }
}

on envVar E_pubc_GW_GW_3C7_HU_MapMatchStatus_SetVt
{
    if(getValue(E_pubc_GW_GW_3C7_HU_MapMatchStatus_SetVt))
    {
        //update the signal value
        Msg_GW_3C7.HU_MapMatchStatus=getvalue(E_pubc_GW_GW_3C7_HU_MapMatchStatus_Vt);
    }
    else
    {
        Msg_GW_3C7.HU_MapMatchStatus=getValue(E_pubc_GW_GW_3C7_HU_MapMatchStatus_Rv);
    }
}
 
on envVar E_pubc_GW_GW_3C6_tx
{
    if(getValue(this))
    {       
        
        //update the BZ Signal
        if(GW_3C6_HU_RollingCounter_3C6_wrongvalctr == 0)
        {
            update_GW_3C6_HU_RollingCounter_3C6_counter();
            Msg_GW_3C6.HU_RollingCounter_3C6= GW_3C6_HU_RollingCounter_3C6_counter;
        }
        else if(GW_3C6_HU_RollingCounter_3C6_wrongvalctr > 0)
        {
             GW_3C6_HU_RollingCounter_3C6_wrongvalctr--;
              // if counter becomes zero, update panel controller to zero
             if(GW_3C6_HU_RollingCounter_3C6_wrongvalctr == 0)
             {
                 putValue(E_pubc_GW_GW_3C6_HU_RollingCounter_3C6_wrongvalctr,0);
             }
        }
        else
        {
            //do nothing
        }        
        //calculate the CRC CheckSum
        update_GW_3C6_CRC_CheckSum();

        output(Msg_GW_3C6);        
    }
}

on envVar E_pubc_GW_GW_3C6_Range
{
    qword rawstatus = 0ll;
    qword rawValue = 0ll;    
    
    rawstatus = getvalue(this);    
    // set all the signals with min raw /max raw /init raw
    switch (rawstatus) 
    {
     case(0) :
        rawValue= 0;
        putValue(E_pubc_GW_GW_3C6_HU_BranchInfo_Rv, rawValue);
        rawValue= 0;
        putValue(E_pubc_GW_GW_3C6_HU_RoadCurvature_70m_Rv, rawValue);
        rawValue= 0;
        putValue(E_pubc_GW_GW_3C6_HU_RoadCurvature_80m_Rv, rawValue);
        rawValue= 0;
        putValue(E_pubc_GW_GW_3C6_HU_RoadCurvature_90m_Rv, rawValue);
        rawValue= 0;
        putValue(E_pubc_GW_GW_3C6_HU_RoadCurvature_60m_Rv, rawValue);
        rawValue= 0;
        putValue(E_pubc_GW_GW_3C6_HU_RoadCurvature_50m_Rv, rawValue);
        break;
     case(1) :
        rawValue= 3;
        putValue(E_pubc_GW_GW_3C6_HU_BranchInfo_Rv, rawValue);
        rawValue= 1023;
        putValue(E_pubc_GW_GW_3C6_HU_RoadCurvature_70m_Rv, rawValue);
        rawValue= 1023;
        putValue(E_pubc_GW_GW_3C6_HU_RoadCurvature_80m_Rv, rawValue);
        rawValue= 1023;
        putValue(E_pubc_GW_GW_3C6_HU_RoadCurvature_90m_Rv, rawValue);
        rawValue= 1023;
        putValue(E_pubc_GW_GW_3C6_HU_RoadCurvature_60m_Rv, rawValue);
        rawValue= 1023;
        putValue(E_pubc_GW_GW_3C6_HU_RoadCurvature_50m_Rv, rawValue);
        break;
     default :
        rawValue= 0;
        putValue(E_pubc_GW_GW_3C6_HU_BranchInfo_Rv, rawValue);
        rawValue= 0;
        putValue(E_pubc_GW_GW_3C6_HU_RoadCurvature_70m_Rv, rawValue);
        rawValue= 0;
        putValue(E_pubc_GW_GW_3C6_HU_RoadCurvature_80m_Rv, rawValue);
        rawValue= 0;
        putValue(E_pubc_GW_GW_3C6_HU_RoadCurvature_90m_Rv, rawValue);
        rawValue= 0;
        putValue(E_pubc_GW_GW_3C6_HU_RoadCurvature_60m_Rv, rawValue);
        rawValue= 0;
        putValue(E_pubc_GW_GW_3C6_HU_RoadCurvature_50m_Rv, rawValue);
      break;
   }
}

on envVar E_pubc_GW_GW_3C6_Dlc
{
    if(getValue(E_pubc_GW_GW_3C6_enDlc))
    {
        Msg_GW_3C6.dlc =getValue(this);
    }
    else
    {
        Msg_GW_3C6.dlc =8;
    }
}

on envVar E_pubc_GW_GW_3C6_enDlc
{
    //For Messages with DLC = 8, set wrong DLC to smaller than defined DLC
    //For Messages with DLC < 8 set wrong DLC to smaller/longer than defined DLC
    if(getValue(this))
    {
        Msg_GW_3C6.dlc =getValue(E_pubc_GW_GW_3C6_Dlc);
    }
    else
    {
        Msg_GW_3C6.dlc =8;
    }
}

on envVar E_pubc_GW_GW_3C6_HU_CRCCheck_3C6_wrongvalctr
{
    //update disturb count
    //disturb value range:(-1 = always send wrong value),( X>0 ,x is the number of Messages with wrong CHK sent)
    GW_3C6_HU_CRCCheck_3C6_wrongvalctr =getValue(this);    
}
on envVar E_pubc_GW_GW_3C6_HU_RollingCounter_3C6_wrongvalctr
{
    //update disturb count
    //disturb value range:(-1 = always send wrong value),( X>0 ,x is the number of Messages with wrong CHK sent)
    GW_3C6_HU_RollingCounter_3C6_wrongvalctr =getValue(this);    
}

on envVar E_pubc_GW_GW_3C6_HU_BranchInfo_Rv
{
    int64 rawValue = 0ll;
    float rawValue_float = 0.0;
    float phyValue = 0.0;        

    //set the signal with updated raw value
    if(getValue(E_pubc_GW_GW_3C6_HU_BranchInfo_SetVt)==0)
    {
        rawValue = getvalue(this);
        if(chgEv_GW_3C6_HU_BranchInfo == 0)
        {
            //type conversion to float
            rawValue_float = rawValue;        
            // raw to physical conversion
            phyValue = ((rawValue_float *1)+(0));
            putValue(E_pubc_GW_GW_3C6_HU_BranchInfo_Pv, phyValue);
            chgEv_GW_3C6_HU_BranchInfo = 1;
        }
        else
        {
            chgEv_GW_3C6_HU_BranchInfo = 0;
        }    
        //update the signal value
        Msg_GW_3C6.HU_BranchInfo=rawValue;        
    }                                                                           
}

on envVar E_pubc_GW_GW_3C6_HU_BranchInfo_Pv
{
    int64 rawValue = 0ll;
    float phyValue = 0.0;
    
    //update the raw value with physical value 
    if(getValue(E_pubc_GW_GW_3C6_HU_BranchInfo_SetVt)==0)
    {
        if(chgEv_GW_3C6_HU_BranchInfo == 0)
        {
            phyValue = getvalue(this);
            // physical to raw conversion
            rawValue = ((phyValue -(0))/1);
            putValue(E_pubc_GW_GW_3C6_HU_BranchInfo_Rv, rawValue);
            chgEv_GW_3C6_HU_BranchInfo = 1;  
        }
        else
        {
            chgEv_GW_3C6_HU_BranchInfo = 0;
        }
    }
}

on envVar E_pubc_GW_GW_3C6_HU_BranchInfo_Vt
{
    qword rawValue = 0ll;
    if(getValue(E_pubc_GW_GW_3C6_HU_BranchInfo_SetVt))
    {
        //update the signal value
        Msg_GW_3C6.HU_BranchInfo=getValue(this);
    }
}

on envVar E_pubc_GW_GW_3C6_HU_BranchInfo_SetVt
{
    if(getValue(E_pubc_GW_GW_3C6_HU_BranchInfo_SetVt))
    {
        //update the signal value
        Msg_GW_3C6.HU_BranchInfo=getvalue(E_pubc_GW_GW_3C6_HU_BranchInfo_Vt);
    }
    else
    {
        Msg_GW_3C6.HU_BranchInfo=getValue(E_pubc_GW_GW_3C6_HU_BranchInfo_Rv);
    }
}
 
on envVar E_pubc_GW_GW_3C6_HU_RoadCurvature_70m_Rv
{
    int64 rawValue = 0ll;
    float rawValue_float = 0.0;
    float phyValue = 0.0;        

    //set the signal with updated raw value
    if(getValue(E_pubc_GW_GW_3C6_HU_RoadCurvature_70m_SetVt)==0)
    {
        rawValue = getvalue(this);
        if(chgEv_GW_3C6_HU_RoadCurvature_70m == 0)
        {
            //type conversion to float
            rawValue_float = rawValue;        
            // raw to physical conversion
            phyValue = ((rawValue_float *1)+(0));
            putValue(E_pubc_GW_GW_3C6_HU_RoadCurvature_70m_Pv, phyValue);
            chgEv_GW_3C6_HU_RoadCurvature_70m = 1;
        }
        else
        {
            chgEv_GW_3C6_HU_RoadCurvature_70m = 0;
        }    
        //update the signal value
        Msg_GW_3C6.HU_RoadCurvature_70m=rawValue;        
    }                                                                           
}

on envVar E_pubc_GW_GW_3C6_HU_RoadCurvature_70m_Pv
{
    int64 rawValue = 0ll;
    float phyValue = 0.0;
    
    //update the raw value with physical value 
    if(getValue(E_pubc_GW_GW_3C6_HU_RoadCurvature_70m_SetVt)==0)
    {
        if(chgEv_GW_3C6_HU_RoadCurvature_70m == 0)
        {
            phyValue = getvalue(this);
            // physical to raw conversion
            rawValue = ((phyValue -(0))/1);
            putValue(E_pubc_GW_GW_3C6_HU_RoadCurvature_70m_Rv, rawValue);
            chgEv_GW_3C6_HU_RoadCurvature_70m = 1;  
        }
        else
        {
            chgEv_GW_3C6_HU_RoadCurvature_70m = 0;
        }
    }
}

on envVar E_pubc_GW_GW_3C6_HU_RoadCurvature_70m_Vt
{
    qword rawValue = 0ll;
    if(getValue(E_pubc_GW_GW_3C6_HU_RoadCurvature_70m_SetVt))
    {
        //update the signal value
        Msg_GW_3C6.HU_RoadCurvature_70m=getValue(this);
    }
}

on envVar E_pubc_GW_GW_3C6_HU_RoadCurvature_70m_SetVt
{
    if(getValue(E_pubc_GW_GW_3C6_HU_RoadCurvature_70m_SetVt))
    {
        //update the signal value
        Msg_GW_3C6.HU_RoadCurvature_70m=getvalue(E_pubc_GW_GW_3C6_HU_RoadCurvature_70m_Vt);
    }
    else
    {
        Msg_GW_3C6.HU_RoadCurvature_70m=getValue(E_pubc_GW_GW_3C6_HU_RoadCurvature_70m_Rv);
    }
}
 
on envVar E_pubc_GW_GW_3C6_HU_RoadCurvature_80m_Rv
{
    int64 rawValue = 0ll;
    float rawValue_float = 0.0;
    float phyValue = 0.0;        

    //set the signal with updated raw value
    if(getValue(E_pubc_GW_GW_3C6_HU_RoadCurvature_80m_SetVt)==0)
    {
        rawValue = getvalue(this);
        if(chgEv_GW_3C6_HU_RoadCurvature_80m == 0)
        {
            //type conversion to float
            rawValue_float = rawValue;        
            // raw to physical conversion
            phyValue = ((rawValue_float *1)+(0));
            putValue(E_pubc_GW_GW_3C6_HU_RoadCurvature_80m_Pv, phyValue);
            chgEv_GW_3C6_HU_RoadCurvature_80m = 1;
        }
        else
        {
            chgEv_GW_3C6_HU_RoadCurvature_80m = 0;
        }    
        //update the signal value
        Msg_GW_3C6.HU_RoadCurvature_80m=rawValue;        
    }                                                                           
}

on envVar E_pubc_GW_GW_3C6_HU_RoadCurvature_80m_Pv
{
    int64 rawValue = 0ll;
    float phyValue = 0.0;
    
    //update the raw value with physical value 
    if(getValue(E_pubc_GW_GW_3C6_HU_RoadCurvature_80m_SetVt)==0)
    {
        if(chgEv_GW_3C6_HU_RoadCurvature_80m == 0)
        {
            phyValue = getvalue(this);
            // physical to raw conversion
            rawValue = ((phyValue -(0))/1);
            putValue(E_pubc_GW_GW_3C6_HU_RoadCurvature_80m_Rv, rawValue);
            chgEv_GW_3C6_HU_RoadCurvature_80m = 1;  
        }
        else
        {
            chgEv_GW_3C6_HU_RoadCurvature_80m = 0;
        }
    }
}

on envVar E_pubc_GW_GW_3C6_HU_RoadCurvature_80m_Vt
{
    qword rawValue = 0ll;
    if(getValue(E_pubc_GW_GW_3C6_HU_RoadCurvature_80m_SetVt))
    {
        //update the signal value
        Msg_GW_3C6.HU_RoadCurvature_80m=getValue(this);
    }
}

on envVar E_pubc_GW_GW_3C6_HU_RoadCurvature_80m_SetVt
{
    if(getValue(E_pubc_GW_GW_3C6_HU_RoadCurvature_80m_SetVt))
    {
        //update the signal value
        Msg_GW_3C6.HU_RoadCurvature_80m=getvalue(E_pubc_GW_GW_3C6_HU_RoadCurvature_80m_Vt);
    }
    else
    {
        Msg_GW_3C6.HU_RoadCurvature_80m=getValue(E_pubc_GW_GW_3C6_HU_RoadCurvature_80m_Rv);
    }
}
 
on envVar E_pubc_GW_GW_3C6_HU_RoadCurvature_90m_Rv
{
    int64 rawValue = 0ll;
    float rawValue_float = 0.0;
    float phyValue = 0.0;        

    //set the signal with updated raw value
    if(getValue(E_pubc_GW_GW_3C6_HU_RoadCurvature_90m_SetVt)==0)
    {
        rawValue = getvalue(this);
        if(chgEv_GW_3C6_HU_RoadCurvature_90m == 0)
        {
            //type conversion to float
            rawValue_float = rawValue;        
            // raw to physical conversion
            phyValue = ((rawValue_float *1)+(0));
            putValue(E_pubc_GW_GW_3C6_HU_RoadCurvature_90m_Pv, phyValue);
            chgEv_GW_3C6_HU_RoadCurvature_90m = 1;
        }
        else
        {
            chgEv_GW_3C6_HU_RoadCurvature_90m = 0;
        }    
        //update the signal value
        Msg_GW_3C6.HU_RoadCurvature_90m=rawValue;        
    }                                                                           
}

on envVar E_pubc_GW_GW_3C6_HU_RoadCurvature_90m_Pv
{
    int64 rawValue = 0ll;
    float phyValue = 0.0;
    
    //update the raw value with physical value 
    if(getValue(E_pubc_GW_GW_3C6_HU_RoadCurvature_90m_SetVt)==0)
    {
        if(chgEv_GW_3C6_HU_RoadCurvature_90m == 0)
        {
            phyValue = getvalue(this);
            // physical to raw conversion
            rawValue = ((phyValue -(0))/1);
            putValue(E_pubc_GW_GW_3C6_HU_RoadCurvature_90m_Rv, rawValue);
            chgEv_GW_3C6_HU_RoadCurvature_90m = 1;  
        }
        else
        {
            chgEv_GW_3C6_HU_RoadCurvature_90m = 0;
        }
    }
}

on envVar E_pubc_GW_GW_3C6_HU_RoadCurvature_90m_Vt
{
    qword rawValue = 0ll;
    if(getValue(E_pubc_GW_GW_3C6_HU_RoadCurvature_90m_SetVt))
    {
        //update the signal value
        Msg_GW_3C6.HU_RoadCurvature_90m=getValue(this);
    }
}

on envVar E_pubc_GW_GW_3C6_HU_RoadCurvature_90m_SetVt
{
    if(getValue(E_pubc_GW_GW_3C6_HU_RoadCurvature_90m_SetVt))
    {
        //update the signal value
        Msg_GW_3C6.HU_RoadCurvature_90m=getvalue(E_pubc_GW_GW_3C6_HU_RoadCurvature_90m_Vt);
    }
    else
    {
        Msg_GW_3C6.HU_RoadCurvature_90m=getValue(E_pubc_GW_GW_3C6_HU_RoadCurvature_90m_Rv);
    }
}
 
on envVar E_pubc_GW_GW_3C6_HU_RoadCurvature_60m_Rv
{
    int64 rawValue = 0ll;
    float rawValue_float = 0.0;
    float phyValue = 0.0;        

    //set the signal with updated raw value
    if(getValue(E_pubc_GW_GW_3C6_HU_RoadCurvature_60m_SetVt)==0)
    {
        rawValue = getvalue(this);
        if(chgEv_GW_3C6_HU_RoadCurvature_60m == 0)
        {
            //type conversion to float
            rawValue_float = rawValue;        
            // raw to physical conversion
            phyValue = ((rawValue_float *1)+(0));
            putValue(E_pubc_GW_GW_3C6_HU_RoadCurvature_60m_Pv, phyValue);
            chgEv_GW_3C6_HU_RoadCurvature_60m = 1;
        }
        else
        {
            chgEv_GW_3C6_HU_RoadCurvature_60m = 0;
        }    
        //update the signal value
        Msg_GW_3C6.HU_RoadCurvature_60m=rawValue;        
    }                                                                           
}

on envVar E_pubc_GW_GW_3C6_HU_RoadCurvature_60m_Pv
{
    int64 rawValue = 0ll;
    float phyValue = 0.0;
    
    //update the raw value with physical value 
    if(getValue(E_pubc_GW_GW_3C6_HU_RoadCurvature_60m_SetVt)==0)
    {
        if(chgEv_GW_3C6_HU_RoadCurvature_60m == 0)
        {
            phyValue = getvalue(this);
            // physical to raw conversion
            rawValue = ((phyValue -(0))/1);
            putValue(E_pubc_GW_GW_3C6_HU_RoadCurvature_60m_Rv, rawValue);
            chgEv_GW_3C6_HU_RoadCurvature_60m = 1;  
        }
        else
        {
            chgEv_GW_3C6_HU_RoadCurvature_60m = 0;
        }
    }
}

on envVar E_pubc_GW_GW_3C6_HU_RoadCurvature_60m_Vt
{
    qword rawValue = 0ll;
    if(getValue(E_pubc_GW_GW_3C6_HU_RoadCurvature_60m_SetVt))
    {
        //update the signal value
        Msg_GW_3C6.HU_RoadCurvature_60m=getValue(this);
    }
}

on envVar E_pubc_GW_GW_3C6_HU_RoadCurvature_60m_SetVt
{
    if(getValue(E_pubc_GW_GW_3C6_HU_RoadCurvature_60m_SetVt))
    {
        //update the signal value
        Msg_GW_3C6.HU_RoadCurvature_60m=getvalue(E_pubc_GW_GW_3C6_HU_RoadCurvature_60m_Vt);
    }
    else
    {
        Msg_GW_3C6.HU_RoadCurvature_60m=getValue(E_pubc_GW_GW_3C6_HU_RoadCurvature_60m_Rv);
    }
}
 
on envVar E_pubc_GW_GW_3C6_HU_RoadCurvature_50m_Rv
{
    int64 rawValue = 0ll;
    float rawValue_float = 0.0;
    float phyValue = 0.0;        

    //set the signal with updated raw value
    if(getValue(E_pubc_GW_GW_3C6_HU_RoadCurvature_50m_SetVt)==0)
    {
        rawValue = getvalue(this);
        if(chgEv_GW_3C6_HU_RoadCurvature_50m == 0)
        {
            //type conversion to float
            rawValue_float = rawValue;        
            // raw to physical conversion
            phyValue = ((rawValue_float *1)+(0));
            putValue(E_pubc_GW_GW_3C6_HU_RoadCurvature_50m_Pv, phyValue);
            chgEv_GW_3C6_HU_RoadCurvature_50m = 1;
        }
        else
        {
            chgEv_GW_3C6_HU_RoadCurvature_50m = 0;
        }    
        //update the signal value
        Msg_GW_3C6.HU_RoadCurvature_50m=rawValue;        
    }                                                                           
}

on envVar E_pubc_GW_GW_3C6_HU_RoadCurvature_50m_Pv
{
    int64 rawValue = 0ll;
    float phyValue = 0.0;
    
    //update the raw value with physical value 
    if(getValue(E_pubc_GW_GW_3C6_HU_RoadCurvature_50m_SetVt)==0)
    {
        if(chgEv_GW_3C6_HU_RoadCurvature_50m == 0)
        {
            phyValue = getvalue(this);
            // physical to raw conversion
            rawValue = ((phyValue -(0))/1);
            putValue(E_pubc_GW_GW_3C6_HU_RoadCurvature_50m_Rv, rawValue);
            chgEv_GW_3C6_HU_RoadCurvature_50m = 1;  
        }
        else
        {
            chgEv_GW_3C6_HU_RoadCurvature_50m = 0;
        }
    }
}

on envVar E_pubc_GW_GW_3C6_HU_RoadCurvature_50m_Vt
{
    qword rawValue = 0ll;
    if(getValue(E_pubc_GW_GW_3C6_HU_RoadCurvature_50m_SetVt))
    {
        //update the signal value
        Msg_GW_3C6.HU_RoadCurvature_50m=getValue(this);
    }
}

on envVar E_pubc_GW_GW_3C6_HU_RoadCurvature_50m_SetVt
{
    if(getValue(E_pubc_GW_GW_3C6_HU_RoadCurvature_50m_SetVt))
    {
        //update the signal value
        Msg_GW_3C6.HU_RoadCurvature_50m=getvalue(E_pubc_GW_GW_3C6_HU_RoadCurvature_50m_Vt);
    }
    else
    {
        Msg_GW_3C6.HU_RoadCurvature_50m=getValue(E_pubc_GW_GW_3C6_HU_RoadCurvature_50m_Rv);
    }
}
 
on envVar E_pubc_GW_GW_1A8_tx
{
    if(getValue(this))
    {       
        
        //update the BZ Signal
        if(GW_1A8_TCU_RollingCounter_1A8_wrongvalctr == 0)
        {
            update_GW_1A8_TCU_RollingCounter_1A8_counter();
            Msg_GW_1A8.TCU_RollingCounter_1A8= GW_1A8_TCU_RollingCounter_1A8_counter;
        }
        else if(GW_1A8_TCU_RollingCounter_1A8_wrongvalctr > 0)
        {
             GW_1A8_TCU_RollingCounter_1A8_wrongvalctr--;
              // if counter becomes zero, update panel controller to zero
             if(GW_1A8_TCU_RollingCounter_1A8_wrongvalctr == 0)
             {
                 putValue(E_pubc_GW_GW_1A8_TCU_RollingCounter_1A8_wrongvalctr,0);
             }
        }
        else
        {
            //do nothing
        }        
        //calculate the CRC CheckSum
        update_GW_1A8_CRC_CheckSum();

        output(Msg_GW_1A8);        
    }
}

on envVar E_pubc_GW_GW_1A8_Range
{
    qword rawstatus = 0ll;
    qword rawValue = 0ll;    
    
    rawstatus = getvalue(this);    
    // set all the signals with min raw /max raw /init raw
    switch (rawstatus) 
    {
     case(0) :
        rawValue= 0;
        putValue(E_pubc_GW_GW_1A8_TCU_ShiftPostionValid_Rv, rawValue);
        rawValue= 0;
        putValue(E_pubc_GW_GW_1A8_TCU_GearShiftPosition_Rv, rawValue);
        rawValue= 0;
        putValue(E_pubc_GW_GW_1A8_TCU_ActualGearValid_Rv, rawValue);
        rawValue= 0;
        putValue(E_pubc_GW_GW_1A8_TCU_ActualGear_Rv, rawValue);
        break;
     case(1) :
        rawValue= 1;
        putValue(E_pubc_GW_GW_1A8_TCU_ShiftPostionValid_Rv, rawValue);
        rawValue= 15;
        putValue(E_pubc_GW_GW_1A8_TCU_GearShiftPosition_Rv, rawValue);
        rawValue= 1;
        putValue(E_pubc_GW_GW_1A8_TCU_ActualGearValid_Rv, rawValue);
        rawValue= 15;
        putValue(E_pubc_GW_GW_1A8_TCU_ActualGear_Rv, rawValue);
        break;
     default :
        rawValue= 0;
        putValue(E_pubc_GW_GW_1A8_TCU_ShiftPostionValid_Rv, rawValue);
        rawValue= 0;
        putValue(E_pubc_GW_GW_1A8_TCU_GearShiftPosition_Rv, rawValue);
        rawValue= 0;
        putValue(E_pubc_GW_GW_1A8_TCU_ActualGearValid_Rv, rawValue);
        rawValue= 0;
        putValue(E_pubc_GW_GW_1A8_TCU_ActualGear_Rv, rawValue);
      break;
   }
}

on envVar E_pubc_GW_GW_1A8_Dlc
{
    if(getValue(E_pubc_GW_GW_1A8_enDlc))
    {
        Msg_GW_1A8.dlc =getValue(this);
    }
    else
    {
        Msg_GW_1A8.dlc =8;
    }
}

on envVar E_pubc_GW_GW_1A8_enDlc
{
    //For Messages with DLC = 8, set wrong DLC to smaller than defined DLC
    //For Messages with DLC < 8 set wrong DLC to smaller/longer than defined DLC
    if(getValue(this))
    {
        Msg_GW_1A8.dlc =getValue(E_pubc_GW_GW_1A8_Dlc);
    }
    else
    {
        Msg_GW_1A8.dlc =8;
    }
}

on envVar E_pubc_GW_GW_1A8_TCU_CRCCheck_1A8_wrongvalctr
{
    //update disturb count
    //disturb value range:(-1 = always send wrong value),( X>0 ,x is the number of Messages with wrong CHK sent)
    GW_1A8_TCU_CRCCheck_1A8_wrongvalctr =getValue(this);    
}
on envVar E_pubc_GW_GW_1A8_TCU_RollingCounter_1A8_wrongvalctr
{
    //update disturb count
    //disturb value range:(-1 = always send wrong value),( X>0 ,x is the number of Messages with wrong CHK sent)
    GW_1A8_TCU_RollingCounter_1A8_wrongvalctr =getValue(this);    
}

on envVar E_pubc_GW_GW_1A8_TCU_ShiftPostionValid_Rv
{
    int64 rawValue = 0ll;
    float rawValue_float = 0.0;
    float phyValue = 0.0;        

    //set the signal with updated raw value
    if(getValue(E_pubc_GW_GW_1A8_TCU_ShiftPostionValid_SetVt)==0)
    {
        rawValue = getvalue(this);
        if(chgEv_GW_1A8_TCU_ShiftPostionValid == 0)
        {
            //type conversion to float
            rawValue_float = rawValue;        
            // raw to physical conversion
            phyValue = ((rawValue_float *1)+(0));
            putValue(E_pubc_GW_GW_1A8_TCU_ShiftPostionValid_Pv, phyValue);
            chgEv_GW_1A8_TCU_ShiftPostionValid = 1;
        }
        else
        {
            chgEv_GW_1A8_TCU_ShiftPostionValid = 0;
        }    
        //update the signal value
        Msg_GW_1A8.TCU_ShiftPostionValid=rawValue;        
    }                                                                           
}

on envVar E_pubc_GW_GW_1A8_TCU_ShiftPostionValid_Pv
{
    int64 rawValue = 0ll;
    float phyValue = 0.0;
    
    //update the raw value with physical value 
    if(getValue(E_pubc_GW_GW_1A8_TCU_ShiftPostionValid_SetVt)==0)
    {
        if(chgEv_GW_1A8_TCU_ShiftPostionValid == 0)
        {
            phyValue = getvalue(this);
            // physical to raw conversion
            rawValue = ((phyValue -(0))/1);
            putValue(E_pubc_GW_GW_1A8_TCU_ShiftPostionValid_Rv, rawValue);
            chgEv_GW_1A8_TCU_ShiftPostionValid = 1;  
        }
        else
        {
            chgEv_GW_1A8_TCU_ShiftPostionValid = 0;
        }
    }
}

on envVar E_pubc_GW_GW_1A8_TCU_ShiftPostionValid_Vt
{
    qword rawValue = 0ll;
    if(getValue(E_pubc_GW_GW_1A8_TCU_ShiftPostionValid_SetVt))
    {
        //update the signal value
        Msg_GW_1A8.TCU_ShiftPostionValid=getValue(this);
    }
}

on envVar E_pubc_GW_GW_1A8_TCU_ShiftPostionValid_SetVt
{
    if(getValue(E_pubc_GW_GW_1A8_TCU_ShiftPostionValid_SetVt))
    {
        //update the signal value
        Msg_GW_1A8.TCU_ShiftPostionValid=getvalue(E_pubc_GW_GW_1A8_TCU_ShiftPostionValid_Vt);
    }
    else
    {
        Msg_GW_1A8.TCU_ShiftPostionValid=getValue(E_pubc_GW_GW_1A8_TCU_ShiftPostionValid_Rv);
    }
}
 
on envVar E_pubc_GW_GW_1A8_TCU_GearShiftPosition_Rv
{
    int64 rawValue = 0ll;
    float rawValue_float = 0.0;
    float phyValue = 0.0;        

    //set the signal with updated raw value
    if(getValue(E_pubc_GW_GW_1A8_TCU_GearShiftPosition_SetVt)==0)
    {
        rawValue = getvalue(this);
        if(chgEv_GW_1A8_TCU_GearShiftPosition == 0)
        {
            //type conversion to float
            rawValue_float = rawValue;        
            // raw to physical conversion
            phyValue = ((rawValue_float *1)+(0));
            putValue(E_pubc_GW_GW_1A8_TCU_GearShiftPosition_Pv, phyValue);
            chgEv_GW_1A8_TCU_GearShiftPosition = 1;
        }
        else
        {
            chgEv_GW_1A8_TCU_GearShiftPosition = 0;
        }    
        //update the signal value
        Msg_GW_1A8.TCU_GearShiftPosition=rawValue;        
    }                                                                           
}

on envVar E_pubc_GW_GW_1A8_TCU_GearShiftPosition_Pv
{
    int64 rawValue = 0ll;
    float phyValue = 0.0;
    
    //update the raw value with physical value 
    if(getValue(E_pubc_GW_GW_1A8_TCU_GearShiftPosition_SetVt)==0)
    {
        if(chgEv_GW_1A8_TCU_GearShiftPosition == 0)
        {
            phyValue = getvalue(this);
            // physical to raw conversion
            rawValue = ((phyValue -(0))/1);
            putValue(E_pubc_GW_GW_1A8_TCU_GearShiftPosition_Rv, rawValue);
            chgEv_GW_1A8_TCU_GearShiftPosition = 1;  
        }
        else
        {
            chgEv_GW_1A8_TCU_GearShiftPosition = 0;
        }
    }
}

on envVar E_pubc_GW_GW_1A8_TCU_GearShiftPosition_Vt
{
    qword rawValue = 0ll;
    if(getValue(E_pubc_GW_GW_1A8_TCU_GearShiftPosition_SetVt))
    {
        //update the signal value
        Msg_GW_1A8.TCU_GearShiftPosition=getValue(this);
    }
}

on envVar E_pubc_GW_GW_1A8_TCU_GearShiftPosition_SetVt
{
    if(getValue(E_pubc_GW_GW_1A8_TCU_GearShiftPosition_SetVt))
    {
        //update the signal value
        Msg_GW_1A8.TCU_GearShiftPosition=getvalue(E_pubc_GW_GW_1A8_TCU_GearShiftPosition_Vt);
    }
    else
    {
        Msg_GW_1A8.TCU_GearShiftPosition=getValue(E_pubc_GW_GW_1A8_TCU_GearShiftPosition_Rv);
    }
}
 
on envVar E_pubc_GW_GW_1A8_TCU_ActualGearValid_Rv
{
    int64 rawValue = 0ll;
    float rawValue_float = 0.0;
    float phyValue = 0.0;        

    //set the signal with updated raw value
    if(getValue(E_pubc_GW_GW_1A8_TCU_ActualGearValid_SetVt)==0)
    {
        rawValue = getvalue(this);
        if(chgEv_GW_1A8_TCU_ActualGearValid == 0)
        {
            //type conversion to float
            rawValue_float = rawValue;        
            // raw to physical conversion
            phyValue = ((rawValue_float *1)+(0));
            putValue(E_pubc_GW_GW_1A8_TCU_ActualGearValid_Pv, phyValue);
            chgEv_GW_1A8_TCU_ActualGearValid = 1;
        }
        else
        {
            chgEv_GW_1A8_TCU_ActualGearValid = 0;
        }    
        //update the signal value
        Msg_GW_1A8.TCU_ActualGearValid=rawValue;        
    }                                                                           
}

on envVar E_pubc_GW_GW_1A8_TCU_ActualGearValid_Pv
{
    int64 rawValue = 0ll;
    float phyValue = 0.0;
    
    //update the raw value with physical value 
    if(getValue(E_pubc_GW_GW_1A8_TCU_ActualGearValid_SetVt)==0)
    {
        if(chgEv_GW_1A8_TCU_ActualGearValid == 0)
        {
            phyValue = getvalue(this);
            // physical to raw conversion
            rawValue = ((phyValue -(0))/1);
            putValue(E_pubc_GW_GW_1A8_TCU_ActualGearValid_Rv, rawValue);
            chgEv_GW_1A8_TCU_ActualGearValid = 1;  
        }
        else
        {
            chgEv_GW_1A8_TCU_ActualGearValid = 0;
        }
    }
}

on envVar E_pubc_GW_GW_1A8_TCU_ActualGearValid_Vt
{
    qword rawValue = 0ll;
    if(getValue(E_pubc_GW_GW_1A8_TCU_ActualGearValid_SetVt))
    {
        //update the signal value
        Msg_GW_1A8.TCU_ActualGearValid=getValue(this);
    }
}

on envVar E_pubc_GW_GW_1A8_TCU_ActualGearValid_SetVt
{
    if(getValue(E_pubc_GW_GW_1A8_TCU_ActualGearValid_SetVt))
    {
        //update the signal value
        Msg_GW_1A8.TCU_ActualGearValid=getvalue(E_pubc_GW_GW_1A8_TCU_ActualGearValid_Vt);
    }
    else
    {
        Msg_GW_1A8.TCU_ActualGearValid=getValue(E_pubc_GW_GW_1A8_TCU_ActualGearValid_Rv);
    }
}
 
on envVar E_pubc_GW_GW_1A8_TCU_ActualGear_Rv
{
    int64 rawValue = 0ll;
    float rawValue_float = 0.0;
    float phyValue = 0.0;        

    //set the signal with updated raw value
    if(getValue(E_pubc_GW_GW_1A8_TCU_ActualGear_SetVt)==0)
    {
        rawValue = getvalue(this);
        if(chgEv_GW_1A8_TCU_ActualGear == 0)
        {
            //type conversion to float
            rawValue_float = rawValue;        
            // raw to physical conversion
            phyValue = ((rawValue_float *1)+(0));
            putValue(E_pubc_GW_GW_1A8_TCU_ActualGear_Pv, phyValue);
            chgEv_GW_1A8_TCU_ActualGear = 1;
        }
        else
        {
            chgEv_GW_1A8_TCU_ActualGear = 0;
        }    
        //update the signal value
        Msg_GW_1A8.TCU_ActualGear=rawValue;        
    }                                                                           
}

on envVar E_pubc_GW_GW_1A8_TCU_ActualGear_Pv
{
    int64 rawValue = 0ll;
    float phyValue = 0.0;
    
    //update the raw value with physical value 
    if(getValue(E_pubc_GW_GW_1A8_TCU_ActualGear_SetVt)==0)
    {
        if(chgEv_GW_1A8_TCU_ActualGear == 0)
        {
            phyValue = getvalue(this);
            // physical to raw conversion
            rawValue = ((phyValue -(0))/1);
            putValue(E_pubc_GW_GW_1A8_TCU_ActualGear_Rv, rawValue);
            chgEv_GW_1A8_TCU_ActualGear = 1;  
        }
        else
        {
            chgEv_GW_1A8_TCU_ActualGear = 0;
        }
    }
}

on envVar E_pubc_GW_GW_1A8_TCU_ActualGear_Vt
{
    qword rawValue = 0ll;
    if(getValue(E_pubc_GW_GW_1A8_TCU_ActualGear_SetVt))
    {
        //update the signal value
        Msg_GW_1A8.TCU_ActualGear=getValue(this);
    }
}

on envVar E_pubc_GW_GW_1A8_TCU_ActualGear_SetVt
{
    if(getValue(E_pubc_GW_GW_1A8_TCU_ActualGear_SetVt))
    {
        //update the signal value
        Msg_GW_1A8.TCU_ActualGear=getvalue(E_pubc_GW_GW_1A8_TCU_ActualGear_Vt);
    }
    else
    {
        Msg_GW_1A8.TCU_ActualGear=getValue(E_pubc_GW_GW_1A8_TCU_ActualGear_Rv);
    }
}
 
on envVar E_pubc_GW_GW_3C2_tx
{
    if(getValue(this))
    {       
        
        //update the BZ Signal
        if(GW_3C2_HU_RollingCounter_3C2_wrongvalctr == 0)
        {
            update_GW_3C2_HU_RollingCounter_3C2_counter();
            Msg_GW_3C2.HU_RollingCounter_3C2= GW_3C2_HU_RollingCounter_3C2_counter;
        }
        else if(GW_3C2_HU_RollingCounter_3C2_wrongvalctr > 0)
        {
             GW_3C2_HU_RollingCounter_3C2_wrongvalctr--;
              // if counter becomes zero, update panel controller to zero
             if(GW_3C2_HU_RollingCounter_3C2_wrongvalctr == 0)
             {
                 putValue(E_pubc_GW_GW_3C2_HU_RollingCounter_3C2_wrongvalctr,0);
             }
        }
        else
        {
            //do nothing
        }        
        //calculate the CRC CheckSum
        update_GW_3C2_CRC_CheckSum();

        output(Msg_GW_3C2);        
    }
}

on envVar E_pubc_GW_GW_3C2_Range
{
    qword rawstatus = 0ll;
    qword rawValue = 0ll;    
    
    rawstatus = getvalue(this);    
    // set all the signals with min raw /max raw /init raw
    switch (rawstatus) 
    {
     case(0) :
        rawValue= 0;
        putValue(E_pubc_GW_GW_3C2_HU_Road_TrafficFlow_Rv, rawValue);
        rawValue= 0;
        putValue(E_pubc_GW_GW_3C2_HU_RampSide_Rv, rawValue);
        rawValue= 0;
        putValue(E_pubc_GW_GW_3C2_HU_To_Branch_Dis_Rv, rawValue);
        rawValue= 0;
        putValue(E_pubc_GW_GW_3C2_HU_LaneCnt_Rv, rawValue);
        rawValue= 0;
        putValue(E_pubc_GW_GW_3C2_HU_TrafficAccident_Info_Rv, rawValue);
        rawValue= 0;
        putValue(E_pubc_GW_GW_3C2_HU_To_TrafficAccident_Dis_Rv, rawValue);
        rawValue= 0;
        putValue(E_pubc_GW_GW_3C2_HU_MapDataUpdateStatus_Rv, rawValue);
        rawValue= 0;
        putValue(E_pubc_GW_GW_3C2_HU_Construction_Info_Rv, rawValue);
        rawValue= 0;
        putValue(E_pubc_GW_GW_3C2_HU_To_Construction_Dis_Rv, rawValue);
        rawValue= 0;
        putValue(E_pubc_GW_GW_3C2_HU_FallingRockInfo_Rv, rawValue);
        rawValue= 0;
        putValue(E_pubc_GW_GW_3C2_HU_ForwardRoadType_Rv, rawValue);
        rawValue= 0;
        putValue(E_pubc_GW_GW_3C2_HU_FallingRockDi_Rv, rawValue);
        rawValue= 0;
        putValue(E_pubc_GW_GW_3C2_HU_TollInfo_Rv, rawValue);
        rawValue= 0;
        putValue(E_pubc_GW_GW_3C2_HU_TollDis_Rv, rawValue);
        break;
     case(1) :
        rawValue= 7;
        putValue(E_pubc_GW_GW_3C2_HU_Road_TrafficFlow_Rv, rawValue);
        rawValue= 3;
        putValue(E_pubc_GW_GW_3C2_HU_RampSide_Rv, rawValue);
        rawValue= 60;
        putValue(E_pubc_GW_GW_3C2_HU_To_Branch_Dis_Rv, rawValue);
        rawValue= 7;
        putValue(E_pubc_GW_GW_3C2_HU_LaneCnt_Rv, rawValue);
        rawValue= 3;
        putValue(E_pubc_GW_GW_3C2_HU_TrafficAccident_Info_Rv, rawValue);
        rawValue= 60;
        putValue(E_pubc_GW_GW_3C2_HU_To_TrafficAccident_Dis_Rv, rawValue);
        rawValue= 7;
        putValue(E_pubc_GW_GW_3C2_HU_MapDataUpdateStatus_Rv, rawValue);
        rawValue= 3;
        putValue(E_pubc_GW_GW_3C2_HU_Construction_Info_Rv, rawValue);
        rawValue= 60;
        putValue(E_pubc_GW_GW_3C2_HU_To_Construction_Dis_Rv, rawValue);
        rawValue= 3;
        putValue(E_pubc_GW_GW_3C2_HU_FallingRockInfo_Rv, rawValue);
        rawValue= 7;
        putValue(E_pubc_GW_GW_3C2_HU_ForwardRoadType_Rv, rawValue);
        rawValue= 60;
        putValue(E_pubc_GW_GW_3C2_HU_FallingRockDi_Rv, rawValue);
        rawValue= 3;
        putValue(E_pubc_GW_GW_3C2_HU_TollInfo_Rv, rawValue);
        rawValue= 60;
        putValue(E_pubc_GW_GW_3C2_HU_TollDis_Rv, rawValue);
        break;
     default :
        rawValue= 0;
        putValue(E_pubc_GW_GW_3C2_HU_Road_TrafficFlow_Rv, rawValue);
        rawValue= 0;
        putValue(E_pubc_GW_GW_3C2_HU_RampSide_Rv, rawValue);
        rawValue= 0;
        putValue(E_pubc_GW_GW_3C2_HU_To_Branch_Dis_Rv, rawValue);
        rawValue= 0;
        putValue(E_pubc_GW_GW_3C2_HU_LaneCnt_Rv, rawValue);
        rawValue= 0;
        putValue(E_pubc_GW_GW_3C2_HU_TrafficAccident_Info_Rv, rawValue);
        rawValue= 0;
        putValue(E_pubc_GW_GW_3C2_HU_To_TrafficAccident_Dis_Rv, rawValue);
        rawValue= 0;
        putValue(E_pubc_GW_GW_3C2_HU_MapDataUpdateStatus_Rv, rawValue);
        rawValue= 0;
        putValue(E_pubc_GW_GW_3C2_HU_Construction_Info_Rv, rawValue);
        rawValue= 0;
        putValue(E_pubc_GW_GW_3C2_HU_To_Construction_Dis_Rv, rawValue);
        rawValue= 0;
        putValue(E_pubc_GW_GW_3C2_HU_FallingRockInfo_Rv, rawValue);
        rawValue= 0;
        putValue(E_pubc_GW_GW_3C2_HU_ForwardRoadType_Rv, rawValue);
        rawValue= 0;
        putValue(E_pubc_GW_GW_3C2_HU_FallingRockDi_Rv, rawValue);
        rawValue= 0;
        putValue(E_pubc_GW_GW_3C2_HU_TollInfo_Rv, rawValue);
        rawValue= 0;
        putValue(E_pubc_GW_GW_3C2_HU_TollDis_Rv, rawValue);
      break;
   }
}

on envVar E_pubc_GW_GW_3C2_Dlc
{
    if(getValue(E_pubc_GW_GW_3C2_enDlc))
    {
        Msg_GW_3C2.dlc =getValue(this);
    }
    else
    {
        Msg_GW_3C2.dlc =8;
    }
}

on envVar E_pubc_GW_GW_3C2_enDlc
{
    //For Messages with DLC = 8, set wrong DLC to smaller than defined DLC
    //For Messages with DLC < 8 set wrong DLC to smaller/longer than defined DLC
    if(getValue(this))
    {
        Msg_GW_3C2.dlc =getValue(E_pubc_GW_GW_3C2_Dlc);
    }
    else
    {
        Msg_GW_3C2.dlc =8;
    }
}

on envVar E_pubc_GW_GW_3C2_HU_CRCCheck_3C2_wrongvalctr
{
    //update disturb count
    //disturb value range:(-1 = always send wrong value),( X>0 ,x is the number of Messages with wrong CHK sent)
    GW_3C2_HU_CRCCheck_3C2_wrongvalctr =getValue(this);    
}
on envVar E_pubc_GW_GW_3C2_HU_RollingCounter_3C2_wrongvalctr
{
    //update disturb count
    //disturb value range:(-1 = always send wrong value),( X>0 ,x is the number of Messages with wrong CHK sent)
    GW_3C2_HU_RollingCounter_3C2_wrongvalctr =getValue(this);    
}

on envVar E_pubc_GW_GW_3C2_HU_Road_TrafficFlow_Rv
{
    int64 rawValue = 0ll;
    float rawValue_float = 0.0;
    float phyValue = 0.0;        

    //set the signal with updated raw value
    if(getValue(E_pubc_GW_GW_3C2_HU_Road_TrafficFlow_SetVt)==0)
    {
        rawValue = getvalue(this);
        if(chgEv_GW_3C2_HU_Road_TrafficFlow == 0)
        {
            //type conversion to float
            rawValue_float = rawValue;        
            // raw to physical conversion
            phyValue = ((rawValue_float *1)+(0));
            putValue(E_pubc_GW_GW_3C2_HU_Road_TrafficFlow_Pv, phyValue);
            chgEv_GW_3C2_HU_Road_TrafficFlow = 1;
        }
        else
        {
            chgEv_GW_3C2_HU_Road_TrafficFlow = 0;
        }    
        //update the signal value
        Msg_GW_3C2.HU_Road_TrafficFlow=rawValue;        
    }                                                                           
}

on envVar E_pubc_GW_GW_3C2_HU_Road_TrafficFlow_Pv
{
    int64 rawValue = 0ll;
    float phyValue = 0.0;
    
    //update the raw value with physical value 
    if(getValue(E_pubc_GW_GW_3C2_HU_Road_TrafficFlow_SetVt)==0)
    {
        if(chgEv_GW_3C2_HU_Road_TrafficFlow == 0)
        {
            phyValue = getvalue(this);
            // physical to raw conversion
            rawValue = ((phyValue -(0))/1);
            putValue(E_pubc_GW_GW_3C2_HU_Road_TrafficFlow_Rv, rawValue);
            chgEv_GW_3C2_HU_Road_TrafficFlow = 1;  
        }
        else
        {
            chgEv_GW_3C2_HU_Road_TrafficFlow = 0;
        }
    }
}

on envVar E_pubc_GW_GW_3C2_HU_Road_TrafficFlow_Vt
{
    qword rawValue = 0ll;
    if(getValue(E_pubc_GW_GW_3C2_HU_Road_TrafficFlow_SetVt))
    {
        //update the signal value
        Msg_GW_3C2.HU_Road_TrafficFlow=getValue(this);
    }
}

on envVar E_pubc_GW_GW_3C2_HU_Road_TrafficFlow_SetVt
{
    if(getValue(E_pubc_GW_GW_3C2_HU_Road_TrafficFlow_SetVt))
    {
        //update the signal value
        Msg_GW_3C2.HU_Road_TrafficFlow=getvalue(E_pubc_GW_GW_3C2_HU_Road_TrafficFlow_Vt);
    }
    else
    {
        Msg_GW_3C2.HU_Road_TrafficFlow=getValue(E_pubc_GW_GW_3C2_HU_Road_TrafficFlow_Rv);
    }
}
 
on envVar E_pubc_GW_GW_3C2_HU_RampSide_Rv
{
    int64 rawValue = 0ll;
    float rawValue_float = 0.0;
    float phyValue = 0.0;        

    //set the signal with updated raw value
    if(getValue(E_pubc_GW_GW_3C2_HU_RampSide_SetVt)==0)
    {
        rawValue = getvalue(this);
        if(chgEv_GW_3C2_HU_RampSide == 0)
        {
            //type conversion to float
            rawValue_float = rawValue;        
            // raw to physical conversion
            phyValue = ((rawValue_float *1)+(0));
            putValue(E_pubc_GW_GW_3C2_HU_RampSide_Pv, phyValue);
            chgEv_GW_3C2_HU_RampSide = 1;
        }
        else
        {
            chgEv_GW_3C2_HU_RampSide = 0;
        }    
        //update the signal value
        Msg_GW_3C2.HU_RampSide=rawValue;        
    }                                                                           
}

on envVar E_pubc_GW_GW_3C2_HU_RampSide_Pv
{
    int64 rawValue = 0ll;
    float phyValue = 0.0;
    
    //update the raw value with physical value 
    if(getValue(E_pubc_GW_GW_3C2_HU_RampSide_SetVt)==0)
    {
        if(chgEv_GW_3C2_HU_RampSide == 0)
        {
            phyValue = getvalue(this);
            // physical to raw conversion
            rawValue = ((phyValue -(0))/1);
            putValue(E_pubc_GW_GW_3C2_HU_RampSide_Rv, rawValue);
            chgEv_GW_3C2_HU_RampSide = 1;  
        }
        else
        {
            chgEv_GW_3C2_HU_RampSide = 0;
        }
    }
}

on envVar E_pubc_GW_GW_3C2_HU_RampSide_Vt
{
    qword rawValue = 0ll;
    if(getValue(E_pubc_GW_GW_3C2_HU_RampSide_SetVt))
    {
        //update the signal value
        Msg_GW_3C2.HU_RampSide=getValue(this);
    }
}

on envVar E_pubc_GW_GW_3C2_HU_RampSide_SetVt
{
    if(getValue(E_pubc_GW_GW_3C2_HU_RampSide_SetVt))
    {
        //update the signal value
        Msg_GW_3C2.HU_RampSide=getvalue(E_pubc_GW_GW_3C2_HU_RampSide_Vt);
    }
    else
    {
        Msg_GW_3C2.HU_RampSide=getValue(E_pubc_GW_GW_3C2_HU_RampSide_Rv);
    }
}
 
on envVar E_pubc_GW_GW_3C2_HU_To_Branch_Dis_Rv
{
    int64 rawValue = 0ll;
    float rawValue_float = 0.0;
    float phyValue = 0.0;        

    //set the signal with updated raw value
    if(getValue(E_pubc_GW_GW_3C2_HU_To_Branch_Dis_SetVt)==0)
    {
        rawValue = getvalue(this);
        if(chgEv_GW_3C2_HU_To_Branch_Dis == 0)
        {
            //type conversion to float
            rawValue_float = rawValue;        
            // raw to physical conversion
            phyValue = ((rawValue_float *10)+(0));
            putValue(E_pubc_GW_GW_3C2_HU_To_Branch_Dis_Pv, phyValue);
            chgEv_GW_3C2_HU_To_Branch_Dis = 1;
        }
        else
        {
            chgEv_GW_3C2_HU_To_Branch_Dis = 0;
        }    
        //update the signal value
        Msg_GW_3C2.HU_To_Branch_Dis=rawValue;        
    }                                                                           
}

on envVar E_pubc_GW_GW_3C2_HU_To_Branch_Dis_Pv
{
    int64 rawValue = 0ll;
    float phyValue = 0.0;
    
    //update the raw value with physical value 
    if(getValue(E_pubc_GW_GW_3C2_HU_To_Branch_Dis_SetVt)==0)
    {
        if(chgEv_GW_3C2_HU_To_Branch_Dis == 0)
        {
            phyValue = getvalue(this);
            // physical to raw conversion
            rawValue = ((phyValue -(0))/10);
            putValue(E_pubc_GW_GW_3C2_HU_To_Branch_Dis_Rv, rawValue);
            chgEv_GW_3C2_HU_To_Branch_Dis = 1;  
        }
        else
        {
            chgEv_GW_3C2_HU_To_Branch_Dis = 0;
        }
    }
}

on envVar E_pubc_GW_GW_3C2_HU_To_Branch_Dis_Vt
{
    qword rawValue = 0ll;
    if(getValue(E_pubc_GW_GW_3C2_HU_To_Branch_Dis_SetVt))
    {
        //update the signal value
        Msg_GW_3C2.HU_To_Branch_Dis=getValue(this);
    }
}

on envVar E_pubc_GW_GW_3C2_HU_To_Branch_Dis_SetVt
{
    if(getValue(E_pubc_GW_GW_3C2_HU_To_Branch_Dis_SetVt))
    {
        //update the signal value
        Msg_GW_3C2.HU_To_Branch_Dis=getvalue(E_pubc_GW_GW_3C2_HU_To_Branch_Dis_Vt);
    }
    else
    {
        Msg_GW_3C2.HU_To_Branch_Dis=getValue(E_pubc_GW_GW_3C2_HU_To_Branch_Dis_Rv);
    }
}
 
on envVar E_pubc_GW_GW_3C2_HU_LaneCnt_Rv
{
    int64 rawValue = 0ll;
    float rawValue_float = 0.0;
    float phyValue = 0.0;        

    //set the signal with updated raw value
    if(getValue(E_pubc_GW_GW_3C2_HU_LaneCnt_SetVt)==0)
    {
        rawValue = getvalue(this);
        if(chgEv_GW_3C2_HU_LaneCnt == 0)
        {
            //type conversion to float
            rawValue_float = rawValue;        
            // raw to physical conversion
            phyValue = ((rawValue_float *1)+(0));
            putValue(E_pubc_GW_GW_3C2_HU_LaneCnt_Pv, phyValue);
            chgEv_GW_3C2_HU_LaneCnt = 1;
        }
        else
        {
            chgEv_GW_3C2_HU_LaneCnt = 0;
        }    
        //update the signal value
        Msg_GW_3C2.HU_LaneCnt=rawValue;        
    }                                                                           
}

on envVar E_pubc_GW_GW_3C2_HU_LaneCnt_Pv
{
    int64 rawValue = 0ll;
    float phyValue = 0.0;
    
    //update the raw value with physical value 
    if(getValue(E_pubc_GW_GW_3C2_HU_LaneCnt_SetVt)==0)
    {
        if(chgEv_GW_3C2_HU_LaneCnt == 0)
        {
            phyValue = getvalue(this);
            // physical to raw conversion
            rawValue = ((phyValue -(0))/1);
            putValue(E_pubc_GW_GW_3C2_HU_LaneCnt_Rv, rawValue);
            chgEv_GW_3C2_HU_LaneCnt = 1;  
        }
        else
        {
            chgEv_GW_3C2_HU_LaneCnt = 0;
        }
    }
}

on envVar E_pubc_GW_GW_3C2_HU_LaneCnt_Vt
{
    qword rawValue = 0ll;
    if(getValue(E_pubc_GW_GW_3C2_HU_LaneCnt_SetVt))
    {
        //update the signal value
        Msg_GW_3C2.HU_LaneCnt=getValue(this);
    }
}

on envVar E_pubc_GW_GW_3C2_HU_LaneCnt_SetVt
{
    if(getValue(E_pubc_GW_GW_3C2_HU_LaneCnt_SetVt))
    {
        //update the signal value
        Msg_GW_3C2.HU_LaneCnt=getvalue(E_pubc_GW_GW_3C2_HU_LaneCnt_Vt);
    }
    else
    {
        Msg_GW_3C2.HU_LaneCnt=getValue(E_pubc_GW_GW_3C2_HU_LaneCnt_Rv);
    }
}
 
on envVar E_pubc_GW_GW_3C2_HU_TrafficAccident_Info_Rv
{
    int64 rawValue = 0ll;
    float rawValue_float = 0.0;
    float phyValue = 0.0;        

    //set the signal with updated raw value
    if(getValue(E_pubc_GW_GW_3C2_HU_TrafficAccident_Info_SetVt)==0)
    {
        rawValue = getvalue(this);
        if(chgEv_GW_3C2_HU_TrafficAccident_Info == 0)
        {
            //type conversion to float
            rawValue_float = rawValue;        
            // raw to physical conversion
            phyValue = ((rawValue_float *1)+(0));
            putValue(E_pubc_GW_GW_3C2_HU_TrafficAccident_Info_Pv, phyValue);
            chgEv_GW_3C2_HU_TrafficAccident_Info = 1;
        }
        else
        {
            chgEv_GW_3C2_HU_TrafficAccident_Info = 0;
        }    
        //update the signal value
        Msg_GW_3C2.HU_TrafficAccident_Info=rawValue;        
    }                                                                           
}

on envVar E_pubc_GW_GW_3C2_HU_TrafficAccident_Info_Pv
{
    int64 rawValue = 0ll;
    float phyValue = 0.0;
    
    //update the raw value with physical value 
    if(getValue(E_pubc_GW_GW_3C2_HU_TrafficAccident_Info_SetVt)==0)
    {
        if(chgEv_GW_3C2_HU_TrafficAccident_Info == 0)
        {
            phyValue = getvalue(this);
            // physical to raw conversion
            rawValue = ((phyValue -(0))/1);
            putValue(E_pubc_GW_GW_3C2_HU_TrafficAccident_Info_Rv, rawValue);
            chgEv_GW_3C2_HU_TrafficAccident_Info = 1;  
        }
        else
        {
            chgEv_GW_3C2_HU_TrafficAccident_Info = 0;
        }
    }
}

on envVar E_pubc_GW_GW_3C2_HU_TrafficAccident_Info_Vt
{
    qword rawValue = 0ll;
    if(getValue(E_pubc_GW_GW_3C2_HU_TrafficAccident_Info_SetVt))
    {
        //update the signal value
        Msg_GW_3C2.HU_TrafficAccident_Info=getValue(this);
    }
}

on envVar E_pubc_GW_GW_3C2_HU_TrafficAccident_Info_SetVt
{
    if(getValue(E_pubc_GW_GW_3C2_HU_TrafficAccident_Info_SetVt))
    {
        //update the signal value
        Msg_GW_3C2.HU_TrafficAccident_Info=getvalue(E_pubc_GW_GW_3C2_HU_TrafficAccident_Info_Vt);
    }
    else
    {
        Msg_GW_3C2.HU_TrafficAccident_Info=getValue(E_pubc_GW_GW_3C2_HU_TrafficAccident_Info_Rv);
    }
}
 
on envVar E_pubc_GW_GW_3C2_HU_To_TrafficAccident_Dis_Rv
{
    int64 rawValue = 0ll;
    float rawValue_float = 0.0;
    float phyValue = 0.0;        

    //set the signal with updated raw value
    if(getValue(E_pubc_GW_GW_3C2_HU_To_TrafficAccident_Dis_SetVt)==0)
    {
        rawValue = getvalue(this);
        if(chgEv_GW_3C2_HU_To_TrafficAccident_Dis == 0)
        {
            //type conversion to float
            rawValue_float = rawValue;        
            // raw to physical conversion
            phyValue = ((rawValue_float *10)+(0));
            putValue(E_pubc_GW_GW_3C2_HU_To_TrafficAccident_Dis_Pv, phyValue);
            chgEv_GW_3C2_HU_To_TrafficAccident_Dis = 1;
        }
        else
        {
            chgEv_GW_3C2_HU_To_TrafficAccident_Dis = 0;
        }    
        //update the signal value
        Msg_GW_3C2.HU_To_TrafficAccident_Dis=rawValue;        
    }                                                                           
}

on envVar E_pubc_GW_GW_3C2_HU_To_TrafficAccident_Dis_Pv
{
    int64 rawValue = 0ll;
    float phyValue = 0.0;
    
    //update the raw value with physical value 
    if(getValue(E_pubc_GW_GW_3C2_HU_To_TrafficAccident_Dis_SetVt)==0)
    {
        if(chgEv_GW_3C2_HU_To_TrafficAccident_Dis == 0)
        {
            phyValue = getvalue(this);
            // physical to raw conversion
            rawValue = ((phyValue -(0))/10);
            putValue(E_pubc_GW_GW_3C2_HU_To_TrafficAccident_Dis_Rv, rawValue);
            chgEv_GW_3C2_HU_To_TrafficAccident_Dis = 1;  
        }
        else
        {
            chgEv_GW_3C2_HU_To_TrafficAccident_Dis = 0;
        }
    }
}

on envVar E_pubc_GW_GW_3C2_HU_To_TrafficAccident_Dis_Vt
{
    qword rawValue = 0ll;
    if(getValue(E_pubc_GW_GW_3C2_HU_To_TrafficAccident_Dis_SetVt))
    {
        //update the signal value
        Msg_GW_3C2.HU_To_TrafficAccident_Dis=getValue(this);
    }
}

on envVar E_pubc_GW_GW_3C2_HU_To_TrafficAccident_Dis_SetVt
{
    if(getValue(E_pubc_GW_GW_3C2_HU_To_TrafficAccident_Dis_SetVt))
    {
        //update the signal value
        Msg_GW_3C2.HU_To_TrafficAccident_Dis=getvalue(E_pubc_GW_GW_3C2_HU_To_TrafficAccident_Dis_Vt);
    }
    else
    {
        Msg_GW_3C2.HU_To_TrafficAccident_Dis=getValue(E_pubc_GW_GW_3C2_HU_To_TrafficAccident_Dis_Rv);
    }
}
 
on envVar E_pubc_GW_GW_3C2_HU_MapDataUpdateStatus_Rv
{
    int64 rawValue = 0ll;
    float rawValue_float = 0.0;
    float phyValue = 0.0;        

    //set the signal with updated raw value
    if(getValue(E_pubc_GW_GW_3C2_HU_MapDataUpdateStatus_SetVt)==0)
    {
        rawValue = getvalue(this);
        if(chgEv_GW_3C2_HU_MapDataUpdateStatus == 0)
        {
            //type conversion to float
            rawValue_float = rawValue;        
            // raw to physical conversion
            phyValue = ((rawValue_float *1)+(0));
            putValue(E_pubc_GW_GW_3C2_HU_MapDataUpdateStatus_Pv, phyValue);
            chgEv_GW_3C2_HU_MapDataUpdateStatus = 1;
        }
        else
        {
            chgEv_GW_3C2_HU_MapDataUpdateStatus = 0;
        }    
        //update the signal value
        Msg_GW_3C2.HU_MapDataUpdateStatus=rawValue;        
    }                                                                           
}

on envVar E_pubc_GW_GW_3C2_HU_MapDataUpdateStatus_Pv
{
    int64 rawValue = 0ll;
    float phyValue = 0.0;
    
    //update the raw value with physical value 
    if(getValue(E_pubc_GW_GW_3C2_HU_MapDataUpdateStatus_SetVt)==0)
    {
        if(chgEv_GW_3C2_HU_MapDataUpdateStatus == 0)
        {
            phyValue = getvalue(this);
            // physical to raw conversion
            rawValue = ((phyValue -(0))/1);
            putValue(E_pubc_GW_GW_3C2_HU_MapDataUpdateStatus_Rv, rawValue);
            chgEv_GW_3C2_HU_MapDataUpdateStatus = 1;  
        }
        else
        {
            chgEv_GW_3C2_HU_MapDataUpdateStatus = 0;
        }
    }
}

on envVar E_pubc_GW_GW_3C2_HU_MapDataUpdateStatus_Vt
{
    qword rawValue = 0ll;
    if(getValue(E_pubc_GW_GW_3C2_HU_MapDataUpdateStatus_SetVt))
    {
        //update the signal value
        Msg_GW_3C2.HU_MapDataUpdateStatus=getValue(this);
    }
}

on envVar E_pubc_GW_GW_3C2_HU_MapDataUpdateStatus_SetVt
{
    if(getValue(E_pubc_GW_GW_3C2_HU_MapDataUpdateStatus_SetVt))
    {
        //update the signal value
        Msg_GW_3C2.HU_MapDataUpdateStatus=getvalue(E_pubc_GW_GW_3C2_HU_MapDataUpdateStatus_Vt);
    }
    else
    {
        Msg_GW_3C2.HU_MapDataUpdateStatus=getValue(E_pubc_GW_GW_3C2_HU_MapDataUpdateStatus_Rv);
    }
}
 
on envVar E_pubc_GW_GW_3C2_HU_Construction_Info_Rv
{
    int64 rawValue = 0ll;
    float rawValue_float = 0.0;
    float phyValue = 0.0;        

    //set the signal with updated raw value
    if(getValue(E_pubc_GW_GW_3C2_HU_Construction_Info_SetVt)==0)
    {
        rawValue = getvalue(this);
        if(chgEv_GW_3C2_HU_Construction_Info == 0)
        {
            //type conversion to float
            rawValue_float = rawValue;        
            // raw to physical conversion
            phyValue = ((rawValue_float *1)+(0));
            putValue(E_pubc_GW_GW_3C2_HU_Construction_Info_Pv, phyValue);
            chgEv_GW_3C2_HU_Construction_Info = 1;
        }
        else
        {
            chgEv_GW_3C2_HU_Construction_Info = 0;
        }    
        //update the signal value
        Msg_GW_3C2.HU_Construction_Info=rawValue;        
    }                                                                           
}

on envVar E_pubc_GW_GW_3C2_HU_Construction_Info_Pv
{
    int64 rawValue = 0ll;
    float phyValue = 0.0;
    
    //update the raw value with physical value 
    if(getValue(E_pubc_GW_GW_3C2_HU_Construction_Info_SetVt)==0)
    {
        if(chgEv_GW_3C2_HU_Construction_Info == 0)
        {
            phyValue = getvalue(this);
            // physical to raw conversion
            rawValue = ((phyValue -(0))/1);
            putValue(E_pubc_GW_GW_3C2_HU_Construction_Info_Rv, rawValue);
            chgEv_GW_3C2_HU_Construction_Info = 1;  
        }
        else
        {
            chgEv_GW_3C2_HU_Construction_Info = 0;
        }
    }
}

on envVar E_pubc_GW_GW_3C2_HU_Construction_Info_Vt
{
    qword rawValue = 0ll;
    if(getValue(E_pubc_GW_GW_3C2_HU_Construction_Info_SetVt))
    {
        //update the signal value
        Msg_GW_3C2.HU_Construction_Info=getValue(this);
    }
}

on envVar E_pubc_GW_GW_3C2_HU_Construction_Info_SetVt
{
    if(getValue(E_pubc_GW_GW_3C2_HU_Construction_Info_SetVt))
    {
        //update the signal value
        Msg_GW_3C2.HU_Construction_Info=getvalue(E_pubc_GW_GW_3C2_HU_Construction_Info_Vt);
    }
    else
    {
        Msg_GW_3C2.HU_Construction_Info=getValue(E_pubc_GW_GW_3C2_HU_Construction_Info_Rv);
    }
}
 
on envVar E_pubc_GW_GW_3C2_HU_To_Construction_Dis_Rv
{
    int64 rawValue = 0ll;
    float rawValue_float = 0.0;
    float phyValue = 0.0;        

    //set the signal with updated raw value
    if(getValue(E_pubc_GW_GW_3C2_HU_To_Construction_Dis_SetVt)==0)
    {
        rawValue = getvalue(this);
        if(chgEv_GW_3C2_HU_To_Construction_Dis == 0)
        {
            //type conversion to float
            rawValue_float = rawValue;        
            // raw to physical conversion
            phyValue = ((rawValue_float *10)+(0));
            putValue(E_pubc_GW_GW_3C2_HU_To_Construction_Dis_Pv, phyValue);
            chgEv_GW_3C2_HU_To_Construction_Dis = 1;
        }
        else
        {
            chgEv_GW_3C2_HU_To_Construction_Dis = 0;
        }    
        //update the signal value
        Msg_GW_3C2.HU_To_Construction_Dis=rawValue;        
    }                                                                           
}

on envVar E_pubc_GW_GW_3C2_HU_To_Construction_Dis_Pv
{
    int64 rawValue = 0ll;
    float phyValue = 0.0;
    
    //update the raw value with physical value 
    if(getValue(E_pubc_GW_GW_3C2_HU_To_Construction_Dis_SetVt)==0)
    {
        if(chgEv_GW_3C2_HU_To_Construction_Dis == 0)
        {
            phyValue = getvalue(this);
            // physical to raw conversion
            rawValue = ((phyValue -(0))/10);
            putValue(E_pubc_GW_GW_3C2_HU_To_Construction_Dis_Rv, rawValue);
            chgEv_GW_3C2_HU_To_Construction_Dis = 1;  
        }
        else
        {
            chgEv_GW_3C2_HU_To_Construction_Dis = 0;
        }
    }
}

on envVar E_pubc_GW_GW_3C2_HU_To_Construction_Dis_Vt
{
    qword rawValue = 0ll;
    if(getValue(E_pubc_GW_GW_3C2_HU_To_Construction_Dis_SetVt))
    {
        //update the signal value
        Msg_GW_3C2.HU_To_Construction_Dis=getValue(this);
    }
}

on envVar E_pubc_GW_GW_3C2_HU_To_Construction_Dis_SetVt
{
    if(getValue(E_pubc_GW_GW_3C2_HU_To_Construction_Dis_SetVt))
    {
        //update the signal value
        Msg_GW_3C2.HU_To_Construction_Dis=getvalue(E_pubc_GW_GW_3C2_HU_To_Construction_Dis_Vt);
    }
    else
    {
        Msg_GW_3C2.HU_To_Construction_Dis=getValue(E_pubc_GW_GW_3C2_HU_To_Construction_Dis_Rv);
    }
}
 
on envVar E_pubc_GW_GW_3C2_HU_FallingRockInfo_Rv
{
    int64 rawValue = 0ll;
    float rawValue_float = 0.0;
    float phyValue = 0.0;        

    //set the signal with updated raw value
    if(getValue(E_pubc_GW_GW_3C2_HU_FallingRockInfo_SetVt)==0)
    {
        rawValue = getvalue(this);
        if(chgEv_GW_3C2_HU_FallingRockInfo == 0)
        {
            //type conversion to float
            rawValue_float = rawValue;        
            // raw to physical conversion
            phyValue = ((rawValue_float *1)+(0));
            putValue(E_pubc_GW_GW_3C2_HU_FallingRockInfo_Pv, phyValue);
            chgEv_GW_3C2_HU_FallingRockInfo = 1;
        }
        else
        {
            chgEv_GW_3C2_HU_FallingRockInfo = 0;
        }    
        //update the signal value
        Msg_GW_3C2.HU_FallingRockInfo=rawValue;        
    }                                                                           
}

on envVar E_pubc_GW_GW_3C2_HU_FallingRockInfo_Pv
{
    int64 rawValue = 0ll;
    float phyValue = 0.0;
    
    //update the raw value with physical value 
    if(getValue(E_pubc_GW_GW_3C2_HU_FallingRockInfo_SetVt)==0)
    {
        if(chgEv_GW_3C2_HU_FallingRockInfo == 0)
        {
            phyValue = getvalue(this);
            // physical to raw conversion
            rawValue = ((phyValue -(0))/1);
            putValue(E_pubc_GW_GW_3C2_HU_FallingRockInfo_Rv, rawValue);
            chgEv_GW_3C2_HU_FallingRockInfo = 1;  
        }
        else
        {
            chgEv_GW_3C2_HU_FallingRockInfo = 0;
        }
    }
}

on envVar E_pubc_GW_GW_3C2_HU_FallingRockInfo_Vt
{
    qword rawValue = 0ll;
    if(getValue(E_pubc_GW_GW_3C2_HU_FallingRockInfo_SetVt))
    {
        //update the signal value
        Msg_GW_3C2.HU_FallingRockInfo=getValue(this);
    }
}

on envVar E_pubc_GW_GW_3C2_HU_FallingRockInfo_SetVt
{
    if(getValue(E_pubc_GW_GW_3C2_HU_FallingRockInfo_SetVt))
    {
        //update the signal value
        Msg_GW_3C2.HU_FallingRockInfo=getvalue(E_pubc_GW_GW_3C2_HU_FallingRockInfo_Vt);
    }
    else
    {
        Msg_GW_3C2.HU_FallingRockInfo=getValue(E_pubc_GW_GW_3C2_HU_FallingRockInfo_Rv);
    }
}
 
on envVar E_pubc_GW_GW_3C2_HU_ForwardRoadType_Rv
{
    int64 rawValue = 0ll;
    float rawValue_float = 0.0;
    float phyValue = 0.0;        

    //set the signal with updated raw value
    if(getValue(E_pubc_GW_GW_3C2_HU_ForwardRoadType_SetVt)==0)
    {
        rawValue = getvalue(this);
        if(chgEv_GW_3C2_HU_ForwardRoadType == 0)
        {
            //type conversion to float
            rawValue_float = rawValue;        
            // raw to physical conversion
            phyValue = ((rawValue_float *1)+(0));
            putValue(E_pubc_GW_GW_3C2_HU_ForwardRoadType_Pv, phyValue);
            chgEv_GW_3C2_HU_ForwardRoadType = 1;
        }
        else
        {
            chgEv_GW_3C2_HU_ForwardRoadType = 0;
        }    
        //update the signal value
        Msg_GW_3C2.HU_ForwardRoadType=rawValue;        
    }                                                                           
}

on envVar E_pubc_GW_GW_3C2_HU_ForwardRoadType_Pv
{
    int64 rawValue = 0ll;
    float phyValue = 0.0;
    
    //update the raw value with physical value 
    if(getValue(E_pubc_GW_GW_3C2_HU_ForwardRoadType_SetVt)==0)
    {
        if(chgEv_GW_3C2_HU_ForwardRoadType == 0)
        {
            phyValue = getvalue(this);
            // physical to raw conversion
            rawValue = ((phyValue -(0))/1);
            putValue(E_pubc_GW_GW_3C2_HU_ForwardRoadType_Rv, rawValue);
            chgEv_GW_3C2_HU_ForwardRoadType = 1;  
        }
        else
        {
            chgEv_GW_3C2_HU_ForwardRoadType = 0;
        }
    }
}

on envVar E_pubc_GW_GW_3C2_HU_ForwardRoadType_Vt
{
    qword rawValue = 0ll;
    if(getValue(E_pubc_GW_GW_3C2_HU_ForwardRoadType_SetVt))
    {
        //update the signal value
        Msg_GW_3C2.HU_ForwardRoadType=getValue(this);
    }
}

on envVar E_pubc_GW_GW_3C2_HU_ForwardRoadType_SetVt
{
    if(getValue(E_pubc_GW_GW_3C2_HU_ForwardRoadType_SetVt))
    {
        //update the signal value
        Msg_GW_3C2.HU_ForwardRoadType=getvalue(E_pubc_GW_GW_3C2_HU_ForwardRoadType_Vt);
    }
    else
    {
        Msg_GW_3C2.HU_ForwardRoadType=getValue(E_pubc_GW_GW_3C2_HU_ForwardRoadType_Rv);
    }
}
 
on envVar E_pubc_GW_GW_3C2_HU_FallingRockDi_Rv
{
    int64 rawValue = 0ll;
    float rawValue_float = 0.0;
    float phyValue = 0.0;        

    //set the signal with updated raw value
    if(getValue(E_pubc_GW_GW_3C2_HU_FallingRockDi_SetVt)==0)
    {
        rawValue = getvalue(this);
        if(chgEv_GW_3C2_HU_FallingRockDi == 0)
        {
            //type conversion to float
            rawValue_float = rawValue;        
            // raw to physical conversion
            phyValue = ((rawValue_float *10)+(0));
            putValue(E_pubc_GW_GW_3C2_HU_FallingRockDi_Pv, phyValue);
            chgEv_GW_3C2_HU_FallingRockDi = 1;
        }
        else
        {
            chgEv_GW_3C2_HU_FallingRockDi = 0;
        }    
        //update the signal value
        Msg_GW_3C2.HU_FallingRockDi=rawValue;        
    }                                                                           
}

on envVar E_pubc_GW_GW_3C2_HU_FallingRockDi_Pv
{
    int64 rawValue = 0ll;
    float phyValue = 0.0;
    
    //update the raw value with physical value 
    if(getValue(E_pubc_GW_GW_3C2_HU_FallingRockDi_SetVt)==0)
    {
        if(chgEv_GW_3C2_HU_FallingRockDi == 0)
        {
            phyValue = getvalue(this);
            // physical to raw conversion
            rawValue = ((phyValue -(0))/10);
            putValue(E_pubc_GW_GW_3C2_HU_FallingRockDi_Rv, rawValue);
            chgEv_GW_3C2_HU_FallingRockDi = 1;  
        }
        else
        {
            chgEv_GW_3C2_HU_FallingRockDi = 0;
        }
    }
}

on envVar E_pubc_GW_GW_3C2_HU_FallingRockDi_Vt
{
    qword rawValue = 0ll;
    if(getValue(E_pubc_GW_GW_3C2_HU_FallingRockDi_SetVt))
    {
        //update the signal value
        Msg_GW_3C2.HU_FallingRockDi=getValue(this);
    }
}

on envVar E_pubc_GW_GW_3C2_HU_FallingRockDi_SetVt
{
    if(getValue(E_pubc_GW_GW_3C2_HU_FallingRockDi_SetVt))
    {
        //update the signal value
        Msg_GW_3C2.HU_FallingRockDi=getvalue(E_pubc_GW_GW_3C2_HU_FallingRockDi_Vt);
    }
    else
    {
        Msg_GW_3C2.HU_FallingRockDi=getValue(E_pubc_GW_GW_3C2_HU_FallingRockDi_Rv);
    }
}
 
on envVar E_pubc_GW_GW_3C2_HU_TollInfo_Rv
{
    int64 rawValue = 0ll;
    float rawValue_float = 0.0;
    float phyValue = 0.0;        

    //set the signal with updated raw value
    if(getValue(E_pubc_GW_GW_3C2_HU_TollInfo_SetVt)==0)
    {
        rawValue = getvalue(this);
        if(chgEv_GW_3C2_HU_TollInfo == 0)
        {
            //type conversion to float
            rawValue_float = rawValue;        
            // raw to physical conversion
            phyValue = ((rawValue_float *1)+(0));
            putValue(E_pubc_GW_GW_3C2_HU_TollInfo_Pv, phyValue);
            chgEv_GW_3C2_HU_TollInfo = 1;
        }
        else
        {
            chgEv_GW_3C2_HU_TollInfo = 0;
        }    
        //update the signal value
        Msg_GW_3C2.HU_TollInfo=rawValue;        
    }                                                                           
}

on envVar E_pubc_GW_GW_3C2_HU_TollInfo_Pv
{
    int64 rawValue = 0ll;
    float phyValue = 0.0;
    
    //update the raw value with physical value 
    if(getValue(E_pubc_GW_GW_3C2_HU_TollInfo_SetVt)==0)
    {
        if(chgEv_GW_3C2_HU_TollInfo == 0)
        {
            phyValue = getvalue(this);
            // physical to raw conversion
            rawValue = ((phyValue -(0))/1);
            putValue(E_pubc_GW_GW_3C2_HU_TollInfo_Rv, rawValue);
            chgEv_GW_3C2_HU_TollInfo = 1;  
        }
        else
        {
            chgEv_GW_3C2_HU_TollInfo = 0;
        }
    }
}

on envVar E_pubc_GW_GW_3C2_HU_TollInfo_Vt
{
    qword rawValue = 0ll;
    if(getValue(E_pubc_GW_GW_3C2_HU_TollInfo_SetVt))
    {
        //update the signal value
        Msg_GW_3C2.HU_TollInfo=getValue(this);
    }
}

on envVar E_pubc_GW_GW_3C2_HU_TollInfo_SetVt
{
    if(getValue(E_pubc_GW_GW_3C2_HU_TollInfo_SetVt))
    {
        //update the signal value
        Msg_GW_3C2.HU_TollInfo=getvalue(E_pubc_GW_GW_3C2_HU_TollInfo_Vt);
    }
    else
    {
        Msg_GW_3C2.HU_TollInfo=getValue(E_pubc_GW_GW_3C2_HU_TollInfo_Rv);
    }
}
 
on envVar E_pubc_GW_GW_3C2_HU_TollDis_Rv
{
    int64 rawValue = 0ll;
    float rawValue_float = 0.0;
    float phyValue = 0.0;        

    //set the signal with updated raw value
    if(getValue(E_pubc_GW_GW_3C2_HU_TollDis_SetVt)==0)
    {
        rawValue = getvalue(this);
        if(chgEv_GW_3C2_HU_TollDis == 0)
        {
            //type conversion to float
            rawValue_float = rawValue;        
            // raw to physical conversion
            phyValue = ((rawValue_float *10)+(0));
            putValue(E_pubc_GW_GW_3C2_HU_TollDis_Pv, phyValue);
            chgEv_GW_3C2_HU_TollDis = 1;
        }
        else
        {
            chgEv_GW_3C2_HU_TollDis = 0;
        }    
        //update the signal value
        Msg_GW_3C2.HU_TollDis=rawValue;        
    }                                                                           
}

on envVar E_pubc_GW_GW_3C2_HU_TollDis_Pv
{
    int64 rawValue = 0ll;
    float phyValue = 0.0;
    
    //update the raw value with physical value 
    if(getValue(E_pubc_GW_GW_3C2_HU_TollDis_SetVt)==0)
    {
        if(chgEv_GW_3C2_HU_TollDis == 0)
        {
            phyValue = getvalue(this);
            // physical to raw conversion
            rawValue = ((phyValue -(0))/10);
            putValue(E_pubc_GW_GW_3C2_HU_TollDis_Rv, rawValue);
            chgEv_GW_3C2_HU_TollDis = 1;  
        }
        else
        {
            chgEv_GW_3C2_HU_TollDis = 0;
        }
    }
}

on envVar E_pubc_GW_GW_3C2_HU_TollDis_Vt
{
    qword rawValue = 0ll;
    if(getValue(E_pubc_GW_GW_3C2_HU_TollDis_SetVt))
    {
        //update the signal value
        Msg_GW_3C2.HU_TollDis=getValue(this);
    }
}

on envVar E_pubc_GW_GW_3C2_HU_TollDis_SetVt
{
    if(getValue(E_pubc_GW_GW_3C2_HU_TollDis_SetVt))
    {
        //update the signal value
        Msg_GW_3C2.HU_TollDis=getvalue(E_pubc_GW_GW_3C2_HU_TollDis_Vt);
    }
    else
    {
        Msg_GW_3C2.HU_TollDis=getValue(E_pubc_GW_GW_3C2_HU_TollDis_Rv);
    }
}
 
on envVar E_pubc_GW_GW_3E7_tx
{
    if(getValue(this))
    {       
        

        output(Msg_GW_3E7);        
    }
}

on envVar E_pubc_GW_GW_3E7_Range
{
    qword rawstatus = 0ll;
    qword rawValue = 0ll;    
    
    rawstatus = getvalue(this);    
    // set all the signals with min raw /max raw /init raw
    switch (rawstatus) 
    {
     case(0) :
        rawValue= 0;
        putValue(E_pubc_GW_GW_3E7_BCM_Status_Temp_Rv, rawValue);
        rawValue= 0;
        putValue(E_pubc_GW_GW_3E7_BCM_T_BATT_Rv, rawValue);
        break;
     case(1) :
        rawValue= 3;
        putValue(E_pubc_GW_GW_3E7_BCM_Status_Temp_Rv, rawValue);
        rawValue= 145;
        putValue(E_pubc_GW_GW_3E7_BCM_T_BATT_Rv, rawValue);
        break;
     default :
        rawValue= 0;
        putValue(E_pubc_GW_GW_3E7_BCM_Status_Temp_Rv, rawValue);
        rawValue= 0;
        putValue(E_pubc_GW_GW_3E7_BCM_T_BATT_Rv, rawValue);
      break;
   }
}

on envVar E_pubc_GW_GW_3E7_Dlc
{
    if(getValue(E_pubc_GW_GW_3E7_enDlc))
    {
        Msg_GW_3E7.dlc =getValue(this);
    }
    else
    {
        Msg_GW_3E7.dlc =8;
    }
}

on envVar E_pubc_GW_GW_3E7_enDlc
{
    //For Messages with DLC = 8, set wrong DLC to smaller than defined DLC
    //For Messages with DLC < 8 set wrong DLC to smaller/longer than defined DLC
    if(getValue(this))
    {
        Msg_GW_3E7.dlc =getValue(E_pubc_GW_GW_3E7_Dlc);
    }
    else
    {
        Msg_GW_3E7.dlc =8;
    }
}


on envVar E_pubc_GW_GW_3E7_BCM_Status_Temp_Rv
{
    int64 rawValue = 0ll;
    float rawValue_float = 0.0;
    float phyValue = 0.0;        

    //set the signal with updated raw value
    if(getValue(E_pubc_GW_GW_3E7_BCM_Status_Temp_SetVt)==0)
    {
        rawValue = getvalue(this);
        if(chgEv_GW_3E7_BCM_Status_Temp == 0)
        {
            //type conversion to float
            rawValue_float = rawValue;        
            // raw to physical conversion
            phyValue = ((rawValue_float *1)+(0));
            putValue(E_pubc_GW_GW_3E7_BCM_Status_Temp_Pv, phyValue);
            chgEv_GW_3E7_BCM_Status_Temp = 1;
        }
        else
        {
            chgEv_GW_3E7_BCM_Status_Temp = 0;
        }    
        //update the signal value
        Msg_GW_3E7.BCM_Status_Temp=rawValue;        
    }                                                                           
}

on envVar E_pubc_GW_GW_3E7_BCM_Status_Temp_Pv
{
    int64 rawValue = 0ll;
    float phyValue = 0.0;
    
    //update the raw value with physical value 
    if(getValue(E_pubc_GW_GW_3E7_BCM_Status_Temp_SetVt)==0)
    {
        if(chgEv_GW_3E7_BCM_Status_Temp == 0)
        {
            phyValue = getvalue(this);
            // physical to raw conversion
            rawValue = ((phyValue -(0))/1);
            putValue(E_pubc_GW_GW_3E7_BCM_Status_Temp_Rv, rawValue);
            chgEv_GW_3E7_BCM_Status_Temp = 1;  
        }
        else
        {
            chgEv_GW_3E7_BCM_Status_Temp = 0;
        }
    }
}

on envVar E_pubc_GW_GW_3E7_BCM_Status_Temp_Vt
{
    qword rawValue = 0ll;
    if(getValue(E_pubc_GW_GW_3E7_BCM_Status_Temp_SetVt))
    {
        //update the signal value
        Msg_GW_3E7.BCM_Status_Temp=getValue(this);
    }
}

on envVar E_pubc_GW_GW_3E7_BCM_Status_Temp_SetVt
{
    if(getValue(E_pubc_GW_GW_3E7_BCM_Status_Temp_SetVt))
    {
        //update the signal value
        Msg_GW_3E7.BCM_Status_Temp=getvalue(E_pubc_GW_GW_3E7_BCM_Status_Temp_Vt);
    }
    else
    {
        Msg_GW_3E7.BCM_Status_Temp=getValue(E_pubc_GW_GW_3E7_BCM_Status_Temp_Rv);
    }
}
 
on envVar E_pubc_GW_GW_3E7_BCM_T_BATT_Rv
{
    int64 rawValue = 0ll;
    float rawValue_float = 0.0;
    float phyValue = 0.0;        

    //set the signal with updated raw value
    if(getValue(E_pubc_GW_GW_3E7_BCM_T_BATT_SetVt)==0)
    {
        rawValue = getvalue(this);
        if(chgEv_GW_3E7_BCM_T_BATT == 0)
        {
            //type conversion to float
            rawValue_float = rawValue;        
            // raw to physical conversion
            phyValue = ((rawValue_float *1)+(-40));
            putValue(E_pubc_GW_GW_3E7_BCM_T_BATT_Pv, phyValue);
            chgEv_GW_3E7_BCM_T_BATT = 1;
        }
        else
        {
            chgEv_GW_3E7_BCM_T_BATT = 0;
        }    
        //update the signal value
        Msg_GW_3E7.BCM_T_BATT=rawValue;        
    }                                                                           
}

on envVar E_pubc_GW_GW_3E7_BCM_T_BATT_Pv
{
    int64 rawValue = 0ll;
    float phyValue = 0.0;
    
    //update the raw value with physical value 
    if(getValue(E_pubc_GW_GW_3E7_BCM_T_BATT_SetVt)==0)
    {
        if(chgEv_GW_3E7_BCM_T_BATT == 0)
        {
            phyValue = getvalue(this);
            // physical to raw conversion
            rawValue = ((phyValue -(-40))/1);
            putValue(E_pubc_GW_GW_3E7_BCM_T_BATT_Rv, rawValue);
            chgEv_GW_3E7_BCM_T_BATT = 1;  
        }
        else
        {
            chgEv_GW_3E7_BCM_T_BATT = 0;
        }
    }
}

on envVar E_pubc_GW_GW_3E7_BCM_T_BATT_Vt
{
    qword rawValue = 0ll;
    if(getValue(E_pubc_GW_GW_3E7_BCM_T_BATT_SetVt))
    {
        //update the signal value
        Msg_GW_3E7.BCM_T_BATT=getValue(this);
    }
}

on envVar E_pubc_GW_GW_3E7_BCM_T_BATT_SetVt
{
    if(getValue(E_pubc_GW_GW_3E7_BCM_T_BATT_SetVt))
    {
        //update the signal value
        Msg_GW_3E7.BCM_T_BATT=getvalue(E_pubc_GW_GW_3E7_BCM_T_BATT_Vt);
    }
    else
    {
        Msg_GW_3E7.BCM_T_BATT=getValue(E_pubc_GW_GW_3E7_BCM_T_BATT_Rv);
    }
}
 
on envVar E_pubc_GW_GW_3E8_tx
{
    if(getValue(this))
    {       
        

        output(Msg_GW_3E8);        
    }
}

on envVar E_pubc_GW_GW_3E8_Range
{
    qword rawstatus = 0ll;
    qword rawValue = 0ll;    
    
    rawstatus = getvalue(this);    
    // set all the signals with min raw /max raw /init raw
    switch (rawstatus) 
    {
     case(0) :
        rawValue= 0;
        putValue(E_pubc_GW_GW_3E8_BCM_SOF_Q_STATE_Rv, rawValue);
        rawValue= 0;
        putValue(E_pubc_GW_GW_3E8_BCM_SOF_Q_Rv, rawValue);
        break;
     case(1) :
        rawValue= 3;
        putValue(E_pubc_GW_GW_3E8_BCM_SOF_Q_STATE_Rv, rawValue);
        rawValue= 254;
        putValue(E_pubc_GW_GW_3E8_BCM_SOF_Q_Rv, rawValue);
        break;
     default :
        rawValue= 0;
        putValue(E_pubc_GW_GW_3E8_BCM_SOF_Q_STATE_Rv, rawValue);
        rawValue= 0;
        putValue(E_pubc_GW_GW_3E8_BCM_SOF_Q_Rv, rawValue);
      break;
   }
}

on envVar E_pubc_GW_GW_3E8_Dlc
{
    if(getValue(E_pubc_GW_GW_3E8_enDlc))
    {
        Msg_GW_3E8.dlc =getValue(this);
    }
    else
    {
        Msg_GW_3E8.dlc =8;
    }
}

on envVar E_pubc_GW_GW_3E8_enDlc
{
    //For Messages with DLC = 8, set wrong DLC to smaller than defined DLC
    //For Messages with DLC < 8 set wrong DLC to smaller/longer than defined DLC
    if(getValue(this))
    {
        Msg_GW_3E8.dlc =getValue(E_pubc_GW_GW_3E8_Dlc);
    }
    else
    {
        Msg_GW_3E8.dlc =8;
    }
}


on envVar E_pubc_GW_GW_3E8_BCM_SOF_Q_STATE_Rv
{
    int64 rawValue = 0ll;
    float rawValue_float = 0.0;
    float phyValue = 0.0;        

    //set the signal with updated raw value
    if(getValue(E_pubc_GW_GW_3E8_BCM_SOF_Q_STATE_SetVt)==0)
    {
        rawValue = getvalue(this);
        if(chgEv_GW_3E8_BCM_SOF_Q_STATE == 0)
        {
            //type conversion to float
            rawValue_float = rawValue;        
            // raw to physical conversion
            phyValue = ((rawValue_float *1)+(0));
            putValue(E_pubc_GW_GW_3E8_BCM_SOF_Q_STATE_Pv, phyValue);
            chgEv_GW_3E8_BCM_SOF_Q_STATE = 1;
        }
        else
        {
            chgEv_GW_3E8_BCM_SOF_Q_STATE = 0;
        }    
        //update the signal value
        Msg_GW_3E8.BCM_SOF_Q_STATE=rawValue;        
    }                                                                           
}

on envVar E_pubc_GW_GW_3E8_BCM_SOF_Q_STATE_Pv
{
    int64 rawValue = 0ll;
    float phyValue = 0.0;
    
    //update the raw value with physical value 
    if(getValue(E_pubc_GW_GW_3E8_BCM_SOF_Q_STATE_SetVt)==0)
    {
        if(chgEv_GW_3E8_BCM_SOF_Q_STATE == 0)
        {
            phyValue = getvalue(this);
            // physical to raw conversion
            rawValue = ((phyValue -(0))/1);
            putValue(E_pubc_GW_GW_3E8_BCM_SOF_Q_STATE_Rv, rawValue);
            chgEv_GW_3E8_BCM_SOF_Q_STATE = 1;  
        }
        else
        {
            chgEv_GW_3E8_BCM_SOF_Q_STATE = 0;
        }
    }
}

on envVar E_pubc_GW_GW_3E8_BCM_SOF_Q_STATE_Vt
{
    qword rawValue = 0ll;
    if(getValue(E_pubc_GW_GW_3E8_BCM_SOF_Q_STATE_SetVt))
    {
        //update the signal value
        Msg_GW_3E8.BCM_SOF_Q_STATE=getValue(this);
    }
}

on envVar E_pubc_GW_GW_3E8_BCM_SOF_Q_STATE_SetVt
{
    if(getValue(E_pubc_GW_GW_3E8_BCM_SOF_Q_STATE_SetVt))
    {
        //update the signal value
        Msg_GW_3E8.BCM_SOF_Q_STATE=getvalue(E_pubc_GW_GW_3E8_BCM_SOF_Q_STATE_Vt);
    }
    else
    {
        Msg_GW_3E8.BCM_SOF_Q_STATE=getValue(E_pubc_GW_GW_3E8_BCM_SOF_Q_STATE_Rv);
    }
}
 
on envVar E_pubc_GW_GW_3E8_BCM_SOF_Q_Rv
{
    int64 rawValue = 0ll;
    float rawValue_float = 0.0;
    float phyValue = 0.0;        

    //set the signal with updated raw value
    if(getValue(E_pubc_GW_GW_3E8_BCM_SOF_Q_SetVt)==0)
    {
        rawValue = getvalue(this);
        if(chgEv_GW_3E8_BCM_SOF_Q == 0)
        {
            //type conversion to float
            rawValue_float = rawValue;        
            // raw to physical conversion
            phyValue = ((rawValue_float *0.5)+(0));
            putValue(E_pubc_GW_GW_3E8_BCM_SOF_Q_Pv, phyValue);
            chgEv_GW_3E8_BCM_SOF_Q = 1;
        }
        else
        {
            chgEv_GW_3E8_BCM_SOF_Q = 0;
        }    
        //update the signal value
        Msg_GW_3E8.BCM_SOF_Q=rawValue;        
    }                                                                           
}

on envVar E_pubc_GW_GW_3E8_BCM_SOF_Q_Pv
{
    int64 rawValue = 0ll;
    float phyValue = 0.0;
    
    //update the raw value with physical value 
    if(getValue(E_pubc_GW_GW_3E8_BCM_SOF_Q_SetVt)==0)
    {
        if(chgEv_GW_3E8_BCM_SOF_Q == 0)
        {
            phyValue = getvalue(this);
            // physical to raw conversion
            rawValue = ((phyValue -(0))/0.5);
            putValue(E_pubc_GW_GW_3E8_BCM_SOF_Q_Rv, rawValue);
            chgEv_GW_3E8_BCM_SOF_Q = 1;  
        }
        else
        {
            chgEv_GW_3E8_BCM_SOF_Q = 0;
        }
    }
}

on envVar E_pubc_GW_GW_3E8_BCM_SOF_Q_Vt
{
    qword rawValue = 0ll;
    if(getValue(E_pubc_GW_GW_3E8_BCM_SOF_Q_SetVt))
    {
        //update the signal value
        Msg_GW_3E8.BCM_SOF_Q=getValue(this);
    }
}

on envVar E_pubc_GW_GW_3E8_BCM_SOF_Q_SetVt
{
    if(getValue(E_pubc_GW_GW_3E8_BCM_SOF_Q_SetVt))
    {
        //update the signal value
        Msg_GW_3E8.BCM_SOF_Q=getvalue(E_pubc_GW_GW_3E8_BCM_SOF_Q_Vt);
    }
    else
    {
        Msg_GW_3E8.BCM_SOF_Q=getValue(E_pubc_GW_GW_3E8_BCM_SOF_Q_Rv);
    }
}
 
on envVar E_pubc_GW_GW_3AF_tx
{
    if(getValue(this))
    {       
        
        //update the BZ Signal
        if(GW_3AF_HU_RollingCounter_3AF_wrongvalctr == 0)
        {
            update_GW_3AF_HU_RollingCounter_3AF_counter();
            Msg_GW_3AF.HU_RollingCounter_3AF= GW_3AF_HU_RollingCounter_3AF_counter;
        }
        else if(GW_3AF_HU_RollingCounter_3AF_wrongvalctr > 0)
        {
             GW_3AF_HU_RollingCounter_3AF_wrongvalctr--;
              // if counter becomes zero, update panel controller to zero
             if(GW_3AF_HU_RollingCounter_3AF_wrongvalctr == 0)
             {
                 putValue(E_pubc_GW_GW_3AF_HU_RollingCounter_3AF_wrongvalctr,0);
             }
        }
        else
        {
            //do nothing
        }        
        //calculate the CRC CheckSum
        update_GW_3AF_CRC_CheckSum();

        output(Msg_GW_3AF);        
    }
}

on envVar E_pubc_GW_GW_3AF_Range
{
    qword rawstatus = 0ll;
    qword rawValue = 0ll;    
    
    rawstatus = getvalue(this);    
    // set all the signals with min raw /max raw /init raw
    switch (rawstatus) 
    {
     case(0) :
        rawValue= 0;
        putValue(E_pubc_GW_GW_3AF_HU_NavStatus_Rv, rawValue);
        rawValue= 0;
        putValue(E_pubc_GW_GW_3AF_HU_EnterCurveInfo_Rv, rawValue);
        rawValue= 0;
        putValue(E_pubc_GW_GW_3AF_HU_NavSpeedLimitType_Rv, rawValue);
        rawValue= 0;
        putValue(E_pubc_GW_GW_3AF_HU_NavCountryCode_Rv, rawValue);
        rawValue= 0;
        putValue(E_pubc_GW_GW_3AF_HU_NavSpeedLimit_Rv, rawValue);
        rawValue= 0;
        putValue(E_pubc_GW_GW_3AF_HU_NavSpeedLimitUnits_Rv, rawValue);
        rawValue= 0;
        putValue(E_pubc_GW_GW_3AF_HU_NavCurrentRoadType_Rv, rawValue);
        rawValue= 0;
        putValue(E_pubc_GW_GW_3AF_HU_CurveDistance_Rv, rawValue);
        rawValue= 0;
        putValue(E_pubc_GW_GW_3AF_HU_RampDistance_Rv, rawValue);
        rawValue= 0;
        putValue(E_pubc_GW_GW_3AF_HU_NavSpeedLimitStatus_Rv, rawValue);
        rawValue= 0;
        putValue(E_pubc_GW_GW_3AF_HU_RampInfo_Rv, rawValue);
        rawValue= 0;
        putValue(E_pubc_GW_GW_3AF_HU_EnterRampInfo_Rv, rawValue);
        break;
     case(1) :
        rawValue= 1;
        putValue(E_pubc_GW_GW_3AF_HU_NavStatus_Rv, rawValue);
        rawValue= 3;
        putValue(E_pubc_GW_GW_3AF_HU_EnterCurveInfo_Rv, rawValue);
        rawValue= 3;
        putValue(E_pubc_GW_GW_3AF_HU_NavSpeedLimitType_Rv, rawValue);
        rawValue= 255;
        putValue(E_pubc_GW_GW_3AF_HU_NavCountryCode_Rv, rawValue);
        rawValue= 255;
        putValue(E_pubc_GW_GW_3AF_HU_NavSpeedLimit_Rv, rawValue);
        rawValue= 3;
        putValue(E_pubc_GW_GW_3AF_HU_NavSpeedLimitUnits_Rv, rawValue);
        rawValue= 7;
        putValue(E_pubc_GW_GW_3AF_HU_NavCurrentRoadType_Rv, rawValue);
        rawValue= 60;
        putValue(E_pubc_GW_GW_3AF_HU_CurveDistance_Rv, rawValue);
        rawValue= 300;
        putValue(E_pubc_GW_GW_3AF_HU_RampDistance_Rv, rawValue);
        rawValue= 3;
        putValue(E_pubc_GW_GW_3AF_HU_NavSpeedLimitStatus_Rv, rawValue);
        rawValue= 3;
        putValue(E_pubc_GW_GW_3AF_HU_RampInfo_Rv, rawValue);
        rawValue= 3;
        putValue(E_pubc_GW_GW_3AF_HU_EnterRampInfo_Rv, rawValue);
        break;
     default :
        rawValue= 0;
        putValue(E_pubc_GW_GW_3AF_HU_NavStatus_Rv, rawValue);
        rawValue= 0;
        putValue(E_pubc_GW_GW_3AF_HU_EnterCurveInfo_Rv, rawValue);
        rawValue= 0;
        putValue(E_pubc_GW_GW_3AF_HU_NavSpeedLimitType_Rv, rawValue);
        rawValue= 0;
        putValue(E_pubc_GW_GW_3AF_HU_NavCountryCode_Rv, rawValue);
        rawValue= 0;
        putValue(E_pubc_GW_GW_3AF_HU_NavSpeedLimit_Rv, rawValue);
        rawValue= 0;
        putValue(E_pubc_GW_GW_3AF_HU_NavSpeedLimitUnits_Rv, rawValue);
        rawValue= 0;
        putValue(E_pubc_GW_GW_3AF_HU_NavCurrentRoadType_Rv, rawValue);
        rawValue= 0;
        putValue(E_pubc_GW_GW_3AF_HU_CurveDistance_Rv, rawValue);
        rawValue= 0;
        putValue(E_pubc_GW_GW_3AF_HU_RampDistance_Rv, rawValue);
        rawValue= 0;
        putValue(E_pubc_GW_GW_3AF_HU_NavSpeedLimitStatus_Rv, rawValue);
        rawValue= 0;
        putValue(E_pubc_GW_GW_3AF_HU_RampInfo_Rv, rawValue);
        rawValue= 0;
        putValue(E_pubc_GW_GW_3AF_HU_EnterRampInfo_Rv, rawValue);
      break;
   }
}

on envVar E_pubc_GW_GW_3AF_Dlc
{
    if(getValue(E_pubc_GW_GW_3AF_enDlc))
    {
        Msg_GW_3AF.dlc =getValue(this);
    }
    else
    {
        Msg_GW_3AF.dlc =8;
    }
}

on envVar E_pubc_GW_GW_3AF_enDlc
{
    //For Messages with DLC = 8, set wrong DLC to smaller than defined DLC
    //For Messages with DLC < 8 set wrong DLC to smaller/longer than defined DLC
    if(getValue(this))
    {
        Msg_GW_3AF.dlc =getValue(E_pubc_GW_GW_3AF_Dlc);
    }
    else
    {
        Msg_GW_3AF.dlc =8;
    }
}

on envVar E_pubc_GW_GW_3AF_HU_CRCCheck_3AF_wrongvalctr
{
    //update disturb count
    //disturb value range:(-1 = always send wrong value),( X>0 ,x is the number of Messages with wrong CHK sent)
    GW_3AF_HU_CRCCheck_3AF_wrongvalctr =getValue(this);    
}
on envVar E_pubc_GW_GW_3AF_HU_RollingCounter_3AF_wrongvalctr
{
    //update disturb count
    //disturb value range:(-1 = always send wrong value),( X>0 ,x is the number of Messages with wrong CHK sent)
    GW_3AF_HU_RollingCounter_3AF_wrongvalctr =getValue(this);    
}

on envVar E_pubc_GW_GW_3AF_HU_NavStatus_Rv
{
    int64 rawValue = 0ll;
    float rawValue_float = 0.0;
    float phyValue = 0.0;        

    //set the signal with updated raw value
    if(getValue(E_pubc_GW_GW_3AF_HU_NavStatus_SetVt)==0)
    {
        rawValue = getvalue(this);
        if(chgEv_GW_3AF_HU_NavStatus == 0)
        {
            //type conversion to float
            rawValue_float = rawValue;        
            // raw to physical conversion
            phyValue = ((rawValue_float *1)+(0));
            putValue(E_pubc_GW_GW_3AF_HU_NavStatus_Pv, phyValue);
            chgEv_GW_3AF_HU_NavStatus = 1;
        }
        else
        {
            chgEv_GW_3AF_HU_NavStatus = 0;
        }    
        //update the signal value
        Msg_GW_3AF.HU_NavStatus=rawValue;        
    }                                                                           
}

on envVar E_pubc_GW_GW_3AF_HU_NavStatus_Pv
{
    int64 rawValue = 0ll;
    float phyValue = 0.0;
    
    //update the raw value with physical value 
    if(getValue(E_pubc_GW_GW_3AF_HU_NavStatus_SetVt)==0)
    {
        if(chgEv_GW_3AF_HU_NavStatus == 0)
        {
            phyValue = getvalue(this);
            // physical to raw conversion
            rawValue = ((phyValue -(0))/1);
            putValue(E_pubc_GW_GW_3AF_HU_NavStatus_Rv, rawValue);
            chgEv_GW_3AF_HU_NavStatus = 1;  
        }
        else
        {
            chgEv_GW_3AF_HU_NavStatus = 0;
        }
    }
}

on envVar E_pubc_GW_GW_3AF_HU_NavStatus_Vt
{
    qword rawValue = 0ll;
    if(getValue(E_pubc_GW_GW_3AF_HU_NavStatus_SetVt))
    {
        //update the signal value
        Msg_GW_3AF.HU_NavStatus=getValue(this);
    }
}

on envVar E_pubc_GW_GW_3AF_HU_NavStatus_SetVt
{
    if(getValue(E_pubc_GW_GW_3AF_HU_NavStatus_SetVt))
    {
        //update the signal value
        Msg_GW_3AF.HU_NavStatus=getvalue(E_pubc_GW_GW_3AF_HU_NavStatus_Vt);
    }
    else
    {
        Msg_GW_3AF.HU_NavStatus=getValue(E_pubc_GW_GW_3AF_HU_NavStatus_Rv);
    }
}
 
on envVar E_pubc_GW_GW_3AF_HU_EnterCurveInfo_Rv
{
    int64 rawValue = 0ll;
    float rawValue_float = 0.0;
    float phyValue = 0.0;        

    //set the signal with updated raw value
    if(getValue(E_pubc_GW_GW_3AF_HU_EnterCurveInfo_SetVt)==0)
    {
        rawValue = getvalue(this);
        if(chgEv_GW_3AF_HU_EnterCurveInfo == 0)
        {
            //type conversion to float
            rawValue_float = rawValue;        
            // raw to physical conversion
            phyValue = ((rawValue_float *1)+(0));
            putValue(E_pubc_GW_GW_3AF_HU_EnterCurveInfo_Pv, phyValue);
            chgEv_GW_3AF_HU_EnterCurveInfo = 1;
        }
        else
        {
            chgEv_GW_3AF_HU_EnterCurveInfo = 0;
        }    
        //update the signal value
        Msg_GW_3AF.HU_EnterCurveInfo=rawValue;        
    }                                                                           
}

on envVar E_pubc_GW_GW_3AF_HU_EnterCurveInfo_Pv
{
    int64 rawValue = 0ll;
    float phyValue = 0.0;
    
    //update the raw value with physical value 
    if(getValue(E_pubc_GW_GW_3AF_HU_EnterCurveInfo_SetVt)==0)
    {
        if(chgEv_GW_3AF_HU_EnterCurveInfo == 0)
        {
            phyValue = getvalue(this);
            // physical to raw conversion
            rawValue = ((phyValue -(0))/1);
            putValue(E_pubc_GW_GW_3AF_HU_EnterCurveInfo_Rv, rawValue);
            chgEv_GW_3AF_HU_EnterCurveInfo = 1;  
        }
        else
        {
            chgEv_GW_3AF_HU_EnterCurveInfo = 0;
        }
    }
}

on envVar E_pubc_GW_GW_3AF_HU_EnterCurveInfo_Vt
{
    qword rawValue = 0ll;
    if(getValue(E_pubc_GW_GW_3AF_HU_EnterCurveInfo_SetVt))
    {
        //update the signal value
        Msg_GW_3AF.HU_EnterCurveInfo=getValue(this);
    }
}

on envVar E_pubc_GW_GW_3AF_HU_EnterCurveInfo_SetVt
{
    if(getValue(E_pubc_GW_GW_3AF_HU_EnterCurveInfo_SetVt))
    {
        //update the signal value
        Msg_GW_3AF.HU_EnterCurveInfo=getvalue(E_pubc_GW_GW_3AF_HU_EnterCurveInfo_Vt);
    }
    else
    {
        Msg_GW_3AF.HU_EnterCurveInfo=getValue(E_pubc_GW_GW_3AF_HU_EnterCurveInfo_Rv);
    }
}
 
on envVar E_pubc_GW_GW_3AF_HU_NavSpeedLimitType_Rv
{
    int64 rawValue = 0ll;
    float rawValue_float = 0.0;
    float phyValue = 0.0;        

    //set the signal with updated raw value
    if(getValue(E_pubc_GW_GW_3AF_HU_NavSpeedLimitType_SetVt)==0)
    {
        rawValue = getvalue(this);
        if(chgEv_GW_3AF_HU_NavSpeedLimitType == 0)
        {
            //type conversion to float
            rawValue_float = rawValue;        
            // raw to physical conversion
            phyValue = ((rawValue_float *1)+(0));
            putValue(E_pubc_GW_GW_3AF_HU_NavSpeedLimitType_Pv, phyValue);
            chgEv_GW_3AF_HU_NavSpeedLimitType = 1;
        }
        else
        {
            chgEv_GW_3AF_HU_NavSpeedLimitType = 0;
        }    
        //update the signal value
        Msg_GW_3AF.HU_NavSpeedLimitType=rawValue;        
    }                                                                           
}

on envVar E_pubc_GW_GW_3AF_HU_NavSpeedLimitType_Pv
{
    int64 rawValue = 0ll;
    float phyValue = 0.0;
    
    //update the raw value with physical value 
    if(getValue(E_pubc_GW_GW_3AF_HU_NavSpeedLimitType_SetVt)==0)
    {
        if(chgEv_GW_3AF_HU_NavSpeedLimitType == 0)
        {
            phyValue = getvalue(this);
            // physical to raw conversion
            rawValue = ((phyValue -(0))/1);
            putValue(E_pubc_GW_GW_3AF_HU_NavSpeedLimitType_Rv, rawValue);
            chgEv_GW_3AF_HU_NavSpeedLimitType = 1;  
        }
        else
        {
            chgEv_GW_3AF_HU_NavSpeedLimitType = 0;
        }
    }
}

on envVar E_pubc_GW_GW_3AF_HU_NavSpeedLimitType_Vt
{
    qword rawValue = 0ll;
    if(getValue(E_pubc_GW_GW_3AF_HU_NavSpeedLimitType_SetVt))
    {
        //update the signal value
        Msg_GW_3AF.HU_NavSpeedLimitType=getValue(this);
    }
}

on envVar E_pubc_GW_GW_3AF_HU_NavSpeedLimitType_SetVt
{
    if(getValue(E_pubc_GW_GW_3AF_HU_NavSpeedLimitType_SetVt))
    {
        //update the signal value
        Msg_GW_3AF.HU_NavSpeedLimitType=getvalue(E_pubc_GW_GW_3AF_HU_NavSpeedLimitType_Vt);
    }
    else
    {
        Msg_GW_3AF.HU_NavSpeedLimitType=getValue(E_pubc_GW_GW_3AF_HU_NavSpeedLimitType_Rv);
    }
}
 
on envVar E_pubc_GW_GW_3AF_HU_NavCountryCode_Rv
{
    int64 rawValue = 0ll;
    float rawValue_float = 0.0;
    float phyValue = 0.0;        

    //set the signal with updated raw value
    {
        rawValue = getvalue(this);
        if(chgEv_GW_3AF_HU_NavCountryCode == 0)
        {
            //type conversion to float
            rawValue_float = rawValue;        
            // raw to physical conversion
            phyValue = ((rawValue_float *1)+(0));
            putValue(E_pubc_GW_GW_3AF_HU_NavCountryCode_Pv, phyValue);
            chgEv_GW_3AF_HU_NavCountryCode = 1;
        }
        else
        {
            chgEv_GW_3AF_HU_NavCountryCode = 0;
        }    
        //update the signal value
        Msg_GW_3AF.HU_NavCountryCode=rawValue;        
    }                                                                           
}

on envVar E_pubc_GW_GW_3AF_HU_NavCountryCode_Pv
{
    int64 rawValue = 0ll;
    float phyValue = 0.0;
    
    //update the raw value with physical value 
    {
        if(chgEv_GW_3AF_HU_NavCountryCode == 0)
        {
            phyValue = getvalue(this);
            // physical to raw conversion
            rawValue = ((phyValue -(0))/1);
            putValue(E_pubc_GW_GW_3AF_HU_NavCountryCode_Rv, rawValue);
            chgEv_GW_3AF_HU_NavCountryCode = 1;  
        }
        else
        {
            chgEv_GW_3AF_HU_NavCountryCode = 0;
        }
    }
}


 
on envVar E_pubc_GW_GW_3AF_HU_NavSpeedLimit_Rv
{
    int64 rawValue = 0ll;
    float rawValue_float = 0.0;
    float phyValue = 0.0;        

    //set the signal with updated raw value
    if(getValue(E_pubc_GW_GW_3AF_HU_NavSpeedLimit_SetVt)==0)
    {
        rawValue = getvalue(this);
        if(chgEv_GW_3AF_HU_NavSpeedLimit == 0)
        {
            //type conversion to float
            rawValue_float = rawValue;        
            // raw to physical conversion
            phyValue = ((rawValue_float *1)+(0));
            putValue(E_pubc_GW_GW_3AF_HU_NavSpeedLimit_Pv, phyValue);
            chgEv_GW_3AF_HU_NavSpeedLimit = 1;
        }
        else
        {
            chgEv_GW_3AF_HU_NavSpeedLimit = 0;
        }    
        //update the signal value
        Msg_GW_3AF.HU_NavSpeedLimit=rawValue;        
    }                                                                           
}

on envVar E_pubc_GW_GW_3AF_HU_NavSpeedLimit_Pv
{
    int64 rawValue = 0ll;
    float phyValue = 0.0;
    
    //update the raw value with physical value 
    if(getValue(E_pubc_GW_GW_3AF_HU_NavSpeedLimit_SetVt)==0)
    {
        if(chgEv_GW_3AF_HU_NavSpeedLimit == 0)
        {
            phyValue = getvalue(this);
            // physical to raw conversion
            rawValue = ((phyValue -(0))/1);
            putValue(E_pubc_GW_GW_3AF_HU_NavSpeedLimit_Rv, rawValue);
            chgEv_GW_3AF_HU_NavSpeedLimit = 1;  
        }
        else
        {
            chgEv_GW_3AF_HU_NavSpeedLimit = 0;
        }
    }
}

on envVar E_pubc_GW_GW_3AF_HU_NavSpeedLimit_Vt
{
    qword rawValue = 0ll;
    if(getValue(E_pubc_GW_GW_3AF_HU_NavSpeedLimit_SetVt))
    {
        //update the signal value
        Msg_GW_3AF.HU_NavSpeedLimit=getValue(this);
    }
}

on envVar E_pubc_GW_GW_3AF_HU_NavSpeedLimit_SetVt
{
    if(getValue(E_pubc_GW_GW_3AF_HU_NavSpeedLimit_SetVt))
    {
        //update the signal value
        Msg_GW_3AF.HU_NavSpeedLimit=getvalue(E_pubc_GW_GW_3AF_HU_NavSpeedLimit_Vt);
    }
    else
    {
        Msg_GW_3AF.HU_NavSpeedLimit=getValue(E_pubc_GW_GW_3AF_HU_NavSpeedLimit_Rv);
    }
}
 
on envVar E_pubc_GW_GW_3AF_HU_NavSpeedLimitUnits_Rv
{
    int64 rawValue = 0ll;
    float rawValue_float = 0.0;
    float phyValue = 0.0;        

    //set the signal with updated raw value
    if(getValue(E_pubc_GW_GW_3AF_HU_NavSpeedLimitUnits_SetVt)==0)
    {
        rawValue = getvalue(this);
        if(chgEv_GW_3AF_HU_NavSpeedLimitUnits == 0)
        {
            //type conversion to float
            rawValue_float = rawValue;        
            // raw to physical conversion
            phyValue = ((rawValue_float *1)+(0));
            putValue(E_pubc_GW_GW_3AF_HU_NavSpeedLimitUnits_Pv, phyValue);
            chgEv_GW_3AF_HU_NavSpeedLimitUnits = 1;
        }
        else
        {
            chgEv_GW_3AF_HU_NavSpeedLimitUnits = 0;
        }    
        //update the signal value
        Msg_GW_3AF.HU_NavSpeedLimitUnits=rawValue;        
    }                                                                           
}

on envVar E_pubc_GW_GW_3AF_HU_NavSpeedLimitUnits_Pv
{
    int64 rawValue = 0ll;
    float phyValue = 0.0;
    
    //update the raw value with physical value 
    if(getValue(E_pubc_GW_GW_3AF_HU_NavSpeedLimitUnits_SetVt)==0)
    {
        if(chgEv_GW_3AF_HU_NavSpeedLimitUnits == 0)
        {
            phyValue = getvalue(this);
            // physical to raw conversion
            rawValue = ((phyValue -(0))/1);
            putValue(E_pubc_GW_GW_3AF_HU_NavSpeedLimitUnits_Rv, rawValue);
            chgEv_GW_3AF_HU_NavSpeedLimitUnits = 1;  
        }
        else
        {
            chgEv_GW_3AF_HU_NavSpeedLimitUnits = 0;
        }
    }
}

on envVar E_pubc_GW_GW_3AF_HU_NavSpeedLimitUnits_Vt
{
    qword rawValue = 0ll;
    if(getValue(E_pubc_GW_GW_3AF_HU_NavSpeedLimitUnits_SetVt))
    {
        //update the signal value
        Msg_GW_3AF.HU_NavSpeedLimitUnits=getValue(this);
    }
}

on envVar E_pubc_GW_GW_3AF_HU_NavSpeedLimitUnits_SetVt
{
    if(getValue(E_pubc_GW_GW_3AF_HU_NavSpeedLimitUnits_SetVt))
    {
        //update the signal value
        Msg_GW_3AF.HU_NavSpeedLimitUnits=getvalue(E_pubc_GW_GW_3AF_HU_NavSpeedLimitUnits_Vt);
    }
    else
    {
        Msg_GW_3AF.HU_NavSpeedLimitUnits=getValue(E_pubc_GW_GW_3AF_HU_NavSpeedLimitUnits_Rv);
    }
}
 
on envVar E_pubc_GW_GW_3AF_HU_NavCurrentRoadType_Rv
{
    int64 rawValue = 0ll;
    float rawValue_float = 0.0;
    float phyValue = 0.0;        

    //set the signal with updated raw value
    if(getValue(E_pubc_GW_GW_3AF_HU_NavCurrentRoadType_SetVt)==0)
    {
        rawValue = getvalue(this);
        if(chgEv_GW_3AF_HU_NavCurrentRoadType == 0)
        {
            //type conversion to float
            rawValue_float = rawValue;        
            // raw to physical conversion
            phyValue = ((rawValue_float *1)+(0));
            putValue(E_pubc_GW_GW_3AF_HU_NavCurrentRoadType_Pv, phyValue);
            chgEv_GW_3AF_HU_NavCurrentRoadType = 1;
        }
        else
        {
            chgEv_GW_3AF_HU_NavCurrentRoadType = 0;
        }    
        //update the signal value
        Msg_GW_3AF.HU_NavCurrentRoadType=rawValue;        
    }                                                                           
}

on envVar E_pubc_GW_GW_3AF_HU_NavCurrentRoadType_Pv
{
    int64 rawValue = 0ll;
    float phyValue = 0.0;
    
    //update the raw value with physical value 
    if(getValue(E_pubc_GW_GW_3AF_HU_NavCurrentRoadType_SetVt)==0)
    {
        if(chgEv_GW_3AF_HU_NavCurrentRoadType == 0)
        {
            phyValue = getvalue(this);
            // physical to raw conversion
            rawValue = ((phyValue -(0))/1);
            putValue(E_pubc_GW_GW_3AF_HU_NavCurrentRoadType_Rv, rawValue);
            chgEv_GW_3AF_HU_NavCurrentRoadType = 1;  
        }
        else
        {
            chgEv_GW_3AF_HU_NavCurrentRoadType = 0;
        }
    }
}

on envVar E_pubc_GW_GW_3AF_HU_NavCurrentRoadType_Vt
{
    qword rawValue = 0ll;
    if(getValue(E_pubc_GW_GW_3AF_HU_NavCurrentRoadType_SetVt))
    {
        //update the signal value
        Msg_GW_3AF.HU_NavCurrentRoadType=getValue(this);
    }
}

on envVar E_pubc_GW_GW_3AF_HU_NavCurrentRoadType_SetVt
{
    if(getValue(E_pubc_GW_GW_3AF_HU_NavCurrentRoadType_SetVt))
    {
        //update the signal value
        Msg_GW_3AF.HU_NavCurrentRoadType=getvalue(E_pubc_GW_GW_3AF_HU_NavCurrentRoadType_Vt);
    }
    else
    {
        Msg_GW_3AF.HU_NavCurrentRoadType=getValue(E_pubc_GW_GW_3AF_HU_NavCurrentRoadType_Rv);
    }
}
 
on envVar E_pubc_GW_GW_3AF_HU_CurveDistance_Rv
{
    int64 rawValue = 0ll;
    float rawValue_float = 0.0;
    float phyValue = 0.0;        

    //set the signal with updated raw value
    if(getValue(E_pubc_GW_GW_3AF_HU_CurveDistance_SetVt)==0)
    {
        rawValue = getvalue(this);
        if(chgEv_GW_3AF_HU_CurveDistance == 0)
        {
            //type conversion to float
            rawValue_float = rawValue;        
            // raw to physical conversion
            phyValue = ((rawValue_float *10)+(0));
            putValue(E_pubc_GW_GW_3AF_HU_CurveDistance_Pv, phyValue);
            chgEv_GW_3AF_HU_CurveDistance = 1;
        }
        else
        {
            chgEv_GW_3AF_HU_CurveDistance = 0;
        }    
        //update the signal value
        Msg_GW_3AF.HU_CurveDistance=rawValue;        
    }                                                                           
}

on envVar E_pubc_GW_GW_3AF_HU_CurveDistance_Pv
{
    int64 rawValue = 0ll;
    float phyValue = 0.0;
    
    //update the raw value with physical value 
    if(getValue(E_pubc_GW_GW_3AF_HU_CurveDistance_SetVt)==0)
    {
        if(chgEv_GW_3AF_HU_CurveDistance == 0)
        {
            phyValue = getvalue(this);
            // physical to raw conversion
            rawValue = ((phyValue -(0))/10);
            putValue(E_pubc_GW_GW_3AF_HU_CurveDistance_Rv, rawValue);
            chgEv_GW_3AF_HU_CurveDistance = 1;  
        }
        else
        {
            chgEv_GW_3AF_HU_CurveDistance = 0;
        }
    }
}

on envVar E_pubc_GW_GW_3AF_HU_CurveDistance_Vt
{
    qword rawValue = 0ll;
    if(getValue(E_pubc_GW_GW_3AF_HU_CurveDistance_SetVt))
    {
        //update the signal value
        Msg_GW_3AF.HU_CurveDistance=getValue(this);
    }
}

on envVar E_pubc_GW_GW_3AF_HU_CurveDistance_SetVt
{
    if(getValue(E_pubc_GW_GW_3AF_HU_CurveDistance_SetVt))
    {
        //update the signal value
        Msg_GW_3AF.HU_CurveDistance=getvalue(E_pubc_GW_GW_3AF_HU_CurveDistance_Vt);
    }
    else
    {
        Msg_GW_3AF.HU_CurveDistance=getValue(E_pubc_GW_GW_3AF_HU_CurveDistance_Rv);
    }
}
 
on envVar E_pubc_GW_GW_3AF_HU_RampDistance_Rv
{
    int64 rawValue = 0ll;
    float rawValue_float = 0.0;
    float phyValue = 0.0;        

    //set the signal with updated raw value
    if(getValue(E_pubc_GW_GW_3AF_HU_RampDistance_SetVt)==0)
    {
        rawValue = getvalue(this);
        if(chgEv_GW_3AF_HU_RampDistance == 0)
        {
            //type conversion to float
            rawValue_float = rawValue;        
            // raw to physical conversion
            phyValue = ((rawValue_float *10)+(0));
            putValue(E_pubc_GW_GW_3AF_HU_RampDistance_Pv, phyValue);
            chgEv_GW_3AF_HU_RampDistance = 1;
        }
        else
        {
            chgEv_GW_3AF_HU_RampDistance = 0;
        }    
        //update the signal value
        Msg_GW_3AF.HU_RampDistance=rawValue;        
    }                                                                           
}

on envVar E_pubc_GW_GW_3AF_HU_RampDistance_Pv
{
    int64 rawValue = 0ll;
    float phyValue = 0.0;
    
    //update the raw value with physical value 
    if(getValue(E_pubc_GW_GW_3AF_HU_RampDistance_SetVt)==0)
    {
        if(chgEv_GW_3AF_HU_RampDistance == 0)
        {
            phyValue = getvalue(this);
            // physical to raw conversion
            rawValue = ((phyValue -(0))/10);
            putValue(E_pubc_GW_GW_3AF_HU_RampDistance_Rv, rawValue);
            chgEv_GW_3AF_HU_RampDistance = 1;  
        }
        else
        {
            chgEv_GW_3AF_HU_RampDistance = 0;
        }
    }
}

on envVar E_pubc_GW_GW_3AF_HU_RampDistance_Vt
{
    qword rawValue = 0ll;
    if(getValue(E_pubc_GW_GW_3AF_HU_RampDistance_SetVt))
    {
        //update the signal value
        Msg_GW_3AF.HU_RampDistance=getValue(this);
    }
}

on envVar E_pubc_GW_GW_3AF_HU_RampDistance_SetVt
{
    if(getValue(E_pubc_GW_GW_3AF_HU_RampDistance_SetVt))
    {
        //update the signal value
        Msg_GW_3AF.HU_RampDistance=getvalue(E_pubc_GW_GW_3AF_HU_RampDistance_Vt);
    }
    else
    {
        Msg_GW_3AF.HU_RampDistance=getValue(E_pubc_GW_GW_3AF_HU_RampDistance_Rv);
    }
}
 
on envVar E_pubc_GW_GW_3AF_HU_NavSpeedLimitStatus_Rv
{
    int64 rawValue = 0ll;
    float rawValue_float = 0.0;
    float phyValue = 0.0;        

    //set the signal with updated raw value
    if(getValue(E_pubc_GW_GW_3AF_HU_NavSpeedLimitStatus_SetVt)==0)
    {
        rawValue = getvalue(this);
        if(chgEv_GW_3AF_HU_NavSpeedLimitStatus == 0)
        {
            //type conversion to float
            rawValue_float = rawValue;        
            // raw to physical conversion
            phyValue = ((rawValue_float *1)+(0));
            putValue(E_pubc_GW_GW_3AF_HU_NavSpeedLimitStatus_Pv, phyValue);
            chgEv_GW_3AF_HU_NavSpeedLimitStatus = 1;
        }
        else
        {
            chgEv_GW_3AF_HU_NavSpeedLimitStatus = 0;
        }    
        //update the signal value
        Msg_GW_3AF.HU_NavSpeedLimitStatus=rawValue;        
    }                                                                           
}

on envVar E_pubc_GW_GW_3AF_HU_NavSpeedLimitStatus_Pv
{
    int64 rawValue = 0ll;
    float phyValue = 0.0;
    
    //update the raw value with physical value 
    if(getValue(E_pubc_GW_GW_3AF_HU_NavSpeedLimitStatus_SetVt)==0)
    {
        if(chgEv_GW_3AF_HU_NavSpeedLimitStatus == 0)
        {
            phyValue = getvalue(this);
            // physical to raw conversion
            rawValue = ((phyValue -(0))/1);
            putValue(E_pubc_GW_GW_3AF_HU_NavSpeedLimitStatus_Rv, rawValue);
            chgEv_GW_3AF_HU_NavSpeedLimitStatus = 1;  
        }
        else
        {
            chgEv_GW_3AF_HU_NavSpeedLimitStatus = 0;
        }
    }
}

on envVar E_pubc_GW_GW_3AF_HU_NavSpeedLimitStatus_Vt
{
    qword rawValue = 0ll;
    if(getValue(E_pubc_GW_GW_3AF_HU_NavSpeedLimitStatus_SetVt))
    {
        //update the signal value
        Msg_GW_3AF.HU_NavSpeedLimitStatus=getValue(this);
    }
}

on envVar E_pubc_GW_GW_3AF_HU_NavSpeedLimitStatus_SetVt
{
    if(getValue(E_pubc_GW_GW_3AF_HU_NavSpeedLimitStatus_SetVt))
    {
        //update the signal value
        Msg_GW_3AF.HU_NavSpeedLimitStatus=getvalue(E_pubc_GW_GW_3AF_HU_NavSpeedLimitStatus_Vt);
    }
    else
    {
        Msg_GW_3AF.HU_NavSpeedLimitStatus=getValue(E_pubc_GW_GW_3AF_HU_NavSpeedLimitStatus_Rv);
    }
}
 
on envVar E_pubc_GW_GW_3AF_HU_RampInfo_Rv
{
    int64 rawValue = 0ll;
    float rawValue_float = 0.0;
    float phyValue = 0.0;        

    //set the signal with updated raw value
    if(getValue(E_pubc_GW_GW_3AF_HU_RampInfo_SetVt)==0)
    {
        rawValue = getvalue(this);
        if(chgEv_GW_3AF_HU_RampInfo == 0)
        {
            //type conversion to float
            rawValue_float = rawValue;        
            // raw to physical conversion
            phyValue = ((rawValue_float *1)+(0));
            putValue(E_pubc_GW_GW_3AF_HU_RampInfo_Pv, phyValue);
            chgEv_GW_3AF_HU_RampInfo = 1;
        }
        else
        {
            chgEv_GW_3AF_HU_RampInfo = 0;
        }    
        //update the signal value
        Msg_GW_3AF.HU_RampInfo=rawValue;        
    }                                                                           
}

on envVar E_pubc_GW_GW_3AF_HU_RampInfo_Pv
{
    int64 rawValue = 0ll;
    float phyValue = 0.0;
    
    //update the raw value with physical value 
    if(getValue(E_pubc_GW_GW_3AF_HU_RampInfo_SetVt)==0)
    {
        if(chgEv_GW_3AF_HU_RampInfo == 0)
        {
            phyValue = getvalue(this);
            // physical to raw conversion
            rawValue = ((phyValue -(0))/1);
            putValue(E_pubc_GW_GW_3AF_HU_RampInfo_Rv, rawValue);
            chgEv_GW_3AF_HU_RampInfo = 1;  
        }
        else
        {
            chgEv_GW_3AF_HU_RampInfo = 0;
        }
    }
}

on envVar E_pubc_GW_GW_3AF_HU_RampInfo_Vt
{
    qword rawValue = 0ll;
    if(getValue(E_pubc_GW_GW_3AF_HU_RampInfo_SetVt))
    {
        //update the signal value
        Msg_GW_3AF.HU_RampInfo=getValue(this);
    }
}

on envVar E_pubc_GW_GW_3AF_HU_RampInfo_SetVt
{
    if(getValue(E_pubc_GW_GW_3AF_HU_RampInfo_SetVt))
    {
        //update the signal value
        Msg_GW_3AF.HU_RampInfo=getvalue(E_pubc_GW_GW_3AF_HU_RampInfo_Vt);
    }
    else
    {
        Msg_GW_3AF.HU_RampInfo=getValue(E_pubc_GW_GW_3AF_HU_RampInfo_Rv);
    }
}
 
on envVar E_pubc_GW_GW_3AF_HU_EnterRampInfo_Rv
{
    int64 rawValue = 0ll;
    float rawValue_float = 0.0;
    float phyValue = 0.0;        

    //set the signal with updated raw value
    if(getValue(E_pubc_GW_GW_3AF_HU_EnterRampInfo_SetVt)==0)
    {
        rawValue = getvalue(this);
        if(chgEv_GW_3AF_HU_EnterRampInfo == 0)
        {
            //type conversion to float
            rawValue_float = rawValue;        
            // raw to physical conversion
            phyValue = ((rawValue_float *1)+(0));
            putValue(E_pubc_GW_GW_3AF_HU_EnterRampInfo_Pv, phyValue);
            chgEv_GW_3AF_HU_EnterRampInfo = 1;
        }
        else
        {
            chgEv_GW_3AF_HU_EnterRampInfo = 0;
        }    
        //update the signal value
        Msg_GW_3AF.HU_EnterRampInfo=rawValue;        
    }                                                                           
}

on envVar E_pubc_GW_GW_3AF_HU_EnterRampInfo_Pv
{
    int64 rawValue = 0ll;
    float phyValue = 0.0;
    
    //update the raw value with physical value 
    if(getValue(E_pubc_GW_GW_3AF_HU_EnterRampInfo_SetVt)==0)
    {
        if(chgEv_GW_3AF_HU_EnterRampInfo == 0)
        {
            phyValue = getvalue(this);
            // physical to raw conversion
            rawValue = ((phyValue -(0))/1);
            putValue(E_pubc_GW_GW_3AF_HU_EnterRampInfo_Rv, rawValue);
            chgEv_GW_3AF_HU_EnterRampInfo = 1;  
        }
        else
        {
            chgEv_GW_3AF_HU_EnterRampInfo = 0;
        }
    }
}

on envVar E_pubc_GW_GW_3AF_HU_EnterRampInfo_Vt
{
    qword rawValue = 0ll;
    if(getValue(E_pubc_GW_GW_3AF_HU_EnterRampInfo_SetVt))
    {
        //update the signal value
        Msg_GW_3AF.HU_EnterRampInfo=getValue(this);
    }
}

on envVar E_pubc_GW_GW_3AF_HU_EnterRampInfo_SetVt
{
    if(getValue(E_pubc_GW_GW_3AF_HU_EnterRampInfo_SetVt))
    {
        //update the signal value
        Msg_GW_3AF.HU_EnterRampInfo=getvalue(E_pubc_GW_GW_3AF_HU_EnterRampInfo_Vt);
    }
    else
    {
        Msg_GW_3AF.HU_EnterRampInfo=getValue(E_pubc_GW_GW_3AF_HU_EnterRampInfo_Rv);
    }
}
 
on envVar E_pubc_GW_GW_1A6_tx
{
    if(getValue(this))
    {       
        
        //update the BZ Signal
        if(GW_1A6_EMS_RollingCounter_1A6_wrongvalctr == 0)
        {
            update_GW_1A6_EMS_RollingCounter_1A6_counter();
            Msg_GW_1A6.EMS_RollingCounter_1A6= GW_1A6_EMS_RollingCounter_1A6_counter;
        }
        else if(GW_1A6_EMS_RollingCounter_1A6_wrongvalctr > 0)
        {
             GW_1A6_EMS_RollingCounter_1A6_wrongvalctr--;
              // if counter becomes zero, update panel controller to zero
             if(GW_1A6_EMS_RollingCounter_1A6_wrongvalctr == 0)
             {
                 putValue(E_pubc_GW_GW_1A6_EMS_RollingCounter_1A6_wrongvalctr,0);
             }
        }
        else
        {
            //do nothing
        }        
        //calculate the CRC CheckSum
        update_GW_1A6_CRC_CheckSum();

        output(Msg_GW_1A6);        
    }
}

on envVar E_pubc_GW_GW_1A6_Range
{
    qword rawstatus = 0ll;
    qword rawValue = 0ll;    
    
    rawstatus = getvalue(this);    
    // set all the signals with min raw /max raw /init raw
    switch (rawstatus) 
    {
     case(0) :
        rawValue= 0;
        putValue(E_pubc_GW_GW_1A6_EMS_EngineStatus_Rv, rawValue);
        break;
     case(1) :
        rawValue= 3;
        putValue(E_pubc_GW_GW_1A6_EMS_EngineStatus_Rv, rawValue);
        break;
     default :
        rawValue= 0;
        putValue(E_pubc_GW_GW_1A6_EMS_EngineStatus_Rv, rawValue);
      break;
   }
}

on envVar E_pubc_GW_GW_1A6_Dlc
{
    if(getValue(E_pubc_GW_GW_1A6_enDlc))
    {
        Msg_GW_1A6.dlc =getValue(this);
    }
    else
    {
        Msg_GW_1A6.dlc =8;
    }
}

on envVar E_pubc_GW_GW_1A6_enDlc
{
    //For Messages with DLC = 8, set wrong DLC to smaller than defined DLC
    //For Messages with DLC < 8 set wrong DLC to smaller/longer than defined DLC
    if(getValue(this))
    {
        Msg_GW_1A6.dlc =getValue(E_pubc_GW_GW_1A6_Dlc);
    }
    else
    {
        Msg_GW_1A6.dlc =8;
    }
}

on envVar E_pubc_GW_GW_1A6_EMS_CRCCheck_1A6_wrongvalctr
{
    //update disturb count
    //disturb value range:(-1 = always send wrong value),( X>0 ,x is the number of Messages with wrong CHK sent)
    GW_1A6_EMS_CRCCheck_1A6_wrongvalctr =getValue(this);    
}
on envVar E_pubc_GW_GW_1A6_EMS_RollingCounter_1A6_wrongvalctr
{
    //update disturb count
    //disturb value range:(-1 = always send wrong value),( X>0 ,x is the number of Messages with wrong CHK sent)
    GW_1A6_EMS_RollingCounter_1A6_wrongvalctr =getValue(this);    
}

on envVar E_pubc_GW_GW_1A6_EMS_EngineStatus_Rv
{
    int64 rawValue = 0ll;
    float rawValue_float = 0.0;
    float phyValue = 0.0;        

    //set the signal with updated raw value
    if(getValue(E_pubc_GW_GW_1A6_EMS_EngineStatus_SetVt)==0)
    {
        rawValue = getvalue(this);
        if(chgEv_GW_1A6_EMS_EngineStatus == 0)
        {
            //type conversion to float
            rawValue_float = rawValue;        
            // raw to physical conversion
            phyValue = ((rawValue_float *1)+(0));
            putValue(E_pubc_GW_GW_1A6_EMS_EngineStatus_Pv, phyValue);
            chgEv_GW_1A6_EMS_EngineStatus = 1;
        }
        else
        {
            chgEv_GW_1A6_EMS_EngineStatus = 0;
        }    
        //update the signal value
        Msg_GW_1A6.EMS_EngineStatus=rawValue;        
    }                                                                           
}

on envVar E_pubc_GW_GW_1A6_EMS_EngineStatus_Pv
{
    int64 rawValue = 0ll;
    float phyValue = 0.0;
    
    //update the raw value with physical value 
    if(getValue(E_pubc_GW_GW_1A6_EMS_EngineStatus_SetVt)==0)
    {
        if(chgEv_GW_1A6_EMS_EngineStatus == 0)
        {
            phyValue = getvalue(this);
            // physical to raw conversion
            rawValue = ((phyValue -(0))/1);
            putValue(E_pubc_GW_GW_1A6_EMS_EngineStatus_Rv, rawValue);
            chgEv_GW_1A6_EMS_EngineStatus = 1;  
        }
        else
        {
            chgEv_GW_1A6_EMS_EngineStatus = 0;
        }
    }
}

on envVar E_pubc_GW_GW_1A6_EMS_EngineStatus_Vt
{
    qword rawValue = 0ll;
    if(getValue(E_pubc_GW_GW_1A6_EMS_EngineStatus_SetVt))
    {
        //update the signal value
        Msg_GW_1A6.EMS_EngineStatus=getValue(this);
    }
}

on envVar E_pubc_GW_GW_1A6_EMS_EngineStatus_SetVt
{
    if(getValue(E_pubc_GW_GW_1A6_EMS_EngineStatus_SetVt))
    {
        //update the signal value
        Msg_GW_1A6.EMS_EngineStatus=getvalue(E_pubc_GW_GW_1A6_EMS_EngineStatus_Vt);
    }
    else
    {
        Msg_GW_1A6.EMS_EngineStatus=getValue(E_pubc_GW_GW_1A6_EMS_EngineStatus_Rv);
    }
}
 
on envVar E_pubc_GW_GW_196_tx
{
    if(getValue(this))
    {       
        
        //update the BZ Signal
        if(GW_196_EMS_RollingCounter_196_wrongvalctr == 0)
        {
            update_GW_196_EMS_RollingCounter_196_counter();
            Msg_GW_196.EMS_RollingCounter_196= GW_196_EMS_RollingCounter_196_counter;
        }
        else if(GW_196_EMS_RollingCounter_196_wrongvalctr > 0)
        {
             GW_196_EMS_RollingCounter_196_wrongvalctr--;
              // if counter becomes zero, update panel controller to zero
             if(GW_196_EMS_RollingCounter_196_wrongvalctr == 0)
             {
                 putValue(E_pubc_GW_GW_196_EMS_RollingCounter_196_wrongvalctr,0);
             }
        }
        else
        {
            //do nothing
        }        
        //calculate the CRC CheckSum
        update_GW_196_CRC_CheckSum();

        output(Msg_GW_196);        
    }
}

on envVar E_pubc_GW_GW_196_Range
{
    qword rawstatus = 0ll;
    qword rawValue = 0ll;    
    
    rawstatus = getvalue(this);    
    // set all the signals with min raw /max raw /init raw
    switch (rawstatus) 
    {
     case(0) :
        rawValue= 0;
        putValue(E_pubc_GW_GW_196_EMS_AccPedal_Rv, rawValue);
        rawValue= 0;
        putValue(E_pubc_GW_GW_196_EMS_BrakePedalStatus_Rv, rawValue);
        rawValue= 0;
        putValue(E_pubc_GW_GW_196_EMS_EngineSpeed_Rv, rawValue);
        rawValue= 0;
        putValue(E_pubc_GW_GW_196_EMS_RealAccPedal_Rv, rawValue);
        break;
     case(1) :
        rawValue= 253;
        putValue(E_pubc_GW_GW_196_EMS_AccPedal_Rv, rawValue);
        rawValue= 3;
        putValue(E_pubc_GW_GW_196_EMS_BrakePedalStatus_Rv, rawValue);
        rawValue= 65534;
        putValue(E_pubc_GW_GW_196_EMS_EngineSpeed_Rv, rawValue);
        rawValue= 253;
        putValue(E_pubc_GW_GW_196_EMS_RealAccPedal_Rv, rawValue);
        break;
     default :
        rawValue= 0;
        putValue(E_pubc_GW_GW_196_EMS_AccPedal_Rv, rawValue);
        rawValue= 0;
        putValue(E_pubc_GW_GW_196_EMS_BrakePedalStatus_Rv, rawValue);
        rawValue= 0;
        putValue(E_pubc_GW_GW_196_EMS_EngineSpeed_Rv, rawValue);
        rawValue= 0;
        putValue(E_pubc_GW_GW_196_EMS_RealAccPedal_Rv, rawValue);
      break;
   }
}

on envVar E_pubc_GW_GW_196_Dlc
{
    if(getValue(E_pubc_GW_GW_196_enDlc))
    {
        Msg_GW_196.dlc =getValue(this);
    }
    else
    {
        Msg_GW_196.dlc =8;
    }
}

on envVar E_pubc_GW_GW_196_enDlc
{
    //For Messages with DLC = 8, set wrong DLC to smaller than defined DLC
    //For Messages with DLC < 8 set wrong DLC to smaller/longer than defined DLC
    if(getValue(this))
    {
        Msg_GW_196.dlc =getValue(E_pubc_GW_GW_196_Dlc);
    }
    else
    {
        Msg_GW_196.dlc =8;
    }
}

on envVar E_pubc_GW_GW_196_EMS_CRCCheck_196_wrongvalctr
{
    //update disturb count
    //disturb value range:(-1 = always send wrong value),( X>0 ,x is the number of Messages with wrong CHK sent)
    GW_196_EMS_CRCCheck_196_wrongvalctr =getValue(this);    
}
on envVar E_pubc_GW_GW_196_EMS_RollingCounter_196_wrongvalctr
{
    //update disturb count
    //disturb value range:(-1 = always send wrong value),( X>0 ,x is the number of Messages with wrong CHK sent)
    GW_196_EMS_RollingCounter_196_wrongvalctr =getValue(this);    
}

on envVar E_pubc_GW_GW_196_EMS_AccPedal_Rv
{
    int64 rawValue = 0ll;
    float rawValue_float = 0.0;
    float phyValue = 0.0;        

    //set the signal with updated raw value
    {
        rawValue = getvalue(this);
        if(chgEv_GW_196_EMS_AccPedal == 0)
        {
            //type conversion to float
            rawValue_float = rawValue;        
            // raw to physical conversion
            phyValue = ((rawValue_float *0.392)+(0));
            putValue(E_pubc_GW_GW_196_EMS_AccPedal_Pv, phyValue);
            chgEv_GW_196_EMS_AccPedal = 1;
        }
        else
        {
            chgEv_GW_196_EMS_AccPedal = 0;
        }    
        //update the signal value
        Msg_GW_196.EMS_AccPedal=rawValue;        
    }                                                                           
}

on envVar E_pubc_GW_GW_196_EMS_AccPedal_Pv
{
    int64 rawValue = 0ll;
    float phyValue = 0.0;
    
    //update the raw value with physical value 
    {
        if(chgEv_GW_196_EMS_AccPedal == 0)
        {
            phyValue = getvalue(this);
            // physical to raw conversion
            rawValue = ((phyValue -(0))/0.392);
            putValue(E_pubc_GW_GW_196_EMS_AccPedal_Rv, rawValue);
            chgEv_GW_196_EMS_AccPedal = 1;  
        }
        else
        {
            chgEv_GW_196_EMS_AccPedal = 0;
        }
    }
}


 
on envVar E_pubc_GW_GW_196_EMS_BrakePedalStatus_Rv
{
    int64 rawValue = 0ll;
    float rawValue_float = 0.0;
    float phyValue = 0.0;        

    //set the signal with updated raw value
    if(getValue(E_pubc_GW_GW_196_EMS_BrakePedalStatus_SetVt)==0)
    {
        rawValue = getvalue(this);
        if(chgEv_GW_196_EMS_BrakePedalStatus == 0)
        {
            //type conversion to float
            rawValue_float = rawValue;        
            // raw to physical conversion
            phyValue = ((rawValue_float *1)+(0));
            putValue(E_pubc_GW_GW_196_EMS_BrakePedalStatus_Pv, phyValue);
            chgEv_GW_196_EMS_BrakePedalStatus = 1;
        }
        else
        {
            chgEv_GW_196_EMS_BrakePedalStatus = 0;
        }    
        //update the signal value
        Msg_GW_196.EMS_BrakePedalStatus=rawValue;        
    }                                                                           
}

on envVar E_pubc_GW_GW_196_EMS_BrakePedalStatus_Pv
{
    int64 rawValue = 0ll;
    float phyValue = 0.0;
    
    //update the raw value with physical value 
    if(getValue(E_pubc_GW_GW_196_EMS_BrakePedalStatus_SetVt)==0)
    {
        if(chgEv_GW_196_EMS_BrakePedalStatus == 0)
        {
            phyValue = getvalue(this);
            // physical to raw conversion
            rawValue = ((phyValue -(0))/1);
            putValue(E_pubc_GW_GW_196_EMS_BrakePedalStatus_Rv, rawValue);
            chgEv_GW_196_EMS_BrakePedalStatus = 1;  
        }
        else
        {
            chgEv_GW_196_EMS_BrakePedalStatus = 0;
        }
    }
}

on envVar E_pubc_GW_GW_196_EMS_BrakePedalStatus_Vt
{
    qword rawValue = 0ll;
    if(getValue(E_pubc_GW_GW_196_EMS_BrakePedalStatus_SetVt))
    {
        //update the signal value
        Msg_GW_196.EMS_BrakePedalStatus=getValue(this);
    }
}

on envVar E_pubc_GW_GW_196_EMS_BrakePedalStatus_SetVt
{
    if(getValue(E_pubc_GW_GW_196_EMS_BrakePedalStatus_SetVt))
    {
        //update the signal value
        Msg_GW_196.EMS_BrakePedalStatus=getvalue(E_pubc_GW_GW_196_EMS_BrakePedalStatus_Vt);
    }
    else
    {
        Msg_GW_196.EMS_BrakePedalStatus=getValue(E_pubc_GW_GW_196_EMS_BrakePedalStatus_Rv);
    }
}
 
on envVar E_pubc_GW_GW_196_EMS_EngineSpeed_Rv
{
    int64 rawValue = 0ll;
    float rawValue_float = 0.0;
    float phyValue = 0.0;        

    //set the signal with updated raw value
    if(getValue(E_pubc_GW_GW_196_EMS_EngineSpeed_SetVt)==0)
    {
        rawValue = getvalue(this);
        if(chgEv_GW_196_EMS_EngineSpeed == 0)
        {
            //type conversion to float
            rawValue_float = rawValue;        
            // raw to physical conversion
            phyValue = ((rawValue_float *0.25)+(0));
            putValue(E_pubc_GW_GW_196_EMS_EngineSpeed_Pv, phyValue);
            chgEv_GW_196_EMS_EngineSpeed = 1;
        }
        else
        {
            chgEv_GW_196_EMS_EngineSpeed = 0;
        }    
        //update the signal value
        Msg_GW_196.EMS_EngineSpeed=rawValue;        
    }                                                                           
}

on envVar E_pubc_GW_GW_196_EMS_EngineSpeed_Pv
{
    int64 rawValue = 0ll;
    float phyValue = 0.0;
    
    //update the raw value with physical value 
    if(getValue(E_pubc_GW_GW_196_EMS_EngineSpeed_SetVt)==0)
    {
        if(chgEv_GW_196_EMS_EngineSpeed == 0)
        {
            phyValue = getvalue(this);
            // physical to raw conversion
            rawValue = ((phyValue -(0))/0.25);
            putValue(E_pubc_GW_GW_196_EMS_EngineSpeed_Rv, rawValue);
            chgEv_GW_196_EMS_EngineSpeed = 1;  
        }
        else
        {
            chgEv_GW_196_EMS_EngineSpeed = 0;
        }
    }
}

on envVar E_pubc_GW_GW_196_EMS_EngineSpeed_Vt
{
    qword rawValue = 0ll;
    if(getValue(E_pubc_GW_GW_196_EMS_EngineSpeed_SetVt))
    {
        //update the signal value
        Msg_GW_196.EMS_EngineSpeed=getValue(this);
    }
}

on envVar E_pubc_GW_GW_196_EMS_EngineSpeed_SetVt
{
    if(getValue(E_pubc_GW_GW_196_EMS_EngineSpeed_SetVt))
    {
        //update the signal value
        Msg_GW_196.EMS_EngineSpeed=getvalue(E_pubc_GW_GW_196_EMS_EngineSpeed_Vt);
    }
    else
    {
        Msg_GW_196.EMS_EngineSpeed=getValue(E_pubc_GW_GW_196_EMS_EngineSpeed_Rv);
    }
}
 
on envVar E_pubc_GW_GW_196_EMS_RealAccPedal_Rv
{
    int64 rawValue = 0ll;
    float rawValue_float = 0.0;
    float phyValue = 0.0;        

    //set the signal with updated raw value
    {
        rawValue = getvalue(this);
        if(chgEv_GW_196_EMS_RealAccPedal == 0)
        {
            //type conversion to float
            rawValue_float = rawValue;        
            // raw to physical conversion
            phyValue = ((rawValue_float *0.392)+(0));
            putValue(E_pubc_GW_GW_196_EMS_RealAccPedal_Pv, phyValue);
            chgEv_GW_196_EMS_RealAccPedal = 1;
        }
        else
        {
            chgEv_GW_196_EMS_RealAccPedal = 0;
        }    
        //update the signal value
        Msg_GW_196.EMS_RealAccPedal=rawValue;        
    }                                                                           
}

on envVar E_pubc_GW_GW_196_EMS_RealAccPedal_Pv
{
    int64 rawValue = 0ll;
    float phyValue = 0.0;
    
    //update the raw value with physical value 
    {
        if(chgEv_GW_196_EMS_RealAccPedal == 0)
        {
            phyValue = getvalue(this);
            // physical to raw conversion
            rawValue = ((phyValue -(0))/0.392);
            putValue(E_pubc_GW_GW_196_EMS_RealAccPedal_Rv, rawValue);
            chgEv_GW_196_EMS_RealAccPedal = 1;  
        }
        else
        {
            chgEv_GW_196_EMS_RealAccPedal = 0;
        }
    }
}


 
on envVar E_pubc_GW_GW_394_tx
{
    if(getValue(this))
    {       
        

        output(Msg_GW_394);        
    }
}

on envVar E_pubc_GW_GW_394_Range
{
    qword rawstatus = 0ll;
    qword rawValue = 0ll;    
    
    rawstatus = getvalue(this);    
    // set all the signals with min raw /max raw /init raw
    switch (rawstatus) 
    {
     case(0) :
        rawValue= 0;
        putValue(E_pubc_GW_GW_394_HU_TLAEnable_Rv, rawValue);
        rawValue= 0;
        putValue(E_pubc_GW_GW_394_HU_ELKEnable_Rv, rawValue);
        break;
     case(1) :
        rawValue= 3;
        putValue(E_pubc_GW_GW_394_HU_TLAEnable_Rv, rawValue);
        rawValue= 1;
        putValue(E_pubc_GW_GW_394_HU_ELKEnable_Rv, rawValue);
        break;
     default :
        rawValue= 0;
        putValue(E_pubc_GW_GW_394_HU_TLAEnable_Rv, rawValue);
        rawValue= 0;
        putValue(E_pubc_GW_GW_394_HU_ELKEnable_Rv, rawValue);
      break;
   }
}

on envVar E_pubc_GW_GW_394_Dlc
{
    if(getValue(E_pubc_GW_GW_394_enDlc))
    {
        Msg_GW_394.dlc =getValue(this);
    }
    else
    {
        Msg_GW_394.dlc =8;
    }
}

on envVar E_pubc_GW_GW_394_enDlc
{
    //For Messages with DLC = 8, set wrong DLC to smaller than defined DLC
    //For Messages with DLC < 8 set wrong DLC to smaller/longer than defined DLC
    if(getValue(this))
    {
        Msg_GW_394.dlc =getValue(E_pubc_GW_GW_394_Dlc);
    }
    else
    {
        Msg_GW_394.dlc =8;
    }
}


on envVar E_pubc_GW_GW_394_HU_TLAEnable_Rv
{
    int64 rawValue = 0ll;
    float rawValue_float = 0.0;
    float phyValue = 0.0;        

    //set the signal with updated raw value
    if(getValue(E_pubc_GW_GW_394_HU_TLAEnable_SetVt)==0)
    {
        rawValue = getvalue(this);
        if(chgEv_GW_394_HU_TLAEnable == 0)
        {
            //type conversion to float
            rawValue_float = rawValue;        
            // raw to physical conversion
            phyValue = ((rawValue_float *1)+(0));
            putValue(E_pubc_GW_GW_394_HU_TLAEnable_Pv, phyValue);
            chgEv_GW_394_HU_TLAEnable = 1;
        }
        else
        {
            chgEv_GW_394_HU_TLAEnable = 0;
        }    
        //update the signal value
        Msg_GW_394.HU_TLAEnable=rawValue;        
    }                                                                           
}

on envVar E_pubc_GW_GW_394_HU_TLAEnable_Pv
{
    int64 rawValue = 0ll;
    float phyValue = 0.0;
    
    //update the raw value with physical value 
    if(getValue(E_pubc_GW_GW_394_HU_TLAEnable_SetVt)==0)
    {
        if(chgEv_GW_394_HU_TLAEnable == 0)
        {
            phyValue = getvalue(this);
            // physical to raw conversion
            rawValue = ((phyValue -(0))/1);
            putValue(E_pubc_GW_GW_394_HU_TLAEnable_Rv, rawValue);
            chgEv_GW_394_HU_TLAEnable = 1;  
        }
        else
        {
            chgEv_GW_394_HU_TLAEnable = 0;
        }
    }
}

on envVar E_pubc_GW_GW_394_HU_TLAEnable_Vt
{
    qword rawValue = 0ll;
    if(getValue(E_pubc_GW_GW_394_HU_TLAEnable_SetVt))
    {
        //update the signal value
        Msg_GW_394.HU_TLAEnable=getValue(this);
    }
}

on envVar E_pubc_GW_GW_394_HU_TLAEnable_SetVt
{
    if(getValue(E_pubc_GW_GW_394_HU_TLAEnable_SetVt))
    {
        //update the signal value
        Msg_GW_394.HU_TLAEnable=getvalue(E_pubc_GW_GW_394_HU_TLAEnable_Vt);
    }
    else
    {
        Msg_GW_394.HU_TLAEnable=getValue(E_pubc_GW_GW_394_HU_TLAEnable_Rv);
    }
}
 
on envVar E_pubc_GW_GW_394_HU_ELKEnable_Rv
{
    int64 rawValue = 0ll;
    float rawValue_float = 0.0;
    float phyValue = 0.0;        

    //set the signal with updated raw value
    if(getValue(E_pubc_GW_GW_394_HU_ELKEnable_SetVt)==0)
    {
        rawValue = getvalue(this);
        if(chgEv_GW_394_HU_ELKEnable == 0)
        {
            //type conversion to float
            rawValue_float = rawValue;        
            // raw to physical conversion
            phyValue = ((rawValue_float *1)+(0));
            putValue(E_pubc_GW_GW_394_HU_ELKEnable_Pv, phyValue);
            chgEv_GW_394_HU_ELKEnable = 1;
        }
        else
        {
            chgEv_GW_394_HU_ELKEnable = 0;
        }    
        //update the signal value
        Msg_GW_394.HU_ELKEnable=rawValue;        
    }                                                                           
}

on envVar E_pubc_GW_GW_394_HU_ELKEnable_Pv
{
    int64 rawValue = 0ll;
    float phyValue = 0.0;
    
    //update the raw value with physical value 
    if(getValue(E_pubc_GW_GW_394_HU_ELKEnable_SetVt)==0)
    {
        if(chgEv_GW_394_HU_ELKEnable == 0)
        {
            phyValue = getvalue(this);
            // physical to raw conversion
            rawValue = ((phyValue -(0))/1);
            putValue(E_pubc_GW_GW_394_HU_ELKEnable_Rv, rawValue);
            chgEv_GW_394_HU_ELKEnable = 1;  
        }
        else
        {
            chgEv_GW_394_HU_ELKEnable = 0;
        }
    }
}

on envVar E_pubc_GW_GW_394_HU_ELKEnable_Vt
{
    qword rawValue = 0ll;
    if(getValue(E_pubc_GW_GW_394_HU_ELKEnable_SetVt))
    {
        //update the signal value
        Msg_GW_394.HU_ELKEnable=getValue(this);
    }
}

on envVar E_pubc_GW_GW_394_HU_ELKEnable_SetVt
{
    if(getValue(E_pubc_GW_GW_394_HU_ELKEnable_SetVt))
    {
        //update the signal value
        Msg_GW_394.HU_ELKEnable=getvalue(E_pubc_GW_GW_394_HU_ELKEnable_Vt);
    }
    else
    {
        Msg_GW_394.HU_ELKEnable=getValue(E_pubc_GW_GW_394_HU_ELKEnable_Rv);
    }
}
 
on envVar E_pubc_GW_GW_390_tx
{
    if(getValue(this))
    {       
        

        output(Msg_GW_390);        
    }
}

on envVar E_pubc_GW_GW_390_Range
{
    qword rawstatus = 0ll;
    qword rawValue = 0ll;    
    
    rawstatus = getvalue(this);    
    // set all the signals with min raw /max raw /init raw
    switch (rawstatus) 
    {
     case(0) :
        rawValue= 0;
        putValue(E_pubc_GW_GW_390_BCM_SOH_LifePercent_Rv, rawValue);
        rawValue= 0;
        putValue(E_pubc_GW_GW_390_BCM_PMSLevel_Rv, rawValue);
        break;
     case(1) :
        rawValue= 100;
        putValue(E_pubc_GW_GW_390_BCM_SOH_LifePercent_Rv, rawValue);
        rawValue= 7;
        putValue(E_pubc_GW_GW_390_BCM_PMSLevel_Rv, rawValue);
        break;
     default :
        rawValue= 0;
        putValue(E_pubc_GW_GW_390_BCM_SOH_LifePercent_Rv, rawValue);
        rawValue= 0;
        putValue(E_pubc_GW_GW_390_BCM_PMSLevel_Rv, rawValue);
      break;
   }
}

on envVar E_pubc_GW_GW_390_Dlc
{
    if(getValue(E_pubc_GW_GW_390_enDlc))
    {
        Msg_GW_390.dlc =getValue(this);
    }
    else
    {
        Msg_GW_390.dlc =8;
    }
}

on envVar E_pubc_GW_GW_390_enDlc
{
    //For Messages with DLC = 8, set wrong DLC to smaller than defined DLC
    //For Messages with DLC < 8 set wrong DLC to smaller/longer than defined DLC
    if(getValue(this))
    {
        Msg_GW_390.dlc =getValue(E_pubc_GW_GW_390_Dlc);
    }
    else
    {
        Msg_GW_390.dlc =8;
    }
}


on envVar E_pubc_GW_GW_390_BCM_SOH_LifePercent_Rv
{
    int64 rawValue = 0ll;
    float rawValue_float = 0.0;
    float phyValue = 0.0;        

    //set the signal with updated raw value
    if(getValue(E_pubc_GW_GW_390_BCM_SOH_LifePercent_SetVt)==0)
    {
        rawValue = getvalue(this);
        if(chgEv_GW_390_BCM_SOH_LifePercent == 0)
        {
            //type conversion to float
            rawValue_float = rawValue;        
            // raw to physical conversion
            phyValue = ((rawValue_float *1)+(0));
            putValue(E_pubc_GW_GW_390_BCM_SOH_LifePercent_Pv, phyValue);
            chgEv_GW_390_BCM_SOH_LifePercent = 1;
        }
        else
        {
            chgEv_GW_390_BCM_SOH_LifePercent = 0;
        }    
        //update the signal value
        Msg_GW_390.BCM_SOH_LifePercent=rawValue;        
    }                                                                           
}

on envVar E_pubc_GW_GW_390_BCM_SOH_LifePercent_Pv
{
    int64 rawValue = 0ll;
    float phyValue = 0.0;
    
    //update the raw value with physical value 
    if(getValue(E_pubc_GW_GW_390_BCM_SOH_LifePercent_SetVt)==0)
    {
        if(chgEv_GW_390_BCM_SOH_LifePercent == 0)
        {
            phyValue = getvalue(this);
            // physical to raw conversion
            rawValue = ((phyValue -(0))/1);
            putValue(E_pubc_GW_GW_390_BCM_SOH_LifePercent_Rv, rawValue);
            chgEv_GW_390_BCM_SOH_LifePercent = 1;  
        }
        else
        {
            chgEv_GW_390_BCM_SOH_LifePercent = 0;
        }
    }
}

on envVar E_pubc_GW_GW_390_BCM_SOH_LifePercent_Vt
{
    qword rawValue = 0ll;
    if(getValue(E_pubc_GW_GW_390_BCM_SOH_LifePercent_SetVt))
    {
        //update the signal value
        Msg_GW_390.BCM_SOH_LifePercent=getValue(this);
    }
}

on envVar E_pubc_GW_GW_390_BCM_SOH_LifePercent_SetVt
{
    if(getValue(E_pubc_GW_GW_390_BCM_SOH_LifePercent_SetVt))
    {
        //update the signal value
        Msg_GW_390.BCM_SOH_LifePercent=getvalue(E_pubc_GW_GW_390_BCM_SOH_LifePercent_Vt);
    }
    else
    {
        Msg_GW_390.BCM_SOH_LifePercent=getValue(E_pubc_GW_GW_390_BCM_SOH_LifePercent_Rv);
    }
}
 
on envVar E_pubc_GW_GW_390_BCM_PMSLevel_Rv
{
    int64 rawValue = 0ll;
    float rawValue_float = 0.0;
    float phyValue = 0.0;        

    //set the signal with updated raw value
    if(getValue(E_pubc_GW_GW_390_BCM_PMSLevel_SetVt)==0)
    {
        rawValue = getvalue(this);
        if(chgEv_GW_390_BCM_PMSLevel == 0)
        {
            //type conversion to float
            rawValue_float = rawValue;        
            // raw to physical conversion
            phyValue = ((rawValue_float *1)+(0));
            putValue(E_pubc_GW_GW_390_BCM_PMSLevel_Pv, phyValue);
            chgEv_GW_390_BCM_PMSLevel = 1;
        }
        else
        {
            chgEv_GW_390_BCM_PMSLevel = 0;
        }    
        //update the signal value
        Msg_GW_390.BCM_PMSLevel=rawValue;        
    }                                                                           
}

on envVar E_pubc_GW_GW_390_BCM_PMSLevel_Pv
{
    int64 rawValue = 0ll;
    float phyValue = 0.0;
    
    //update the raw value with physical value 
    if(getValue(E_pubc_GW_GW_390_BCM_PMSLevel_SetVt)==0)
    {
        if(chgEv_GW_390_BCM_PMSLevel == 0)
        {
            phyValue = getvalue(this);
            // physical to raw conversion
            rawValue = ((phyValue -(0))/1);
            putValue(E_pubc_GW_GW_390_BCM_PMSLevel_Rv, rawValue);
            chgEv_GW_390_BCM_PMSLevel = 1;  
        }
        else
        {
            chgEv_GW_390_BCM_PMSLevel = 0;
        }
    }
}

on envVar E_pubc_GW_GW_390_BCM_PMSLevel_Vt
{
    qword rawValue = 0ll;
    if(getValue(E_pubc_GW_GW_390_BCM_PMSLevel_SetVt))
    {
        //update the signal value
        Msg_GW_390.BCM_PMSLevel=getValue(this);
    }
}

on envVar E_pubc_GW_GW_390_BCM_PMSLevel_SetVt
{
    if(getValue(E_pubc_GW_GW_390_BCM_PMSLevel_SetVt))
    {
        //update the signal value
        Msg_GW_390.BCM_PMSLevel=getvalue(E_pubc_GW_GW_390_BCM_PMSLevel_Vt);
    }
    else
    {
        Msg_GW_390.BCM_PMSLevel=getValue(E_pubc_GW_GW_390_BCM_PMSLevel_Rv);
    }
}
 
on envVar E_pubc_GW_GW_17E_tx
{
    if(getValue(this))
    {       
        
        //update the BZ Signal
        if(GW_17E_EPS_RollingCounter_17E_wrongvalctr == 0)
        {
            update_GW_17E_EPS_RollingCounter_17E_counter();
            Msg_GW_17E.EPS_RollingCounter_17E= GW_17E_EPS_RollingCounter_17E_counter;
        }
        else if(GW_17E_EPS_RollingCounter_17E_wrongvalctr > 0)
        {
             GW_17E_EPS_RollingCounter_17E_wrongvalctr--;
              // if counter becomes zero, update panel controller to zero
             if(GW_17E_EPS_RollingCounter_17E_wrongvalctr == 0)
             {
                 putValue(E_pubc_GW_GW_17E_EPS_RollingCounter_17E_wrongvalctr,0);
             }
        }
        else
        {
            //do nothing
        }        
        //calculate the CRC CheckSum
        update_GW_17E_CRC_CheckSum();

        output(Msg_GW_17E);        
    }
}

on envVar E_pubc_GW_GW_17E_Range
{
    qword rawstatus = 0ll;
    qword rawValue = 0ll;    
    
    rawstatus = getvalue(this);    
    // set all the signals with min raw /max raw /init raw
    switch (rawstatus) 
    {
     case(0) :
        rawValue= 0;
        putValue(E_pubc_GW_GW_17E_EPS_LatCtrlActive_Rv, rawValue);
        rawValue= 0;
        putValue(E_pubc_GW_GW_17E_EPS_MeasuredTorsionBarTorqValid_Rv, rawValue);
        rawValue= 0;
        putValue(E_pubc_GW_GW_17E_EPS_MeasuredTorsionBarTorque_Rv, rawValue);
        rawValue= 0;
        putValue(E_pubc_GW_GW_17E_EPS_LatCtrlAvailabilityStatus_Rv, rawValue);
        break;
     case(1) :
        rawValue= 1;
        putValue(E_pubc_GW_GW_17E_EPS_LatCtrlActive_Rv, rawValue);
        rawValue= 1;
        putValue(E_pubc_GW_GW_17E_EPS_MeasuredTorsionBarTorqValid_Rv, rawValue);
        rawValue= 2046;
        putValue(E_pubc_GW_GW_17E_EPS_MeasuredTorsionBarTorque_Rv, rawValue);
        rawValue= 3;
        putValue(E_pubc_GW_GW_17E_EPS_LatCtrlAvailabilityStatus_Rv, rawValue);
        break;
     default :
        rawValue= 0;
        putValue(E_pubc_GW_GW_17E_EPS_LatCtrlActive_Rv, rawValue);
        rawValue= 0;
        putValue(E_pubc_GW_GW_17E_EPS_MeasuredTorsionBarTorqValid_Rv, rawValue);
        rawValue= 0;
        putValue(E_pubc_GW_GW_17E_EPS_MeasuredTorsionBarTorque_Rv, rawValue);
        rawValue= 0;
        putValue(E_pubc_GW_GW_17E_EPS_LatCtrlAvailabilityStatus_Rv, rawValue);
      break;
   }
}

on envVar E_pubc_GW_GW_17E_Dlc
{
    if(getValue(E_pubc_GW_GW_17E_enDlc))
    {
        Msg_GW_17E.dlc =getValue(this);
    }
    else
    {
        Msg_GW_17E.dlc =8;
    }
}

on envVar E_pubc_GW_GW_17E_enDlc
{
    //For Messages with DLC = 8, set wrong DLC to smaller than defined DLC
    //For Messages with DLC < 8 set wrong DLC to smaller/longer than defined DLC
    if(getValue(this))
    {
        Msg_GW_17E.dlc =getValue(E_pubc_GW_GW_17E_Dlc);
    }
    else
    {
        Msg_GW_17E.dlc =8;
    }
}

on envVar E_pubc_GW_GW_17E_EPS_CRCCheck_17E_wrongvalctr
{
    //update disturb count
    //disturb value range:(-1 = always send wrong value),( X>0 ,x is the number of Messages with wrong CHK sent)
    GW_17E_EPS_CRCCheck_17E_wrongvalctr =getValue(this);    
}
on envVar E_pubc_GW_GW_17E_EPS_RollingCounter_17E_wrongvalctr
{
    //update disturb count
    //disturb value range:(-1 = always send wrong value),( X>0 ,x is the number of Messages with wrong CHK sent)
    GW_17E_EPS_RollingCounter_17E_wrongvalctr =getValue(this);    
}

on envVar E_pubc_GW_GW_17E_EPS_LatCtrlActive_Rv
{
    int64 rawValue = 0ll;
    float rawValue_float = 0.0;
    float phyValue = 0.0;        

    //set the signal with updated raw value
    if(getValue(E_pubc_GW_GW_17E_EPS_LatCtrlActive_SetVt)==0)
    {
        rawValue = getvalue(this);
        if(chgEv_GW_17E_EPS_LatCtrlActive == 0)
        {
            //type conversion to float
            rawValue_float = rawValue;        
            // raw to physical conversion
            phyValue = ((rawValue_float *1)+(0));
            putValue(E_pubc_GW_GW_17E_EPS_LatCtrlActive_Pv, phyValue);
            chgEv_GW_17E_EPS_LatCtrlActive = 1;
        }
        else
        {
            chgEv_GW_17E_EPS_LatCtrlActive = 0;
        }    
        //update the signal value
        Msg_GW_17E.EPS_LatCtrlActive=rawValue;        
    }                                                                           
}

on envVar E_pubc_GW_GW_17E_EPS_LatCtrlActive_Pv
{
    int64 rawValue = 0ll;
    float phyValue = 0.0;
    
    //update the raw value with physical value 
    if(getValue(E_pubc_GW_GW_17E_EPS_LatCtrlActive_SetVt)==0)
    {
        if(chgEv_GW_17E_EPS_LatCtrlActive == 0)
        {
            phyValue = getvalue(this);
            // physical to raw conversion
            rawValue = ((phyValue -(0))/1);
            putValue(E_pubc_GW_GW_17E_EPS_LatCtrlActive_Rv, rawValue);
            chgEv_GW_17E_EPS_LatCtrlActive = 1;  
        }
        else
        {
            chgEv_GW_17E_EPS_LatCtrlActive = 0;
        }
    }
}

on envVar E_pubc_GW_GW_17E_EPS_LatCtrlActive_Vt
{
    qword rawValue = 0ll;
    if(getValue(E_pubc_GW_GW_17E_EPS_LatCtrlActive_SetVt))
    {
        //update the signal value
        Msg_GW_17E.EPS_LatCtrlActive=getValue(this);
    }
}

on envVar E_pubc_GW_GW_17E_EPS_LatCtrlActive_SetVt
{
    if(getValue(E_pubc_GW_GW_17E_EPS_LatCtrlActive_SetVt))
    {
        //update the signal value
        Msg_GW_17E.EPS_LatCtrlActive=getvalue(E_pubc_GW_GW_17E_EPS_LatCtrlActive_Vt);
    }
    else
    {
        Msg_GW_17E.EPS_LatCtrlActive=getValue(E_pubc_GW_GW_17E_EPS_LatCtrlActive_Rv);
    }
}
 
on envVar E_pubc_GW_GW_17E_EPS_MeasuredTorsionBarTorqValid_Rv
{
    int64 rawValue = 0ll;
    float rawValue_float = 0.0;
    float phyValue = 0.0;        

    //set the signal with updated raw value
    if(getValue(E_pubc_GW_GW_17E_EPS_MeasuredTorsionBarTorqValid_SetVt)==0)
    {
        rawValue = getvalue(this);
        if(chgEv_GW_17E_EPS_MeasuredTorsionBarTorqValid == 0)
        {
            //type conversion to float
            rawValue_float = rawValue;        
            // raw to physical conversion
            phyValue = ((rawValue_float *1)+(0));
            putValue(E_pubc_GW_GW_17E_EPS_MeasuredTorsionBarTorqValid_Pv, phyValue);
            chgEv_GW_17E_EPS_MeasuredTorsionBarTorqValid = 1;
        }
        else
        {
            chgEv_GW_17E_EPS_MeasuredTorsionBarTorqValid = 0;
        }    
        //update the signal value
        Msg_GW_17E.EPS_MeasuredTorsionBarTorqValid=rawValue;        
    }                                                                           
}

on envVar E_pubc_GW_GW_17E_EPS_MeasuredTorsionBarTorqValid_Pv
{
    int64 rawValue = 0ll;
    float phyValue = 0.0;
    
    //update the raw value with physical value 
    if(getValue(E_pubc_GW_GW_17E_EPS_MeasuredTorsionBarTorqValid_SetVt)==0)
    {
        if(chgEv_GW_17E_EPS_MeasuredTorsionBarTorqValid == 0)
        {
            phyValue = getvalue(this);
            // physical to raw conversion
            rawValue = ((phyValue -(0))/1);
            putValue(E_pubc_GW_GW_17E_EPS_MeasuredTorsionBarTorqValid_Rv, rawValue);
            chgEv_GW_17E_EPS_MeasuredTorsionBarTorqValid = 1;  
        }
        else
        {
            chgEv_GW_17E_EPS_MeasuredTorsionBarTorqValid = 0;
        }
    }
}

on envVar E_pubc_GW_GW_17E_EPS_MeasuredTorsionBarTorqValid_Vt
{
    qword rawValue = 0ll;
    if(getValue(E_pubc_GW_GW_17E_EPS_MeasuredTorsionBarTorqValid_SetVt))
    {
        //update the signal value
        Msg_GW_17E.EPS_MeasuredTorsionBarTorqValid=getValue(this);
    }
}

on envVar E_pubc_GW_GW_17E_EPS_MeasuredTorsionBarTorqValid_SetVt
{
    if(getValue(E_pubc_GW_GW_17E_EPS_MeasuredTorsionBarTorqValid_SetVt))
    {
        //update the signal value
        Msg_GW_17E.EPS_MeasuredTorsionBarTorqValid=getvalue(E_pubc_GW_GW_17E_EPS_MeasuredTorsionBarTorqValid_Vt);
    }
    else
    {
        Msg_GW_17E.EPS_MeasuredTorsionBarTorqValid=getValue(E_pubc_GW_GW_17E_EPS_MeasuredTorsionBarTorqValid_Rv);
    }
}
 
on envVar E_pubc_GW_GW_17E_EPS_MeasuredTorsionBarTorque_Rv
{
    int64 rawValue = 0ll;
    float rawValue_float = 0.0;
    float phyValue = 0.0;        

    //set the signal with updated raw value
    {
        rawValue = getvalue(this);
        if(chgEv_GW_17E_EPS_MeasuredTorsionBarTorque == 0)
        {
            //type conversion to float
            rawValue_float = rawValue;        
            // raw to physical conversion
            phyValue = ((rawValue_float *0.01)+(-10.23));
            putValue(E_pubc_GW_GW_17E_EPS_MeasuredTorsionBarTorque_Pv, phyValue);
            chgEv_GW_17E_EPS_MeasuredTorsionBarTorque = 1;
        }
        else
        {
            chgEv_GW_17E_EPS_MeasuredTorsionBarTorque = 0;
        }    
        //update the signal value
        Msg_GW_17E.EPS_MeasuredTorsionBarTorque=rawValue;        
    }                                                                           
}

on envVar E_pubc_GW_GW_17E_EPS_MeasuredTorsionBarTorque_Pv
{
    int64 rawValue = 0ll;
    float phyValue = 0.0;
    
    //update the raw value with physical value 
    {
        if(chgEv_GW_17E_EPS_MeasuredTorsionBarTorque == 0)
        {
            phyValue = getvalue(this);
            // physical to raw conversion
            rawValue = ((phyValue -(-10.23))/0.01);
            putValue(E_pubc_GW_GW_17E_EPS_MeasuredTorsionBarTorque_Rv, rawValue);
            chgEv_GW_17E_EPS_MeasuredTorsionBarTorque = 1;  
        }
        else
        {
            chgEv_GW_17E_EPS_MeasuredTorsionBarTorque = 0;
        }
    }
}


 
on envVar E_pubc_GW_GW_17E_EPS_LatCtrlAvailabilityStatus_Rv
{
    int64 rawValue = 0ll;
    float rawValue_float = 0.0;
    float phyValue = 0.0;        

    //set the signal with updated raw value
    if(getValue(E_pubc_GW_GW_17E_EPS_LatCtrlAvailabilityStatus_SetVt)==0)
    {
        rawValue = getvalue(this);
        if(chgEv_GW_17E_EPS_LatCtrlAvailabilityStatus == 0)
        {
            //type conversion to float
            rawValue_float = rawValue;        
            // raw to physical conversion
            phyValue = ((rawValue_float *1)+(0));
            putValue(E_pubc_GW_GW_17E_EPS_LatCtrlAvailabilityStatus_Pv, phyValue);
            chgEv_GW_17E_EPS_LatCtrlAvailabilityStatus = 1;
        }
        else
        {
            chgEv_GW_17E_EPS_LatCtrlAvailabilityStatus = 0;
        }    
        //update the signal value
        Msg_GW_17E.EPS_LatCtrlAvailabilityStatus=rawValue;        
    }                                                                           
}

on envVar E_pubc_GW_GW_17E_EPS_LatCtrlAvailabilityStatus_Pv
{
    int64 rawValue = 0ll;
    float phyValue = 0.0;
    
    //update the raw value with physical value 
    if(getValue(E_pubc_GW_GW_17E_EPS_LatCtrlAvailabilityStatus_SetVt)==0)
    {
        if(chgEv_GW_17E_EPS_LatCtrlAvailabilityStatus == 0)
        {
            phyValue = getvalue(this);
            // physical to raw conversion
            rawValue = ((phyValue -(0))/1);
            putValue(E_pubc_GW_GW_17E_EPS_LatCtrlAvailabilityStatus_Rv, rawValue);
            chgEv_GW_17E_EPS_LatCtrlAvailabilityStatus = 1;  
        }
        else
        {
            chgEv_GW_17E_EPS_LatCtrlAvailabilityStatus = 0;
        }
    }
}

on envVar E_pubc_GW_GW_17E_EPS_LatCtrlAvailabilityStatus_Vt
{
    qword rawValue = 0ll;
    if(getValue(E_pubc_GW_GW_17E_EPS_LatCtrlAvailabilityStatus_SetVt))
    {
        //update the signal value
        Msg_GW_17E.EPS_LatCtrlAvailabilityStatus=getValue(this);
    }
}

on envVar E_pubc_GW_GW_17E_EPS_LatCtrlAvailabilityStatus_SetVt
{
    if(getValue(E_pubc_GW_GW_17E_EPS_LatCtrlAvailabilityStatus_SetVt))
    {
        //update the signal value
        Msg_GW_17E.EPS_LatCtrlAvailabilityStatus=getvalue(E_pubc_GW_GW_17E_EPS_LatCtrlAvailabilityStatus_Vt);
    }
    else
    {
        Msg_GW_17E.EPS_LatCtrlAvailabilityStatus=getValue(E_pubc_GW_GW_17E_EPS_LatCtrlAvailabilityStatus_Rv);
    }
}
 
on envVar E_pubc_GW_GW_514_tx
{
    if(getValue(this))
    {       
        

        output(Msg_GW_514);        
    }
}

on envVar E_pubc_GW_GW_514_Range
{
    qword rawstatus = 0ll;
    qword rawValue = 0ll;    
    
    rawstatus = getvalue(this);    
    // set all the signals with min raw /max raw /init raw
    switch (rawstatus) 
    {
     case(0) :
        rawValue= 0;
        putValue(E_pubc_GW_GW_514_HU_OverspeedWarningOffset_Rv, rawValue);
        rawValue= 0;
        putValue(E_pubc_GW_GW_514_HU_LASWarningModeSelection_Rv, rawValue);
        rawValue= 0;
        putValue(E_pubc_GW_GW_514_HU_LDWShakeLev_Rv, rawValue);
        rawValue= 0;
        putValue(E_pubc_GW_GW_514_HU_HMAEnable_Rv, rawValue);
        rawValue= 0;
        putValue(E_pubc_GW_GW_514_HU_OverspeedWarningEnable_Rv, rawValue);
        rawValue= 0;
        putValue(E_pubc_GW_GW_514_HU_OverspeedSoundWarEnable_Rv, rawValue);
        rawValue= 0;
        putValue(E_pubc_GW_GW_514_HU_TSRSwitch_Rv, rawValue);
        rawValue= 0;
        putValue(E_pubc_GW_GW_514_HU_IACCEnable_Rv, rawValue);
        rawValue= 0;
        putValue(E_pubc_GW_GW_514_HU_LASModeSelection_Rv, rawValue);
        break;
     case(1) :
        rawValue= 20;
        putValue(E_pubc_GW_GW_514_HU_OverspeedWarningOffset_Rv, rawValue);
        rawValue= 7;
        putValue(E_pubc_GW_GW_514_HU_LASWarningModeSelection_Rv, rawValue);
        rawValue= 3;
        putValue(E_pubc_GW_GW_514_HU_LDWShakeLev_Rv, rawValue);
        rawValue= 1;
        putValue(E_pubc_GW_GW_514_HU_HMAEnable_Rv, rawValue);
        rawValue= 3;
        putValue(E_pubc_GW_GW_514_HU_OverspeedWarningEnable_Rv, rawValue);
        rawValue= 3;
        putValue(E_pubc_GW_GW_514_HU_OverspeedSoundWarEnable_Rv, rawValue);
        rawValue= 1;
        putValue(E_pubc_GW_GW_514_HU_TSRSwitch_Rv, rawValue);
        rawValue= 3;
        putValue(E_pubc_GW_GW_514_HU_IACCEnable_Rv, rawValue);
        rawValue= 7;
        putValue(E_pubc_GW_GW_514_HU_LASModeSelection_Rv, rawValue);
        break;
     default :
        rawValue= 0;
        putValue(E_pubc_GW_GW_514_HU_OverspeedWarningOffset_Rv, rawValue);
        rawValue= 0;
        putValue(E_pubc_GW_GW_514_HU_LASWarningModeSelection_Rv, rawValue);
        rawValue= 0;
        putValue(E_pubc_GW_GW_514_HU_LDWShakeLev_Rv, rawValue);
        rawValue= 0;
        putValue(E_pubc_GW_GW_514_HU_HMAEnable_Rv, rawValue);
        rawValue= 0;
        putValue(E_pubc_GW_GW_514_HU_OverspeedWarningEnable_Rv, rawValue);
        rawValue= 0;
        putValue(E_pubc_GW_GW_514_HU_OverspeedSoundWarEnable_Rv, rawValue);
        rawValue= 0;
        putValue(E_pubc_GW_GW_514_HU_TSRSwitch_Rv, rawValue);
        rawValue= 0;
        putValue(E_pubc_GW_GW_514_HU_IACCEnable_Rv, rawValue);
        rawValue= 0;
        putValue(E_pubc_GW_GW_514_HU_LASModeSelection_Rv, rawValue);
      break;
   }
}

on envVar E_pubc_GW_GW_514_Dlc
{
    if(getValue(E_pubc_GW_GW_514_enDlc))
    {
        Msg_GW_514.dlc =getValue(this);
    }
    else
    {
        Msg_GW_514.dlc =8;
    }
}

on envVar E_pubc_GW_GW_514_enDlc
{
    //For Messages with DLC = 8, set wrong DLC to smaller than defined DLC
    //For Messages with DLC < 8 set wrong DLC to smaller/longer than defined DLC
    if(getValue(this))
    {
        Msg_GW_514.dlc =getValue(E_pubc_GW_GW_514_Dlc);
    }
    else
    {
        Msg_GW_514.dlc =8;
    }
}


on envVar E_pubc_GW_GW_514_HU_OverspeedWarningOffset_Rv
{
    int64 rawValue = 0ll;
    float rawValue_float = 0.0;
    float phyValue = 0.0;        

    //set the signal with updated raw value
    if(getValue(E_pubc_GW_GW_514_HU_OverspeedWarningOffset_SetVt)==0)
    {
        rawValue = getvalue(this);
        if(chgEv_GW_514_HU_OverspeedWarningOffset == 0)
        {
            //type conversion to float
            rawValue_float = rawValue;        
            // raw to physical conversion
            phyValue = ((rawValue_float *1)+(-10));
            putValue(E_pubc_GW_GW_514_HU_OverspeedWarningOffset_Pv, phyValue);
            chgEv_GW_514_HU_OverspeedWarningOffset = 1;
        }
        else
        {
            chgEv_GW_514_HU_OverspeedWarningOffset = 0;
        }    
        //update the signal value
        Msg_GW_514.HU_OverspeedWarningOffset=rawValue;        
    }                                                                           
}

on envVar E_pubc_GW_GW_514_HU_OverspeedWarningOffset_Pv
{
    int64 rawValue = 0ll;
    float phyValue = 0.0;
    
    //update the raw value with physical value 
    if(getValue(E_pubc_GW_GW_514_HU_OverspeedWarningOffset_SetVt)==0)
    {
        if(chgEv_GW_514_HU_OverspeedWarningOffset == 0)
        {
            phyValue = getvalue(this);
            // physical to raw conversion
            rawValue = ((phyValue -(-10))/1);
            putValue(E_pubc_GW_GW_514_HU_OverspeedWarningOffset_Rv, rawValue);
            chgEv_GW_514_HU_OverspeedWarningOffset = 1;  
        }
        else
        {
            chgEv_GW_514_HU_OverspeedWarningOffset = 0;
        }
    }
}

on envVar E_pubc_GW_GW_514_HU_OverspeedWarningOffset_Vt
{
    qword rawValue = 0ll;
    if(getValue(E_pubc_GW_GW_514_HU_OverspeedWarningOffset_SetVt))
    {
        //update the signal value
        Msg_GW_514.HU_OverspeedWarningOffset=getValue(this);
    }
}

on envVar E_pubc_GW_GW_514_HU_OverspeedWarningOffset_SetVt
{
    if(getValue(E_pubc_GW_GW_514_HU_OverspeedWarningOffset_SetVt))
    {
        //update the signal value
        Msg_GW_514.HU_OverspeedWarningOffset=getvalue(E_pubc_GW_GW_514_HU_OverspeedWarningOffset_Vt);
    }
    else
    {
        Msg_GW_514.HU_OverspeedWarningOffset=getValue(E_pubc_GW_GW_514_HU_OverspeedWarningOffset_Rv);
    }
}
 
on envVar E_pubc_GW_GW_514_HU_LASWarningModeSelection_Rv
{
    int64 rawValue = 0ll;
    float rawValue_float = 0.0;
    float phyValue = 0.0;        

    //set the signal with updated raw value
    if(getValue(E_pubc_GW_GW_514_HU_LASWarningModeSelection_SetVt)==0)
    {
        rawValue = getvalue(this);
        if(chgEv_GW_514_HU_LASWarningModeSelection == 0)
        {
            //type conversion to float
            rawValue_float = rawValue;        
            // raw to physical conversion
            phyValue = ((rawValue_float *1)+(0));
            putValue(E_pubc_GW_GW_514_HU_LASWarningModeSelection_Pv, phyValue);
            chgEv_GW_514_HU_LASWarningModeSelection = 1;
        }
        else
        {
            chgEv_GW_514_HU_LASWarningModeSelection = 0;
        }    
        //update the signal value
        Msg_GW_514.HU_LASWarningModeSelection=rawValue;        
    }                                                                           
}

on envVar E_pubc_GW_GW_514_HU_LASWarningModeSelection_Pv
{
    int64 rawValue = 0ll;
    float phyValue = 0.0;
    
    //update the raw value with physical value 
    if(getValue(E_pubc_GW_GW_514_HU_LASWarningModeSelection_SetVt)==0)
    {
        if(chgEv_GW_514_HU_LASWarningModeSelection == 0)
        {
            phyValue = getvalue(this);
            // physical to raw conversion
            rawValue = ((phyValue -(0))/1);
            putValue(E_pubc_GW_GW_514_HU_LASWarningModeSelection_Rv, rawValue);
            chgEv_GW_514_HU_LASWarningModeSelection = 1;  
        }
        else
        {
            chgEv_GW_514_HU_LASWarningModeSelection = 0;
        }
    }
}

on envVar E_pubc_GW_GW_514_HU_LASWarningModeSelection_Vt
{
    qword rawValue = 0ll;
    if(getValue(E_pubc_GW_GW_514_HU_LASWarningModeSelection_SetVt))
    {
        //update the signal value
        Msg_GW_514.HU_LASWarningModeSelection=getValue(this);
    }
}

on envVar E_pubc_GW_GW_514_HU_LASWarningModeSelection_SetVt
{
    if(getValue(E_pubc_GW_GW_514_HU_LASWarningModeSelection_SetVt))
    {
        //update the signal value
        Msg_GW_514.HU_LASWarningModeSelection=getvalue(E_pubc_GW_GW_514_HU_LASWarningModeSelection_Vt);
    }
    else
    {
        Msg_GW_514.HU_LASWarningModeSelection=getValue(E_pubc_GW_GW_514_HU_LASWarningModeSelection_Rv);
    }
}
 
on envVar E_pubc_GW_GW_514_HU_LDWShakeLev_Rv
{
    int64 rawValue = 0ll;
    float rawValue_float = 0.0;
    float phyValue = 0.0;        

    //set the signal with updated raw value
    if(getValue(E_pubc_GW_GW_514_HU_LDWShakeLev_SetVt)==0)
    {
        rawValue = getvalue(this);
        if(chgEv_GW_514_HU_LDWShakeLev == 0)
        {
            //type conversion to float
            rawValue_float = rawValue;        
            // raw to physical conversion
            phyValue = ((rawValue_float *1)+(0));
            putValue(E_pubc_GW_GW_514_HU_LDWShakeLev_Pv, phyValue);
            chgEv_GW_514_HU_LDWShakeLev = 1;
        }
        else
        {
            chgEv_GW_514_HU_LDWShakeLev = 0;
        }    
        //update the signal value
        Msg_GW_514.HU_LDWShakeLev=rawValue;        
    }                                                                           
}

on envVar E_pubc_GW_GW_514_HU_LDWShakeLev_Pv
{
    int64 rawValue = 0ll;
    float phyValue = 0.0;
    
    //update the raw value with physical value 
    if(getValue(E_pubc_GW_GW_514_HU_LDWShakeLev_SetVt)==0)
    {
        if(chgEv_GW_514_HU_LDWShakeLev == 0)
        {
            phyValue = getvalue(this);
            // physical to raw conversion
            rawValue = ((phyValue -(0))/1);
            putValue(E_pubc_GW_GW_514_HU_LDWShakeLev_Rv, rawValue);
            chgEv_GW_514_HU_LDWShakeLev = 1;  
        }
        else
        {
            chgEv_GW_514_HU_LDWShakeLev = 0;
        }
    }
}

on envVar E_pubc_GW_GW_514_HU_LDWShakeLev_Vt
{
    qword rawValue = 0ll;
    if(getValue(E_pubc_GW_GW_514_HU_LDWShakeLev_SetVt))
    {
        //update the signal value
        Msg_GW_514.HU_LDWShakeLev=getValue(this);
    }
}

on envVar E_pubc_GW_GW_514_HU_LDWShakeLev_SetVt
{
    if(getValue(E_pubc_GW_GW_514_HU_LDWShakeLev_SetVt))
    {
        //update the signal value
        Msg_GW_514.HU_LDWShakeLev=getvalue(E_pubc_GW_GW_514_HU_LDWShakeLev_Vt);
    }
    else
    {
        Msg_GW_514.HU_LDWShakeLev=getValue(E_pubc_GW_GW_514_HU_LDWShakeLev_Rv);
    }
}
 
on envVar E_pubc_GW_GW_514_HU_HMAEnable_Rv
{
    int64 rawValue = 0ll;
    float rawValue_float = 0.0;
    float phyValue = 0.0;        

    //set the signal with updated raw value
    if(getValue(E_pubc_GW_GW_514_HU_HMAEnable_SetVt)==0)
    {
        rawValue = getvalue(this);
        if(chgEv_GW_514_HU_HMAEnable == 0)
        {
            //type conversion to float
            rawValue_float = rawValue;        
            // raw to physical conversion
            phyValue = ((rawValue_float *1)+(0));
            putValue(E_pubc_GW_GW_514_HU_HMAEnable_Pv, phyValue);
            chgEv_GW_514_HU_HMAEnable = 1;
        }
        else
        {
            chgEv_GW_514_HU_HMAEnable = 0;
        }    
        //update the signal value
        Msg_GW_514.HU_HMAEnable=rawValue;        
    }                                                                           
}

on envVar E_pubc_GW_GW_514_HU_HMAEnable_Pv
{
    int64 rawValue = 0ll;
    float phyValue = 0.0;
    
    //update the raw value with physical value 
    if(getValue(E_pubc_GW_GW_514_HU_HMAEnable_SetVt)==0)
    {
        if(chgEv_GW_514_HU_HMAEnable == 0)
        {
            phyValue = getvalue(this);
            // physical to raw conversion
            rawValue = ((phyValue -(0))/1);
            putValue(E_pubc_GW_GW_514_HU_HMAEnable_Rv, rawValue);
            chgEv_GW_514_HU_HMAEnable = 1;  
        }
        else
        {
            chgEv_GW_514_HU_HMAEnable = 0;
        }
    }
}

on envVar E_pubc_GW_GW_514_HU_HMAEnable_Vt
{
    qword rawValue = 0ll;
    if(getValue(E_pubc_GW_GW_514_HU_HMAEnable_SetVt))
    {
        //update the signal value
        Msg_GW_514.HU_HMAEnable=getValue(this);
    }
}

on envVar E_pubc_GW_GW_514_HU_HMAEnable_SetVt
{
    if(getValue(E_pubc_GW_GW_514_HU_HMAEnable_SetVt))
    {
        //update the signal value
        Msg_GW_514.HU_HMAEnable=getvalue(E_pubc_GW_GW_514_HU_HMAEnable_Vt);
    }
    else
    {
        Msg_GW_514.HU_HMAEnable=getValue(E_pubc_GW_GW_514_HU_HMAEnable_Rv);
    }
}
 
on envVar E_pubc_GW_GW_514_HU_OverspeedWarningEnable_Rv
{
    int64 rawValue = 0ll;
    float rawValue_float = 0.0;
    float phyValue = 0.0;        

    //set the signal with updated raw value
    if(getValue(E_pubc_GW_GW_514_HU_OverspeedWarningEnable_SetVt)==0)
    {
        rawValue = getvalue(this);
        if(chgEv_GW_514_HU_OverspeedWarningEnable == 0)
        {
            //type conversion to float
            rawValue_float = rawValue;        
            // raw to physical conversion
            phyValue = ((rawValue_float *1)+(0));
            putValue(E_pubc_GW_GW_514_HU_OverspeedWarningEnable_Pv, phyValue);
            chgEv_GW_514_HU_OverspeedWarningEnable = 1;
        }
        else
        {
            chgEv_GW_514_HU_OverspeedWarningEnable = 0;
        }    
        //update the signal value
        Msg_GW_514.HU_OverspeedWarningEnable=rawValue;        
    }                                                                           
}

on envVar E_pubc_GW_GW_514_HU_OverspeedWarningEnable_Pv
{
    int64 rawValue = 0ll;
    float phyValue = 0.0;
    
    //update the raw value with physical value 
    if(getValue(E_pubc_GW_GW_514_HU_OverspeedWarningEnable_SetVt)==0)
    {
        if(chgEv_GW_514_HU_OverspeedWarningEnable == 0)
        {
            phyValue = getvalue(this);
            // physical to raw conversion
            rawValue = ((phyValue -(0))/1);
            putValue(E_pubc_GW_GW_514_HU_OverspeedWarningEnable_Rv, rawValue);
            chgEv_GW_514_HU_OverspeedWarningEnable = 1;  
        }
        else
        {
            chgEv_GW_514_HU_OverspeedWarningEnable = 0;
        }
    }
}

on envVar E_pubc_GW_GW_514_HU_OverspeedWarningEnable_Vt
{
    qword rawValue = 0ll;
    if(getValue(E_pubc_GW_GW_514_HU_OverspeedWarningEnable_SetVt))
    {
        //update the signal value
        Msg_GW_514.HU_OverspeedWarningEnable=getValue(this);
    }
}

on envVar E_pubc_GW_GW_514_HU_OverspeedWarningEnable_SetVt
{
    if(getValue(E_pubc_GW_GW_514_HU_OverspeedWarningEnable_SetVt))
    {
        //update the signal value
        Msg_GW_514.HU_OverspeedWarningEnable=getvalue(E_pubc_GW_GW_514_HU_OverspeedWarningEnable_Vt);
    }
    else
    {
        Msg_GW_514.HU_OverspeedWarningEnable=getValue(E_pubc_GW_GW_514_HU_OverspeedWarningEnable_Rv);
    }
}
 
on envVar E_pubc_GW_GW_514_HU_OverspeedSoundWarEnable_Rv
{
    int64 rawValue = 0ll;
    float rawValue_float = 0.0;
    float phyValue = 0.0;        

    //set the signal with updated raw value
    if(getValue(E_pubc_GW_GW_514_HU_OverspeedSoundWarEnable_SetVt)==0)
    {
        rawValue = getvalue(this);
        if(chgEv_GW_514_HU_OverspeedSoundWarEnable == 0)
        {
            //type conversion to float
            rawValue_float = rawValue;        
            // raw to physical conversion
            phyValue = ((rawValue_float *1)+(0));
            putValue(E_pubc_GW_GW_514_HU_OverspeedSoundWarEnable_Pv, phyValue);
            chgEv_GW_514_HU_OverspeedSoundWarEnable = 1;
        }
        else
        {
            chgEv_GW_514_HU_OverspeedSoundWarEnable = 0;
        }    
        //update the signal value
        Msg_GW_514.HU_OverspeedSoundWarEnable=rawValue;        
    }                                                                           
}

on envVar E_pubc_GW_GW_514_HU_OverspeedSoundWarEnable_Pv
{
    int64 rawValue = 0ll;
    float phyValue = 0.0;
    
    //update the raw value with physical value 
    if(getValue(E_pubc_GW_GW_514_HU_OverspeedSoundWarEnable_SetVt)==0)
    {
        if(chgEv_GW_514_HU_OverspeedSoundWarEnable == 0)
        {
            phyValue = getvalue(this);
            // physical to raw conversion
            rawValue = ((phyValue -(0))/1);
            putValue(E_pubc_GW_GW_514_HU_OverspeedSoundWarEnable_Rv, rawValue);
            chgEv_GW_514_HU_OverspeedSoundWarEnable = 1;  
        }
        else
        {
            chgEv_GW_514_HU_OverspeedSoundWarEnable = 0;
        }
    }
}

on envVar E_pubc_GW_GW_514_HU_OverspeedSoundWarEnable_Vt
{
    qword rawValue = 0ll;
    if(getValue(E_pubc_GW_GW_514_HU_OverspeedSoundWarEnable_SetVt))
    {
        //update the signal value
        Msg_GW_514.HU_OverspeedSoundWarEnable=getValue(this);
    }
}

on envVar E_pubc_GW_GW_514_HU_OverspeedSoundWarEnable_SetVt
{
    if(getValue(E_pubc_GW_GW_514_HU_OverspeedSoundWarEnable_SetVt))
    {
        //update the signal value
        Msg_GW_514.HU_OverspeedSoundWarEnable=getvalue(E_pubc_GW_GW_514_HU_OverspeedSoundWarEnable_Vt);
    }
    else
    {
        Msg_GW_514.HU_OverspeedSoundWarEnable=getValue(E_pubc_GW_GW_514_HU_OverspeedSoundWarEnable_Rv);
    }
}
 
on envVar E_pubc_GW_GW_514_HU_TSRSwitch_Rv
{
    int64 rawValue = 0ll;
    float rawValue_float = 0.0;
    float phyValue = 0.0;        

    //set the signal with updated raw value
    if(getValue(E_pubc_GW_GW_514_HU_TSRSwitch_SetVt)==0)
    {
        rawValue = getvalue(this);
        if(chgEv_GW_514_HU_TSRSwitch == 0)
        {
            //type conversion to float
            rawValue_float = rawValue;        
            // raw to physical conversion
            phyValue = ((rawValue_float *1)+(0));
            putValue(E_pubc_GW_GW_514_HU_TSRSwitch_Pv, phyValue);
            chgEv_GW_514_HU_TSRSwitch = 1;
        }
        else
        {
            chgEv_GW_514_HU_TSRSwitch = 0;
        }    
        //update the signal value
        Msg_GW_514.HU_TSRSwitch=rawValue;        
    }                                                                           
}

on envVar E_pubc_GW_GW_514_HU_TSRSwitch_Pv
{
    int64 rawValue = 0ll;
    float phyValue = 0.0;
    
    //update the raw value with physical value 
    if(getValue(E_pubc_GW_GW_514_HU_TSRSwitch_SetVt)==0)
    {
        if(chgEv_GW_514_HU_TSRSwitch == 0)
        {
            phyValue = getvalue(this);
            // physical to raw conversion
            rawValue = ((phyValue -(0))/1);
            putValue(E_pubc_GW_GW_514_HU_TSRSwitch_Rv, rawValue);
            chgEv_GW_514_HU_TSRSwitch = 1;  
        }
        else
        {
            chgEv_GW_514_HU_TSRSwitch = 0;
        }
    }
}

on envVar E_pubc_GW_GW_514_HU_TSRSwitch_Vt
{
    qword rawValue = 0ll;
    if(getValue(E_pubc_GW_GW_514_HU_TSRSwitch_SetVt))
    {
        //update the signal value
        Msg_GW_514.HU_TSRSwitch=getValue(this);
    }
}

on envVar E_pubc_GW_GW_514_HU_TSRSwitch_SetVt
{
    if(getValue(E_pubc_GW_GW_514_HU_TSRSwitch_SetVt))
    {
        //update the signal value
        Msg_GW_514.HU_TSRSwitch=getvalue(E_pubc_GW_GW_514_HU_TSRSwitch_Vt);
    }
    else
    {
        Msg_GW_514.HU_TSRSwitch=getValue(E_pubc_GW_GW_514_HU_TSRSwitch_Rv);
    }
}
 
on envVar E_pubc_GW_GW_514_HU_IACCEnable_Rv
{
    int64 rawValue = 0ll;
    float rawValue_float = 0.0;
    float phyValue = 0.0;        

    //set the signal with updated raw value
    if(getValue(E_pubc_GW_GW_514_HU_IACCEnable_SetVt)==0)
    {
        rawValue = getvalue(this);
        if(chgEv_GW_514_HU_IACCEnable == 0)
        {
            //type conversion to float
            rawValue_float = rawValue;        
            // raw to physical conversion
            phyValue = ((rawValue_float *1)+(0));
            putValue(E_pubc_GW_GW_514_HU_IACCEnable_Pv, phyValue);
            chgEv_GW_514_HU_IACCEnable = 1;
        }
        else
        {
            chgEv_GW_514_HU_IACCEnable = 0;
        }    
        //update the signal value
        Msg_GW_514.HU_IACCEnable=rawValue;        
    }                                                                           
}

on envVar E_pubc_GW_GW_514_HU_IACCEnable_Pv
{
    int64 rawValue = 0ll;
    float phyValue = 0.0;
    
    //update the raw value with physical value 
    if(getValue(E_pubc_GW_GW_514_HU_IACCEnable_SetVt)==0)
    {
        if(chgEv_GW_514_HU_IACCEnable == 0)
        {
            phyValue = getvalue(this);
            // physical to raw conversion
            rawValue = ((phyValue -(0))/1);
            putValue(E_pubc_GW_GW_514_HU_IACCEnable_Rv, rawValue);
            chgEv_GW_514_HU_IACCEnable = 1;  
        }
        else
        {
            chgEv_GW_514_HU_IACCEnable = 0;
        }
    }
}

on envVar E_pubc_GW_GW_514_HU_IACCEnable_Vt
{
    qword rawValue = 0ll;
    if(getValue(E_pubc_GW_GW_514_HU_IACCEnable_SetVt))
    {
        //update the signal value
        Msg_GW_514.HU_IACCEnable=getValue(this);
    }
}

on envVar E_pubc_GW_GW_514_HU_IACCEnable_SetVt
{
    if(getValue(E_pubc_GW_GW_514_HU_IACCEnable_SetVt))
    {
        //update the signal value
        Msg_GW_514.HU_IACCEnable=getvalue(E_pubc_GW_GW_514_HU_IACCEnable_Vt);
    }
    else
    {
        Msg_GW_514.HU_IACCEnable=getValue(E_pubc_GW_GW_514_HU_IACCEnable_Rv);
    }
}
 
on envVar E_pubc_GW_GW_514_HU_LASModeSelection_Rv
{
    int64 rawValue = 0ll;
    float rawValue_float = 0.0;
    float phyValue = 0.0;        

    //set the signal with updated raw value
    if(getValue(E_pubc_GW_GW_514_HU_LASModeSelection_SetVt)==0)
    {
        rawValue = getvalue(this);
        if(chgEv_GW_514_HU_LASModeSelection == 0)
        {
            //type conversion to float
            rawValue_float = rawValue;        
            // raw to physical conversion
            phyValue = ((rawValue_float *1)+(0));
            putValue(E_pubc_GW_GW_514_HU_LASModeSelection_Pv, phyValue);
            chgEv_GW_514_HU_LASModeSelection = 1;
        }
        else
        {
            chgEv_GW_514_HU_LASModeSelection = 0;
        }    
        //update the signal value
        Msg_GW_514.HU_LASModeSelection=rawValue;        
    }                                                                           
}

on envVar E_pubc_GW_GW_514_HU_LASModeSelection_Pv
{
    int64 rawValue = 0ll;
    float phyValue = 0.0;
    
    //update the raw value with physical value 
    if(getValue(E_pubc_GW_GW_514_HU_LASModeSelection_SetVt)==0)
    {
        if(chgEv_GW_514_HU_LASModeSelection == 0)
        {
            phyValue = getvalue(this);
            // physical to raw conversion
            rawValue = ((phyValue -(0))/1);
            putValue(E_pubc_GW_GW_514_HU_LASModeSelection_Rv, rawValue);
            chgEv_GW_514_HU_LASModeSelection = 1;  
        }
        else
        {
            chgEv_GW_514_HU_LASModeSelection = 0;
        }
    }
}

on envVar E_pubc_GW_GW_514_HU_LASModeSelection_Vt
{
    qword rawValue = 0ll;
    if(getValue(E_pubc_GW_GW_514_HU_LASModeSelection_SetVt))
    {
        //update the signal value
        Msg_GW_514.HU_LASModeSelection=getValue(this);
    }
}

on envVar E_pubc_GW_GW_514_HU_LASModeSelection_SetVt
{
    if(getValue(E_pubc_GW_GW_514_HU_LASModeSelection_SetVt))
    {
        //update the signal value
        Msg_GW_514.HU_LASModeSelection=getvalue(E_pubc_GW_GW_514_HU_LASModeSelection_Vt);
    }
    else
    {
        Msg_GW_514.HU_LASModeSelection=getValue(E_pubc_GW_GW_514_HU_LASModeSelection_Rv);
    }
}
 
on envVar E_pubc_GW_GW_206_tx
{
    if(getValue(this))
    {       
        
        //update the BZ Signal
        if(GW_206_ESP_RollingCounter_206_wrongvalctr == 0)
        {
            update_GW_206_ESP_RollingCounter_206_counter();
            Msg_GW_206.ESP_RollingCounter_206= GW_206_ESP_RollingCounter_206_counter;
        }
        else if(GW_206_ESP_RollingCounter_206_wrongvalctr > 0)
        {
             GW_206_ESP_RollingCounter_206_wrongvalctr--;
              // if counter becomes zero, update panel controller to zero
             if(GW_206_ESP_RollingCounter_206_wrongvalctr == 0)
             {
                 putValue(E_pubc_GW_GW_206_ESP_RollingCounter_206_wrongvalctr,0);
             }
        }
        else
        {
            //do nothing
        }        
        //calculate the CRC CheckSum
        update_GW_206_CRC_CheckSum();

        output(Msg_GW_206);        
    }
}

on envVar E_pubc_GW_GW_206_Range
{
    qword rawstatus = 0ll;
    qword rawValue = 0ll;    
    
    rawstatus = getvalue(this);    
    // set all the signals with min raw /max raw /init raw
    switch (rawstatus) 
    {
     case(0) :
        rawValue= 0;
        putValue(E_pubc_GW_GW_206_Wheel_Speed_FR_Direction_Rv, rawValue);
        rawValue= 0;
        putValue(E_pubc_GW_GW_206_Wheel_Speed_FR_Valid_Data_Rv, rawValue);
        rawValue= 0;
        putValue(E_pubc_GW_GW_206_Wheel_Speed_FL_Data_Rv, rawValue);
        rawValue= 0;
        putValue(E_pubc_GW_GW_206_Wheel_Speed_FL_Direction_Rv, rawValue);
        rawValue= 0;
        putValue(E_pubc_GW_GW_206_Wheel_Speed_FR_Data_Rv, rawValue);
        rawValue= 0;
        putValue(E_pubc_GW_GW_206_Wheel_Speed_FL_Valid_Data_Rv, rawValue);
        break;
     case(1) :
        rawValue= 3;
        putValue(E_pubc_GW_GW_206_Wheel_Speed_FR_Direction_Rv, rawValue);
        rawValue= 1;
        putValue(E_pubc_GW_GW_206_Wheel_Speed_FR_Valid_Data_Rv, rawValue);
        rawValue= 6400;
        putValue(E_pubc_GW_GW_206_Wheel_Speed_FL_Data_Rv, rawValue);
        rawValue= 3;
        putValue(E_pubc_GW_GW_206_Wheel_Speed_FL_Direction_Rv, rawValue);
        rawValue= 6400;
        putValue(E_pubc_GW_GW_206_Wheel_Speed_FR_Data_Rv, rawValue);
        rawValue= 1;
        putValue(E_pubc_GW_GW_206_Wheel_Speed_FL_Valid_Data_Rv, rawValue);
        break;
     default :
        rawValue= 0;
        putValue(E_pubc_GW_GW_206_Wheel_Speed_FR_Direction_Rv, rawValue);
        rawValue= 0;
        putValue(E_pubc_GW_GW_206_Wheel_Speed_FR_Valid_Data_Rv, rawValue);
        rawValue= 0;
        putValue(E_pubc_GW_GW_206_Wheel_Speed_FL_Data_Rv, rawValue);
        rawValue= 0;
        putValue(E_pubc_GW_GW_206_Wheel_Speed_FL_Direction_Rv, rawValue);
        rawValue= 0;
        putValue(E_pubc_GW_GW_206_Wheel_Speed_FR_Data_Rv, rawValue);
        rawValue= 0;
        putValue(E_pubc_GW_GW_206_Wheel_Speed_FL_Valid_Data_Rv, rawValue);
      break;
   }
}

on envVar E_pubc_GW_GW_206_Dlc
{
    if(getValue(E_pubc_GW_GW_206_enDlc))
    {
        Msg_GW_206.dlc =getValue(this);
    }
    else
    {
        Msg_GW_206.dlc =8;
    }
}

on envVar E_pubc_GW_GW_206_enDlc
{
    //For Messages with DLC = 8, set wrong DLC to smaller than defined DLC
    //For Messages with DLC < 8 set wrong DLC to smaller/longer than defined DLC
    if(getValue(this))
    {
        Msg_GW_206.dlc =getValue(E_pubc_GW_GW_206_Dlc);
    }
    else
    {
        Msg_GW_206.dlc =8;
    }
}

on envVar E_pubc_GW_GW_206_ESP_CRCCheck_206_wrongvalctr
{
    //update disturb count
    //disturb value range:(-1 = always send wrong value),( X>0 ,x is the number of Messages with wrong CHK sent)
    GW_206_ESP_CRCCheck_206_wrongvalctr =getValue(this);    
}
on envVar E_pubc_GW_GW_206_ESP_RollingCounter_206_wrongvalctr
{
    //update disturb count
    //disturb value range:(-1 = always send wrong value),( X>0 ,x is the number of Messages with wrong CHK sent)
    GW_206_ESP_RollingCounter_206_wrongvalctr =getValue(this);    
}

on envVar E_pubc_GW_GW_206_Wheel_Speed_FR_Direction_Rv
{
    int64 rawValue = 0ll;
    float rawValue_float = 0.0;
    float phyValue = 0.0;        

    //set the signal with updated raw value
    if(getValue(E_pubc_GW_GW_206_Wheel_Speed_FR_Direction_SetVt)==0)
    {
        rawValue = getvalue(this);
        if(chgEv_GW_206_Wheel_Speed_FR_Direction == 0)
        {
            //type conversion to float
            rawValue_float = rawValue;        
            // raw to physical conversion
            phyValue = ((rawValue_float *1)+(0));
            putValue(E_pubc_GW_GW_206_Wheel_Speed_FR_Direction_Pv, phyValue);
            chgEv_GW_206_Wheel_Speed_FR_Direction = 1;
        }
        else
        {
            chgEv_GW_206_Wheel_Speed_FR_Direction = 0;
        }    
        //update the signal value
        Msg_GW_206.Wheel_Speed_FR_Direction=rawValue;        
    }                                                                           
}

on envVar E_pubc_GW_GW_206_Wheel_Speed_FR_Direction_Pv
{
    int64 rawValue = 0ll;
    float phyValue = 0.0;
    
    //update the raw value with physical value 
    if(getValue(E_pubc_GW_GW_206_Wheel_Speed_FR_Direction_SetVt)==0)
    {
        if(chgEv_GW_206_Wheel_Speed_FR_Direction == 0)
        {
            phyValue = getvalue(this);
            // physical to raw conversion
            rawValue = ((phyValue -(0))/1);
            putValue(E_pubc_GW_GW_206_Wheel_Speed_FR_Direction_Rv, rawValue);
            chgEv_GW_206_Wheel_Speed_FR_Direction = 1;  
        }
        else
        {
            chgEv_GW_206_Wheel_Speed_FR_Direction = 0;
        }
    }
}

on envVar E_pubc_GW_GW_206_Wheel_Speed_FR_Direction_Vt
{
    qword rawValue = 0ll;
    if(getValue(E_pubc_GW_GW_206_Wheel_Speed_FR_Direction_SetVt))
    {
        //update the signal value
        Msg_GW_206.Wheel_Speed_FR_Direction=getValue(this);
    }
}

on envVar E_pubc_GW_GW_206_Wheel_Speed_FR_Direction_SetVt
{
    if(getValue(E_pubc_GW_GW_206_Wheel_Speed_FR_Direction_SetVt))
    {
        //update the signal value
        Msg_GW_206.Wheel_Speed_FR_Direction=getvalue(E_pubc_GW_GW_206_Wheel_Speed_FR_Direction_Vt);
    }
    else
    {
        Msg_GW_206.Wheel_Speed_FR_Direction=getValue(E_pubc_GW_GW_206_Wheel_Speed_FR_Direction_Rv);
    }
}
 
on envVar E_pubc_GW_GW_206_Wheel_Speed_FR_Valid_Data_Rv
{
    int64 rawValue = 0ll;
    float rawValue_float = 0.0;
    float phyValue = 0.0;        

    //set the signal with updated raw value
    if(getValue(E_pubc_GW_GW_206_Wheel_Speed_FR_Valid_Data_SetVt)==0)
    {
        rawValue = getvalue(this);
        if(chgEv_GW_206_Wheel_Speed_FR_Valid_Data == 0)
        {
            //type conversion to float
            rawValue_float = rawValue;        
            // raw to physical conversion
            phyValue = ((rawValue_float *1)+(0));
            putValue(E_pubc_GW_GW_206_Wheel_Speed_FR_Valid_Data_Pv, phyValue);
            chgEv_GW_206_Wheel_Speed_FR_Valid_Data = 1;
        }
        else
        {
            chgEv_GW_206_Wheel_Speed_FR_Valid_Data = 0;
        }    
        //update the signal value
        Msg_GW_206.Wheel_Speed_FR_Valid_Data=rawValue;        
    }                                                                           
}

on envVar E_pubc_GW_GW_206_Wheel_Speed_FR_Valid_Data_Pv
{
    int64 rawValue = 0ll;
    float phyValue = 0.0;
    
    //update the raw value with physical value 
    if(getValue(E_pubc_GW_GW_206_Wheel_Speed_FR_Valid_Data_SetVt)==0)
    {
        if(chgEv_GW_206_Wheel_Speed_FR_Valid_Data == 0)
        {
            phyValue = getvalue(this);
            // physical to raw conversion
            rawValue = ((phyValue -(0))/1);
            putValue(E_pubc_GW_GW_206_Wheel_Speed_FR_Valid_Data_Rv, rawValue);
            chgEv_GW_206_Wheel_Speed_FR_Valid_Data = 1;  
        }
        else
        {
            chgEv_GW_206_Wheel_Speed_FR_Valid_Data = 0;
        }
    }
}

on envVar E_pubc_GW_GW_206_Wheel_Speed_FR_Valid_Data_Vt
{
    qword rawValue = 0ll;
    if(getValue(E_pubc_GW_GW_206_Wheel_Speed_FR_Valid_Data_SetVt))
    {
        //update the signal value
        Msg_GW_206.Wheel_Speed_FR_Valid_Data=getValue(this);
    }
}

on envVar E_pubc_GW_GW_206_Wheel_Speed_FR_Valid_Data_SetVt
{
    if(getValue(E_pubc_GW_GW_206_Wheel_Speed_FR_Valid_Data_SetVt))
    {
        //update the signal value
        Msg_GW_206.Wheel_Speed_FR_Valid_Data=getvalue(E_pubc_GW_GW_206_Wheel_Speed_FR_Valid_Data_Vt);
    }
    else
    {
        Msg_GW_206.Wheel_Speed_FR_Valid_Data=getValue(E_pubc_GW_GW_206_Wheel_Speed_FR_Valid_Data_Rv);
    }
}
 
on envVar E_pubc_GW_GW_206_Wheel_Speed_FL_Data_Rv
{
    int64 rawValue = 0ll;
    float rawValue_float = 0.0;
    float phyValue = 0.0;        

    //set the signal with updated raw value
    {
        rawValue = getvalue(this);
        if(chgEv_GW_206_Wheel_Speed_FL_Data == 0)
        {
            //type conversion to float
            rawValue_float = rawValue;        
            // raw to physical conversion
            phyValue = ((rawValue_float *0.05625)+(0));
            putValue(E_pubc_GW_GW_206_Wheel_Speed_FL_Data_Pv, phyValue);
            chgEv_GW_206_Wheel_Speed_FL_Data = 1;
        }
        else
        {
            chgEv_GW_206_Wheel_Speed_FL_Data = 0;
        }    
        //update the signal value
        Msg_GW_206.Wheel_Speed_FL_Data=rawValue;        
    }                                                                           
}

on envVar E_pubc_GW_GW_206_Wheel_Speed_FL_Data_Pv
{
    int64 rawValue = 0ll;
    float phyValue = 0.0;
    
    //update the raw value with physical value 
    {
        if(chgEv_GW_206_Wheel_Speed_FL_Data == 0)
        {
            phyValue = getvalue(this);
            // physical to raw conversion
            rawValue = ((phyValue -(0))/0.05625);
            putValue(E_pubc_GW_GW_206_Wheel_Speed_FL_Data_Rv, rawValue);
            chgEv_GW_206_Wheel_Speed_FL_Data = 1;  
        }
        else
        {
            chgEv_GW_206_Wheel_Speed_FL_Data = 0;
        }
    }
}


 
on envVar E_pubc_GW_GW_206_Wheel_Speed_FL_Direction_Rv
{
    int64 rawValue = 0ll;
    float rawValue_float = 0.0;
    float phyValue = 0.0;        

    //set the signal with updated raw value
    if(getValue(E_pubc_GW_GW_206_Wheel_Speed_FL_Direction_SetVt)==0)
    {
        rawValue = getvalue(this);
        if(chgEv_GW_206_Wheel_Speed_FL_Direction == 0)
        {
            //type conversion to float
            rawValue_float = rawValue;        
            // raw to physical conversion
            phyValue = ((rawValue_float *1)+(0));
            putValue(E_pubc_GW_GW_206_Wheel_Speed_FL_Direction_Pv, phyValue);
            chgEv_GW_206_Wheel_Speed_FL_Direction = 1;
        }
        else
        {
            chgEv_GW_206_Wheel_Speed_FL_Direction = 0;
        }    
        //update the signal value
        Msg_GW_206.Wheel_Speed_FL_Direction=rawValue;        
    }                                                                           
}

on envVar E_pubc_GW_GW_206_Wheel_Speed_FL_Direction_Pv
{
    int64 rawValue = 0ll;
    float phyValue = 0.0;
    
    //update the raw value with physical value 
    if(getValue(E_pubc_GW_GW_206_Wheel_Speed_FL_Direction_SetVt)==0)
    {
        if(chgEv_GW_206_Wheel_Speed_FL_Direction == 0)
        {
            phyValue = getvalue(this);
            // physical to raw conversion
            rawValue = ((phyValue -(0))/1);
            putValue(E_pubc_GW_GW_206_Wheel_Speed_FL_Direction_Rv, rawValue);
            chgEv_GW_206_Wheel_Speed_FL_Direction = 1;  
        }
        else
        {
            chgEv_GW_206_Wheel_Speed_FL_Direction = 0;
        }
    }
}

on envVar E_pubc_GW_GW_206_Wheel_Speed_FL_Direction_Vt
{
    qword rawValue = 0ll;
    if(getValue(E_pubc_GW_GW_206_Wheel_Speed_FL_Direction_SetVt))
    {
        //update the signal value
        Msg_GW_206.Wheel_Speed_FL_Direction=getValue(this);
    }
}

on envVar E_pubc_GW_GW_206_Wheel_Speed_FL_Direction_SetVt
{
    if(getValue(E_pubc_GW_GW_206_Wheel_Speed_FL_Direction_SetVt))
    {
        //update the signal value
        Msg_GW_206.Wheel_Speed_FL_Direction=getvalue(E_pubc_GW_GW_206_Wheel_Speed_FL_Direction_Vt);
    }
    else
    {
        Msg_GW_206.Wheel_Speed_FL_Direction=getValue(E_pubc_GW_GW_206_Wheel_Speed_FL_Direction_Rv);
    }
}
 
on envVar E_pubc_GW_GW_206_Wheel_Speed_FR_Data_Rv
{
    int64 rawValue = 0ll;
    float rawValue_float = 0.0;
    float phyValue = 0.0;        

    //set the signal with updated raw value
    {
        rawValue = getvalue(this);
        if(chgEv_GW_206_Wheel_Speed_FR_Data == 0)
        {
            //type conversion to float
            rawValue_float = rawValue;        
            // raw to physical conversion
            phyValue = ((rawValue_float *0.05625)+(0));
            putValue(E_pubc_GW_GW_206_Wheel_Speed_FR_Data_Pv, phyValue);
            chgEv_GW_206_Wheel_Speed_FR_Data = 1;
        }
        else
        {
            chgEv_GW_206_Wheel_Speed_FR_Data = 0;
        }    
        //update the signal value
        Msg_GW_206.Wheel_Speed_FR_Data=rawValue;        
    }                                                                           
}

on envVar E_pubc_GW_GW_206_Wheel_Speed_FR_Data_Pv
{
    int64 rawValue = 0ll;
    float phyValue = 0.0;
    
    //update the raw value with physical value 
    {
        if(chgEv_GW_206_Wheel_Speed_FR_Data == 0)
        {
            phyValue = getvalue(this);
            // physical to raw conversion
            rawValue = ((phyValue -(0))/0.05625);
            putValue(E_pubc_GW_GW_206_Wheel_Speed_FR_Data_Rv, rawValue);
            chgEv_GW_206_Wheel_Speed_FR_Data = 1;  
        }
        else
        {
            chgEv_GW_206_Wheel_Speed_FR_Data = 0;
        }
    }
}


 
on envVar E_pubc_GW_GW_206_Wheel_Speed_FL_Valid_Data_Rv
{
    int64 rawValue = 0ll;
    float rawValue_float = 0.0;
    float phyValue = 0.0;        

    //set the signal with updated raw value
    if(getValue(E_pubc_GW_GW_206_Wheel_Speed_FL_Valid_Data_SetVt)==0)
    {
        rawValue = getvalue(this);
        if(chgEv_GW_206_Wheel_Speed_FL_Valid_Data == 0)
        {
            //type conversion to float
            rawValue_float = rawValue;        
            // raw to physical conversion
            phyValue = ((rawValue_float *1)+(0));
            putValue(E_pubc_GW_GW_206_Wheel_Speed_FL_Valid_Data_Pv, phyValue);
            chgEv_GW_206_Wheel_Speed_FL_Valid_Data = 1;
        }
        else
        {
            chgEv_GW_206_Wheel_Speed_FL_Valid_Data = 0;
        }    
        //update the signal value
        Msg_GW_206.Wheel_Speed_FL_Valid_Data=rawValue;        
    }                                                                           
}

on envVar E_pubc_GW_GW_206_Wheel_Speed_FL_Valid_Data_Pv
{
    int64 rawValue = 0ll;
    float phyValue = 0.0;
    
    //update the raw value with physical value 
    if(getValue(E_pubc_GW_GW_206_Wheel_Speed_FL_Valid_Data_SetVt)==0)
    {
        if(chgEv_GW_206_Wheel_Speed_FL_Valid_Data == 0)
        {
            phyValue = getvalue(this);
            // physical to raw conversion
            rawValue = ((phyValue -(0))/1);
            putValue(E_pubc_GW_GW_206_Wheel_Speed_FL_Valid_Data_Rv, rawValue);
            chgEv_GW_206_Wheel_Speed_FL_Valid_Data = 1;  
        }
        else
        {
            chgEv_GW_206_Wheel_Speed_FL_Valid_Data = 0;
        }
    }
}

on envVar E_pubc_GW_GW_206_Wheel_Speed_FL_Valid_Data_Vt
{
    qword rawValue = 0ll;
    if(getValue(E_pubc_GW_GW_206_Wheel_Speed_FL_Valid_Data_SetVt))
    {
        //update the signal value
        Msg_GW_206.Wheel_Speed_FL_Valid_Data=getValue(this);
    }
}

on envVar E_pubc_GW_GW_206_Wheel_Speed_FL_Valid_Data_SetVt
{
    if(getValue(E_pubc_GW_GW_206_Wheel_Speed_FL_Valid_Data_SetVt))
    {
        //update the signal value
        Msg_GW_206.Wheel_Speed_FL_Valid_Data=getvalue(E_pubc_GW_GW_206_Wheel_Speed_FL_Valid_Data_Vt);
    }
    else
    {
        Msg_GW_206.Wheel_Speed_FL_Valid_Data=getValue(E_pubc_GW_GW_206_Wheel_Speed_FL_Valid_Data_Rv);
    }
}
 
on envVar E_pubc_GW_GW_340_tx
{
    if(getValue(this))
    {       
        

        output(Msg_GW_340);        
    }
}

on envVar E_pubc_GW_GW_340_Range
{
    qword rawstatus = 0ll;
    qword rawValue = 0ll;    
    
    rawstatus = getvalue(this);    
    // set all the signals with min raw /max raw /init raw
    switch (rawstatus) 
    {
     case(0) :
        rawValue= 0;
        putValue(E_pubc_GW_GW_340_AC_FrBlowType_Rv, rawValue);
        break;
     case(1) :
        rawValue= 7;
        putValue(E_pubc_GW_GW_340_AC_FrBlowType_Rv, rawValue);
        break;
     default :
        rawValue= 0;
        putValue(E_pubc_GW_GW_340_AC_FrBlowType_Rv, rawValue);
      break;
   }
}

on envVar E_pubc_GW_GW_340_Dlc
{
    if(getValue(E_pubc_GW_GW_340_enDlc))
    {
        Msg_GW_340.dlc =getValue(this);
    }
    else
    {
        Msg_GW_340.dlc =8;
    }
}

on envVar E_pubc_GW_GW_340_enDlc
{
    //For Messages with DLC = 8, set wrong DLC to smaller than defined DLC
    //For Messages with DLC < 8 set wrong DLC to smaller/longer than defined DLC
    if(getValue(this))
    {
        Msg_GW_340.dlc =getValue(E_pubc_GW_GW_340_Dlc);
    }
    else
    {
        Msg_GW_340.dlc =8;
    }
}


on envVar E_pubc_GW_GW_340_AC_FrBlowType_Rv
{
    int64 rawValue = 0ll;
    float rawValue_float = 0.0;
    float phyValue = 0.0;        

    //set the signal with updated raw value
    if(getValue(E_pubc_GW_GW_340_AC_FrBlowType_SetVt)==0)
    {
        rawValue = getvalue(this);
        if(chgEv_GW_340_AC_FrBlowType == 0)
        {
            //type conversion to float
            rawValue_float = rawValue;        
            // raw to physical conversion
            phyValue = ((rawValue_float *1)+(0));
            putValue(E_pubc_GW_GW_340_AC_FrBlowType_Pv, phyValue);
            chgEv_GW_340_AC_FrBlowType = 1;
        }
        else
        {
            chgEv_GW_340_AC_FrBlowType = 0;
        }    
        //update the signal value
        Msg_GW_340.AC_FrBlowType=rawValue;        
    }                                                                           
}

on envVar E_pubc_GW_GW_340_AC_FrBlowType_Pv
{
    int64 rawValue = 0ll;
    float phyValue = 0.0;
    
    //update the raw value with physical value 
    if(getValue(E_pubc_GW_GW_340_AC_FrBlowType_SetVt)==0)
    {
        if(chgEv_GW_340_AC_FrBlowType == 0)
        {
            phyValue = getvalue(this);
            // physical to raw conversion
            rawValue = ((phyValue -(0))/1);
            putValue(E_pubc_GW_GW_340_AC_FrBlowType_Rv, rawValue);
            chgEv_GW_340_AC_FrBlowType = 1;  
        }
        else
        {
            chgEv_GW_340_AC_FrBlowType = 0;
        }
    }
}

on envVar E_pubc_GW_GW_340_AC_FrBlowType_Vt
{
    qword rawValue = 0ll;
    if(getValue(E_pubc_GW_GW_340_AC_FrBlowType_SetVt))
    {
        //update the signal value
        Msg_GW_340.AC_FrBlowType=getValue(this);
    }
}

on envVar E_pubc_GW_GW_340_AC_FrBlowType_SetVt
{
    if(getValue(E_pubc_GW_GW_340_AC_FrBlowType_SetVt))
    {
        //update the signal value
        Msg_GW_340.AC_FrBlowType=getvalue(E_pubc_GW_GW_340_AC_FrBlowType_Vt);
    }
    else
    {
        Msg_GW_340.AC_FrBlowType=getValue(E_pubc_GW_GW_340_AC_FrBlowType_Rv);
    }
}
 
on envVar E_pubc_GW_GW_28C_tx
{
    if(getValue(this))
    {       
        
        //update the BZ Signal
        if(GW_28C_GW_MFS_RollingCounter_28C_wrongvalctr == 0)
        {
            update_GW_28C_GW_MFS_RollingCounter_28C_counter();
            Msg_GW_28C.GW_MFS_RollingCounter_28C= GW_28C_GW_MFS_RollingCounter_28C_counter;
        }
        else if(GW_28C_GW_MFS_RollingCounter_28C_wrongvalctr > 0)
        {
             GW_28C_GW_MFS_RollingCounter_28C_wrongvalctr--;
              // if counter becomes zero, update panel controller to zero
             if(GW_28C_GW_MFS_RollingCounter_28C_wrongvalctr == 0)
             {
                 putValue(E_pubc_GW_GW_28C_GW_MFS_RollingCounter_28C_wrongvalctr,0);
             }
        }
        else
        {
            //do nothing
        }        
        //calculate the CRC CheckSum
        update_GW_28C_CRC_CheckSum();

        output(Msg_GW_28C);        
    }
}

on envVar E_pubc_GW_GW_28C_Range
{
    qword rawstatus = 0ll;
    qword rawValue = 0ll;    
    
    rawstatus = getvalue(this);    
    // set all the signals with min raw /max raw /init raw
    switch (rawstatus) 
    {
     case(0) :
        rawValue= 0;
        putValue(E_pubc_GW_GW_28C_GW_MFS_HODSystemStatus_Rv, rawValue);
        rawValue= 0;
        putValue(E_pubc_GW_GW_28C_GW_MFS_HODLinStatus_Rv, rawValue);
        rawValue= 0;
        putValue(E_pubc_GW_GW_28C_GW_MFS_HODSenserStatus_Rv, rawValue);
        rawValue= 0;
        putValue(E_pubc_GW_GW_28C_GW_MFS_HODAppStatus_Rv, rawValue);
        rawValue= 0;
        putValue(E_pubc_GW_GW_28C_GW_MFS_handsoffAbilityDetect_Rv, rawValue);
        rawValue= 0;
        putValue(E_pubc_GW_GW_28C_GW_MFS_handsoffDetectResult_Rv, rawValue);
        rawValue= 0;
        putValue(E_pubc_GW_GW_28C_GW_MFS_DiagInfoSW_28C_Rv, rawValue);
        rawValue= 0;
        putValue(E_pubc_GW_GW_28C_GW_MFS_IACCenable_switch_signal_Rv, rawValue);
        rawValue= 0;
        putValue(E_pubc_GW_GW_28C_GW_MFS_HODCalibratedStatus_Rv, rawValue);
        break;
     case(1) :
        rawValue= 7;
        putValue(E_pubc_GW_GW_28C_GW_MFS_HODSystemStatus_Rv, rawValue);
        rawValue= 1;
        putValue(E_pubc_GW_GW_28C_GW_MFS_HODLinStatus_Rv, rawValue);
        rawValue= 1;
        putValue(E_pubc_GW_GW_28C_GW_MFS_HODSenserStatus_Rv, rawValue);
        rawValue= 1;
        putValue(E_pubc_GW_GW_28C_GW_MFS_HODAppStatus_Rv, rawValue);
        rawValue= 7;
        putValue(E_pubc_GW_GW_28C_GW_MFS_handsoffAbilityDetect_Rv, rawValue);
        rawValue= 7;
        putValue(E_pubc_GW_GW_28C_GW_MFS_handsoffDetectResult_Rv, rawValue);
        rawValue= 7;
        putValue(E_pubc_GW_GW_28C_GW_MFS_DiagInfoSW_28C_Rv, rawValue);
        rawValue= 3;
        putValue(E_pubc_GW_GW_28C_GW_MFS_IACCenable_switch_signal_Rv, rawValue);
        rawValue= 1;
        putValue(E_pubc_GW_GW_28C_GW_MFS_HODCalibratedStatus_Rv, rawValue);
        break;
     default :
        rawValue= 0;
        putValue(E_pubc_GW_GW_28C_GW_MFS_HODSystemStatus_Rv, rawValue);
        rawValue= 0;
        putValue(E_pubc_GW_GW_28C_GW_MFS_HODLinStatus_Rv, rawValue);
        rawValue= 0;
        putValue(E_pubc_GW_GW_28C_GW_MFS_HODSenserStatus_Rv, rawValue);
        rawValue= 0;
        putValue(E_pubc_GW_GW_28C_GW_MFS_HODAppStatus_Rv, rawValue);
        rawValue= 0;
        putValue(E_pubc_GW_GW_28C_GW_MFS_handsoffAbilityDetect_Rv, rawValue);
        rawValue= 0;
        putValue(E_pubc_GW_GW_28C_GW_MFS_handsoffDetectResult_Rv, rawValue);
        rawValue= 0;
        putValue(E_pubc_GW_GW_28C_GW_MFS_DiagInfoSW_28C_Rv, rawValue);
        rawValue= 0;
        putValue(E_pubc_GW_GW_28C_GW_MFS_IACCenable_switch_signal_Rv, rawValue);
        rawValue= 0;
        putValue(E_pubc_GW_GW_28C_GW_MFS_HODCalibratedStatus_Rv, rawValue);
      break;
   }
}

on envVar E_pubc_GW_GW_28C_Dlc
{
    if(getValue(E_pubc_GW_GW_28C_enDlc))
    {
        Msg_GW_28C.dlc =getValue(this);
    }
    else
    {
        Msg_GW_28C.dlc =8;
    }
}

on envVar E_pubc_GW_GW_28C_enDlc
{
    //For Messages with DLC = 8, set wrong DLC to smaller than defined DLC
    //For Messages with DLC < 8 set wrong DLC to smaller/longer than defined DLC
    if(getValue(this))
    {
        Msg_GW_28C.dlc =getValue(E_pubc_GW_GW_28C_Dlc);
    }
    else
    {
        Msg_GW_28C.dlc =8;
    }
}

on envVar E_pubc_GW_GW_28C_GW_MFS_CRCCheck_28C_wrongvalctr
{
    //update disturb count
    //disturb value range:(-1 = always send wrong value),( X>0 ,x is the number of Messages with wrong CHK sent)
    GW_28C_GW_MFS_CRCCheck_28C_wrongvalctr =getValue(this);    
}
on envVar E_pubc_GW_GW_28C_GW_MFS_RollingCounter_28C_wrongvalctr
{
    //update disturb count
    //disturb value range:(-1 = always send wrong value),( X>0 ,x is the number of Messages with wrong CHK sent)
    GW_28C_GW_MFS_RollingCounter_28C_wrongvalctr =getValue(this);    
}

on envVar E_pubc_GW_GW_28C_GW_MFS_HODSystemStatus_Rv
{
    int64 rawValue = 0ll;
    float rawValue_float = 0.0;
    float phyValue = 0.0;        

    //set the signal with updated raw value
    if(getValue(E_pubc_GW_GW_28C_GW_MFS_HODSystemStatus_SetVt)==0)
    {
        rawValue = getvalue(this);
        if(chgEv_GW_28C_GW_MFS_HODSystemStatus == 0)
        {
            //type conversion to float
            rawValue_float = rawValue;        
            // raw to physical conversion
            phyValue = ((rawValue_float *1)+(0));
            putValue(E_pubc_GW_GW_28C_GW_MFS_HODSystemStatus_Pv, phyValue);
            chgEv_GW_28C_GW_MFS_HODSystemStatus = 1;
        }
        else
        {
            chgEv_GW_28C_GW_MFS_HODSystemStatus = 0;
        }    
        //update the signal value
        Msg_GW_28C.GW_MFS_HODSystemStatus=rawValue;        
    }                                                                           
}

on envVar E_pubc_GW_GW_28C_GW_MFS_HODSystemStatus_Pv
{
    int64 rawValue = 0ll;
    float phyValue = 0.0;
    
    //update the raw value with physical value 
    if(getValue(E_pubc_GW_GW_28C_GW_MFS_HODSystemStatus_SetVt)==0)
    {
        if(chgEv_GW_28C_GW_MFS_HODSystemStatus == 0)
        {
            phyValue = getvalue(this);
            // physical to raw conversion
            rawValue = ((phyValue -(0))/1);
            putValue(E_pubc_GW_GW_28C_GW_MFS_HODSystemStatus_Rv, rawValue);
            chgEv_GW_28C_GW_MFS_HODSystemStatus = 1;  
        }
        else
        {
            chgEv_GW_28C_GW_MFS_HODSystemStatus = 0;
        }
    }
}

on envVar E_pubc_GW_GW_28C_GW_MFS_HODSystemStatus_Vt
{
    qword rawValue = 0ll;
    if(getValue(E_pubc_GW_GW_28C_GW_MFS_HODSystemStatus_SetVt))
    {
        //update the signal value
        Msg_GW_28C.GW_MFS_HODSystemStatus=getValue(this);
    }
}

on envVar E_pubc_GW_GW_28C_GW_MFS_HODSystemStatus_SetVt
{
    if(getValue(E_pubc_GW_GW_28C_GW_MFS_HODSystemStatus_SetVt))
    {
        //update the signal value
        Msg_GW_28C.GW_MFS_HODSystemStatus=getvalue(E_pubc_GW_GW_28C_GW_MFS_HODSystemStatus_Vt);
    }
    else
    {
        Msg_GW_28C.GW_MFS_HODSystemStatus=getValue(E_pubc_GW_GW_28C_GW_MFS_HODSystemStatus_Rv);
    }
}
 
on envVar E_pubc_GW_GW_28C_GW_MFS_HODLinStatus_Rv
{
    int64 rawValue = 0ll;
    float rawValue_float = 0.0;
    float phyValue = 0.0;        

    //set the signal with updated raw value
    if(getValue(E_pubc_GW_GW_28C_GW_MFS_HODLinStatus_SetVt)==0)
    {
        rawValue = getvalue(this);
        if(chgEv_GW_28C_GW_MFS_HODLinStatus == 0)
        {
            //type conversion to float
            rawValue_float = rawValue;        
            // raw to physical conversion
            phyValue = ((rawValue_float *1)+(0));
            putValue(E_pubc_GW_GW_28C_GW_MFS_HODLinStatus_Pv, phyValue);
            chgEv_GW_28C_GW_MFS_HODLinStatus = 1;
        }
        else
        {
            chgEv_GW_28C_GW_MFS_HODLinStatus = 0;
        }    
        //update the signal value
        Msg_GW_28C.GW_MFS_HODLinStatus=rawValue;        
    }                                                                           
}

on envVar E_pubc_GW_GW_28C_GW_MFS_HODLinStatus_Pv
{
    int64 rawValue = 0ll;
    float phyValue = 0.0;
    
    //update the raw value with physical value 
    if(getValue(E_pubc_GW_GW_28C_GW_MFS_HODLinStatus_SetVt)==0)
    {
        if(chgEv_GW_28C_GW_MFS_HODLinStatus == 0)
        {
            phyValue = getvalue(this);
            // physical to raw conversion
            rawValue = ((phyValue -(0))/1);
            putValue(E_pubc_GW_GW_28C_GW_MFS_HODLinStatus_Rv, rawValue);
            chgEv_GW_28C_GW_MFS_HODLinStatus = 1;  
        }
        else
        {
            chgEv_GW_28C_GW_MFS_HODLinStatus = 0;
        }
    }
}

on envVar E_pubc_GW_GW_28C_GW_MFS_HODLinStatus_Vt
{
    qword rawValue = 0ll;
    if(getValue(E_pubc_GW_GW_28C_GW_MFS_HODLinStatus_SetVt))
    {
        //update the signal value
        Msg_GW_28C.GW_MFS_HODLinStatus=getValue(this);
    }
}

on envVar E_pubc_GW_GW_28C_GW_MFS_HODLinStatus_SetVt
{
    if(getValue(E_pubc_GW_GW_28C_GW_MFS_HODLinStatus_SetVt))
    {
        //update the signal value
        Msg_GW_28C.GW_MFS_HODLinStatus=getvalue(E_pubc_GW_GW_28C_GW_MFS_HODLinStatus_Vt);
    }
    else
    {
        Msg_GW_28C.GW_MFS_HODLinStatus=getValue(E_pubc_GW_GW_28C_GW_MFS_HODLinStatus_Rv);
    }
}
 
on envVar E_pubc_GW_GW_28C_GW_MFS_HODSenserStatus_Rv
{
    int64 rawValue = 0ll;
    float rawValue_float = 0.0;
    float phyValue = 0.0;        

    //set the signal with updated raw value
    if(getValue(E_pubc_GW_GW_28C_GW_MFS_HODSenserStatus_SetVt)==0)
    {
        rawValue = getvalue(this);
        if(chgEv_GW_28C_GW_MFS_HODSenserStatus == 0)
        {
            //type conversion to float
            rawValue_float = rawValue;        
            // raw to physical conversion
            phyValue = ((rawValue_float *1)+(0));
            putValue(E_pubc_GW_GW_28C_GW_MFS_HODSenserStatus_Pv, phyValue);
            chgEv_GW_28C_GW_MFS_HODSenserStatus = 1;
        }
        else
        {
            chgEv_GW_28C_GW_MFS_HODSenserStatus = 0;
        }    
        //update the signal value
        Msg_GW_28C.GW_MFS_HODSenserStatus=rawValue;        
    }                                                                           
}

on envVar E_pubc_GW_GW_28C_GW_MFS_HODSenserStatus_Pv
{
    int64 rawValue = 0ll;
    float phyValue = 0.0;
    
    //update the raw value with physical value 
    if(getValue(E_pubc_GW_GW_28C_GW_MFS_HODSenserStatus_SetVt)==0)
    {
        if(chgEv_GW_28C_GW_MFS_HODSenserStatus == 0)
        {
            phyValue = getvalue(this);
            // physical to raw conversion
            rawValue = ((phyValue -(0))/1);
            putValue(E_pubc_GW_GW_28C_GW_MFS_HODSenserStatus_Rv, rawValue);
            chgEv_GW_28C_GW_MFS_HODSenserStatus = 1;  
        }
        else
        {
            chgEv_GW_28C_GW_MFS_HODSenserStatus = 0;
        }
    }
}

on envVar E_pubc_GW_GW_28C_GW_MFS_HODSenserStatus_Vt
{
    qword rawValue = 0ll;
    if(getValue(E_pubc_GW_GW_28C_GW_MFS_HODSenserStatus_SetVt))
    {
        //update the signal value
        Msg_GW_28C.GW_MFS_HODSenserStatus=getValue(this);
    }
}

on envVar E_pubc_GW_GW_28C_GW_MFS_HODSenserStatus_SetVt
{
    if(getValue(E_pubc_GW_GW_28C_GW_MFS_HODSenserStatus_SetVt))
    {
        //update the signal value
        Msg_GW_28C.GW_MFS_HODSenserStatus=getvalue(E_pubc_GW_GW_28C_GW_MFS_HODSenserStatus_Vt);
    }
    else
    {
        Msg_GW_28C.GW_MFS_HODSenserStatus=getValue(E_pubc_GW_GW_28C_GW_MFS_HODSenserStatus_Rv);
    }
}
 
on envVar E_pubc_GW_GW_28C_GW_MFS_HODAppStatus_Rv
{
    int64 rawValue = 0ll;
    float rawValue_float = 0.0;
    float phyValue = 0.0;        

    //set the signal with updated raw value
    if(getValue(E_pubc_GW_GW_28C_GW_MFS_HODAppStatus_SetVt)==0)
    {
        rawValue = getvalue(this);
        if(chgEv_GW_28C_GW_MFS_HODAppStatus == 0)
        {
            //type conversion to float
            rawValue_float = rawValue;        
            // raw to physical conversion
            phyValue = ((rawValue_float *1)+(0));
            putValue(E_pubc_GW_GW_28C_GW_MFS_HODAppStatus_Pv, phyValue);
            chgEv_GW_28C_GW_MFS_HODAppStatus = 1;
        }
        else
        {
            chgEv_GW_28C_GW_MFS_HODAppStatus = 0;
        }    
        //update the signal value
        Msg_GW_28C.GW_MFS_HODAppStatus=rawValue;        
    }                                                                           
}

on envVar E_pubc_GW_GW_28C_GW_MFS_HODAppStatus_Pv
{
    int64 rawValue = 0ll;
    float phyValue = 0.0;
    
    //update the raw value with physical value 
    if(getValue(E_pubc_GW_GW_28C_GW_MFS_HODAppStatus_SetVt)==0)
    {
        if(chgEv_GW_28C_GW_MFS_HODAppStatus == 0)
        {
            phyValue = getvalue(this);
            // physical to raw conversion
            rawValue = ((phyValue -(0))/1);
            putValue(E_pubc_GW_GW_28C_GW_MFS_HODAppStatus_Rv, rawValue);
            chgEv_GW_28C_GW_MFS_HODAppStatus = 1;  
        }
        else
        {
            chgEv_GW_28C_GW_MFS_HODAppStatus = 0;
        }
    }
}

on envVar E_pubc_GW_GW_28C_GW_MFS_HODAppStatus_Vt
{
    qword rawValue = 0ll;
    if(getValue(E_pubc_GW_GW_28C_GW_MFS_HODAppStatus_SetVt))
    {
        //update the signal value
        Msg_GW_28C.GW_MFS_HODAppStatus=getValue(this);
    }
}

on envVar E_pubc_GW_GW_28C_GW_MFS_HODAppStatus_SetVt
{
    if(getValue(E_pubc_GW_GW_28C_GW_MFS_HODAppStatus_SetVt))
    {
        //update the signal value
        Msg_GW_28C.GW_MFS_HODAppStatus=getvalue(E_pubc_GW_GW_28C_GW_MFS_HODAppStatus_Vt);
    }
    else
    {
        Msg_GW_28C.GW_MFS_HODAppStatus=getValue(E_pubc_GW_GW_28C_GW_MFS_HODAppStatus_Rv);
    }
}
 
on envVar E_pubc_GW_GW_28C_GW_MFS_handsoffAbilityDetect_Rv
{
    int64 rawValue = 0ll;
    float rawValue_float = 0.0;
    float phyValue = 0.0;        

    //set the signal with updated raw value
    if(getValue(E_pubc_GW_GW_28C_GW_MFS_handsoffAbilityDetect_SetVt)==0)
    {
        rawValue = getvalue(this);
        if(chgEv_GW_28C_GW_MFS_handsoffAbilityDetect == 0)
        {
            //type conversion to float
            rawValue_float = rawValue;        
            // raw to physical conversion
            phyValue = ((rawValue_float *1)+(0));
            putValue(E_pubc_GW_GW_28C_GW_MFS_handsoffAbilityDetect_Pv, phyValue);
            chgEv_GW_28C_GW_MFS_handsoffAbilityDetect = 1;
        }
        else
        {
            chgEv_GW_28C_GW_MFS_handsoffAbilityDetect = 0;
        }    
        //update the signal value
        Msg_GW_28C.GW_MFS_handsoffAbilityDetect=rawValue;        
    }                                                                           
}

on envVar E_pubc_GW_GW_28C_GW_MFS_handsoffAbilityDetect_Pv
{
    int64 rawValue = 0ll;
    float phyValue = 0.0;
    
    //update the raw value with physical value 
    if(getValue(E_pubc_GW_GW_28C_GW_MFS_handsoffAbilityDetect_SetVt)==0)
    {
        if(chgEv_GW_28C_GW_MFS_handsoffAbilityDetect == 0)
        {
            phyValue = getvalue(this);
            // physical to raw conversion
            rawValue = ((phyValue -(0))/1);
            putValue(E_pubc_GW_GW_28C_GW_MFS_handsoffAbilityDetect_Rv, rawValue);
            chgEv_GW_28C_GW_MFS_handsoffAbilityDetect = 1;  
        }
        else
        {
            chgEv_GW_28C_GW_MFS_handsoffAbilityDetect = 0;
        }
    }
}

on envVar E_pubc_GW_GW_28C_GW_MFS_handsoffAbilityDetect_Vt
{
    qword rawValue = 0ll;
    if(getValue(E_pubc_GW_GW_28C_GW_MFS_handsoffAbilityDetect_SetVt))
    {
        //update the signal value
        Msg_GW_28C.GW_MFS_handsoffAbilityDetect=getValue(this);
    }
}

on envVar E_pubc_GW_GW_28C_GW_MFS_handsoffAbilityDetect_SetVt
{
    if(getValue(E_pubc_GW_GW_28C_GW_MFS_handsoffAbilityDetect_SetVt))
    {
        //update the signal value
        Msg_GW_28C.GW_MFS_handsoffAbilityDetect=getvalue(E_pubc_GW_GW_28C_GW_MFS_handsoffAbilityDetect_Vt);
    }
    else
    {
        Msg_GW_28C.GW_MFS_handsoffAbilityDetect=getValue(E_pubc_GW_GW_28C_GW_MFS_handsoffAbilityDetect_Rv);
    }
}
 
on envVar E_pubc_GW_GW_28C_GW_MFS_handsoffDetectResult_Rv
{
    int64 rawValue = 0ll;
    float rawValue_float = 0.0;
    float phyValue = 0.0;        

    //set the signal with updated raw value
    if(getValue(E_pubc_GW_GW_28C_GW_MFS_handsoffDetectResult_SetVt)==0)
    {
        rawValue = getvalue(this);
        if(chgEv_GW_28C_GW_MFS_handsoffDetectResult == 0)
        {
            //type conversion to float
            rawValue_float = rawValue;        
            // raw to physical conversion
            phyValue = ((rawValue_float *1)+(0));
            putValue(E_pubc_GW_GW_28C_GW_MFS_handsoffDetectResult_Pv, phyValue);
            chgEv_GW_28C_GW_MFS_handsoffDetectResult = 1;
        }
        else
        {
            chgEv_GW_28C_GW_MFS_handsoffDetectResult = 0;
        }    
        //update the signal value
        Msg_GW_28C.GW_MFS_handsoffDetectResult=rawValue;        
    }                                                                           
}

on envVar E_pubc_GW_GW_28C_GW_MFS_handsoffDetectResult_Pv
{
    int64 rawValue = 0ll;
    float phyValue = 0.0;
    
    //update the raw value with physical value 
    if(getValue(E_pubc_GW_GW_28C_GW_MFS_handsoffDetectResult_SetVt)==0)
    {
        if(chgEv_GW_28C_GW_MFS_handsoffDetectResult == 0)
        {
            phyValue = getvalue(this);
            // physical to raw conversion
            rawValue = ((phyValue -(0))/1);
            putValue(E_pubc_GW_GW_28C_GW_MFS_handsoffDetectResult_Rv, rawValue);
            chgEv_GW_28C_GW_MFS_handsoffDetectResult = 1;  
        }
        else
        {
            chgEv_GW_28C_GW_MFS_handsoffDetectResult = 0;
        }
    }
}

on envVar E_pubc_GW_GW_28C_GW_MFS_handsoffDetectResult_Vt
{
    qword rawValue = 0ll;
    if(getValue(E_pubc_GW_GW_28C_GW_MFS_handsoffDetectResult_SetVt))
    {
        //update the signal value
        Msg_GW_28C.GW_MFS_handsoffDetectResult=getValue(this);
    }
}

on envVar E_pubc_GW_GW_28C_GW_MFS_handsoffDetectResult_SetVt
{
    if(getValue(E_pubc_GW_GW_28C_GW_MFS_handsoffDetectResult_SetVt))
    {
        //update the signal value
        Msg_GW_28C.GW_MFS_handsoffDetectResult=getvalue(E_pubc_GW_GW_28C_GW_MFS_handsoffDetectResult_Vt);
    }
    else
    {
        Msg_GW_28C.GW_MFS_handsoffDetectResult=getValue(E_pubc_GW_GW_28C_GW_MFS_handsoffDetectResult_Rv);
    }
}
 
on envVar E_pubc_GW_GW_28C_GW_MFS_DiagInfoSW_28C_Rv
{
    int64 rawValue = 0ll;
    float rawValue_float = 0.0;
    float phyValue = 0.0;        

    //set the signal with updated raw value
    if(getValue(E_pubc_GW_GW_28C_GW_MFS_DiagInfoSW_28C_SetVt)==0)
    {
        rawValue = getvalue(this);
        if(chgEv_GW_28C_GW_MFS_DiagInfoSW_28C == 0)
        {
            //type conversion to float
            rawValue_float = rawValue;        
            // raw to physical conversion
            phyValue = ((rawValue_float *1)+(0));
            putValue(E_pubc_GW_GW_28C_GW_MFS_DiagInfoSW_28C_Pv, phyValue);
            chgEv_GW_28C_GW_MFS_DiagInfoSW_28C = 1;
        }
        else
        {
            chgEv_GW_28C_GW_MFS_DiagInfoSW_28C = 0;
        }    
        //update the signal value
        Msg_GW_28C.GW_MFS_DiagInfoSW_28C=rawValue;        
    }                                                                           
}

on envVar E_pubc_GW_GW_28C_GW_MFS_DiagInfoSW_28C_Pv
{
    int64 rawValue = 0ll;
    float phyValue = 0.0;
    
    //update the raw value with physical value 
    if(getValue(E_pubc_GW_GW_28C_GW_MFS_DiagInfoSW_28C_SetVt)==0)
    {
        if(chgEv_GW_28C_GW_MFS_DiagInfoSW_28C == 0)
        {
            phyValue = getvalue(this);
            // physical to raw conversion
            rawValue = ((phyValue -(0))/1);
            putValue(E_pubc_GW_GW_28C_GW_MFS_DiagInfoSW_28C_Rv, rawValue);
            chgEv_GW_28C_GW_MFS_DiagInfoSW_28C = 1;  
        }
        else
        {
            chgEv_GW_28C_GW_MFS_DiagInfoSW_28C = 0;
        }
    }
}

on envVar E_pubc_GW_GW_28C_GW_MFS_DiagInfoSW_28C_Vt
{
    qword rawValue = 0ll;
    if(getValue(E_pubc_GW_GW_28C_GW_MFS_DiagInfoSW_28C_SetVt))
    {
        //update the signal value
        Msg_GW_28C.GW_MFS_DiagInfoSW_28C=getValue(this);
    }
}

on envVar E_pubc_GW_GW_28C_GW_MFS_DiagInfoSW_28C_SetVt
{
    if(getValue(E_pubc_GW_GW_28C_GW_MFS_DiagInfoSW_28C_SetVt))
    {
        //update the signal value
        Msg_GW_28C.GW_MFS_DiagInfoSW_28C=getvalue(E_pubc_GW_GW_28C_GW_MFS_DiagInfoSW_28C_Vt);
    }
    else
    {
        Msg_GW_28C.GW_MFS_DiagInfoSW_28C=getValue(E_pubc_GW_GW_28C_GW_MFS_DiagInfoSW_28C_Rv);
    }
}
 
on envVar E_pubc_GW_GW_28C_GW_MFS_IACCenable_switch_signal_Rv
{
    int64 rawValue = 0ll;
    float rawValue_float = 0.0;
    float phyValue = 0.0;        

    //set the signal with updated raw value
    if(getValue(E_pubc_GW_GW_28C_GW_MFS_IACCenable_switch_signal_SetVt)==0)
    {
        rawValue = getvalue(this);
        if(chgEv_GW_28C_GW_MFS_IACCenable_switch_signal == 0)
        {
            //type conversion to float
            rawValue_float = rawValue;        
            // raw to physical conversion
            phyValue = ((rawValue_float *1)+(0));
            putValue(E_pubc_GW_GW_28C_GW_MFS_IACCenable_switch_signal_Pv, phyValue);
            chgEv_GW_28C_GW_MFS_IACCenable_switch_signal = 1;
        }
        else
        {
            chgEv_GW_28C_GW_MFS_IACCenable_switch_signal = 0;
        }    
        //update the signal value
        Msg_GW_28C.GW_MFS_IACCenable_switch_signal=rawValue;        
    }                                                                           
}

on envVar E_pubc_GW_GW_28C_GW_MFS_IACCenable_switch_signal_Pv
{
    int64 rawValue = 0ll;
    float phyValue = 0.0;
    
    //update the raw value with physical value 
    if(getValue(E_pubc_GW_GW_28C_GW_MFS_IACCenable_switch_signal_SetVt)==0)
    {
        if(chgEv_GW_28C_GW_MFS_IACCenable_switch_signal == 0)
        {
            phyValue = getvalue(this);
            // physical to raw conversion
            rawValue = ((phyValue -(0))/1);
            putValue(E_pubc_GW_GW_28C_GW_MFS_IACCenable_switch_signal_Rv, rawValue);
            chgEv_GW_28C_GW_MFS_IACCenable_switch_signal = 1;  
        }
        else
        {
            chgEv_GW_28C_GW_MFS_IACCenable_switch_signal = 0;
        }
    }
}

on envVar E_pubc_GW_GW_28C_GW_MFS_IACCenable_switch_signal_Vt
{
    qword rawValue = 0ll;
    if(getValue(E_pubc_GW_GW_28C_GW_MFS_IACCenable_switch_signal_SetVt))
    {
        //update the signal value
        Msg_GW_28C.GW_MFS_IACCenable_switch_signal=getValue(this);
    }
}

on envVar E_pubc_GW_GW_28C_GW_MFS_IACCenable_switch_signal_SetVt
{
    if(getValue(E_pubc_GW_GW_28C_GW_MFS_IACCenable_switch_signal_SetVt))
    {
        //update the signal value
        Msg_GW_28C.GW_MFS_IACCenable_switch_signal=getvalue(E_pubc_GW_GW_28C_GW_MFS_IACCenable_switch_signal_Vt);
    }
    else
    {
        Msg_GW_28C.GW_MFS_IACCenable_switch_signal=getValue(E_pubc_GW_GW_28C_GW_MFS_IACCenable_switch_signal_Rv);
    }
}
 
on envVar E_pubc_GW_GW_28C_GW_MFS_HODCalibratedStatus_Rv
{
    int64 rawValue = 0ll;
    float rawValue_float = 0.0;
    float phyValue = 0.0;        

    //set the signal with updated raw value
    if(getValue(E_pubc_GW_GW_28C_GW_MFS_HODCalibratedStatus_SetVt)==0)
    {
        rawValue = getvalue(this);
        if(chgEv_GW_28C_GW_MFS_HODCalibratedStatus == 0)
        {
            //type conversion to float
            rawValue_float = rawValue;        
            // raw to physical conversion
            phyValue = ((rawValue_float *1)+(0));
            putValue(E_pubc_GW_GW_28C_GW_MFS_HODCalibratedStatus_Pv, phyValue);
            chgEv_GW_28C_GW_MFS_HODCalibratedStatus = 1;
        }
        else
        {
            chgEv_GW_28C_GW_MFS_HODCalibratedStatus = 0;
        }    
        //update the signal value
        Msg_GW_28C.GW_MFS_HODCalibratedStatus=rawValue;        
    }                                                                           
}

on envVar E_pubc_GW_GW_28C_GW_MFS_HODCalibratedStatus_Pv
{
    int64 rawValue = 0ll;
    float phyValue = 0.0;
    
    //update the raw value with physical value 
    if(getValue(E_pubc_GW_GW_28C_GW_MFS_HODCalibratedStatus_SetVt)==0)
    {
        if(chgEv_GW_28C_GW_MFS_HODCalibratedStatus == 0)
        {
            phyValue = getvalue(this);
            // physical to raw conversion
            rawValue = ((phyValue -(0))/1);
            putValue(E_pubc_GW_GW_28C_GW_MFS_HODCalibratedStatus_Rv, rawValue);
            chgEv_GW_28C_GW_MFS_HODCalibratedStatus = 1;  
        }
        else
        {
            chgEv_GW_28C_GW_MFS_HODCalibratedStatus = 0;
        }
    }
}

on envVar E_pubc_GW_GW_28C_GW_MFS_HODCalibratedStatus_Vt
{
    qword rawValue = 0ll;
    if(getValue(E_pubc_GW_GW_28C_GW_MFS_HODCalibratedStatus_SetVt))
    {
        //update the signal value
        Msg_GW_28C.GW_MFS_HODCalibratedStatus=getValue(this);
    }
}

on envVar E_pubc_GW_GW_28C_GW_MFS_HODCalibratedStatus_SetVt
{
    if(getValue(E_pubc_GW_GW_28C_GW_MFS_HODCalibratedStatus_SetVt))
    {
        //update the signal value
        Msg_GW_28C.GW_MFS_HODCalibratedStatus=getvalue(E_pubc_GW_GW_28C_GW_MFS_HODCalibratedStatus_Vt);
    }
    else
    {
        Msg_GW_28C.GW_MFS_HODCalibratedStatus=getValue(E_pubc_GW_GW_28C_GW_MFS_HODCalibratedStatus_Rv);
    }
}
 
on envVar E_pubc_GW_GW_366_tx
{
    if(getValue(this))
    {       
        

        output(Msg_GW_366);        
    }
}

on envVar E_pubc_GW_GW_366_Range
{
    qword rawstatus = 0ll;
    qword rawValue = 0ll;    
    
    rawstatus = getvalue(this);    
    // set all the signals with min raw /max raw /init raw
    switch (rawstatus) 
    {
     case(0) :
        rawValue= 0;
        putValue(E_pubc_GW_GW_366_AC_EnvironmentalTemp_Rv, rawValue);
        rawValue= 0;
        putValue(E_pubc_GW_GW_366_AC_EnvironmentalTempVD_Rv, rawValue);
        break;
     case(1) :
        rawValue= 254;
        putValue(E_pubc_GW_GW_366_AC_EnvironmentalTemp_Rv, rawValue);
        rawValue= 1;
        putValue(E_pubc_GW_GW_366_AC_EnvironmentalTempVD_Rv, rawValue);
        break;
     default :
        rawValue= 0;
        putValue(E_pubc_GW_GW_366_AC_EnvironmentalTemp_Rv, rawValue);
        rawValue= 0;
        putValue(E_pubc_GW_GW_366_AC_EnvironmentalTempVD_Rv, rawValue);
      break;
   }
}

on envVar E_pubc_GW_GW_366_Dlc
{
    if(getValue(E_pubc_GW_GW_366_enDlc))
    {
        Msg_GW_366.dlc =getValue(this);
    }
    else
    {
        Msg_GW_366.dlc =8;
    }
}

on envVar E_pubc_GW_GW_366_enDlc
{
    //For Messages with DLC = 8, set wrong DLC to smaller than defined DLC
    //For Messages with DLC < 8 set wrong DLC to smaller/longer than defined DLC
    if(getValue(this))
    {
        Msg_GW_366.dlc =getValue(E_pubc_GW_GW_366_Dlc);
    }
    else
    {
        Msg_GW_366.dlc =8;
    }
}


on envVar E_pubc_GW_GW_366_AC_EnvironmentalTemp_Rv
{
    int64 rawValue = 0ll;
    float rawValue_float = 0.0;
    float phyValue = 0.0;        

    //set the signal with updated raw value
    if(getValue(E_pubc_GW_GW_366_AC_EnvironmentalTemp_SetVt)==0)
    {
        rawValue = getvalue(this);
        if(chgEv_GW_366_AC_EnvironmentalTemp == 0)
        {
            //type conversion to float
            rawValue_float = rawValue;        
            // raw to physical conversion
            phyValue = ((rawValue_float *0.5)+(-40));
            putValue(E_pubc_GW_GW_366_AC_EnvironmentalTemp_Pv, phyValue);
            chgEv_GW_366_AC_EnvironmentalTemp = 1;
        }
        else
        {
            chgEv_GW_366_AC_EnvironmentalTemp = 0;
        }    
        //update the signal value
        Msg_GW_366.AC_EnvironmentalTemp=rawValue;        
    }                                                                           
}

on envVar E_pubc_GW_GW_366_AC_EnvironmentalTemp_Pv
{
    int64 rawValue = 0ll;
    float phyValue = 0.0;
    
    //update the raw value with physical value 
    if(getValue(E_pubc_GW_GW_366_AC_EnvironmentalTemp_SetVt)==0)
    {
        if(chgEv_GW_366_AC_EnvironmentalTemp == 0)
        {
            phyValue = getvalue(this);
            // physical to raw conversion
            rawValue = ((phyValue -(-40))/0.5);
            putValue(E_pubc_GW_GW_366_AC_EnvironmentalTemp_Rv, rawValue);
            chgEv_GW_366_AC_EnvironmentalTemp = 1;  
        }
        else
        {
            chgEv_GW_366_AC_EnvironmentalTemp = 0;
        }
    }
}

on envVar E_pubc_GW_GW_366_AC_EnvironmentalTemp_Vt
{
    qword rawValue = 0ll;
    if(getValue(E_pubc_GW_GW_366_AC_EnvironmentalTemp_SetVt))
    {
        //update the signal value
        Msg_GW_366.AC_EnvironmentalTemp=getValue(this);
    }
}

on envVar E_pubc_GW_GW_366_AC_EnvironmentalTemp_SetVt
{
    if(getValue(E_pubc_GW_GW_366_AC_EnvironmentalTemp_SetVt))
    {
        //update the signal value
        Msg_GW_366.AC_EnvironmentalTemp=getvalue(E_pubc_GW_GW_366_AC_EnvironmentalTemp_Vt);
    }
    else
    {
        Msg_GW_366.AC_EnvironmentalTemp=getValue(E_pubc_GW_GW_366_AC_EnvironmentalTemp_Rv);
    }
}
 
on envVar E_pubc_GW_GW_366_AC_EnvironmentalTempVD_Rv
{
    int64 rawValue = 0ll;
    float rawValue_float = 0.0;
    float phyValue = 0.0;        

    //set the signal with updated raw value
    if(getValue(E_pubc_GW_GW_366_AC_EnvironmentalTempVD_SetVt)==0)
    {
        rawValue = getvalue(this);
        if(chgEv_GW_366_AC_EnvironmentalTempVD == 0)
        {
            //type conversion to float
            rawValue_float = rawValue;        
            // raw to physical conversion
            phyValue = ((rawValue_float *1)+(0));
            putValue(E_pubc_GW_GW_366_AC_EnvironmentalTempVD_Pv, phyValue);
            chgEv_GW_366_AC_EnvironmentalTempVD = 1;
        }
        else
        {
            chgEv_GW_366_AC_EnvironmentalTempVD = 0;
        }    
        //update the signal value
        Msg_GW_366.AC_EnvironmentalTempVD=rawValue;        
    }                                                                           
}

on envVar E_pubc_GW_GW_366_AC_EnvironmentalTempVD_Pv
{
    int64 rawValue = 0ll;
    float phyValue = 0.0;
    
    //update the raw value with physical value 
    if(getValue(E_pubc_GW_GW_366_AC_EnvironmentalTempVD_SetVt)==0)
    {
        if(chgEv_GW_366_AC_EnvironmentalTempVD == 0)
        {
            phyValue = getvalue(this);
            // physical to raw conversion
            rawValue = ((phyValue -(0))/1);
            putValue(E_pubc_GW_GW_366_AC_EnvironmentalTempVD_Rv, rawValue);
            chgEv_GW_366_AC_EnvironmentalTempVD = 1;  
        }
        else
        {
            chgEv_GW_366_AC_EnvironmentalTempVD = 0;
        }
    }
}

on envVar E_pubc_GW_GW_366_AC_EnvironmentalTempVD_Vt
{
    qword rawValue = 0ll;
    if(getValue(E_pubc_GW_GW_366_AC_EnvironmentalTempVD_SetVt))
    {
        //update the signal value
        Msg_GW_366.AC_EnvironmentalTempVD=getValue(this);
    }
}

on envVar E_pubc_GW_GW_366_AC_EnvironmentalTempVD_SetVt
{
    if(getValue(E_pubc_GW_GW_366_AC_EnvironmentalTempVD_SetVt))
    {
        //update the signal value
        Msg_GW_366.AC_EnvironmentalTempVD=getvalue(E_pubc_GW_GW_366_AC_EnvironmentalTempVD_Vt);
    }
    else
    {
        Msg_GW_366.AC_EnvironmentalTempVD=getValue(E_pubc_GW_GW_366_AC_EnvironmentalTempVD_Rv);
    }
}
 
on envVar E_pubc_GW_GW_360_tx
{
    if(getValue(this))
    {       
        
        //update the BZ Signal
        if(GW_360_IMS_RollingCounter_360_wrongvalctr == 0)
        {
            update_GW_360_IMS_RollingCounter_360_counter();
            Msg_GW_360.IMS_RollingCounter_360= GW_360_IMS_RollingCounter_360_counter;
        }
        else if(GW_360_IMS_RollingCounter_360_wrongvalctr > 0)
        {
             GW_360_IMS_RollingCounter_360_wrongvalctr--;
              // if counter becomes zero, update panel controller to zero
             if(GW_360_IMS_RollingCounter_360_wrongvalctr == 0)
             {
                 putValue(E_pubc_GW_GW_360_IMS_RollingCounter_360_wrongvalctr,0);
             }
        }
        else
        {
            //do nothing
        }        
        //calculate the CRC CheckSum
        update_GW_360_CRC_CheckSum();

        output(Msg_GW_360);        
    }
}

on envVar E_pubc_GW_GW_360_Range
{
    qword rawstatus = 0ll;
    qword rawValue = 0ll;    
    
    rawstatus = getvalue(this);    
    // set all the signals with min raw /max raw /init raw
    switch (rawstatus) 
    {
     case(0) :
        rawValue= 0;
        putValue(E_pubc_GW_GW_360_IMS_BrowOffsetValue_Rv, rawValue);
        rawValue= 0;
        putValue(E_pubc_GW_GW_360_IMS_HeadDetectSts_Pitch_Rv, rawValue);
        rawValue= 0;
        putValue(E_pubc_GW_GW_360_IMS_JawOffsetValue_Rv, rawValue);
        rawValue= 0;
        putValue(E_pubc_GW_GW_360_IMS_HeadDetectSts_Roll_Rv, rawValue);
        rawValue= 0;
        putValue(E_pubc_GW_GW_360_IMS_HeadDetectSts_Yaw_Rv, rawValue);
        break;
     case(1) :
        rawValue= 15;
        putValue(E_pubc_GW_GW_360_IMS_BrowOffsetValue_Rv, rawValue);
        rawValue= 70;
        putValue(E_pubc_GW_GW_360_IMS_HeadDetectSts_Pitch_Rv, rawValue);
        rawValue= 15;
        putValue(E_pubc_GW_GW_360_IMS_JawOffsetValue_Rv, rawValue);
        rawValue= 90;
        putValue(E_pubc_GW_GW_360_IMS_HeadDetectSts_Roll_Rv, rawValue);
        rawValue= 150;
        putValue(E_pubc_GW_GW_360_IMS_HeadDetectSts_Yaw_Rv, rawValue);
        break;
     default :
        rawValue= 0;
        putValue(E_pubc_GW_GW_360_IMS_BrowOffsetValue_Rv, rawValue);
        rawValue= 0;
        putValue(E_pubc_GW_GW_360_IMS_HeadDetectSts_Pitch_Rv, rawValue);
        rawValue= 0;
        putValue(E_pubc_GW_GW_360_IMS_JawOffsetValue_Rv, rawValue);
        rawValue= 0;
        putValue(E_pubc_GW_GW_360_IMS_HeadDetectSts_Roll_Rv, rawValue);
        rawValue= 0;
        putValue(E_pubc_GW_GW_360_IMS_HeadDetectSts_Yaw_Rv, rawValue);
      break;
   }
}

on envVar E_pubc_GW_GW_360_Dlc
{
    if(getValue(E_pubc_GW_GW_360_enDlc))
    {
        Msg_GW_360.dlc =getValue(this);
    }
    else
    {
        Msg_GW_360.dlc =8;
    }
}

on envVar E_pubc_GW_GW_360_enDlc
{
    //For Messages with DLC = 8, set wrong DLC to smaller than defined DLC
    //For Messages with DLC < 8 set wrong DLC to smaller/longer than defined DLC
    if(getValue(this))
    {
        Msg_GW_360.dlc =getValue(E_pubc_GW_GW_360_Dlc);
    }
    else
    {
        Msg_GW_360.dlc =8;
    }
}

on envVar E_pubc_GW_GW_360_IMS_CRCCheck_360_wrongvalctr
{
    //update disturb count
    //disturb value range:(-1 = always send wrong value),( X>0 ,x is the number of Messages with wrong CHK sent)
    GW_360_IMS_CRCCheck_360_wrongvalctr =getValue(this);    
}
on envVar E_pubc_GW_GW_360_IMS_RollingCounter_360_wrongvalctr
{
    //update disturb count
    //disturb value range:(-1 = always send wrong value),( X>0 ,x is the number of Messages with wrong CHK sent)
    GW_360_IMS_RollingCounter_360_wrongvalctr =getValue(this);    
}

on envVar E_pubc_GW_GW_360_IMS_BrowOffsetValue_Rv
{
    int64 rawValue = 0ll;
    float rawValue_float = 0.0;
    float phyValue = 0.0;        

    //set the signal with updated raw value
    if(getValue(E_pubc_GW_GW_360_IMS_BrowOffsetValue_SetVt)==0)
    {
        rawValue = getvalue(this);
        if(chgEv_GW_360_IMS_BrowOffsetValue == 0)
        {
            //type conversion to float
            rawValue_float = rawValue;        
            // raw to physical conversion
            phyValue = ((rawValue_float *1)+(0));
            putValue(E_pubc_GW_GW_360_IMS_BrowOffsetValue_Pv, phyValue);
            chgEv_GW_360_IMS_BrowOffsetValue = 1;
        }
        else
        {
            chgEv_GW_360_IMS_BrowOffsetValue = 0;
        }    
        //update the signal value
        Msg_GW_360.IMS_BrowOffsetValue=rawValue;        
    }                                                                           
}

on envVar E_pubc_GW_GW_360_IMS_BrowOffsetValue_Pv
{
    int64 rawValue = 0ll;
    float phyValue = 0.0;
    
    //update the raw value with physical value 
    if(getValue(E_pubc_GW_GW_360_IMS_BrowOffsetValue_SetVt)==0)
    {
        if(chgEv_GW_360_IMS_BrowOffsetValue == 0)
        {
            phyValue = getvalue(this);
            // physical to raw conversion
            rawValue = ((phyValue -(0))/1);
            putValue(E_pubc_GW_GW_360_IMS_BrowOffsetValue_Rv, rawValue);
            chgEv_GW_360_IMS_BrowOffsetValue = 1;  
        }
        else
        {
            chgEv_GW_360_IMS_BrowOffsetValue = 0;
        }
    }
}

on envVar E_pubc_GW_GW_360_IMS_BrowOffsetValue_Vt
{
    qword rawValue = 0ll;
    if(getValue(E_pubc_GW_GW_360_IMS_BrowOffsetValue_SetVt))
    {
        //update the signal value
        Msg_GW_360.IMS_BrowOffsetValue=getValue(this);
    }
}

on envVar E_pubc_GW_GW_360_IMS_BrowOffsetValue_SetVt
{
    if(getValue(E_pubc_GW_GW_360_IMS_BrowOffsetValue_SetVt))
    {
        //update the signal value
        Msg_GW_360.IMS_BrowOffsetValue=getvalue(E_pubc_GW_GW_360_IMS_BrowOffsetValue_Vt);
    }
    else
    {
        Msg_GW_360.IMS_BrowOffsetValue=getValue(E_pubc_GW_GW_360_IMS_BrowOffsetValue_Rv);
    }
}
 
on envVar E_pubc_GW_GW_360_IMS_HeadDetectSts_Pitch_Rv
{
    int64 rawValue = 0ll;
    float rawValue_float = 0.0;
    float phyValue = 0.0;        

    //set the signal with updated raw value
    if(getValue(E_pubc_GW_GW_360_IMS_HeadDetectSts_Pitch_SetVt)==0)
    {
        rawValue = getvalue(this);
        if(chgEv_GW_360_IMS_HeadDetectSts_Pitch == 0)
        {
            //type conversion to float
            rawValue_float = rawValue;        
            // raw to physical conversion
            phyValue = ((rawValue_float *1)+(-25));
            putValue(E_pubc_GW_GW_360_IMS_HeadDetectSts_Pitch_Pv, phyValue);
            chgEv_GW_360_IMS_HeadDetectSts_Pitch = 1;
        }
        else
        {
            chgEv_GW_360_IMS_HeadDetectSts_Pitch = 0;
        }    
        //update the signal value
        Msg_GW_360.IMS_HeadDetectSts_Pitch=rawValue;        
    }                                                                           
}

on envVar E_pubc_GW_GW_360_IMS_HeadDetectSts_Pitch_Pv
{
    int64 rawValue = 0ll;
    float phyValue = 0.0;
    
    //update the raw value with physical value 
    if(getValue(E_pubc_GW_GW_360_IMS_HeadDetectSts_Pitch_SetVt)==0)
    {
        if(chgEv_GW_360_IMS_HeadDetectSts_Pitch == 0)
        {
            phyValue = getvalue(this);
            // physical to raw conversion
            rawValue = ((phyValue -(-25))/1);
            putValue(E_pubc_GW_GW_360_IMS_HeadDetectSts_Pitch_Rv, rawValue);
            chgEv_GW_360_IMS_HeadDetectSts_Pitch = 1;  
        }
        else
        {
            chgEv_GW_360_IMS_HeadDetectSts_Pitch = 0;
        }
    }
}

on envVar E_pubc_GW_GW_360_IMS_HeadDetectSts_Pitch_Vt
{
    qword rawValue = 0ll;
    if(getValue(E_pubc_GW_GW_360_IMS_HeadDetectSts_Pitch_SetVt))
    {
        //update the signal value
        Msg_GW_360.IMS_HeadDetectSts_Pitch=getValue(this);
    }
}

on envVar E_pubc_GW_GW_360_IMS_HeadDetectSts_Pitch_SetVt
{
    if(getValue(E_pubc_GW_GW_360_IMS_HeadDetectSts_Pitch_SetVt))
    {
        //update the signal value
        Msg_GW_360.IMS_HeadDetectSts_Pitch=getvalue(E_pubc_GW_GW_360_IMS_HeadDetectSts_Pitch_Vt);
    }
    else
    {
        Msg_GW_360.IMS_HeadDetectSts_Pitch=getValue(E_pubc_GW_GW_360_IMS_HeadDetectSts_Pitch_Rv);
    }
}
 
on envVar E_pubc_GW_GW_360_IMS_JawOffsetValue_Rv
{
    int64 rawValue = 0ll;
    float rawValue_float = 0.0;
    float phyValue = 0.0;        

    //set the signal with updated raw value
    if(getValue(E_pubc_GW_GW_360_IMS_JawOffsetValue_SetVt)==0)
    {
        rawValue = getvalue(this);
        if(chgEv_GW_360_IMS_JawOffsetValue == 0)
        {
            //type conversion to float
            rawValue_float = rawValue;        
            // raw to physical conversion
            phyValue = ((rawValue_float *1)+(0));
            putValue(E_pubc_GW_GW_360_IMS_JawOffsetValue_Pv, phyValue);
            chgEv_GW_360_IMS_JawOffsetValue = 1;
        }
        else
        {
            chgEv_GW_360_IMS_JawOffsetValue = 0;
        }    
        //update the signal value
        Msg_GW_360.IMS_JawOffsetValue=rawValue;        
    }                                                                           
}

on envVar E_pubc_GW_GW_360_IMS_JawOffsetValue_Pv
{
    int64 rawValue = 0ll;
    float phyValue = 0.0;
    
    //update the raw value with physical value 
    if(getValue(E_pubc_GW_GW_360_IMS_JawOffsetValue_SetVt)==0)
    {
        if(chgEv_GW_360_IMS_JawOffsetValue == 0)
        {
            phyValue = getvalue(this);
            // physical to raw conversion
            rawValue = ((phyValue -(0))/1);
            putValue(E_pubc_GW_GW_360_IMS_JawOffsetValue_Rv, rawValue);
            chgEv_GW_360_IMS_JawOffsetValue = 1;  
        }
        else
        {
            chgEv_GW_360_IMS_JawOffsetValue = 0;
        }
    }
}

on envVar E_pubc_GW_GW_360_IMS_JawOffsetValue_Vt
{
    qword rawValue = 0ll;
    if(getValue(E_pubc_GW_GW_360_IMS_JawOffsetValue_SetVt))
    {
        //update the signal value
        Msg_GW_360.IMS_JawOffsetValue=getValue(this);
    }
}

on envVar E_pubc_GW_GW_360_IMS_JawOffsetValue_SetVt
{
    if(getValue(E_pubc_GW_GW_360_IMS_JawOffsetValue_SetVt))
    {
        //update the signal value
        Msg_GW_360.IMS_JawOffsetValue=getvalue(E_pubc_GW_GW_360_IMS_JawOffsetValue_Vt);
    }
    else
    {
        Msg_GW_360.IMS_JawOffsetValue=getValue(E_pubc_GW_GW_360_IMS_JawOffsetValue_Rv);
    }
}
 
on envVar E_pubc_GW_GW_360_IMS_HeadDetectSts_Roll_Rv
{
    int64 rawValue = 0ll;
    float rawValue_float = 0.0;
    float phyValue = 0.0;        

    //set the signal with updated raw value
    if(getValue(E_pubc_GW_GW_360_IMS_HeadDetectSts_Roll_SetVt)==0)
    {
        rawValue = getvalue(this);
        if(chgEv_GW_360_IMS_HeadDetectSts_Roll == 0)
        {
            //type conversion to float
            rawValue_float = rawValue;        
            // raw to physical conversion
            phyValue = ((rawValue_float *1)+(-45));
            putValue(E_pubc_GW_GW_360_IMS_HeadDetectSts_Roll_Pv, phyValue);
            chgEv_GW_360_IMS_HeadDetectSts_Roll = 1;
        }
        else
        {
            chgEv_GW_360_IMS_HeadDetectSts_Roll = 0;
        }    
        //update the signal value
        Msg_GW_360.IMS_HeadDetectSts_Roll=rawValue;        
    }                                                                           
}

on envVar E_pubc_GW_GW_360_IMS_HeadDetectSts_Roll_Pv
{
    int64 rawValue = 0ll;
    float phyValue = 0.0;
    
    //update the raw value with physical value 
    if(getValue(E_pubc_GW_GW_360_IMS_HeadDetectSts_Roll_SetVt)==0)
    {
        if(chgEv_GW_360_IMS_HeadDetectSts_Roll == 0)
        {
            phyValue = getvalue(this);
            // physical to raw conversion
            rawValue = ((phyValue -(-45))/1);
            putValue(E_pubc_GW_GW_360_IMS_HeadDetectSts_Roll_Rv, rawValue);
            chgEv_GW_360_IMS_HeadDetectSts_Roll = 1;  
        }
        else
        {
            chgEv_GW_360_IMS_HeadDetectSts_Roll = 0;
        }
    }
}

on envVar E_pubc_GW_GW_360_IMS_HeadDetectSts_Roll_Vt
{
    qword rawValue = 0ll;
    if(getValue(E_pubc_GW_GW_360_IMS_HeadDetectSts_Roll_SetVt))
    {
        //update the signal value
        Msg_GW_360.IMS_HeadDetectSts_Roll=getValue(this);
    }
}

on envVar E_pubc_GW_GW_360_IMS_HeadDetectSts_Roll_SetVt
{
    if(getValue(E_pubc_GW_GW_360_IMS_HeadDetectSts_Roll_SetVt))
    {
        //update the signal value
        Msg_GW_360.IMS_HeadDetectSts_Roll=getvalue(E_pubc_GW_GW_360_IMS_HeadDetectSts_Roll_Vt);
    }
    else
    {
        Msg_GW_360.IMS_HeadDetectSts_Roll=getValue(E_pubc_GW_GW_360_IMS_HeadDetectSts_Roll_Rv);
    }
}
 
on envVar E_pubc_GW_GW_360_IMS_HeadDetectSts_Yaw_Rv
{
    int64 rawValue = 0ll;
    float rawValue_float = 0.0;
    float phyValue = 0.0;        

    //set the signal with updated raw value
    if(getValue(E_pubc_GW_GW_360_IMS_HeadDetectSts_Yaw_SetVt)==0)
    {
        rawValue = getvalue(this);
        if(chgEv_GW_360_IMS_HeadDetectSts_Yaw == 0)
        {
            //type conversion to float
            rawValue_float = rawValue;        
            // raw to physical conversion
            phyValue = ((rawValue_float *1)+(-75));
            putValue(E_pubc_GW_GW_360_IMS_HeadDetectSts_Yaw_Pv, phyValue);
            chgEv_GW_360_IMS_HeadDetectSts_Yaw = 1;
        }
        else
        {
            chgEv_GW_360_IMS_HeadDetectSts_Yaw = 0;
        }    
        //update the signal value
        Msg_GW_360.IMS_HeadDetectSts_Yaw=rawValue;        
    }                                                                           
}

on envVar E_pubc_GW_GW_360_IMS_HeadDetectSts_Yaw_Pv
{
    int64 rawValue = 0ll;
    float phyValue = 0.0;
    
    //update the raw value with physical value 
    if(getValue(E_pubc_GW_GW_360_IMS_HeadDetectSts_Yaw_SetVt)==0)
    {
        if(chgEv_GW_360_IMS_HeadDetectSts_Yaw == 0)
        {
            phyValue = getvalue(this);
            // physical to raw conversion
            rawValue = ((phyValue -(-75))/1);
            putValue(E_pubc_GW_GW_360_IMS_HeadDetectSts_Yaw_Rv, rawValue);
            chgEv_GW_360_IMS_HeadDetectSts_Yaw = 1;  
        }
        else
        {
            chgEv_GW_360_IMS_HeadDetectSts_Yaw = 0;
        }
    }
}

on envVar E_pubc_GW_GW_360_IMS_HeadDetectSts_Yaw_Vt
{
    qword rawValue = 0ll;
    if(getValue(E_pubc_GW_GW_360_IMS_HeadDetectSts_Yaw_SetVt))
    {
        //update the signal value
        Msg_GW_360.IMS_HeadDetectSts_Yaw=getValue(this);
    }
}

on envVar E_pubc_GW_GW_360_IMS_HeadDetectSts_Yaw_SetVt
{
    if(getValue(E_pubc_GW_GW_360_IMS_HeadDetectSts_Yaw_SetVt))
    {
        //update the signal value
        Msg_GW_360.IMS_HeadDetectSts_Yaw=getvalue(E_pubc_GW_GW_360_IMS_HeadDetectSts_Yaw_Vt);
    }
    else
    {
        Msg_GW_360.IMS_HeadDetectSts_Yaw=getValue(E_pubc_GW_GW_360_IMS_HeadDetectSts_Yaw_Rv);
    }
}
 
on envVar E_pubc_GW_GW_530_tx
{
    if(getValue(this))
    {       
        

        output(Msg_GW_530);        
    }
}

on envVar E_pubc_GW_GW_530_Range
{
    qword rawstatus = 0ll;
    qword rawValue = 0ll;    
    
    rawstatus = getvalue(this);    
    // set all the signals with min raw /max raw /init raw
    switch (rawstatus) 
    {
     case(0) :
        rawValue= 0;
        putValue(E_pubc_GW_GW_530_IP_TotalOdometer_Rv, rawValue);
        break;
     case(1) :
        rawValue= 9999990;
        putValue(E_pubc_GW_GW_530_IP_TotalOdometer_Rv, rawValue);
        break;
     default :
        rawValue= 0;
        putValue(E_pubc_GW_GW_530_IP_TotalOdometer_Rv, rawValue);
      break;
   }
}

on envVar E_pubc_GW_GW_530_Dlc
{
    if(getValue(E_pubc_GW_GW_530_enDlc))
    {
        Msg_GW_530.dlc =getValue(this);
    }
    else
    {
        Msg_GW_530.dlc =8;
    }
}

on envVar E_pubc_GW_GW_530_enDlc
{
    //For Messages with DLC = 8, set wrong DLC to smaller than defined DLC
    //For Messages with DLC < 8 set wrong DLC to smaller/longer than defined DLC
    if(getValue(this))
    {
        Msg_GW_530.dlc =getValue(E_pubc_GW_GW_530_Dlc);
    }
    else
    {
        Msg_GW_530.dlc =8;
    }
}


on envVar E_pubc_GW_GW_530_IP_TotalOdometer_Rv
{
    int64 rawValue = 0ll;
    float rawValue_float = 0.0;
    float phyValue = 0.0;        

    //set the signal with updated raw value
    {
        rawValue = getvalue(this);
        if(chgEv_GW_530_IP_TotalOdometer == 0)
        {
            //type conversion to float
            rawValue_float = rawValue;        
            // raw to physical conversion
            phyValue = ((rawValue_float *0.1)+(0));
            putValue(E_pubc_GW_GW_530_IP_TotalOdometer_Pv, phyValue);
            chgEv_GW_530_IP_TotalOdometer = 1;
        }
        else
        {
            chgEv_GW_530_IP_TotalOdometer = 0;
        }    
        //update the signal value
        Msg_GW_530.IP_TotalOdometer=rawValue;        
    }                                                                           
}

on envVar E_pubc_GW_GW_530_IP_TotalOdometer_Pv
{
    int64 rawValue = 0ll;
    float phyValue = 0.0;
    
    //update the raw value with physical value 
    {
        if(chgEv_GW_530_IP_TotalOdometer == 0)
        {
            phyValue = getvalue(this);
            // physical to raw conversion
            rawValue = ((phyValue -(0))/0.1);
            putValue(E_pubc_GW_GW_530_IP_TotalOdometer_Rv, rawValue);
            chgEv_GW_530_IP_TotalOdometer = 1;  
        }
        else
        {
            chgEv_GW_530_IP_TotalOdometer = 0;
        }
    }
}


 
on envVar E_pubc_GW_GW_170_tx
{
    if(getValue(this))
    {       
        
        //update the BZ Signal
        if(GW_170_EPS_RollingCounter_170_wrongvalctr == 0)
        {
            update_GW_170_EPS_RollingCounter_170_counter();
            Msg_GW_170.EPS_RollingCounter_170= GW_170_EPS_RollingCounter_170_counter;
        }
        else if(GW_170_EPS_RollingCounter_170_wrongvalctr > 0)
        {
             GW_170_EPS_RollingCounter_170_wrongvalctr--;
              // if counter becomes zero, update panel controller to zero
             if(GW_170_EPS_RollingCounter_170_wrongvalctr == 0)
             {
                 putValue(E_pubc_GW_GW_170_EPS_RollingCounter_170_wrongvalctr,0);
             }
        }
        else
        {
            //do nothing
        }        
        //calculate the CRC CheckSum
        update_GW_170_CRC_CheckSum();

        output(Msg_GW_170);        
    }
}

on envVar E_pubc_GW_GW_170_Range
{
    qword rawstatus = 0ll;
    qword rawValue = 0ll;    
    
    rawstatus = getvalue(this);    
    // set all the signals with min raw /max raw /init raw
    switch (rawstatus) 
    {
     case(0) :
        rawValue= 0;
        putValue(E_pubc_GW_GW_170_EPS_ActualTorsionBarTorq_Rv, rawValue);
        rawValue= 0;
        putValue(E_pubc_GW_GW_170_EPS_MinSafetyTorsionBarTorq_Rv, rawValue);
        rawValue= 0;
        putValue(E_pubc_GW_GW_170_EPS_MaxSafetyTorsionBarTorq_Rv, rawValue);
        break;
     case(1) :
        rawValue= 2046;
        putValue(E_pubc_GW_GW_170_EPS_ActualTorsionBarTorq_Rv, rawValue);
        rawValue= 2046;
        putValue(E_pubc_GW_GW_170_EPS_MinSafetyTorsionBarTorq_Rv, rawValue);
        rawValue= 2046;
        putValue(E_pubc_GW_GW_170_EPS_MaxSafetyTorsionBarTorq_Rv, rawValue);
        break;
     default :
        rawValue= 0;
        putValue(E_pubc_GW_GW_170_EPS_ActualTorsionBarTorq_Rv, rawValue);
        rawValue= 0;
        putValue(E_pubc_GW_GW_170_EPS_MinSafetyTorsionBarTorq_Rv, rawValue);
        rawValue= 0;
        putValue(E_pubc_GW_GW_170_EPS_MaxSafetyTorsionBarTorq_Rv, rawValue);
      break;
   }
}

on envVar E_pubc_GW_GW_170_Dlc
{
    if(getValue(E_pubc_GW_GW_170_enDlc))
    {
        Msg_GW_170.dlc =getValue(this);
    }
    else
    {
        Msg_GW_170.dlc =8;
    }
}

on envVar E_pubc_GW_GW_170_enDlc
{
    //For Messages with DLC = 8, set wrong DLC to smaller than defined DLC
    //For Messages with DLC < 8 set wrong DLC to smaller/longer than defined DLC
    if(getValue(this))
    {
        Msg_GW_170.dlc =getValue(E_pubc_GW_GW_170_Dlc);
    }
    else
    {
        Msg_GW_170.dlc =8;
    }
}

on envVar E_pubc_GW_GW_170_EPS_CRCCheck_170_wrongvalctr
{
    //update disturb count
    //disturb value range:(-1 = always send wrong value),( X>0 ,x is the number of Messages with wrong CHK sent)
    GW_170_EPS_CRCCheck_170_wrongvalctr =getValue(this);    
}
on envVar E_pubc_GW_GW_170_EPS_RollingCounter_170_wrongvalctr
{
    //update disturb count
    //disturb value range:(-1 = always send wrong value),( X>0 ,x is the number of Messages with wrong CHK sent)
    GW_170_EPS_RollingCounter_170_wrongvalctr =getValue(this);    
}

on envVar E_pubc_GW_GW_170_EPS_ActualTorsionBarTorq_Rv
{
    int64 rawValue = 0ll;
    float rawValue_float = 0.0;
    float phyValue = 0.0;        

    //set the signal with updated raw value
    {
        rawValue = getvalue(this);
        if(chgEv_GW_170_EPS_ActualTorsionBarTorq == 0)
        {
            //type conversion to float
            rawValue_float = rawValue;        
            // raw to physical conversion
            phyValue = ((rawValue_float *0.02)+(-20.48));
            putValue(E_pubc_GW_GW_170_EPS_ActualTorsionBarTorq_Pv, phyValue);
            chgEv_GW_170_EPS_ActualTorsionBarTorq = 1;
        }
        else
        {
            chgEv_GW_170_EPS_ActualTorsionBarTorq = 0;
        }    
        //update the signal value
        Msg_GW_170.EPS_ActualTorsionBarTorq=rawValue;        
    }                                                                           
}

on envVar E_pubc_GW_GW_170_EPS_ActualTorsionBarTorq_Pv
{
    int64 rawValue = 0ll;
    float phyValue = 0.0;
    
    //update the raw value with physical value 
    {
        if(chgEv_GW_170_EPS_ActualTorsionBarTorq == 0)
        {
            phyValue = getvalue(this);
            // physical to raw conversion
            rawValue = ((phyValue -(-20.48))/0.02);
            putValue(E_pubc_GW_GW_170_EPS_ActualTorsionBarTorq_Rv, rawValue);
            chgEv_GW_170_EPS_ActualTorsionBarTorq = 1;  
        }
        else
        {
            chgEv_GW_170_EPS_ActualTorsionBarTorq = 0;
        }
    }
}


 
on envVar E_pubc_GW_GW_170_EPS_MinSafetyTorsionBarTorq_Rv
{
    int64 rawValue = 0ll;
    float rawValue_float = 0.0;
    float phyValue = 0.0;        

    //set the signal with updated raw value
    {
        rawValue = getvalue(this);
        if(chgEv_GW_170_EPS_MinSafetyTorsionBarTorq == 0)
        {
            //type conversion to float
            rawValue_float = rawValue;        
            // raw to physical conversion
            phyValue = ((rawValue_float *0.02)+(-20.48));
            putValue(E_pubc_GW_GW_170_EPS_MinSafetyTorsionBarTorq_Pv, phyValue);
            chgEv_GW_170_EPS_MinSafetyTorsionBarTorq = 1;
        }
        else
        {
            chgEv_GW_170_EPS_MinSafetyTorsionBarTorq = 0;
        }    
        //update the signal value
        Msg_GW_170.EPS_MinSafetyTorsionBarTorq=rawValue;        
    }                                                                           
}

on envVar E_pubc_GW_GW_170_EPS_MinSafetyTorsionBarTorq_Pv
{
    int64 rawValue = 0ll;
    float phyValue = 0.0;
    
    //update the raw value with physical value 
    {
        if(chgEv_GW_170_EPS_MinSafetyTorsionBarTorq == 0)
        {
            phyValue = getvalue(this);
            // physical to raw conversion
            rawValue = ((phyValue -(-20.48))/0.02);
            putValue(E_pubc_GW_GW_170_EPS_MinSafetyTorsionBarTorq_Rv, rawValue);
            chgEv_GW_170_EPS_MinSafetyTorsionBarTorq = 1;  
        }
        else
        {
            chgEv_GW_170_EPS_MinSafetyTorsionBarTorq = 0;
        }
    }
}


 
on envVar E_pubc_GW_GW_170_EPS_MaxSafetyTorsionBarTorq_Rv
{
    int64 rawValue = 0ll;
    float rawValue_float = 0.0;
    float phyValue = 0.0;        

    //set the signal with updated raw value
    {
        rawValue = getvalue(this);
        if(chgEv_GW_170_EPS_MaxSafetyTorsionBarTorq == 0)
        {
            //type conversion to float
            rawValue_float = rawValue;        
            // raw to physical conversion
            phyValue = ((rawValue_float *0.02)+(-20.48));
            putValue(E_pubc_GW_GW_170_EPS_MaxSafetyTorsionBarTorq_Pv, phyValue);
            chgEv_GW_170_EPS_MaxSafetyTorsionBarTorq = 1;
        }
        else
        {
            chgEv_GW_170_EPS_MaxSafetyTorsionBarTorq = 0;
        }    
        //update the signal value
        Msg_GW_170.EPS_MaxSafetyTorsionBarTorq=rawValue;        
    }                                                                           
}

on envVar E_pubc_GW_GW_170_EPS_MaxSafetyTorsionBarTorq_Pv
{
    int64 rawValue = 0ll;
    float phyValue = 0.0;
    
    //update the raw value with physical value 
    {
        if(chgEv_GW_170_EPS_MaxSafetyTorsionBarTorq == 0)
        {
            phyValue = getvalue(this);
            // physical to raw conversion
            rawValue = ((phyValue -(-20.48))/0.02);
            putValue(E_pubc_GW_GW_170_EPS_MaxSafetyTorsionBarTorq_Rv, rawValue);
            chgEv_GW_170_EPS_MaxSafetyTorsionBarTorq = 1;  
        }
        else
        {
            chgEv_GW_170_EPS_MaxSafetyTorsionBarTorq = 0;
        }
    }
}


 
on envVar E_pubc_GW_GW_187_tx
{
    if(getValue(this))
    {       
        
        //update the BZ Signal
        if(GW_187_ESP_RollingCounter_187_wrongvalctr == 0)
        {
            update_GW_187_ESP_RollingCounter_187_counter();
            Msg_GW_187.ESP_RollingCounter_187= GW_187_ESP_RollingCounter_187_counter;
        }
        else if(GW_187_ESP_RollingCounter_187_wrongvalctr > 0)
        {
             GW_187_ESP_RollingCounter_187_wrongvalctr--;
              // if counter becomes zero, update panel controller to zero
             if(GW_187_ESP_RollingCounter_187_wrongvalctr == 0)
             {
                 putValue(E_pubc_GW_GW_187_ESP_RollingCounter_187_wrongvalctr,0);
             }
        }
        else
        {
            //do nothing
        }        
        //calculate the CRC CheckSum
        update_GW_187_CRC_CheckSum();

        output(Msg_GW_187);        
    }
}

on envVar E_pubc_GW_GW_187_Range
{
    qword rawstatus = 0ll;
    qword rawValue = 0ll;    
    
    rawstatus = getvalue(this);    
    // set all the signals with min raw /max raw /init raw
    switch (rawstatus) 
    {
     case(0) :
        rawValue= 0;
        putValue(E_pubc_GW_GW_187_ESP_ESPActiveStatus_Rv, rawValue);
        rawValue= 0;
        putValue(E_pubc_GW_GW_187_ESP_ABSFailStatus_Rv, rawValue);
        rawValue= 0;
        putValue(E_pubc_GW_GW_187_ESP_ESPFunctionStatus_Rv, rawValue);
        rawValue= 0;
        putValue(E_pubc_GW_GW_187_ESP_VehicleSpeedValid_Rv, rawValue);
        rawValue= 0;
        putValue(E_pubc_GW_GW_187_ESP_VehicleSpeed_Rv, rawValue);
        rawValue= 0;
        putValue(E_pubc_GW_GW_187_ESP_TCSFailStatus_Rv, rawValue);
        break;
     case(1) :
        rawValue= 1;
        putValue(E_pubc_GW_GW_187_ESP_ESPActiveStatus_Rv, rawValue);
        rawValue= 1;
        putValue(E_pubc_GW_GW_187_ESP_ABSFailStatus_Rv, rawValue);
        rawValue= 1;
        putValue(E_pubc_GW_GW_187_ESP_ESPFunctionStatus_Rv, rawValue);
        rawValue= 1;
        putValue(E_pubc_GW_GW_187_ESP_VehicleSpeedValid_Rv, rawValue);
        rawValue= 6400;
        putValue(E_pubc_GW_GW_187_ESP_VehicleSpeed_Rv, rawValue);
        rawValue= 1;
        putValue(E_pubc_GW_GW_187_ESP_TCSFailStatus_Rv, rawValue);
        break;
     default :
        rawValue= 0;
        putValue(E_pubc_GW_GW_187_ESP_ESPActiveStatus_Rv, rawValue);
        rawValue= 0;
        putValue(E_pubc_GW_GW_187_ESP_ABSFailStatus_Rv, rawValue);
        rawValue= 0;
        putValue(E_pubc_GW_GW_187_ESP_ESPFunctionStatus_Rv, rawValue);
        rawValue= 0;
        putValue(E_pubc_GW_GW_187_ESP_VehicleSpeedValid_Rv, rawValue);
        rawValue= 0;
        putValue(E_pubc_GW_GW_187_ESP_VehicleSpeed_Rv, rawValue);
        rawValue= 0;
        putValue(E_pubc_GW_GW_187_ESP_TCSFailStatus_Rv, rawValue);
      break;
   }
}

on envVar E_pubc_GW_GW_187_Dlc
{
    if(getValue(E_pubc_GW_GW_187_enDlc))
    {
        Msg_GW_187.dlc =getValue(this);
    }
    else
    {
        Msg_GW_187.dlc =8;
    }
}

on envVar E_pubc_GW_GW_187_enDlc
{
    //For Messages with DLC = 8, set wrong DLC to smaller than defined DLC
    //For Messages with DLC < 8 set wrong DLC to smaller/longer than defined DLC
    if(getValue(this))
    {
        Msg_GW_187.dlc =getValue(E_pubc_GW_GW_187_Dlc);
    }
    else
    {
        Msg_GW_187.dlc =8;
    }
}

on envVar E_pubc_GW_GW_187_ESP_CRCCheck_187_wrongvalctr
{
    //update disturb count
    //disturb value range:(-1 = always send wrong value),( X>0 ,x is the number of Messages with wrong CHK sent)
    GW_187_ESP_CRCCheck_187_wrongvalctr =getValue(this);    
}
on envVar E_pubc_GW_GW_187_ESP_RollingCounter_187_wrongvalctr
{
    //update disturb count
    //disturb value range:(-1 = always send wrong value),( X>0 ,x is the number of Messages with wrong CHK sent)
    GW_187_ESP_RollingCounter_187_wrongvalctr =getValue(this);    
}

on envVar E_pubc_GW_GW_187_ESP_ESPActiveStatus_Rv
{
    int64 rawValue = 0ll;
    float rawValue_float = 0.0;
    float phyValue = 0.0;        

    //set the signal with updated raw value
    if(getValue(E_pubc_GW_GW_187_ESP_ESPActiveStatus_SetVt)==0)
    {
        rawValue = getvalue(this);
        if(chgEv_GW_187_ESP_ESPActiveStatus == 0)
        {
            //type conversion to float
            rawValue_float = rawValue;        
            // raw to physical conversion
            phyValue = ((rawValue_float *1)+(0));
            putValue(E_pubc_GW_GW_187_ESP_ESPActiveStatus_Pv, phyValue);
            chgEv_GW_187_ESP_ESPActiveStatus = 1;
        }
        else
        {
            chgEv_GW_187_ESP_ESPActiveStatus = 0;
        }    
        //update the signal value
        Msg_GW_187.ESP_ESPActiveStatus=rawValue;        
    }                                                                           
}

on envVar E_pubc_GW_GW_187_ESP_ESPActiveStatus_Pv
{
    int64 rawValue = 0ll;
    float phyValue = 0.0;
    
    //update the raw value with physical value 
    if(getValue(E_pubc_GW_GW_187_ESP_ESPActiveStatus_SetVt)==0)
    {
        if(chgEv_GW_187_ESP_ESPActiveStatus == 0)
        {
            phyValue = getvalue(this);
            // physical to raw conversion
            rawValue = ((phyValue -(0))/1);
            putValue(E_pubc_GW_GW_187_ESP_ESPActiveStatus_Rv, rawValue);
            chgEv_GW_187_ESP_ESPActiveStatus = 1;  
        }
        else
        {
            chgEv_GW_187_ESP_ESPActiveStatus = 0;
        }
    }
}

on envVar E_pubc_GW_GW_187_ESP_ESPActiveStatus_Vt
{
    qword rawValue = 0ll;
    if(getValue(E_pubc_GW_GW_187_ESP_ESPActiveStatus_SetVt))
    {
        //update the signal value
        Msg_GW_187.ESP_ESPActiveStatus=getValue(this);
    }
}

on envVar E_pubc_GW_GW_187_ESP_ESPActiveStatus_SetVt
{
    if(getValue(E_pubc_GW_GW_187_ESP_ESPActiveStatus_SetVt))
    {
        //update the signal value
        Msg_GW_187.ESP_ESPActiveStatus=getvalue(E_pubc_GW_GW_187_ESP_ESPActiveStatus_Vt);
    }
    else
    {
        Msg_GW_187.ESP_ESPActiveStatus=getValue(E_pubc_GW_GW_187_ESP_ESPActiveStatus_Rv);
    }
}
 
on envVar E_pubc_GW_GW_187_ESP_ABSFailStatus_Rv
{
    int64 rawValue = 0ll;
    float rawValue_float = 0.0;
    float phyValue = 0.0;        

    //set the signal with updated raw value
    if(getValue(E_pubc_GW_GW_187_ESP_ABSFailStatus_SetVt)==0)
    {
        rawValue = getvalue(this);
        if(chgEv_GW_187_ESP_ABSFailStatus == 0)
        {
            //type conversion to float
            rawValue_float = rawValue;        
            // raw to physical conversion
            phyValue = ((rawValue_float *1)+(0));
            putValue(E_pubc_GW_GW_187_ESP_ABSFailStatus_Pv, phyValue);
            chgEv_GW_187_ESP_ABSFailStatus = 1;
        }
        else
        {
            chgEv_GW_187_ESP_ABSFailStatus = 0;
        }    
        //update the signal value
        Msg_GW_187.ESP_ABSFailStatus=rawValue;        
    }                                                                           
}

on envVar E_pubc_GW_GW_187_ESP_ABSFailStatus_Pv
{
    int64 rawValue = 0ll;
    float phyValue = 0.0;
    
    //update the raw value with physical value 
    if(getValue(E_pubc_GW_GW_187_ESP_ABSFailStatus_SetVt)==0)
    {
        if(chgEv_GW_187_ESP_ABSFailStatus == 0)
        {
            phyValue = getvalue(this);
            // physical to raw conversion
            rawValue = ((phyValue -(0))/1);
            putValue(E_pubc_GW_GW_187_ESP_ABSFailStatus_Rv, rawValue);
            chgEv_GW_187_ESP_ABSFailStatus = 1;  
        }
        else
        {
            chgEv_GW_187_ESP_ABSFailStatus = 0;
        }
    }
}

on envVar E_pubc_GW_GW_187_ESP_ABSFailStatus_Vt
{
    qword rawValue = 0ll;
    if(getValue(E_pubc_GW_GW_187_ESP_ABSFailStatus_SetVt))
    {
        //update the signal value
        Msg_GW_187.ESP_ABSFailStatus=getValue(this);
    }
}

on envVar E_pubc_GW_GW_187_ESP_ABSFailStatus_SetVt
{
    if(getValue(E_pubc_GW_GW_187_ESP_ABSFailStatus_SetVt))
    {
        //update the signal value
        Msg_GW_187.ESP_ABSFailStatus=getvalue(E_pubc_GW_GW_187_ESP_ABSFailStatus_Vt);
    }
    else
    {
        Msg_GW_187.ESP_ABSFailStatus=getValue(E_pubc_GW_GW_187_ESP_ABSFailStatus_Rv);
    }
}
 
on envVar E_pubc_GW_GW_187_ESP_ESPFunctionStatus_Rv
{
    int64 rawValue = 0ll;
    float rawValue_float = 0.0;
    float phyValue = 0.0;        

    //set the signal with updated raw value
    if(getValue(E_pubc_GW_GW_187_ESP_ESPFunctionStatus_SetVt)==0)
    {
        rawValue = getvalue(this);
        if(chgEv_GW_187_ESP_ESPFunctionStatus == 0)
        {
            //type conversion to float
            rawValue_float = rawValue;        
            // raw to physical conversion
            phyValue = ((rawValue_float *1)+(0));
            putValue(E_pubc_GW_GW_187_ESP_ESPFunctionStatus_Pv, phyValue);
            chgEv_GW_187_ESP_ESPFunctionStatus = 1;
        }
        else
        {
            chgEv_GW_187_ESP_ESPFunctionStatus = 0;
        }    
        //update the signal value
        Msg_GW_187.ESP_ESPFunctionStatus=rawValue;        
    }                                                                           
}

on envVar E_pubc_GW_GW_187_ESP_ESPFunctionStatus_Pv
{
    int64 rawValue = 0ll;
    float phyValue = 0.0;
    
    //update the raw value with physical value 
    if(getValue(E_pubc_GW_GW_187_ESP_ESPFunctionStatus_SetVt)==0)
    {
        if(chgEv_GW_187_ESP_ESPFunctionStatus == 0)
        {
            phyValue = getvalue(this);
            // physical to raw conversion
            rawValue = ((phyValue -(0))/1);
            putValue(E_pubc_GW_GW_187_ESP_ESPFunctionStatus_Rv, rawValue);
            chgEv_GW_187_ESP_ESPFunctionStatus = 1;  
        }
        else
        {
            chgEv_GW_187_ESP_ESPFunctionStatus = 0;
        }
    }
}

on envVar E_pubc_GW_GW_187_ESP_ESPFunctionStatus_Vt
{
    qword rawValue = 0ll;
    if(getValue(E_pubc_GW_GW_187_ESP_ESPFunctionStatus_SetVt))
    {
        //update the signal value
        Msg_GW_187.ESP_ESPFunctionStatus=getValue(this);
    }
}

on envVar E_pubc_GW_GW_187_ESP_ESPFunctionStatus_SetVt
{
    if(getValue(E_pubc_GW_GW_187_ESP_ESPFunctionStatus_SetVt))
    {
        //update the signal value
        Msg_GW_187.ESP_ESPFunctionStatus=getvalue(E_pubc_GW_GW_187_ESP_ESPFunctionStatus_Vt);
    }
    else
    {
        Msg_GW_187.ESP_ESPFunctionStatus=getValue(E_pubc_GW_GW_187_ESP_ESPFunctionStatus_Rv);
    }
}
 
on envVar E_pubc_GW_GW_187_ESP_VehicleSpeedValid_Rv
{
    int64 rawValue = 0ll;
    float rawValue_float = 0.0;
    float phyValue = 0.0;        

    //set the signal with updated raw value
    if(getValue(E_pubc_GW_GW_187_ESP_VehicleSpeedValid_SetVt)==0)
    {
        rawValue = getvalue(this);
        if(chgEv_GW_187_ESP_VehicleSpeedValid == 0)
        {
            //type conversion to float
            rawValue_float = rawValue;        
            // raw to physical conversion
            phyValue = ((rawValue_float *1)+(0));
            putValue(E_pubc_GW_GW_187_ESP_VehicleSpeedValid_Pv, phyValue);
            chgEv_GW_187_ESP_VehicleSpeedValid = 1;
        }
        else
        {
            chgEv_GW_187_ESP_VehicleSpeedValid = 0;
        }    
        //update the signal value
        Msg_GW_187.ESP_VehicleSpeedValid=rawValue;        
    }                                                                           
}

on envVar E_pubc_GW_GW_187_ESP_VehicleSpeedValid_Pv
{
    int64 rawValue = 0ll;
    float phyValue = 0.0;
    
    //update the raw value with physical value 
    if(getValue(E_pubc_GW_GW_187_ESP_VehicleSpeedValid_SetVt)==0)
    {
        if(chgEv_GW_187_ESP_VehicleSpeedValid == 0)
        {
            phyValue = getvalue(this);
            // physical to raw conversion
            rawValue = ((phyValue -(0))/1);
            putValue(E_pubc_GW_GW_187_ESP_VehicleSpeedValid_Rv, rawValue);
            chgEv_GW_187_ESP_VehicleSpeedValid = 1;  
        }
        else
        {
            chgEv_GW_187_ESP_VehicleSpeedValid = 0;
        }
    }
}

on envVar E_pubc_GW_GW_187_ESP_VehicleSpeedValid_Vt
{
    qword rawValue = 0ll;
    if(getValue(E_pubc_GW_GW_187_ESP_VehicleSpeedValid_SetVt))
    {
        //update the signal value
        Msg_GW_187.ESP_VehicleSpeedValid=getValue(this);
    }
}

on envVar E_pubc_GW_GW_187_ESP_VehicleSpeedValid_SetVt
{
    if(getValue(E_pubc_GW_GW_187_ESP_VehicleSpeedValid_SetVt))
    {
        //update the signal value
        Msg_GW_187.ESP_VehicleSpeedValid=getvalue(E_pubc_GW_GW_187_ESP_VehicleSpeedValid_Vt);
    }
    else
    {
        Msg_GW_187.ESP_VehicleSpeedValid=getValue(E_pubc_GW_GW_187_ESP_VehicleSpeedValid_Rv);
    }
}
 
on envVar E_pubc_GW_GW_187_ESP_VehicleSpeed_Rv
{
    int64 rawValue = 0ll;
    float rawValue_float = 0.0;
    float phyValue = 0.0;        

    //set the signal with updated raw value
    if(getValue(E_pubc_GW_GW_187_ESP_VehicleSpeed_SetVt)==0)
    {
        rawValue = getvalue(this);
        if(chgEv_GW_187_ESP_VehicleSpeed == 0)
        {
            //type conversion to float
            rawValue_float = rawValue;        
            // raw to physical conversion
            phyValue = ((rawValue_float *0.05625)+(0));
            putValue(E_pubc_GW_GW_187_ESP_VehicleSpeed_Pv, phyValue);
            chgEv_GW_187_ESP_VehicleSpeed = 1;
        }
        else
        {
            chgEv_GW_187_ESP_VehicleSpeed = 0;
        }    
        //update the signal value
        Msg_GW_187.ESP_VehicleSpeed=rawValue;        
    }                                                                           
}

on envVar E_pubc_GW_GW_187_ESP_VehicleSpeed_Pv
{
    int64 rawValue = 0ll;
    float phyValue = 0.0;
    
    //update the raw value with physical value 
    if(getValue(E_pubc_GW_GW_187_ESP_VehicleSpeed_SetVt)==0)
    {
        if(chgEv_GW_187_ESP_VehicleSpeed == 0)
        {
            phyValue = getvalue(this);
            // physical to raw conversion
            rawValue = ((phyValue -(0))/0.05625);
            putValue(E_pubc_GW_GW_187_ESP_VehicleSpeed_Rv, rawValue);
            chgEv_GW_187_ESP_VehicleSpeed = 1;  
        }
        else
        {
            chgEv_GW_187_ESP_VehicleSpeed = 0;
        }
    }
}

on envVar E_pubc_GW_GW_187_ESP_VehicleSpeed_Vt
{
    qword rawValue = 0ll;
    if(getValue(E_pubc_GW_GW_187_ESP_VehicleSpeed_SetVt))
    {
        //update the signal value
        Msg_GW_187.ESP_VehicleSpeed=getValue(this);
    }
}

on envVar E_pubc_GW_GW_187_ESP_VehicleSpeed_SetVt
{
    if(getValue(E_pubc_GW_GW_187_ESP_VehicleSpeed_SetVt))
    {
        //update the signal value
        Msg_GW_187.ESP_VehicleSpeed=getvalue(E_pubc_GW_GW_187_ESP_VehicleSpeed_Vt);
    }
    else
    {
        Msg_GW_187.ESP_VehicleSpeed=getValue(E_pubc_GW_GW_187_ESP_VehicleSpeed_Rv);
    }
}
 
on envVar E_pubc_GW_GW_187_ESP_TCSFailStatus_Rv
{
    int64 rawValue = 0ll;
    float rawValue_float = 0.0;
    float phyValue = 0.0;        

    //set the signal with updated raw value
    if(getValue(E_pubc_GW_GW_187_ESP_TCSFailStatus_SetVt)==0)
    {
        rawValue = getvalue(this);
        if(chgEv_GW_187_ESP_TCSFailStatus == 0)
        {
            //type conversion to float
            rawValue_float = rawValue;        
            // raw to physical conversion
            phyValue = ((rawValue_float *1)+(0));
            putValue(E_pubc_GW_GW_187_ESP_TCSFailStatus_Pv, phyValue);
            chgEv_GW_187_ESP_TCSFailStatus = 1;
        }
        else
        {
            chgEv_GW_187_ESP_TCSFailStatus = 0;
        }    
        //update the signal value
        Msg_GW_187.ESP_TCSFailStatus=rawValue;        
    }                                                                           
}

on envVar E_pubc_GW_GW_187_ESP_TCSFailStatus_Pv
{
    int64 rawValue = 0ll;
    float phyValue = 0.0;
    
    //update the raw value with physical value 
    if(getValue(E_pubc_GW_GW_187_ESP_TCSFailStatus_SetVt)==0)
    {
        if(chgEv_GW_187_ESP_TCSFailStatus == 0)
        {
            phyValue = getvalue(this);
            // physical to raw conversion
            rawValue = ((phyValue -(0))/1);
            putValue(E_pubc_GW_GW_187_ESP_TCSFailStatus_Rv, rawValue);
            chgEv_GW_187_ESP_TCSFailStatus = 1;  
        }
        else
        {
            chgEv_GW_187_ESP_TCSFailStatus = 0;
        }
    }
}

on envVar E_pubc_GW_GW_187_ESP_TCSFailStatus_Vt
{
    qword rawValue = 0ll;
    if(getValue(E_pubc_GW_GW_187_ESP_TCSFailStatus_SetVt))
    {
        //update the signal value
        Msg_GW_187.ESP_TCSFailStatus=getValue(this);
    }
}

on envVar E_pubc_GW_GW_187_ESP_TCSFailStatus_SetVt
{
    if(getValue(E_pubc_GW_GW_187_ESP_TCSFailStatus_SetVt))
    {
        //update the signal value
        Msg_GW_187.ESP_TCSFailStatus=getvalue(E_pubc_GW_GW_187_ESP_TCSFailStatus_Vt);
    }
    else
    {
        Msg_GW_187.ESP_TCSFailStatus=getValue(E_pubc_GW_GW_187_ESP_TCSFailStatus_Rv);
    }
}
 
on envVar E_pubc_GW_GW_180_tx
{
    if(getValue(this))
    {       
        
        //update the BZ Signal
        if(GW_180_SAS_RollingCounter_wrongvalctr == 0)
        {
            update_GW_180_SAS_RollingCounter_counter();
            Msg_GW_180.SAS_RollingCounter= GW_180_SAS_RollingCounter_counter;
        }
        else if(GW_180_SAS_RollingCounter_wrongvalctr > 0)
        {
             GW_180_SAS_RollingCounter_wrongvalctr--;
              // if counter becomes zero, update panel controller to zero
             if(GW_180_SAS_RollingCounter_wrongvalctr == 0)
             {
                 putValue(E_pubc_GW_GW_180_SAS_RollingCounter_wrongvalctr,0);
             }
        }
        else
        {
            //do nothing
        }        
        //calculate the CRC CheckSum
        update_GW_180_CRC_CheckSum();

        output(Msg_GW_180);        
    }
}

on envVar E_pubc_GW_GW_180_Range
{
    qword rawstatus = 0ll;
    qword rawValue = 0ll;    
    
    rawstatus = getvalue(this);    
    // set all the signals with min raw /max raw /init raw
    switch (rawstatus) 
    {
     case(0) :
        rawValue= 0;
        putValue(E_pubc_GW_GW_180_SAS_SteeringAngleValid_Rv, rawValue);
        rawValue= 0;
        putValue(E_pubc_GW_GW_180_SAS_Calibrated_Rv, rawValue);
        rawValue= -7800;
        putValue(E_pubc_GW_GW_180_SAS_SteeringAngle_Rv, rawValue);
        rawValue= 0;
        putValue(E_pubc_GW_GW_180_SAS_SteeringAngleSpeed_Rv, rawValue);
        rawValue= 0;
        putValue(E_pubc_GW_GW_180_SAS_SASFailure_Rv, rawValue);
        break;
     case(1) :
        rawValue= 1;
        putValue(E_pubc_GW_GW_180_SAS_SteeringAngleValid_Rv, rawValue);
        rawValue= 1;
        putValue(E_pubc_GW_GW_180_SAS_Calibrated_Rv, rawValue);
        rawValue= 7800;
        putValue(E_pubc_GW_GW_180_SAS_SteeringAngle_Rv, rawValue);
        rawValue= 254;
        putValue(E_pubc_GW_GW_180_SAS_SteeringAngleSpeed_Rv, rawValue);
        rawValue= 1;
        putValue(E_pubc_GW_GW_180_SAS_SASFailure_Rv, rawValue);
        break;
     default :
        rawValue= 0;
        putValue(E_pubc_GW_GW_180_SAS_SteeringAngleValid_Rv, rawValue);
        rawValue= 0;
        putValue(E_pubc_GW_GW_180_SAS_Calibrated_Rv, rawValue);
        rawValue= -7800;
        putValue(E_pubc_GW_GW_180_SAS_SteeringAngle_Rv, rawValue);
        rawValue= 0;
        putValue(E_pubc_GW_GW_180_SAS_SteeringAngleSpeed_Rv, rawValue);
        rawValue= 0;
        putValue(E_pubc_GW_GW_180_SAS_SASFailure_Rv, rawValue);
      break;
   }
}

on envVar E_pubc_GW_GW_180_Dlc
{
    if(getValue(E_pubc_GW_GW_180_enDlc))
    {
        Msg_GW_180.dlc =getValue(this);
    }
    else
    {
        Msg_GW_180.dlc =8;
    }
}

on envVar E_pubc_GW_GW_180_enDlc
{
    //For Messages with DLC = 8, set wrong DLC to smaller than defined DLC
    //For Messages with DLC < 8 set wrong DLC to smaller/longer than defined DLC
    if(getValue(this))
    {
        Msg_GW_180.dlc =getValue(E_pubc_GW_GW_180_Dlc);
    }
    else
    {
        Msg_GW_180.dlc =8;
    }
}

on envVar E_pubc_GW_GW_180_SAS_CRCCheck_wrongvalctr
{
    //update disturb count
    //disturb value range:(-1 = always send wrong value),( X>0 ,x is the number of Messages with wrong CHK sent)
    GW_180_SAS_CRCCheck_wrongvalctr =getValue(this);    
}
on envVar E_pubc_GW_GW_180_SAS_RollingCounter_wrongvalctr
{
    //update disturb count
    //disturb value range:(-1 = always send wrong value),( X>0 ,x is the number of Messages with wrong CHK sent)
    GW_180_SAS_RollingCounter_wrongvalctr =getValue(this);    
}

on envVar E_pubc_GW_GW_180_SAS_SteeringAngleValid_Rv
{
    int64 rawValue = 0ll;
    float rawValue_float = 0.0;
    float phyValue = 0.0;        

    //set the signal with updated raw value
    if(getValue(E_pubc_GW_GW_180_SAS_SteeringAngleValid_SetVt)==0)
    {
        rawValue = getvalue(this);
        if(chgEv_GW_180_SAS_SteeringAngleValid == 0)
        {
            //type conversion to float
            rawValue_float = rawValue;        
            // raw to physical conversion
            phyValue = ((rawValue_float *1)+(0));
            putValue(E_pubc_GW_GW_180_SAS_SteeringAngleValid_Pv, phyValue);
            chgEv_GW_180_SAS_SteeringAngleValid = 1;
        }
        else
        {
            chgEv_GW_180_SAS_SteeringAngleValid = 0;
        }    
        //update the signal value
        Msg_GW_180.SAS_SteeringAngleValid=rawValue;        
    }                                                                           
}

on envVar E_pubc_GW_GW_180_SAS_SteeringAngleValid_Pv
{
    int64 rawValue = 0ll;
    float phyValue = 0.0;
    
    //update the raw value with physical value 
    if(getValue(E_pubc_GW_GW_180_SAS_SteeringAngleValid_SetVt)==0)
    {
        if(chgEv_GW_180_SAS_SteeringAngleValid == 0)
        {
            phyValue = getvalue(this);
            // physical to raw conversion
            rawValue = ((phyValue -(0))/1);
            putValue(E_pubc_GW_GW_180_SAS_SteeringAngleValid_Rv, rawValue);
            chgEv_GW_180_SAS_SteeringAngleValid = 1;  
        }
        else
        {
            chgEv_GW_180_SAS_SteeringAngleValid = 0;
        }
    }
}

on envVar E_pubc_GW_GW_180_SAS_SteeringAngleValid_Vt
{
    qword rawValue = 0ll;
    if(getValue(E_pubc_GW_GW_180_SAS_SteeringAngleValid_SetVt))
    {
        //update the signal value
        Msg_GW_180.SAS_SteeringAngleValid=getValue(this);
    }
}

on envVar E_pubc_GW_GW_180_SAS_SteeringAngleValid_SetVt
{
    if(getValue(E_pubc_GW_GW_180_SAS_SteeringAngleValid_SetVt))
    {
        //update the signal value
        Msg_GW_180.SAS_SteeringAngleValid=getvalue(E_pubc_GW_GW_180_SAS_SteeringAngleValid_Vt);
    }
    else
    {
        Msg_GW_180.SAS_SteeringAngleValid=getValue(E_pubc_GW_GW_180_SAS_SteeringAngleValid_Rv);
    }
}
 
on envVar E_pubc_GW_GW_180_SAS_Calibrated_Rv
{
    int64 rawValue = 0ll;
    float rawValue_float = 0.0;
    float phyValue = 0.0;        

    //set the signal with updated raw value
    if(getValue(E_pubc_GW_GW_180_SAS_Calibrated_SetVt)==0)
    {
        rawValue = getvalue(this);
        if(chgEv_GW_180_SAS_Calibrated == 0)
        {
            //type conversion to float
            rawValue_float = rawValue;        
            // raw to physical conversion
            phyValue = ((rawValue_float *1)+(0));
            putValue(E_pubc_GW_GW_180_SAS_Calibrated_Pv, phyValue);
            chgEv_GW_180_SAS_Calibrated = 1;
        }
        else
        {
            chgEv_GW_180_SAS_Calibrated = 0;
        }    
        //update the signal value
        Msg_GW_180.SAS_Calibrated=rawValue;        
    }                                                                           
}

on envVar E_pubc_GW_GW_180_SAS_Calibrated_Pv
{
    int64 rawValue = 0ll;
    float phyValue = 0.0;
    
    //update the raw value with physical value 
    if(getValue(E_pubc_GW_GW_180_SAS_Calibrated_SetVt)==0)
    {
        if(chgEv_GW_180_SAS_Calibrated == 0)
        {
            phyValue = getvalue(this);
            // physical to raw conversion
            rawValue = ((phyValue -(0))/1);
            putValue(E_pubc_GW_GW_180_SAS_Calibrated_Rv, rawValue);
            chgEv_GW_180_SAS_Calibrated = 1;  
        }
        else
        {
            chgEv_GW_180_SAS_Calibrated = 0;
        }
    }
}

on envVar E_pubc_GW_GW_180_SAS_Calibrated_Vt
{
    qword rawValue = 0ll;
    if(getValue(E_pubc_GW_GW_180_SAS_Calibrated_SetVt))
    {
        //update the signal value
        Msg_GW_180.SAS_Calibrated=getValue(this);
    }
}

on envVar E_pubc_GW_GW_180_SAS_Calibrated_SetVt
{
    if(getValue(E_pubc_GW_GW_180_SAS_Calibrated_SetVt))
    {
        //update the signal value
        Msg_GW_180.SAS_Calibrated=getvalue(E_pubc_GW_GW_180_SAS_Calibrated_Vt);
    }
    else
    {
        Msg_GW_180.SAS_Calibrated=getValue(E_pubc_GW_GW_180_SAS_Calibrated_Rv);
    }
}
 
on envVar E_pubc_GW_GW_180_SAS_SteeringAngle_Rv
{
    int64 rawValue = 0ll;
    float rawValue_float = 0.0;
    float phyValue = 0.0;        

    //set the signal with updated raw value
    {
        rawValue = getvalue(this);
        if(chgEv_GW_180_SAS_SteeringAngle == 0)
        {
            //type conversion to float
            rawValue_float = rawValue;        
            // raw to physical conversion
            phyValue = ((rawValue_float *0.1)+(0));
            putValue(E_pubc_GW_GW_180_SAS_SteeringAngle_Pv, phyValue);
            chgEv_GW_180_SAS_SteeringAngle = 1;
        }
        else
        {
            chgEv_GW_180_SAS_SteeringAngle = 0;
        }    
        //update the signal value
        Msg_GW_180.SAS_SteeringAngle=rawValue;        
    }                                                                           
}

on envVar E_pubc_GW_GW_180_SAS_SteeringAngle_Pv
{
    int64 rawValue = 0ll;
    float phyValue = 0.0;
    
    //update the raw value with physical value 
    {
        if(chgEv_GW_180_SAS_SteeringAngle == 0)
        {
            phyValue = getvalue(this);
            // physical to raw conversion
            rawValue = ((phyValue -(0))/0.1);
            putValue(E_pubc_GW_GW_180_SAS_SteeringAngle_Rv, rawValue);
            chgEv_GW_180_SAS_SteeringAngle = 1;  
        }
        else
        {
            chgEv_GW_180_SAS_SteeringAngle = 0;
        }
    }
}


 
on envVar E_pubc_GW_GW_180_SAS_SteeringAngleSpeed_Rv
{
    int64 rawValue = 0ll;
    float rawValue_float = 0.0;
    float phyValue = 0.0;        

    //set the signal with updated raw value
    {
        rawValue = getvalue(this);
        if(chgEv_GW_180_SAS_SteeringAngleSpeed == 0)
        {
            //type conversion to float
            rawValue_float = rawValue;        
            // raw to physical conversion
            phyValue = ((rawValue_float *4)+(0));
            putValue(E_pubc_GW_GW_180_SAS_SteeringAngleSpeed_Pv, phyValue);
            chgEv_GW_180_SAS_SteeringAngleSpeed = 1;
        }
        else
        {
            chgEv_GW_180_SAS_SteeringAngleSpeed = 0;
        }    
        //update the signal value
        Msg_GW_180.SAS_SteeringAngleSpeed=rawValue;        
    }                                                                           
}

on envVar E_pubc_GW_GW_180_SAS_SteeringAngleSpeed_Pv
{
    int64 rawValue = 0ll;
    float phyValue = 0.0;
    
    //update the raw value with physical value 
    {
        if(chgEv_GW_180_SAS_SteeringAngleSpeed == 0)
        {
            phyValue = getvalue(this);
            // physical to raw conversion
            rawValue = ((phyValue -(0))/4);
            putValue(E_pubc_GW_GW_180_SAS_SteeringAngleSpeed_Rv, rawValue);
            chgEv_GW_180_SAS_SteeringAngleSpeed = 1;  
        }
        else
        {
            chgEv_GW_180_SAS_SteeringAngleSpeed = 0;
        }
    }
}


 
on envVar E_pubc_GW_GW_180_SAS_SASFailure_Rv
{
    int64 rawValue = 0ll;
    float rawValue_float = 0.0;
    float phyValue = 0.0;        

    //set the signal with updated raw value
    if(getValue(E_pubc_GW_GW_180_SAS_SASFailure_SetVt)==0)
    {
        rawValue = getvalue(this);
        if(chgEv_GW_180_SAS_SASFailure == 0)
        {
            //type conversion to float
            rawValue_float = rawValue;        
            // raw to physical conversion
            phyValue = ((rawValue_float *1)+(0));
            putValue(E_pubc_GW_GW_180_SAS_SASFailure_Pv, phyValue);
            chgEv_GW_180_SAS_SASFailure = 1;
        }
        else
        {
            chgEv_GW_180_SAS_SASFailure = 0;
        }    
        //update the signal value
        Msg_GW_180.SAS_SASFailure=rawValue;        
    }                                                                           
}

on envVar E_pubc_GW_GW_180_SAS_SASFailure_Pv
{
    int64 rawValue = 0ll;
    float phyValue = 0.0;
    
    //update the raw value with physical value 
    if(getValue(E_pubc_GW_GW_180_SAS_SASFailure_SetVt)==0)
    {
        if(chgEv_GW_180_SAS_SASFailure == 0)
        {
            phyValue = getvalue(this);
            // physical to raw conversion
            rawValue = ((phyValue -(0))/1);
            putValue(E_pubc_GW_GW_180_SAS_SASFailure_Rv, rawValue);
            chgEv_GW_180_SAS_SASFailure = 1;  
        }
        else
        {
            chgEv_GW_180_SAS_SASFailure = 0;
        }
    }
}

on envVar E_pubc_GW_GW_180_SAS_SASFailure_Vt
{
    qword rawValue = 0ll;
    if(getValue(E_pubc_GW_GW_180_SAS_SASFailure_SetVt))
    {
        //update the signal value
        Msg_GW_180.SAS_SASFailure=getValue(this);
    }
}

on envVar E_pubc_GW_GW_180_SAS_SASFailure_SetVt
{
    if(getValue(E_pubc_GW_GW_180_SAS_SASFailure_SetVt))
    {
        //update the signal value
        Msg_GW_180.SAS_SASFailure=getvalue(E_pubc_GW_GW_180_SAS_SASFailure_Vt);
    }
    else
    {
        Msg_GW_180.SAS_SASFailure=getValue(E_pubc_GW_GW_180_SAS_SASFailure_Rv);
    }
}
 
on envVar E_pubc_GW_GW_3BB_tx
{
    if(getValue(this))
    {       
        

        output(Msg_GW_3BB);        
    }
}

on envVar E_pubc_GW_GW_3BB_Range
{
    qword rawstatus = 0ll;
    qword rawValue = 0ll;    
    
    rawstatus = getvalue(this);    
    // set all the signals with min raw /max raw /init raw
    switch (rawstatus) 
    {
     case(0) :
        rawValue= 0;
        putValue(E_pubc_GW_GW_3BB_HU_SpeedLimitDistance_Rv, rawValue);
        break;
     case(1) :
        rawValue= 60;
        putValue(E_pubc_GW_GW_3BB_HU_SpeedLimitDistance_Rv, rawValue);
        break;
     default :
        rawValue= 0;
        putValue(E_pubc_GW_GW_3BB_HU_SpeedLimitDistance_Rv, rawValue);
      break;
   }
}

on envVar E_pubc_GW_GW_3BB_Dlc
{
    if(getValue(E_pubc_GW_GW_3BB_enDlc))
    {
        Msg_GW_3BB.dlc =getValue(this);
    }
    else
    {
        Msg_GW_3BB.dlc =8;
    }
}

on envVar E_pubc_GW_GW_3BB_enDlc
{
    //For Messages with DLC = 8, set wrong DLC to smaller than defined DLC
    //For Messages with DLC < 8 set wrong DLC to smaller/longer than defined DLC
    if(getValue(this))
    {
        Msg_GW_3BB.dlc =getValue(E_pubc_GW_GW_3BB_Dlc);
    }
    else
    {
        Msg_GW_3BB.dlc =8;
    }
}


on envVar E_pubc_GW_GW_3BB_HU_SpeedLimitDistance_Rv
{
    int64 rawValue = 0ll;
    float rawValue_float = 0.0;
    float phyValue = 0.0;        

    //set the signal with updated raw value
    if(getValue(E_pubc_GW_GW_3BB_HU_SpeedLimitDistance_SetVt)==0)
    {
        rawValue = getvalue(this);
        if(chgEv_GW_3BB_HU_SpeedLimitDistance == 0)
        {
            //type conversion to float
            rawValue_float = rawValue;        
            // raw to physical conversion
            phyValue = ((rawValue_float *10)+(0));
            putValue(E_pubc_GW_GW_3BB_HU_SpeedLimitDistance_Pv, phyValue);
            chgEv_GW_3BB_HU_SpeedLimitDistance = 1;
        }
        else
        {
            chgEv_GW_3BB_HU_SpeedLimitDistance = 0;
        }    
        //update the signal value
        Msg_GW_3BB.HU_SpeedLimitDistance=rawValue;        
    }                                                                           
}

on envVar E_pubc_GW_GW_3BB_HU_SpeedLimitDistance_Pv
{
    int64 rawValue = 0ll;
    float phyValue = 0.0;
    
    //update the raw value with physical value 
    if(getValue(E_pubc_GW_GW_3BB_HU_SpeedLimitDistance_SetVt)==0)
    {
        if(chgEv_GW_3BB_HU_SpeedLimitDistance == 0)
        {
            phyValue = getvalue(this);
            // physical to raw conversion
            rawValue = ((phyValue -(0))/10);
            putValue(E_pubc_GW_GW_3BB_HU_SpeedLimitDistance_Rv, rawValue);
            chgEv_GW_3BB_HU_SpeedLimitDistance = 1;  
        }
        else
        {
            chgEv_GW_3BB_HU_SpeedLimitDistance = 0;
        }
    }
}

on envVar E_pubc_GW_GW_3BB_HU_SpeedLimitDistance_Vt
{
    qword rawValue = 0ll;
    if(getValue(E_pubc_GW_GW_3BB_HU_SpeedLimitDistance_SetVt))
    {
        //update the signal value
        Msg_GW_3BB.HU_SpeedLimitDistance=getValue(this);
    }
}

on envVar E_pubc_GW_GW_3BB_HU_SpeedLimitDistance_SetVt
{
    if(getValue(E_pubc_GW_GW_3BB_HU_SpeedLimitDistance_SetVt))
    {
        //update the signal value
        Msg_GW_3BB.HU_SpeedLimitDistance=getvalue(E_pubc_GW_GW_3BB_HU_SpeedLimitDistance_Vt);
    }
    else
    {
        Msg_GW_3BB.HU_SpeedLimitDistance=getValue(E_pubc_GW_GW_3BB_HU_SpeedLimitDistance_Rv);
    }
}
 
on envVar E_pubc_GW_GW_188_tx
{
    if(getValue(this))
    {       
        
        //update the BZ Signal
        if(GW_188_TCU_RollingCounter_188_wrongvalctr == 0)
        {
            update_GW_188_TCU_RollingCounter_188_counter();
            Msg_GW_188.TCU_RollingCounter_188= GW_188_TCU_RollingCounter_188_counter;
        }
        else if(GW_188_TCU_RollingCounter_188_wrongvalctr > 0)
        {
             GW_188_TCU_RollingCounter_188_wrongvalctr--;
              // if counter becomes zero, update panel controller to zero
             if(GW_188_TCU_RollingCounter_188_wrongvalctr == 0)
             {
                 putValue(E_pubc_GW_GW_188_TCU_RollingCounter_188_wrongvalctr,0);
             }
        }
        else
        {
            //do nothing
        }        
        //calculate the CRC CheckSum
        update_GW_188_CRC_CheckSum();

        output(Msg_GW_188);        
    }
}

on envVar E_pubc_GW_GW_188_Range
{
    qword rawstatus = 0ll;
    qword rawValue = 0ll;    
    
    rawstatus = getvalue(this);    
    // set all the signals with min raw /max raw /init raw
    switch (rawstatus) 
    {
     case(0) :
        rawValue= 0;
        putValue(E_pubc_GW_GW_188_TCU_ShiftinProgressValid_Rv, rawValue);
        rawValue= 0;
        putValue(E_pubc_GW_GW_188_TCU_ShiftinProgress_Rv, rawValue);
        break;
     case(1) :
        rawValue= 1;
        putValue(E_pubc_GW_GW_188_TCU_ShiftinProgressValid_Rv, rawValue);
        rawValue= 1;
        putValue(E_pubc_GW_GW_188_TCU_ShiftinProgress_Rv, rawValue);
        break;
     default :
        rawValue= 0;
        putValue(E_pubc_GW_GW_188_TCU_ShiftinProgressValid_Rv, rawValue);
        rawValue= 0;
        putValue(E_pubc_GW_GW_188_TCU_ShiftinProgress_Rv, rawValue);
      break;
   }
}

on envVar E_pubc_GW_GW_188_Dlc
{
    if(getValue(E_pubc_GW_GW_188_enDlc))
    {
        Msg_GW_188.dlc =getValue(this);
    }
    else
    {
        Msg_GW_188.dlc =8;
    }
}

on envVar E_pubc_GW_GW_188_enDlc
{
    //For Messages with DLC = 8, set wrong DLC to smaller than defined DLC
    //For Messages with DLC < 8 set wrong DLC to smaller/longer than defined DLC
    if(getValue(this))
    {
        Msg_GW_188.dlc =getValue(E_pubc_GW_GW_188_Dlc);
    }
    else
    {
        Msg_GW_188.dlc =8;
    }
}

on envVar E_pubc_GW_GW_188_TCU_CRCCheck_188_wrongvalctr
{
    //update disturb count
    //disturb value range:(-1 = always send wrong value),( X>0 ,x is the number of Messages with wrong CHK sent)
    GW_188_TCU_CRCCheck_188_wrongvalctr =getValue(this);    
}
on envVar E_pubc_GW_GW_188_TCU_RollingCounter_188_wrongvalctr
{
    //update disturb count
    //disturb value range:(-1 = always send wrong value),( X>0 ,x is the number of Messages with wrong CHK sent)
    GW_188_TCU_RollingCounter_188_wrongvalctr =getValue(this);    
}

on envVar E_pubc_GW_GW_188_TCU_ShiftinProgressValid_Rv
{
    int64 rawValue = 0ll;
    float rawValue_float = 0.0;
    float phyValue = 0.0;        

    //set the signal with updated raw value
    if(getValue(E_pubc_GW_GW_188_TCU_ShiftinProgressValid_SetVt)==0)
    {
        rawValue = getvalue(this);
        if(chgEv_GW_188_TCU_ShiftinProgressValid == 0)
        {
            //type conversion to float
            rawValue_float = rawValue;        
            // raw to physical conversion
            phyValue = ((rawValue_float *1)+(0));
            putValue(E_pubc_GW_GW_188_TCU_ShiftinProgressValid_Pv, phyValue);
            chgEv_GW_188_TCU_ShiftinProgressValid = 1;
        }
        else
        {
            chgEv_GW_188_TCU_ShiftinProgressValid = 0;
        }    
        //update the signal value
        Msg_GW_188.TCU_ShiftinProgressValid=rawValue;        
    }                                                                           
}

on envVar E_pubc_GW_GW_188_TCU_ShiftinProgressValid_Pv
{
    int64 rawValue = 0ll;
    float phyValue = 0.0;
    
    //update the raw value with physical value 
    if(getValue(E_pubc_GW_GW_188_TCU_ShiftinProgressValid_SetVt)==0)
    {
        if(chgEv_GW_188_TCU_ShiftinProgressValid == 0)
        {
            phyValue = getvalue(this);
            // physical to raw conversion
            rawValue = ((phyValue -(0))/1);
            putValue(E_pubc_GW_GW_188_TCU_ShiftinProgressValid_Rv, rawValue);
            chgEv_GW_188_TCU_ShiftinProgressValid = 1;  
        }
        else
        {
            chgEv_GW_188_TCU_ShiftinProgressValid = 0;
        }
    }
}

on envVar E_pubc_GW_GW_188_TCU_ShiftinProgressValid_Vt
{
    qword rawValue = 0ll;
    if(getValue(E_pubc_GW_GW_188_TCU_ShiftinProgressValid_SetVt))
    {
        //update the signal value
        Msg_GW_188.TCU_ShiftinProgressValid=getValue(this);
    }
}

on envVar E_pubc_GW_GW_188_TCU_ShiftinProgressValid_SetVt
{
    if(getValue(E_pubc_GW_GW_188_TCU_ShiftinProgressValid_SetVt))
    {
        //update the signal value
        Msg_GW_188.TCU_ShiftinProgressValid=getvalue(E_pubc_GW_GW_188_TCU_ShiftinProgressValid_Vt);
    }
    else
    {
        Msg_GW_188.TCU_ShiftinProgressValid=getValue(E_pubc_GW_GW_188_TCU_ShiftinProgressValid_Rv);
    }
}
 
on envVar E_pubc_GW_GW_188_TCU_ShiftinProgress_Rv
{
    int64 rawValue = 0ll;
    float rawValue_float = 0.0;
    float phyValue = 0.0;        

    //set the signal with updated raw value
    if(getValue(E_pubc_GW_GW_188_TCU_ShiftinProgress_SetVt)==0)
    {
        rawValue = getvalue(this);
        if(chgEv_GW_188_TCU_ShiftinProgress == 0)
        {
            //type conversion to float
            rawValue_float = rawValue;        
            // raw to physical conversion
            phyValue = ((rawValue_float *1)+(0));
            putValue(E_pubc_GW_GW_188_TCU_ShiftinProgress_Pv, phyValue);
            chgEv_GW_188_TCU_ShiftinProgress = 1;
        }
        else
        {
            chgEv_GW_188_TCU_ShiftinProgress = 0;
        }    
        //update the signal value
        Msg_GW_188.TCU_ShiftinProgress=rawValue;        
    }                                                                           
}

on envVar E_pubc_GW_GW_188_TCU_ShiftinProgress_Pv
{
    int64 rawValue = 0ll;
    float phyValue = 0.0;
    
    //update the raw value with physical value 
    if(getValue(E_pubc_GW_GW_188_TCU_ShiftinProgress_SetVt)==0)
    {
        if(chgEv_GW_188_TCU_ShiftinProgress == 0)
        {
            phyValue = getvalue(this);
            // physical to raw conversion
            rawValue = ((phyValue -(0))/1);
            putValue(E_pubc_GW_GW_188_TCU_ShiftinProgress_Rv, rawValue);
            chgEv_GW_188_TCU_ShiftinProgress = 1;  
        }
        else
        {
            chgEv_GW_188_TCU_ShiftinProgress = 0;
        }
    }
}

on envVar E_pubc_GW_GW_188_TCU_ShiftinProgress_Vt
{
    qword rawValue = 0ll;
    if(getValue(E_pubc_GW_GW_188_TCU_ShiftinProgress_SetVt))
    {
        //update the signal value
        Msg_GW_188.TCU_ShiftinProgress=getValue(this);
    }
}

on envVar E_pubc_GW_GW_188_TCU_ShiftinProgress_SetVt
{
    if(getValue(E_pubc_GW_GW_188_TCU_ShiftinProgress_SetVt))
    {
        //update the signal value
        Msg_GW_188.TCU_ShiftinProgress=getvalue(E_pubc_GW_GW_188_TCU_ShiftinProgress_Vt);
    }
    else
    {
        Msg_GW_188.TCU_ShiftinProgress=getValue(E_pubc_GW_GW_188_TCU_ShiftinProgress_Rv);
    }
}
 
on envVar E_pubc_GW_GW_28B_tx
{
    if(getValue(this))
    {       
        

        output(Msg_GW_28B);        
    }
}

on envVar E_pubc_GW_GW_28B_Range
{
    qword rawstatus = 0ll;
    qword rawValue = 0ll;    
    
    rawstatus = getvalue(this);    
    // set all the signals with min raw /max raw /init raw
    switch (rawstatus) 
    {
     case(0) :
        rawValue= 0;
        putValue(E_pubc_GW_GW_28B_LCM_LASSwitch_Rv, rawValue);
        rawValue= 0;
        putValue(E_pubc_GW_GW_28B_BCM_emergencylightstatus_Rv, rawValue);
        rawValue= 0;
        putValue(E_pubc_GW_GW_28B_BCM_LowBeamStatus_Rv, rawValue);
        rawValue= 0;
        putValue(E_pubc_GW_GW_28B_BCM_TurnIndicatorLeft_Rv, rawValue);
        rawValue= 0;
        putValue(E_pubc_GW_GW_28B_BCM_TurnLightSwitchSts_Rv, rawValue);
        rawValue= 0;
        putValue(E_pubc_GW_GW_28B_BCM_HighBeamStatus_Rv, rawValue);
        rawValue= 0;
        putValue(E_pubc_GW_GW_28B_BCM_TurnIndicatorRight_Rv, rawValue);
        break;
     case(1) :
        rawValue= 3;
        putValue(E_pubc_GW_GW_28B_LCM_LASSwitch_Rv, rawValue);
        rawValue= 3;
        putValue(E_pubc_GW_GW_28B_BCM_emergencylightstatus_Rv, rawValue);
        rawValue= 3;
        putValue(E_pubc_GW_GW_28B_BCM_LowBeamStatus_Rv, rawValue);
        rawValue= 3;
        putValue(E_pubc_GW_GW_28B_BCM_TurnIndicatorLeft_Rv, rawValue);
        rawValue= 3;
        putValue(E_pubc_GW_GW_28B_BCM_TurnLightSwitchSts_Rv, rawValue);
        rawValue= 3;
        putValue(E_pubc_GW_GW_28B_BCM_HighBeamStatus_Rv, rawValue);
        rawValue= 3;
        putValue(E_pubc_GW_GW_28B_BCM_TurnIndicatorRight_Rv, rawValue);
        break;
     default :
        rawValue= 0;
        putValue(E_pubc_GW_GW_28B_LCM_LASSwitch_Rv, rawValue);
        rawValue= 0;
        putValue(E_pubc_GW_GW_28B_BCM_emergencylightstatus_Rv, rawValue);
        rawValue= 0;
        putValue(E_pubc_GW_GW_28B_BCM_LowBeamStatus_Rv, rawValue);
        rawValue= 0;
        putValue(E_pubc_GW_GW_28B_BCM_TurnIndicatorLeft_Rv, rawValue);
        rawValue= 0;
        putValue(E_pubc_GW_GW_28B_BCM_TurnLightSwitchSts_Rv, rawValue);
        rawValue= 0;
        putValue(E_pubc_GW_GW_28B_BCM_HighBeamStatus_Rv, rawValue);
        rawValue= 0;
        putValue(E_pubc_GW_GW_28B_BCM_TurnIndicatorRight_Rv, rawValue);
      break;
   }
}

on envVar E_pubc_GW_GW_28B_Dlc
{
    if(getValue(E_pubc_GW_GW_28B_enDlc))
    {
        Msg_GW_28B.dlc =getValue(this);
    }
    else
    {
        Msg_GW_28B.dlc =8;
    }
}

on envVar E_pubc_GW_GW_28B_enDlc
{
    //For Messages with DLC = 8, set wrong DLC to smaller than defined DLC
    //For Messages with DLC < 8 set wrong DLC to smaller/longer than defined DLC
    if(getValue(this))
    {
        Msg_GW_28B.dlc =getValue(E_pubc_GW_GW_28B_Dlc);
    }
    else
    {
        Msg_GW_28B.dlc =8;
    }
}


on envVar E_pubc_GW_GW_28B_LCM_LASSwitch_Rv
{
    int64 rawValue = 0ll;
    float rawValue_float = 0.0;
    float phyValue = 0.0;        

    //set the signal with updated raw value
    if(getValue(E_pubc_GW_GW_28B_LCM_LASSwitch_SetVt)==0)
    {
        rawValue = getvalue(this);
        if(chgEv_GW_28B_LCM_LASSwitch == 0)
        {
            //type conversion to float
            rawValue_float = rawValue;        
            // raw to physical conversion
            phyValue = ((rawValue_float *1)+(0));
            putValue(E_pubc_GW_GW_28B_LCM_LASSwitch_Pv, phyValue);
            chgEv_GW_28B_LCM_LASSwitch = 1;
        }
        else
        {
            chgEv_GW_28B_LCM_LASSwitch = 0;
        }    
        //update the signal value
        Msg_GW_28B.LCM_LASSwitch=rawValue;        
    }                                                                           
}

on envVar E_pubc_GW_GW_28B_LCM_LASSwitch_Pv
{
    int64 rawValue = 0ll;
    float phyValue = 0.0;
    
    //update the raw value with physical value 
    if(getValue(E_pubc_GW_GW_28B_LCM_LASSwitch_SetVt)==0)
    {
        if(chgEv_GW_28B_LCM_LASSwitch == 0)
        {
            phyValue = getvalue(this);
            // physical to raw conversion
            rawValue = ((phyValue -(0))/1);
            putValue(E_pubc_GW_GW_28B_LCM_LASSwitch_Rv, rawValue);
            chgEv_GW_28B_LCM_LASSwitch = 1;  
        }
        else
        {
            chgEv_GW_28B_LCM_LASSwitch = 0;
        }
    }
}

on envVar E_pubc_GW_GW_28B_LCM_LASSwitch_Vt
{
    qword rawValue = 0ll;
    if(getValue(E_pubc_GW_GW_28B_LCM_LASSwitch_SetVt))
    {
        //update the signal value
        Msg_GW_28B.LCM_LASSwitch=getValue(this);
    }
}

on envVar E_pubc_GW_GW_28B_LCM_LASSwitch_SetVt
{
    if(getValue(E_pubc_GW_GW_28B_LCM_LASSwitch_SetVt))
    {
        //update the signal value
        Msg_GW_28B.LCM_LASSwitch=getvalue(E_pubc_GW_GW_28B_LCM_LASSwitch_Vt);
    }
    else
    {
        Msg_GW_28B.LCM_LASSwitch=getValue(E_pubc_GW_GW_28B_LCM_LASSwitch_Rv);
    }
}
 
on envVar E_pubc_GW_GW_28B_BCM_emergencylightstatus_Rv
{
    int64 rawValue = 0ll;
    float rawValue_float = 0.0;
    float phyValue = 0.0;        

    //set the signal with updated raw value
    if(getValue(E_pubc_GW_GW_28B_BCM_emergencylightstatus_SetVt)==0)
    {
        rawValue = getvalue(this);
        if(chgEv_GW_28B_BCM_emergencylightstatus == 0)
        {
            //type conversion to float
            rawValue_float = rawValue;        
            // raw to physical conversion
            phyValue = ((rawValue_float *1)+(0));
            putValue(E_pubc_GW_GW_28B_BCM_emergencylightstatus_Pv, phyValue);
            chgEv_GW_28B_BCM_emergencylightstatus = 1;
        }
        else
        {
            chgEv_GW_28B_BCM_emergencylightstatus = 0;
        }    
        //update the signal value
        Msg_GW_28B.BCM_emergencylightstatus=rawValue;        
    }                                                                           
}

on envVar E_pubc_GW_GW_28B_BCM_emergencylightstatus_Pv
{
    int64 rawValue = 0ll;
    float phyValue = 0.0;
    
    //update the raw value with physical value 
    if(getValue(E_pubc_GW_GW_28B_BCM_emergencylightstatus_SetVt)==0)
    {
        if(chgEv_GW_28B_BCM_emergencylightstatus == 0)
        {
            phyValue = getvalue(this);
            // physical to raw conversion
            rawValue = ((phyValue -(0))/1);
            putValue(E_pubc_GW_GW_28B_BCM_emergencylightstatus_Rv, rawValue);
            chgEv_GW_28B_BCM_emergencylightstatus = 1;  
        }
        else
        {
            chgEv_GW_28B_BCM_emergencylightstatus = 0;
        }
    }
}

on envVar E_pubc_GW_GW_28B_BCM_emergencylightstatus_Vt
{
    qword rawValue = 0ll;
    if(getValue(E_pubc_GW_GW_28B_BCM_emergencylightstatus_SetVt))
    {
        //update the signal value
        Msg_GW_28B.BCM_emergencylightstatus=getValue(this);
    }
}

on envVar E_pubc_GW_GW_28B_BCM_emergencylightstatus_SetVt
{
    if(getValue(E_pubc_GW_GW_28B_BCM_emergencylightstatus_SetVt))
    {
        //update the signal value
        Msg_GW_28B.BCM_emergencylightstatus=getvalue(E_pubc_GW_GW_28B_BCM_emergencylightstatus_Vt);
    }
    else
    {
        Msg_GW_28B.BCM_emergencylightstatus=getValue(E_pubc_GW_GW_28B_BCM_emergencylightstatus_Rv);
    }
}
 
on envVar E_pubc_GW_GW_28B_BCM_LowBeamStatus_Rv
{
    int64 rawValue = 0ll;
    float rawValue_float = 0.0;
    float phyValue = 0.0;        

    //set the signal with updated raw value
    if(getValue(E_pubc_GW_GW_28B_BCM_LowBeamStatus_SetVt)==0)
    {
        rawValue = getvalue(this);
        if(chgEv_GW_28B_BCM_LowBeamStatus == 0)
        {
            //type conversion to float
            rawValue_float = rawValue;        
            // raw to physical conversion
            phyValue = ((rawValue_float *1)+(0));
            putValue(E_pubc_GW_GW_28B_BCM_LowBeamStatus_Pv, phyValue);
            chgEv_GW_28B_BCM_LowBeamStatus = 1;
        }
        else
        {
            chgEv_GW_28B_BCM_LowBeamStatus = 0;
        }    
        //update the signal value
        Msg_GW_28B.BCM_LowBeamStatus=rawValue;        
    }                                                                           
}

on envVar E_pubc_GW_GW_28B_BCM_LowBeamStatus_Pv
{
    int64 rawValue = 0ll;
    float phyValue = 0.0;
    
    //update the raw value with physical value 
    if(getValue(E_pubc_GW_GW_28B_BCM_LowBeamStatus_SetVt)==0)
    {
        if(chgEv_GW_28B_BCM_LowBeamStatus == 0)
        {
            phyValue = getvalue(this);
            // physical to raw conversion
            rawValue = ((phyValue -(0))/1);
            putValue(E_pubc_GW_GW_28B_BCM_LowBeamStatus_Rv, rawValue);
            chgEv_GW_28B_BCM_LowBeamStatus = 1;  
        }
        else
        {
            chgEv_GW_28B_BCM_LowBeamStatus = 0;
        }
    }
}

on envVar E_pubc_GW_GW_28B_BCM_LowBeamStatus_Vt
{
    qword rawValue = 0ll;
    if(getValue(E_pubc_GW_GW_28B_BCM_LowBeamStatus_SetVt))
    {
        //update the signal value
        Msg_GW_28B.BCM_LowBeamStatus=getValue(this);
    }
}

on envVar E_pubc_GW_GW_28B_BCM_LowBeamStatus_SetVt
{
    if(getValue(E_pubc_GW_GW_28B_BCM_LowBeamStatus_SetVt))
    {
        //update the signal value
        Msg_GW_28B.BCM_LowBeamStatus=getvalue(E_pubc_GW_GW_28B_BCM_LowBeamStatus_Vt);
    }
    else
    {
        Msg_GW_28B.BCM_LowBeamStatus=getValue(E_pubc_GW_GW_28B_BCM_LowBeamStatus_Rv);
    }
}
 
on envVar E_pubc_GW_GW_28B_BCM_TurnIndicatorLeft_Rv
{
    int64 rawValue = 0ll;
    float rawValue_float = 0.0;
    float phyValue = 0.0;        

    //set the signal with updated raw value
    if(getValue(E_pubc_GW_GW_28B_BCM_TurnIndicatorLeft_SetVt)==0)
    {
        rawValue = getvalue(this);
        if(chgEv_GW_28B_BCM_TurnIndicatorLeft == 0)
        {
            //type conversion to float
            rawValue_float = rawValue;        
            // raw to physical conversion
            phyValue = ((rawValue_float *1)+(0));
            putValue(E_pubc_GW_GW_28B_BCM_TurnIndicatorLeft_Pv, phyValue);
            chgEv_GW_28B_BCM_TurnIndicatorLeft = 1;
        }
        else
        {
            chgEv_GW_28B_BCM_TurnIndicatorLeft = 0;
        }    
        //update the signal value
        Msg_GW_28B.BCM_TurnIndicatorLeft=rawValue;        
    }                                                                           
}

on envVar E_pubc_GW_GW_28B_BCM_TurnIndicatorLeft_Pv
{
    int64 rawValue = 0ll;
    float phyValue = 0.0;
    
    //update the raw value with physical value 
    if(getValue(E_pubc_GW_GW_28B_BCM_TurnIndicatorLeft_SetVt)==0)
    {
        if(chgEv_GW_28B_BCM_TurnIndicatorLeft == 0)
        {
            phyValue = getvalue(this);
            // physical to raw conversion
            rawValue = ((phyValue -(0))/1);
            putValue(E_pubc_GW_GW_28B_BCM_TurnIndicatorLeft_Rv, rawValue);
            chgEv_GW_28B_BCM_TurnIndicatorLeft = 1;  
        }
        else
        {
            chgEv_GW_28B_BCM_TurnIndicatorLeft = 0;
        }
    }
}

on envVar E_pubc_GW_GW_28B_BCM_TurnIndicatorLeft_Vt
{
    qword rawValue = 0ll;
    if(getValue(E_pubc_GW_GW_28B_BCM_TurnIndicatorLeft_SetVt))
    {
        //update the signal value
        Msg_GW_28B.BCM_TurnIndicatorLeft=getValue(this);
    }
}

on envVar E_pubc_GW_GW_28B_BCM_TurnIndicatorLeft_SetVt
{
    if(getValue(E_pubc_GW_GW_28B_BCM_TurnIndicatorLeft_SetVt))
    {
        //update the signal value
        Msg_GW_28B.BCM_TurnIndicatorLeft=getvalue(E_pubc_GW_GW_28B_BCM_TurnIndicatorLeft_Vt);
    }
    else
    {
        Msg_GW_28B.BCM_TurnIndicatorLeft=getValue(E_pubc_GW_GW_28B_BCM_TurnIndicatorLeft_Rv);
    }
}
 
on envVar E_pubc_GW_GW_28B_BCM_TurnLightSwitchSts_Rv
{
    int64 rawValue = 0ll;
    float rawValue_float = 0.0;
    float phyValue = 0.0;        

    //set the signal with updated raw value
    if(getValue(E_pubc_GW_GW_28B_BCM_TurnLightSwitchSts_SetVt)==0)
    {
        rawValue = getvalue(this);
        if(chgEv_GW_28B_BCM_TurnLightSwitchSts == 0)
        {
            //type conversion to float
            rawValue_float = rawValue;        
            // raw to physical conversion
            phyValue = ((rawValue_float *1)+(0));
            putValue(E_pubc_GW_GW_28B_BCM_TurnLightSwitchSts_Pv, phyValue);
            chgEv_GW_28B_BCM_TurnLightSwitchSts = 1;
        }
        else
        {
            chgEv_GW_28B_BCM_TurnLightSwitchSts = 0;
        }    
        //update the signal value
        Msg_GW_28B.BCM_TurnLightSwitchSts=rawValue;        
    }                                                                           
}

on envVar E_pubc_GW_GW_28B_BCM_TurnLightSwitchSts_Pv
{
    int64 rawValue = 0ll;
    float phyValue = 0.0;
    
    //update the raw value with physical value 
    if(getValue(E_pubc_GW_GW_28B_BCM_TurnLightSwitchSts_SetVt)==0)
    {
        if(chgEv_GW_28B_BCM_TurnLightSwitchSts == 0)
        {
            phyValue = getvalue(this);
            // physical to raw conversion
            rawValue = ((phyValue -(0))/1);
            putValue(E_pubc_GW_GW_28B_BCM_TurnLightSwitchSts_Rv, rawValue);
            chgEv_GW_28B_BCM_TurnLightSwitchSts = 1;  
        }
        else
        {
            chgEv_GW_28B_BCM_TurnLightSwitchSts = 0;
        }
    }
}

on envVar E_pubc_GW_GW_28B_BCM_TurnLightSwitchSts_Vt
{
    qword rawValue = 0ll;
    if(getValue(E_pubc_GW_GW_28B_BCM_TurnLightSwitchSts_SetVt))
    {
        //update the signal value
        Msg_GW_28B.BCM_TurnLightSwitchSts=getValue(this);
    }
}

on envVar E_pubc_GW_GW_28B_BCM_TurnLightSwitchSts_SetVt
{
    if(getValue(E_pubc_GW_GW_28B_BCM_TurnLightSwitchSts_SetVt))
    {
        //update the signal value
        Msg_GW_28B.BCM_TurnLightSwitchSts=getvalue(E_pubc_GW_GW_28B_BCM_TurnLightSwitchSts_Vt);
    }
    else
    {
        Msg_GW_28B.BCM_TurnLightSwitchSts=getValue(E_pubc_GW_GW_28B_BCM_TurnLightSwitchSts_Rv);
    }
}
 
on envVar E_pubc_GW_GW_28B_BCM_HighBeamStatus_Rv
{
    int64 rawValue = 0ll;
    float rawValue_float = 0.0;
    float phyValue = 0.0;        

    //set the signal with updated raw value
    if(getValue(E_pubc_GW_GW_28B_BCM_HighBeamStatus_SetVt)==0)
    {
        rawValue = getvalue(this);
        if(chgEv_GW_28B_BCM_HighBeamStatus == 0)
        {
            //type conversion to float
            rawValue_float = rawValue;        
            // raw to physical conversion
            phyValue = ((rawValue_float *1)+(0));
            putValue(E_pubc_GW_GW_28B_BCM_HighBeamStatus_Pv, phyValue);
            chgEv_GW_28B_BCM_HighBeamStatus = 1;
        }
        else
        {
            chgEv_GW_28B_BCM_HighBeamStatus = 0;
        }    
        //update the signal value
        Msg_GW_28B.BCM_HighBeamStatus=rawValue;        
    }                                                                           
}

on envVar E_pubc_GW_GW_28B_BCM_HighBeamStatus_Pv
{
    int64 rawValue = 0ll;
    float phyValue = 0.0;
    
    //update the raw value with physical value 
    if(getValue(E_pubc_GW_GW_28B_BCM_HighBeamStatus_SetVt)==0)
    {
        if(chgEv_GW_28B_BCM_HighBeamStatus == 0)
        {
            phyValue = getvalue(this);
            // physical to raw conversion
            rawValue = ((phyValue -(0))/1);
            putValue(E_pubc_GW_GW_28B_BCM_HighBeamStatus_Rv, rawValue);
            chgEv_GW_28B_BCM_HighBeamStatus = 1;  
        }
        else
        {
            chgEv_GW_28B_BCM_HighBeamStatus = 0;
        }
    }
}

on envVar E_pubc_GW_GW_28B_BCM_HighBeamStatus_Vt
{
    qword rawValue = 0ll;
    if(getValue(E_pubc_GW_GW_28B_BCM_HighBeamStatus_SetVt))
    {
        //update the signal value
        Msg_GW_28B.BCM_HighBeamStatus=getValue(this);
    }
}

on envVar E_pubc_GW_GW_28B_BCM_HighBeamStatus_SetVt
{
    if(getValue(E_pubc_GW_GW_28B_BCM_HighBeamStatus_SetVt))
    {
        //update the signal value
        Msg_GW_28B.BCM_HighBeamStatus=getvalue(E_pubc_GW_GW_28B_BCM_HighBeamStatus_Vt);
    }
    else
    {
        Msg_GW_28B.BCM_HighBeamStatus=getValue(E_pubc_GW_GW_28B_BCM_HighBeamStatus_Rv);
    }
}
 
on envVar E_pubc_GW_GW_28B_BCM_TurnIndicatorRight_Rv
{
    int64 rawValue = 0ll;
    float rawValue_float = 0.0;
    float phyValue = 0.0;        

    //set the signal with updated raw value
    if(getValue(E_pubc_GW_GW_28B_BCM_TurnIndicatorRight_SetVt)==0)
    {
        rawValue = getvalue(this);
        if(chgEv_GW_28B_BCM_TurnIndicatorRight == 0)
        {
            //type conversion to float
            rawValue_float = rawValue;        
            // raw to physical conversion
            phyValue = ((rawValue_float *1)+(0));
            putValue(E_pubc_GW_GW_28B_BCM_TurnIndicatorRight_Pv, phyValue);
            chgEv_GW_28B_BCM_TurnIndicatorRight = 1;
        }
        else
        {
            chgEv_GW_28B_BCM_TurnIndicatorRight = 0;
        }    
        //update the signal value
        Msg_GW_28B.BCM_TurnIndicatorRight=rawValue;        
    }                                                                           
}

on envVar E_pubc_GW_GW_28B_BCM_TurnIndicatorRight_Pv
{
    int64 rawValue = 0ll;
    float phyValue = 0.0;
    
    //update the raw value with physical value 
    if(getValue(E_pubc_GW_GW_28B_BCM_TurnIndicatorRight_SetVt)==0)
    {
        if(chgEv_GW_28B_BCM_TurnIndicatorRight == 0)
        {
            phyValue = getvalue(this);
            // physical to raw conversion
            rawValue = ((phyValue -(0))/1);
            putValue(E_pubc_GW_GW_28B_BCM_TurnIndicatorRight_Rv, rawValue);
            chgEv_GW_28B_BCM_TurnIndicatorRight = 1;  
        }
        else
        {
            chgEv_GW_28B_BCM_TurnIndicatorRight = 0;
        }
    }
}

on envVar E_pubc_GW_GW_28B_BCM_TurnIndicatorRight_Vt
{
    qword rawValue = 0ll;
    if(getValue(E_pubc_GW_GW_28B_BCM_TurnIndicatorRight_SetVt))
    {
        //update the signal value
        Msg_GW_28B.BCM_TurnIndicatorRight=getValue(this);
    }
}

on envVar E_pubc_GW_GW_28B_BCM_TurnIndicatorRight_SetVt
{
    if(getValue(E_pubc_GW_GW_28B_BCM_TurnIndicatorRight_SetVt))
    {
        //update the signal value
        Msg_GW_28B.BCM_TurnIndicatorRight=getvalue(E_pubc_GW_GW_28B_BCM_TurnIndicatorRight_Vt);
    }
    else
    {
        Msg_GW_28B.BCM_TurnIndicatorRight=getValue(E_pubc_GW_GW_28B_BCM_TurnIndicatorRight_Rv);
    }
}
 

update_GW_3B8_HU_RollingCounter_3B8_counter()
{
    //update the signal value
    Msg_GW_3B8.HU_RollingCounter_3B8=GW_3B8_HU_RollingCounter_3B8_counter;
    
    if(GW_3B8_HU_RollingCounter_3B8_counter == 15)
    {
        GW_3B8_HU_RollingCounter_3B8_counter =0;
    }
    else
    {
        GW_3B8_HU_RollingCounter_3B8_counter =GW_3B8_HU_RollingCounter_3B8_counter+1;
    }    
    
}
update_GW_3C4_HU_RollingCounter_3C4_counter()
{
    //update the signal value
    Msg_GW_3C4.HU_RollingCounter_3C4=GW_3C4_HU_RollingCounter_3C4_counter;
    
    if(GW_3C4_HU_RollingCounter_3C4_counter == 15)
    {
        GW_3C4_HU_RollingCounter_3C4_counter =0;
    }
    else
    {
        GW_3C4_HU_RollingCounter_3C4_counter =GW_3C4_HU_RollingCounter_3C4_counter+1;
    }    
    
}
update_GW_50_SRS_RollingCounter_id050_counter()
{
    //update the signal value
    Msg_GW_50.SRS_RollingCounter_id050=GW_50_SRS_RollingCounter_id050_counter;
    
    if(GW_50_SRS_RollingCounter_id050_counter == 15)
    {
        GW_50_SRS_RollingCounter_id050_counter =0;
    }
    else
    {
        GW_50_SRS_RollingCounter_id050_counter =GW_50_SRS_RollingCounter_id050_counter+1;
    }    
    
}
update_GW_208_ESP_RollingCounter_208_counter()
{
    //update the signal value
    Msg_GW_208.ESP_RollingCounter_208=GW_208_ESP_RollingCounter_208_counter;
    
    if(GW_208_ESP_RollingCounter_208_counter == 15)
    {
        GW_208_ESP_RollingCounter_208_counter =0;
    }
    else
    {
        GW_208_ESP_RollingCounter_208_counter =GW_208_ESP_RollingCounter_208_counter+1;
    }    
    
}
update_GW_24F_EPS_RollingCounter_24F_counter()
{
    //update the signal value
    Msg_GW_24F.EPS_RollingCounter_24F=GW_24F_EPS_RollingCounter_24F_counter;
    
    if(GW_24F_EPS_RollingCounter_24F_counter == 15)
    {
        GW_24F_EPS_RollingCounter_24F_counter =0;
    }
    else
    {
        GW_24F_EPS_RollingCounter_24F_counter =GW_24F_EPS_RollingCounter_24F_counter+1;
    }    
    
}
update_GW_258_ESP_RollingCounter_258_counter()
{
    //update the signal value
    Msg_GW_258.ESP_RollingCounter_258=GW_258_ESP_RollingCounter_258_counter;
    
    if(GW_258_ESP_RollingCounter_258_counter == 15)
    {
        GW_258_ESP_RollingCounter_258_counter =0;
    }
    else
    {
        GW_258_ESP_RollingCounter_258_counter =GW_258_ESP_RollingCounter_258_counter+1;
    }    
    
}
update_GW_277_ESP_RollingCounter_277_counter()
{
    //update the signal value
    Msg_GW_277.ESP_RollingCounter_277=GW_277_ESP_RollingCounter_277_counter;
    
    if(GW_277_ESP_RollingCounter_277_counter == 15)
    {
        GW_277_ESP_RollingCounter_277_counter =0;
    }
    else
    {
        GW_277_ESP_RollingCounter_277_counter =GW_277_ESP_RollingCounter_277_counter+1;
    }    
    
}
update_GW_356_IMS_RollingCounter_356_counter()
{
    //update the signal value
    Msg_GW_356.IMS_RollingCounter_356=GW_356_IMS_RollingCounter_356_counter;
    
    if(GW_356_IMS_RollingCounter_356_counter == 15)
    {
        GW_356_IMS_RollingCounter_356_counter =0;
    }
    else
    {
        GW_356_IMS_RollingCounter_356_counter =GW_356_IMS_RollingCounter_356_counter+1;
    }    
    
}
update_GW_278_ESP_RollingCounter_278_counter()
{
    //update the signal value
    Msg_GW_278.ESP_RollingCounter_278=GW_278_ESP_RollingCounter_278_counter;
    
    if(GW_278_ESP_RollingCounter_278_counter == 15)
    {
        GW_278_ESP_RollingCounter_278_counter =0;
    }
    else
    {
        GW_278_ESP_RollingCounter_278_counter =GW_278_ESP_RollingCounter_278_counter+1;
    }    
    
}
update_GW_3C7_HU_RollingCounter_3C7_counter()
{
    //update the signal value
    Msg_GW_3C7.HU_RollingCounter_3C7=GW_3C7_HU_RollingCounter_3C7_counter;
    
    if(GW_3C7_HU_RollingCounter_3C7_counter == 15)
    {
        GW_3C7_HU_RollingCounter_3C7_counter =0;
    }
    else
    {
        GW_3C7_HU_RollingCounter_3C7_counter =GW_3C7_HU_RollingCounter_3C7_counter+1;
    }    
    
}
update_GW_3C6_HU_RollingCounter_3C6_counter()
{
    //update the signal value
    Msg_GW_3C6.HU_RollingCounter_3C6=GW_3C6_HU_RollingCounter_3C6_counter;
    
    if(GW_3C6_HU_RollingCounter_3C6_counter == 15)
    {
        GW_3C6_HU_RollingCounter_3C6_counter =0;
    }
    else
    {
        GW_3C6_HU_RollingCounter_3C6_counter =GW_3C6_HU_RollingCounter_3C6_counter+1;
    }    
    
}
update_GW_1A8_TCU_RollingCounter_1A8_counter()
{
    //update the signal value
    Msg_GW_1A8.TCU_RollingCounter_1A8=GW_1A8_TCU_RollingCounter_1A8_counter;
    
    if(GW_1A8_TCU_RollingCounter_1A8_counter == 15)
    {
        GW_1A8_TCU_RollingCounter_1A8_counter =0;
    }
    else
    {
        GW_1A8_TCU_RollingCounter_1A8_counter =GW_1A8_TCU_RollingCounter_1A8_counter+1;
    }    
    
}
update_GW_3C2_HU_RollingCounter_3C2_counter()
{
    //update the signal value
    Msg_GW_3C2.HU_RollingCounter_3C2=GW_3C2_HU_RollingCounter_3C2_counter;
    
    if(GW_3C2_HU_RollingCounter_3C2_counter == 15)
    {
        GW_3C2_HU_RollingCounter_3C2_counter =0;
    }
    else
    {
        GW_3C2_HU_RollingCounter_3C2_counter =GW_3C2_HU_RollingCounter_3C2_counter+1;
    }    
    
}
update_GW_3AF_HU_RollingCounter_3AF_counter()
{
    //update the signal value
    Msg_GW_3AF.HU_RollingCounter_3AF=GW_3AF_HU_RollingCounter_3AF_counter;
    
    if(GW_3AF_HU_RollingCounter_3AF_counter == 15)
    {
        GW_3AF_HU_RollingCounter_3AF_counter =0;
    }
    else
    {
        GW_3AF_HU_RollingCounter_3AF_counter =GW_3AF_HU_RollingCounter_3AF_counter+1;
    }    
    
}
update_GW_1A6_EMS_RollingCounter_1A6_counter()
{
    //update the signal value
    Msg_GW_1A6.EMS_RollingCounter_1A6=GW_1A6_EMS_RollingCounter_1A6_counter;
    
    if(GW_1A6_EMS_RollingCounter_1A6_counter == 15)
    {
        GW_1A6_EMS_RollingCounter_1A6_counter =0;
    }
    else
    {
        GW_1A6_EMS_RollingCounter_1A6_counter =GW_1A6_EMS_RollingCounter_1A6_counter+1;
    }    
    
}
update_GW_196_EMS_RollingCounter_196_counter()
{
    //update the signal value
    Msg_GW_196.EMS_RollingCounter_196=GW_196_EMS_RollingCounter_196_counter;
    
    if(GW_196_EMS_RollingCounter_196_counter == 15)
    {
        GW_196_EMS_RollingCounter_196_counter =0;
    }
    else
    {
        GW_196_EMS_RollingCounter_196_counter =GW_196_EMS_RollingCounter_196_counter+1;
    }    
    
}
update_GW_17E_EPS_RollingCounter_17E_counter()
{
    //update the signal value
    Msg_GW_17E.EPS_RollingCounter_17E=GW_17E_EPS_RollingCounter_17E_counter;
    
    if(GW_17E_EPS_RollingCounter_17E_counter == 15)
    {
        GW_17E_EPS_RollingCounter_17E_counter =0;
    }
    else
    {
        GW_17E_EPS_RollingCounter_17E_counter =GW_17E_EPS_RollingCounter_17E_counter+1;
    }    
    
}
update_GW_206_ESP_RollingCounter_206_counter()
{
    //update the signal value
    Msg_GW_206.ESP_RollingCounter_206=GW_206_ESP_RollingCounter_206_counter;
    
    if(GW_206_ESP_RollingCounter_206_counter == 15)
    {
        GW_206_ESP_RollingCounter_206_counter =0;
    }
    else
    {
        GW_206_ESP_RollingCounter_206_counter =GW_206_ESP_RollingCounter_206_counter+1;
    }    
    
}
update_GW_28C_GW_MFS_RollingCounter_28C_counter()
{
    //update the signal value
    Msg_GW_28C.GW_MFS_RollingCounter_28C=GW_28C_GW_MFS_RollingCounter_28C_counter;
    
    if(GW_28C_GW_MFS_RollingCounter_28C_counter == 15)
    {
        GW_28C_GW_MFS_RollingCounter_28C_counter =0;
    }
    else
    {
        GW_28C_GW_MFS_RollingCounter_28C_counter =GW_28C_GW_MFS_RollingCounter_28C_counter+1;
    }    
    
}
update_GW_360_IMS_RollingCounter_360_counter()
{
    //update the signal value
    Msg_GW_360.IMS_RollingCounter_360=GW_360_IMS_RollingCounter_360_counter;
    
    if(GW_360_IMS_RollingCounter_360_counter == 15)
    {
        GW_360_IMS_RollingCounter_360_counter =0;
    }
    else
    {
        GW_360_IMS_RollingCounter_360_counter =GW_360_IMS_RollingCounter_360_counter+1;
    }    
    
}
update_GW_170_EPS_RollingCounter_170_counter()
{
    //update the signal value
    Msg_GW_170.EPS_RollingCounter_170=GW_170_EPS_RollingCounter_170_counter;
    
    if(GW_170_EPS_RollingCounter_170_counter == 15)
    {
        GW_170_EPS_RollingCounter_170_counter =0;
    }
    else
    {
        GW_170_EPS_RollingCounter_170_counter =GW_170_EPS_RollingCounter_170_counter+1;
    }    
    
}
update_GW_187_ESP_RollingCounter_187_counter()
{
    //update the signal value
    Msg_GW_187.ESP_RollingCounter_187=GW_187_ESP_RollingCounter_187_counter;
    
    if(GW_187_ESP_RollingCounter_187_counter == 15)
    {
        GW_187_ESP_RollingCounter_187_counter =0;
    }
    else
    {
        GW_187_ESP_RollingCounter_187_counter =GW_187_ESP_RollingCounter_187_counter+1;
    }    
    
}
update_GW_180_SAS_RollingCounter_counter()
{
    //update the signal value
    Msg_GW_180.SAS_RollingCounter=GW_180_SAS_RollingCounter_counter;
    
    if(GW_180_SAS_RollingCounter_counter == 15)
    {
        GW_180_SAS_RollingCounter_counter =0;
    }
    else
    {
        GW_180_SAS_RollingCounter_counter =GW_180_SAS_RollingCounter_counter+1;
    }    
    
}
update_GW_188_TCU_RollingCounter_188_counter()
{
    //update the signal value
    Msg_GW_188.TCU_RollingCounter_188=GW_188_TCU_RollingCounter_188_counter;
    
    if(GW_188_TCU_RollingCounter_188_counter == 15)
    {
        GW_188_TCU_RollingCounter_188_counter =0;
    }
    else
    {
        GW_188_TCU_RollingCounter_188_counter =GW_188_TCU_RollingCounter_188_counter+1;
    }    
    
}


update_GW_3B8_CRC_CheckSum()
{
  int l_Crc_Len=0,l_count=0;
  int l_data[64];
 
  l_Crc_Len = 8-1;
  for (l_count=0;l_count<l_Crc_Len;l_count++)
    {
      l_data[l_count] = Msg_GW_3B8.BYTE(l_count);    
    }
       
	Msg_GW_3B8.BYTE(l_Crc_Len) = calc_SAE_J1850(l_data,l_Crc_Len); 

	
	if(GW_3B8_HU_CRCCheck_3B8_wrongvalctr != 0)
    {
		Msg_GW_3B8.HU_CRCCheck_3B8+=1; 
        //update signal with wrong CRC value
		if(GW_3B8_HU_CRCCheck_3B8_wrongvalctr > 0)
        {
             GW_3B8_HU_CRCCheck_3B8_wrongvalctr--;
              // if counter becomes zero, update panel controller to zero
             if(GW_3B8_HU_CRCCheck_3B8_wrongvalctr == 0)
             {
                 putValue(E_pubc_GW_GW_3B8_HU_CRCCheck_3B8_wrongvalctr,0);
             }
        }
	}
	
}
update_GW_3C4_CRC_CheckSum()
{
  int l_Crc_Len=0,l_count=0;
  int l_data[64];
 
  l_Crc_Len = 8-1;
  for (l_count=0;l_count<l_Crc_Len;l_count++)
    {
      l_data[l_count] = Msg_GW_3C4.BYTE(l_count);    
    }
       
	Msg_GW_3C4.BYTE(l_Crc_Len) = calc_SAE_J1850(l_data,l_Crc_Len); 

	
	if(GW_3C4_HU_CRCCheck_3C4_wrongvalctr != 0)
    {
		Msg_GW_3C4.HU_CRCCheck_3C4+=1; 
        //update signal with wrong CRC value
		if(GW_3C4_HU_CRCCheck_3C4_wrongvalctr > 0)
        {
             GW_3C4_HU_CRCCheck_3C4_wrongvalctr--;
              // if counter becomes zero, update panel controller to zero
             if(GW_3C4_HU_CRCCheck_3C4_wrongvalctr == 0)
             {
                 putValue(E_pubc_GW_GW_3C4_HU_CRCCheck_3C4_wrongvalctr,0);
             }
        }
	}
	
}
update_GW_50_CRC_CheckSum()
{
  int l_Crc_Len=0,l_count=0;
  int l_data[64];int sig_data;
 
  l_Crc_Len = 4-1;
//  for (l_count=0;l_count<l_Crc_Len+1;l_count++)
//    {
//      l_data[l_count] = Msg_GW_50.BYTE(l_count);    
//    }
    sig_data  =Msg_GW_50.SRS_CrashOutputStatus;  
	Msg_GW_50.SRS_CrashOutputStatusCheckSum= GW_50_Checksum(sig_data);

	
	if(GW_50_SRS_CrashOutputStatusCheckSum_wrongvalctr != 0)
    {
		Msg_GW_50.SRS_CrashOutputStatusCheckSum+=1; 
        //update signal with wrong CRC value
		if(GW_50_SRS_CrashOutputStatusCheckSum_wrongvalctr > 0)
        {
             GW_50_SRS_CrashOutputStatusCheckSum_wrongvalctr--;
              // if counter becomes zero, update panel controller to zero
             if(GW_50_SRS_CrashOutputStatusCheckSum_wrongvalctr == 0)
             {
                 putValue(E_pubc_GW_GW_50_SRS_CrashOutputStatusCheckSum_wrongvalctr,0);
             }
        }
	}
	
}
update_GW_208_CRC_CheckSum()
{
  int l_Crc_Len=0,l_count=0;
  int l_data[64];
 
  l_Crc_Len = 8-1;
  for (l_count=0;l_count<l_Crc_Len;l_count++)
    {
      l_data[l_count] = Msg_GW_208.BYTE(l_count);    
    }
       
	Msg_GW_208.BYTE(l_Crc_Len) = calc_SAE_J1850(l_data,l_Crc_Len); 

	
	if(GW_208_ESP_CRCCheck_208_wrongvalctr != 0)
    {
		Msg_GW_208.ESP_CRCCheck_208+=1; 
        //update signal with wrong CRC value
		if(GW_208_ESP_CRCCheck_208_wrongvalctr > 0)
        {
             GW_208_ESP_CRCCheck_208_wrongvalctr--;
              // if counter becomes zero, update panel controller to zero
             if(GW_208_ESP_CRCCheck_208_wrongvalctr == 0)
             {
                 putValue(E_pubc_GW_GW_208_ESP_CRCCheck_208_wrongvalctr,0);
             }
        }
	}
	
}
update_GW_24F_CRC_CheckSum()
{
  int l_Crc_Len=0,l_count=0;
  int l_data[64];
 
  l_Crc_Len = 8-1;
  for (l_count=0;l_count<l_Crc_Len;l_count++)
    {
      l_data[l_count] = Msg_GW_24F.BYTE(l_count);    
    }
       
	Msg_GW_24F.BYTE(l_Crc_Len) = calc_SAE_J1850(l_data,l_Crc_Len); 

	
	if(GW_24F_EPS_CRCCheck_24F_wrongvalctr != 0)
    {
		Msg_GW_24F.EPS_CRCCheck_24F+=1; 
        //update signal with wrong CRC value
		if(GW_24F_EPS_CRCCheck_24F_wrongvalctr > 0)
        {
             GW_24F_EPS_CRCCheck_24F_wrongvalctr--;
              // if counter becomes zero, update panel controller to zero
             if(GW_24F_EPS_CRCCheck_24F_wrongvalctr == 0)
             {
                 putValue(E_pubc_GW_GW_24F_EPS_CRCCheck_24F_wrongvalctr,0);
             }
        }
	}
	
}
update_GW_258_CRC_CheckSum()
{
  int l_Crc_Len=0,l_count=0;
  int l_data[64];
 
  l_Crc_Len = 8-1;
  for (l_count=0;l_count<l_Crc_Len;l_count++)
    {
      l_data[l_count] = Msg_GW_258.BYTE(l_count);    
    }
       
	Msg_GW_258.BYTE(l_Crc_Len) = calc_SAE_J1850(l_data,l_Crc_Len); 

	
	if(GW_258_ESP_CRCCheck_258_wrongvalctr != 0)
    {
		Msg_GW_258.ESP_CRCCheck_258+=1; 
        //update signal with wrong CRC value
		if(GW_258_ESP_CRCCheck_258_wrongvalctr > 0)
        {
             GW_258_ESP_CRCCheck_258_wrongvalctr--;
              // if counter becomes zero, update panel controller to zero
             if(GW_258_ESP_CRCCheck_258_wrongvalctr == 0)
             {
                 putValue(E_pubc_GW_GW_258_ESP_CRCCheck_258_wrongvalctr,0);
             }
        }
	}
	
}
update_GW_277_CRC_CheckSum()
{
  int l_Crc_Len=0,l_count=0;
  int l_data[64];
 
  l_Crc_Len = 8-1;
  for (l_count=0;l_count<l_Crc_Len;l_count++)
    {
      l_data[l_count] = Msg_GW_277.BYTE(l_count);    
    }
       
	Msg_GW_277.BYTE(l_Crc_Len) = calc_SAE_J1850(l_data,l_Crc_Len); 

	
	if(GW_277_ESP_CRCCheck_277_wrongvalctr != 0)
    {
		Msg_GW_277.ESP_CRCCheck_277+=1; 
        //update signal with wrong CRC value
		if(GW_277_ESP_CRCCheck_277_wrongvalctr > 0)
        {
             GW_277_ESP_CRCCheck_277_wrongvalctr--;
              // if counter becomes zero, update panel controller to zero
             if(GW_277_ESP_CRCCheck_277_wrongvalctr == 0)
             {
                 putValue(E_pubc_GW_GW_277_ESP_CRCCheck_277_wrongvalctr,0);
             }
        }
	}
	
}
update_GW_356_CRC_CheckSum()
{
  int l_Crc_Len=0,l_count=0;
  int l_data[64];
 
  l_Crc_Len = 8-1;
  for (l_count=0;l_count<l_Crc_Len;l_count++)
    {
      l_data[l_count] = Msg_GW_356.BYTE(l_count);    
    }
       
	Msg_GW_356.BYTE(l_Crc_Len) = calc_SAE_J1850(l_data,l_Crc_Len); 

	
	if(GW_356_IMS_CRCCheck_356_wrongvalctr != 0)
    {
		Msg_GW_356.IMS_CRCCheck_356+=1; 
        //update signal with wrong CRC value
		if(GW_356_IMS_CRCCheck_356_wrongvalctr > 0)
        {
             GW_356_IMS_CRCCheck_356_wrongvalctr--;
              // if counter becomes zero, update panel controller to zero
             if(GW_356_IMS_CRCCheck_356_wrongvalctr == 0)
             {
                 putValue(E_pubc_GW_GW_356_IMS_CRCCheck_356_wrongvalctr,0);
             }
        }
	}
	
}
update_GW_278_CRC_CheckSum()
{
  int l_Crc_Len=0,l_count=0;
  int l_data[64];
 
  l_Crc_Len = 8-1;
  for (l_count=0;l_count<l_Crc_Len;l_count++)
    {
      l_data[l_count] = Msg_GW_278.BYTE(l_count);    
    }
       
	Msg_GW_278.BYTE(l_Crc_Len) = calc_SAE_J1850(l_data,l_Crc_Len); 

	
	if(GW_278_ESP_CRCCheck_278_wrongvalctr != 0)
    {
		Msg_GW_278.ESP_CRCCheck_278+=1; 
        //update signal with wrong CRC value
		if(GW_278_ESP_CRCCheck_278_wrongvalctr > 0)
        {
             GW_278_ESP_CRCCheck_278_wrongvalctr--;
              // if counter becomes zero, update panel controller to zero
             if(GW_278_ESP_CRCCheck_278_wrongvalctr == 0)
             {
                 putValue(E_pubc_GW_GW_278_ESP_CRCCheck_278_wrongvalctr,0);
             }
        }
	}
	
}
update_GW_3C7_CRC_CheckSum()
{
  int l_Crc_Len=0,l_count=0;
  int l_data[64];
 
  l_Crc_Len = 8-1;
  for (l_count=0;l_count<l_Crc_Len;l_count++)
    {
      l_data[l_count] = Msg_GW_3C7.BYTE(l_count);    
    }
       
	Msg_GW_3C7.BYTE(l_Crc_Len) = calc_SAE_J1850(l_data,l_Crc_Len); 

	
	if(GW_3C7_HU_CRCCheck_3C7_wrongvalctr != 0)
    {
		Msg_GW_3C7.HU_CRCCheck_3C7+=1; 
        //update signal with wrong CRC value
		if(GW_3C7_HU_CRCCheck_3C7_wrongvalctr > 0)
        {
             GW_3C7_HU_CRCCheck_3C7_wrongvalctr--;
              // if counter becomes zero, update panel controller to zero
             if(GW_3C7_HU_CRCCheck_3C7_wrongvalctr == 0)
             {
                 putValue(E_pubc_GW_GW_3C7_HU_CRCCheck_3C7_wrongvalctr,0);
             }
        }
	}
	
}
update_GW_3C6_CRC_CheckSum()
{
  int l_Crc_Len=0,l_count=0;
  int l_data[64];
 
  l_Crc_Len = 8-1;
  for (l_count=0;l_count<l_Crc_Len;l_count++)
    {
      l_data[l_count] = Msg_GW_3C6.BYTE(l_count);    
    }
       
	Msg_GW_3C6.BYTE(l_Crc_Len) = calc_SAE_J1850(l_data,l_Crc_Len); 

	
	if(GW_3C6_HU_CRCCheck_3C6_wrongvalctr != 0)
    {
		Msg_GW_3C6.HU_CRCCheck_3C6+=1; 
        //update signal with wrong CRC value
		if(GW_3C6_HU_CRCCheck_3C6_wrongvalctr > 0)
        {
             GW_3C6_HU_CRCCheck_3C6_wrongvalctr--;
              // if counter becomes zero, update panel controller to zero
             if(GW_3C6_HU_CRCCheck_3C6_wrongvalctr == 0)
             {
                 putValue(E_pubc_GW_GW_3C6_HU_CRCCheck_3C6_wrongvalctr,0);
             }
        }
	}
	
}
update_GW_1A8_CRC_CheckSum()
{
  int l_Crc_Len=0,l_count=0;
  int l_data[64];
 
  l_Crc_Len = 8-1;
  for (l_count=0;l_count<l_Crc_Len;l_count++)
    {
      l_data[l_count] = Msg_GW_1A8.BYTE(l_count);    
    }
       
	Msg_GW_1A8.BYTE(l_Crc_Len) = calc_SAE_J1850(l_data,l_Crc_Len); 

	
	if(GW_1A8_TCU_CRCCheck_1A8_wrongvalctr != 0)
    {
		Msg_GW_1A8.TCU_CRCCheck_1A8+=1; 
        //update signal with wrong CRC value
		if(GW_1A8_TCU_CRCCheck_1A8_wrongvalctr > 0)
        {
             GW_1A8_TCU_CRCCheck_1A8_wrongvalctr--;
              // if counter becomes zero, update panel controller to zero
             if(GW_1A8_TCU_CRCCheck_1A8_wrongvalctr == 0)
             {
                 putValue(E_pubc_GW_GW_1A8_TCU_CRCCheck_1A8_wrongvalctr,0);
             }
        }
	}
	
}
update_GW_3C2_CRC_CheckSum()
{
  int l_Crc_Len=0,l_count=0;
  int l_data[64];
 
  l_Crc_Len = 8-1;
  for (l_count=0;l_count<l_Crc_Len;l_count++)
    {
      l_data[l_count] = Msg_GW_3C2.BYTE(l_count);    
    }
       
	Msg_GW_3C2.BYTE(l_Crc_Len) = calc_SAE_J1850(l_data,l_Crc_Len); 

	
	if(GW_3C2_HU_CRCCheck_3C2_wrongvalctr != 0)
    {
		Msg_GW_3C2.HU_CRCCheck_3C2+=1; 
        //update signal with wrong CRC value
		if(GW_3C2_HU_CRCCheck_3C2_wrongvalctr > 0)
        {
             GW_3C2_HU_CRCCheck_3C2_wrongvalctr--;
              // if counter becomes zero, update panel controller to zero
             if(GW_3C2_HU_CRCCheck_3C2_wrongvalctr == 0)
             {
                 putValue(E_pubc_GW_GW_3C2_HU_CRCCheck_3C2_wrongvalctr,0);
             }
        }
	}
	
}
update_GW_3AF_CRC_CheckSum()
{
  int l_Crc_Len=0,l_count=0;
  int l_data[64];
 
  l_Crc_Len = 8-1;
  for (l_count=0;l_count<l_Crc_Len;l_count++)
    {
      l_data[l_count] = Msg_GW_3AF.BYTE(l_count);    
    }
       
	Msg_GW_3AF.BYTE(l_Crc_Len) = calc_SAE_J1850(l_data,l_Crc_Len); 

	
	if(GW_3AF_HU_CRCCheck_3AF_wrongvalctr != 0)
    {
		Msg_GW_3AF.HU_CRCCheck_3AF+=1; 
        //update signal with wrong CRC value
		if(GW_3AF_HU_CRCCheck_3AF_wrongvalctr > 0)
        {
             GW_3AF_HU_CRCCheck_3AF_wrongvalctr--;
              // if counter becomes zero, update panel controller to zero
             if(GW_3AF_HU_CRCCheck_3AF_wrongvalctr == 0)
             {
                 putValue(E_pubc_GW_GW_3AF_HU_CRCCheck_3AF_wrongvalctr,0);
             }
        }
	}
	
}
update_GW_1A6_CRC_CheckSum()
{
  int l_Crc_Len=0,l_count=0;
  int l_data[64];
 
  l_Crc_Len = 8-1;
  for (l_count=0;l_count<l_Crc_Len;l_count++)
    {
      l_data[l_count] = Msg_GW_1A6.BYTE(l_count);    
    }
       
	Msg_GW_1A6.BYTE(l_Crc_Len) = calc_SAE_J1850(l_data,l_Crc_Len); 

	
	if(GW_1A6_EMS_CRCCheck_1A6_wrongvalctr != 0)
    {
		Msg_GW_1A6.EMS_CRCCheck_1A6+=1; 
        //update signal with wrong CRC value
		if(GW_1A6_EMS_CRCCheck_1A6_wrongvalctr > 0)
        {
             GW_1A6_EMS_CRCCheck_1A6_wrongvalctr--;
              // if counter becomes zero, update panel controller to zero
             if(GW_1A6_EMS_CRCCheck_1A6_wrongvalctr == 0)
             {
                 putValue(E_pubc_GW_GW_1A6_EMS_CRCCheck_1A6_wrongvalctr,0);
             }
        }
	}
	
}
update_GW_196_CRC_CheckSum()
{
  int l_Crc_Len=0,l_count=0;
  int l_data[64];
 
  l_Crc_Len = 8-1;
  for (l_count=0;l_count<l_Crc_Len;l_count++)
    {
      l_data[l_count] = Msg_GW_196.BYTE(l_count);    
    }
       
	Msg_GW_196.BYTE(l_Crc_Len) = calc_SAE_J1850(l_data,l_Crc_Len); 

	
	if(GW_196_EMS_CRCCheck_196_wrongvalctr != 0)
    {
		Msg_GW_196.EMS_CRCCheck_196+=1; 
        //update signal with wrong CRC value
		if(GW_196_EMS_CRCCheck_196_wrongvalctr > 0)
        {
             GW_196_EMS_CRCCheck_196_wrongvalctr--;
              // if counter becomes zero, update panel controller to zero
             if(GW_196_EMS_CRCCheck_196_wrongvalctr == 0)
             {
                 putValue(E_pubc_GW_GW_196_EMS_CRCCheck_196_wrongvalctr,0);
             }
        }
	}
	
}
update_GW_17E_CRC_CheckSum()
{
  int l_Crc_Len=0,l_count=0;
  int l_data[64];
 
  l_Crc_Len = 8-1;
  for (l_count=0;l_count<l_Crc_Len;l_count++)
    {
      l_data[l_count] = Msg_GW_17E.BYTE(l_count);    
    }
       
	Msg_GW_17E.BYTE(l_Crc_Len) = calc_SAE_J1850(l_data,l_Crc_Len); 

	
	if(GW_17E_EPS_CRCCheck_17E_wrongvalctr != 0)
    {
		Msg_GW_17E.EPS_CRCCheck_17E+=1; 
        //update signal with wrong CRC value
		if(GW_17E_EPS_CRCCheck_17E_wrongvalctr > 0)
        {
             GW_17E_EPS_CRCCheck_17E_wrongvalctr--;
              // if counter becomes zero, update panel controller to zero
             if(GW_17E_EPS_CRCCheck_17E_wrongvalctr == 0)
             {
                 putValue(E_pubc_GW_GW_17E_EPS_CRCCheck_17E_wrongvalctr,0);
             }
        }
	}
	
}
update_GW_206_CRC_CheckSum()
{
  int l_Crc_Len=0,l_count=0;
  int l_data[64];
 
  l_Crc_Len = 8-1;
  for (l_count=0;l_count<l_Crc_Len;l_count++)
    {
      l_data[l_count] = Msg_GW_206.BYTE(l_count);    
    }
       
	Msg_GW_206.BYTE(l_Crc_Len) = calc_SAE_J1850(l_data,l_Crc_Len); 

	
	if(GW_206_ESP_CRCCheck_206_wrongvalctr != 0)
    {
		Msg_GW_206.ESP_CRCCheck_206+=1; 
        //update signal with wrong CRC value
		if(GW_206_ESP_CRCCheck_206_wrongvalctr > 0)
        {
             GW_206_ESP_CRCCheck_206_wrongvalctr--;
              // if counter becomes zero, update panel controller to zero
             if(GW_206_ESP_CRCCheck_206_wrongvalctr == 0)
             {
                 putValue(E_pubc_GW_GW_206_ESP_CRCCheck_206_wrongvalctr,0);
             }
        }
	}
	
}
update_GW_28C_CRC_CheckSum()
{
  int l_Crc_Len=0,l_count=0;
  int l_data[64];
 
  l_Crc_Len = 8-1;
  for (l_count=0;l_count<l_Crc_Len;l_count++)
    {
      l_data[l_count] = Msg_GW_28C.BYTE(l_count);    
    }
       
	Msg_GW_28C.BYTE(l_Crc_Len) = calc_SAE_J1850(l_data,l_Crc_Len); 

	
	if(GW_28C_GW_MFS_CRCCheck_28C_wrongvalctr != 0)
    {
		Msg_GW_28C.GW_MFS_CRCCheck_28C+=1; 
        //update signal with wrong CRC value
		if(GW_28C_GW_MFS_CRCCheck_28C_wrongvalctr > 0)
        {
             GW_28C_GW_MFS_CRCCheck_28C_wrongvalctr--;
              // if counter becomes zero, update panel controller to zero
             if(GW_28C_GW_MFS_CRCCheck_28C_wrongvalctr == 0)
             {
                 putValue(E_pubc_GW_GW_28C_GW_MFS_CRCCheck_28C_wrongvalctr,0);
             }
        }
	}
	
}
update_GW_360_CRC_CheckSum()
{
  int l_Crc_Len=0,l_count=0;
  int l_data[64];
 
  l_Crc_Len = 8-1;
  for (l_count=0;l_count<l_Crc_Len;l_count++)
    {
      l_data[l_count] = Msg_GW_360.BYTE(l_count);    
    }
       
	Msg_GW_360.BYTE(l_Crc_Len) = calc_SAE_J1850(l_data,l_Crc_Len); 

	
	if(GW_360_IMS_CRCCheck_360_wrongvalctr != 0)
    {
		Msg_GW_360.IMS_CRCCheck_360+=1; 
        //update signal with wrong CRC value
		if(GW_360_IMS_CRCCheck_360_wrongvalctr > 0)
        {
             GW_360_IMS_CRCCheck_360_wrongvalctr--;
              // if counter becomes zero, update panel controller to zero
             if(GW_360_IMS_CRCCheck_360_wrongvalctr == 0)
             {
                 putValue(E_pubc_GW_GW_360_IMS_CRCCheck_360_wrongvalctr,0);
             }
        }
	}
	
}
update_GW_170_CRC_CheckSum()
{
  int l_Crc_Len=0,l_count=0;
  int l_data[64];
 
  l_Crc_Len = 8-1;
  for (l_count=0;l_count<l_Crc_Len;l_count++)
    {
      l_data[l_count] = Msg_GW_170.BYTE(l_count);    
    }
       
	Msg_GW_170.BYTE(l_Crc_Len) = calc_SAE_J1850(l_data,l_Crc_Len); 

	
	if(GW_170_EPS_CRCCheck_170_wrongvalctr != 0)
    {
		Msg_GW_170.EPS_CRCCheck_170+=1; 
        //update signal with wrong CRC value
		if(GW_170_EPS_CRCCheck_170_wrongvalctr > 0)
        {
             GW_170_EPS_CRCCheck_170_wrongvalctr--;
              // if counter becomes zero, update panel controller to zero
             if(GW_170_EPS_CRCCheck_170_wrongvalctr == 0)
             {
                 putValue(E_pubc_GW_GW_170_EPS_CRCCheck_170_wrongvalctr,0);
             }
        }
	}
	
}
update_GW_187_CRC_CheckSum()
{
  int l_Crc_Len=0,l_count=0;
  int l_data[64];
 
  l_Crc_Len = 8-1;
  for (l_count=0;l_count<l_Crc_Len;l_count++)
    {
      l_data[l_count] = Msg_GW_187.BYTE(l_count);    
    }
       
	Msg_GW_187.BYTE(l_Crc_Len) = calc_SAE_J1850(l_data,l_Crc_Len); 

	
	if(GW_187_ESP_CRCCheck_187_wrongvalctr != 0)
    {
		Msg_GW_187.ESP_CRCCheck_187+=1; 
        //update signal with wrong CRC value
		if(GW_187_ESP_CRCCheck_187_wrongvalctr > 0)
        {
             GW_187_ESP_CRCCheck_187_wrongvalctr--;
              // if counter becomes zero, update panel controller to zero
             if(GW_187_ESP_CRCCheck_187_wrongvalctr == 0)
             {
                 putValue(E_pubc_GW_GW_187_ESP_CRCCheck_187_wrongvalctr,0);
             }
        }
	}
	
}
update_GW_180_CRC_CheckSum()
{
  int l_Crc_Len=0,l_count=0;
  int l_data[64];
 
  l_Crc_Len = 8-1;
  for (l_count=0;l_count<l_Crc_Len;l_count++)
    {
      l_data[l_count] = Msg_GW_180.BYTE(l_count);    
    }
       
	Msg_GW_180.BYTE(l_Crc_Len) = calc_SAE_J1850(l_data,l_Crc_Len); 

	
	if(GW_180_SAS_CRCCheck_wrongvalctr != 0)
    {
		Msg_GW_180.SAS_CRCCheck+=1; 
        //update signal with wrong CRC value
		if(GW_180_SAS_CRCCheck_wrongvalctr > 0)
        {
             GW_180_SAS_CRCCheck_wrongvalctr--;
              // if counter becomes zero, update panel controller to zero
             if(GW_180_SAS_CRCCheck_wrongvalctr == 0)
             {
                 putValue(E_pubc_GW_GW_180_SAS_CRCCheck_wrongvalctr,0);
             }
        }
	}
	
}
update_GW_188_CRC_CheckSum()
{
  int l_Crc_Len=0,l_count=0;
  int l_data[64];
 
  l_Crc_Len = 8-1;
  for (l_count=0;l_count<l_Crc_Len;l_count++)
    {
      l_data[l_count] = Msg_GW_188.BYTE(l_count);    
    }
       
	Msg_GW_188.BYTE(l_Crc_Len) = calc_SAE_J1850(l_data,l_Crc_Len); 

	
	if(GW_188_TCU_CRCCheck_188_wrongvalctr != 0)
    {
		Msg_GW_188.TCU_CRCCheck_188+=1; 
        //update signal with wrong CRC value
		if(GW_188_TCU_CRCCheck_188_wrongvalctr > 0)
        {
             GW_188_TCU_CRCCheck_188_wrongvalctr--;
              // if counter becomes zero, update panel controller to zero
             if(GW_188_TCU_CRCCheck_188_wrongvalctr == 0)
             {
                 putValue(E_pubc_GW_GW_188_TCU_CRCCheck_188_wrongvalctr,0);
             }
        }
	}
	
}









int calc_SAE_J1850(int data[], int Crc_len)
	{
		int idx,crc,temp,temp1;
		crc = 0xFF;
        idx = 0;
        temp = 0;
        temp1 = 0;
	
        for(idx=0;idx < Crc_len;idx++)
        {
         temp1 = data[idx];
         temp = (crc^temp1);
         crc = CRC_J1850_Table[temp];
       }
		crc ^= 0xFF;
		return crc;
	}

//GW_50_Checksum
int GW_50_Checksum(int data)
	{
		int idx,crc;
		   crc = 0;
        idx = 0;
	      crc = data ^ 0xF;
//        for(idx=1;idx < Crc_len;idx++)
//        {
//         crc=crc^data[idx];
//       }
		//crc ^= 0xF0;
		return crc;
	}




	/*	int calc_SAE_J1851(int data[], int Crc_len)
	{
		int crc;
		
        crc = (data[0]+data[1]+data[2]+data[3]+data[4]+data[5]+data[6]) ;
          
		crc ^= 255;
		return crc;
	}*/

	

/* 	int calc_SAE_J1850(int data, int Crc_len)
	{
		int idx,crc,temp,temp1,temp2,idy;
		crc = 0xFF;
        idx = 0;
        idy = 0;
        temp = 0;
        temp1 = 0;
        temp2 = 0;
	
        for(idx=0;idx < Crc_len;idx++)
        {
         temp1 = data[idx];
         crc = (crc^temp1);
          for (idy=8; idy>0; idy--)
          {
              // Save the value before the top bit is shifted out.
              temp2 = crc;
              crc <<= 1;
              if (0 != (temp2 & 128))
              {
                  crc ^= 0x2f;
              }
          } 
          
         //crc = CRC_J1850_Table[temp];
        }
		crc ^= 0xFF;
		return crc;
	} */

