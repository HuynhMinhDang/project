/*@!Encoding:1252*/

variables
{
    //Used interact between raw and the physical environment variables
    byte chgEv_TrajPointACCObj16_TrajPointACCObj16_dyv_sw = 0;
    byte chgEv_TrajPointACCObj16_TrajPointACCObj16_Stand_b = 0;
    byte chgEv_TrajPointACCObj16_TrajPointACCObj16_dxv_sw = 0;
    byte chgEv_TrajPointACCObj16_TrajPointACCObj16_timestamp = 0;
    byte chgEv_TrajPointACCObj16_TrajPointACCObj16_Drive_b = 0;
    byte chgEv_TrajPointACCObj16_TrajPointACCObj16_dVarYv_uw = 0;
    byte chgEv_TrajPointACCObj16_TrajPointACCObj16_dVarXv_uw = 0;
    byte chgEv_TrajPointACCObj16_TrajPointACCObj16_wExistProb_ub = 0;
    byte chgEv_TrajPointACCObj16_TrajPointACCObj16_InvDir_b = 0;
    byte chgEv_TrajPointACCObj16_TrajPointACCObj16_Valid_b = 0;
    byte chgEv_TrajPointACCObj16_TrajPointACCObj16_Stopped_b = 0;
    byte chgEv_TrajPointACCObj16_TrajPointACCObj16_TrajEnd_b = 0;
    byte chgEv_RDR1Header_FRS_Pri_ALOD_ControlType = 0;
    byte chgEv_RDR1Header_NumVehEgoLane = 0;
    byte chgEv_RDR1Header_Status_AvoidCollision = 0;
    byte chgEv_RDR1Header_TjaFID = 0;
    byte chgEv_RDR1Header_RDR1ObjectDataAge = 0;
    byte chgEv_RDR1Header_ACC_ExitReason = 0;
    byte chgEv_RDR1Header_StatusACC = 0;
    byte chgEv_OnComingObj3_OnComingObj3_RFF_ub = 0;
    byte chgEv_OnComingObj3_OnComingObj3_Handle_ub = 0;
    byte chgEv_OnComingObj3_OnComingObj3_dyv_sw = 0;
    byte chgEv_OnComingObj3_OnComingObj3_vxv_sw = 0;
    byte chgEv_OnComingObj3_OnComingObj3_dxv_sw = 0;
    byte chgEv_OnComingObj3_OnComingObj3_dWidth_sw = 0;
    byte chgEv_OnComingObj2_OnComingObj2_dyv_sw = 0;
    byte chgEv_OnComingObj2_OnComingObj2_Handle_ub = 0;
    byte chgEv_OnComingObj2_OnComingObj2_dWidth_sw = 0;
    byte chgEv_OnComingObj2_OnComingObj2_dxv_sw = 0;
    byte chgEv_OnComingObj2_OnComingObj2_vxv_sw = 0;
    byte chgEv_OnComingObj2_OnComingObj2_RFF_ub = 0;
    byte chgEv_OnComingObj1_OnComingObj1_RFF_ub = 0;
    byte chgEv_OnComingObj1_OnComingObj1_dxv_sw = 0;
    byte chgEv_OnComingObj1_OnComingObj1_dWidth_sw = 0;
    byte chgEv_OnComingObj1_OnComingObj1_dyv_sw = 0;
    byte chgEv_OnComingObj1_OnComingObj1_Handle_ub = 0;
    byte chgEv_OnComingObj1_OnComingObj1_vxv_sw = 0;
    byte chgEv_OnComingObj0_OnComingObj0_dWidth_sw = 0;
    byte chgEv_OnComingObj0_OnComingObj0_dyv_sw = 0;
    byte chgEv_OnComingObj0_OnComingObj0_RFF_ub = 0;
    byte chgEv_OnComingObj0_OnComingObj0_dxv_sw = 0;
    byte chgEv_OnComingObj0_OnComingObj0_vxv_sw = 0;
    byte chgEv_OnComingObj0_OnComingObj0_Handle_ub = 0;
    byte chgEv_TrajPointACCObj19_TrajPointACCObj19_Drive_b = 0;
    byte chgEv_TrajPointACCObj19_TrajPointACCObj19_InvDir_b = 0;
    byte chgEv_TrajPointACCObj19_TrajPointACCObj19_dyv_sw = 0;
    byte chgEv_TrajPointACCObj19_TrajPointACCObj19_Stopped_b = 0;
    byte chgEv_TrajPointACCObj19_TrajPointACCObj19_dxv_sw = 0;
    byte chgEv_TrajPointACCObj19_TrajPointACCObj19_Stand_b = 0;
    byte chgEv_TrajPointACCObj19_TrajPointACCObj19_wExistProb_ub = 0;
    byte chgEv_TrajPointACCObj19_TrajPointACCObj19_dVarYv_uw = 0;
    byte chgEv_TrajPointACCObj19_TrajPointACCObj19_dVarXv_uw = 0;
    byte chgEv_TrajPointACCObj19_TrajPointACCObj19_Valid_b = 0;
    byte chgEv_TrajPointACCObj19_TrajPointACCObj19_TrajEnd_b = 0;
    byte chgEv_TrajPointACCObj19_TrajPointACCObj19_timestamp = 0;
    byte chgEv_TrajPointACCObj18_TrajPointACCObj18_TrajEnd_b = 0;
    byte chgEv_TrajPointACCObj18_TrajPointACCObj18_dxv_sw = 0;
    byte chgEv_TrajPointACCObj18_TrajPointACCObj18_Valid_b = 0;
    byte chgEv_TrajPointACCObj18_TrajPointACCObj18_Stopped_b = 0;
    byte chgEv_TrajPointACCObj18_TrajPointACCObj18_Stand_b = 0;
    byte chgEv_TrajPointACCObj18_TrajPointACCObj18_Drive_b = 0;
    byte chgEv_TrajPointACCObj18_TrajPointACCObj18_timestamp = 0;
    byte chgEv_TrajPointACCObj18_TrajPointACCObj18_dVarYv_uw = 0;
    byte chgEv_TrajPointACCObj18_TrajPointACCObj18_InvDir_b = 0;
    byte chgEv_TrajPointACCObj18_TrajPointACCObj18_dyv_sw = 0;
    byte chgEv_TrajPointACCObj18_TrajPointACCObj18_dVarXv_uw = 0;
    byte chgEv_TrajPointACCObj18_TrajPointACCObj18_wExistProb_ub = 0;
    byte chgEv_OnGoingObj1_OnGoingObj1_RFF_ub = 0;
    byte chgEv_OnGoingObj1_OnGoingObj1_dyv_sw = 0;
    byte chgEv_OnGoingObj1_OnGoingObj1_vxv_sw = 0;
    byte chgEv_OnGoingObj1_OnGoingObj1_dxv_sw = 0;
    byte chgEv_OnGoingObj1_OnGoingObj1_Handle_ub = 0;
    byte chgEv_OnGoingObj0_OnGoingObj0_dyv_sw = 0;
    byte chgEv_OnGoingObj0_OnGoingObj0_Handle_ub = 0;
    byte chgEv_OnGoingObj0_OnGoingObj0_dxv_sw = 0;
    byte chgEv_OnGoingObj0_OnGoingObj0_vxv_sw = 0;
    byte chgEv_OnGoingObj0_OnGoingObj0_RFF_ub = 0;
    byte chgEv_TrajPointACCObj13_TrajPointACCObj13_dyv_sw = 0;
    byte chgEv_TrajPointACCObj13_TrajPointACCObj13_TrajEnd_b = 0;
    byte chgEv_TrajPointACCObj13_TrajPointACCObj13_Drive_b = 0;
    byte chgEv_TrajPointACCObj13_TrajPointACCObj13_Stand_b = 0;
    byte chgEv_TrajPointACCObj13_TrajPointACCObj13_dxv_sw = 0;
    byte chgEv_TrajPointACCObj13_TrajPointACCObj13_dVarXv_uw = 0;
    byte chgEv_TrajPointACCObj13_TrajPointACCObj13_wExistProb_ub = 0;
    byte chgEv_TrajPointACCObj13_TrajPointACCObj13_Valid_b = 0;
    byte chgEv_TrajPointACCObj13_TrajPointACCObj13_dVarYv_uw = 0;
    byte chgEv_TrajPointACCObj13_TrajPointACCObj13_InvDir_b = 0;
    byte chgEv_TrajPointACCObj13_TrajPointACCObj13_Stopped_b = 0;
    byte chgEv_TrajPointACCObj13_TrajPointACCObj13_timestamp = 0;
    byte chgEv_TrajPointACCObj12_TrajPointACCObj12_Valid_b = 0;
    byte chgEv_TrajPointACCObj12_TrajPointACCObj12_dVarYv_uw = 0;
    byte chgEv_TrajPointACCObj12_TrajPointACCObj12_wExistProb_ub = 0;
    byte chgEv_TrajPointACCObj12_TrajPointACCObj12_InvDir_b = 0;
    byte chgEv_TrajPointACCObj12_TrajPointACCObj12_dVarXv_uw = 0;
    byte chgEv_TrajPointACCObj12_TrajPointACCObj12_Stopped_b = 0;
    byte chgEv_TrajPointACCObj12_TrajPointACCObj12_dyv_sw = 0;
    byte chgEv_TrajPointACCObj12_TrajPointACCObj12_dxv_sw = 0;
    byte chgEv_TrajPointACCObj12_TrajPointACCObj12_Drive_b = 0;
    byte chgEv_TrajPointACCObj12_TrajPointACCObj12_timestamp = 0;
    byte chgEv_TrajPointACCObj12_TrajPointACCObj12_TrajEnd_b = 0;
    byte chgEv_TrajPointACCObj12_TrajPointACCObj12_Stand_b = 0;
    byte chgEv_TrajPointACCObj11_TrajPointACCObj11_dyv_sw = 0;
    byte chgEv_TrajPointACCObj11_TrajPointACCObj11_dVarXv_uw = 0;
    byte chgEv_TrajPointACCObj11_TrajPointACCObj11_dxv_sw = 0;
    byte chgEv_TrajPointACCObj11_TrajPointACCObj11_Drive_b = 0;
    byte chgEv_TrajPointACCObj11_TrajPointACCObj11_timestamp = 0;
    byte chgEv_TrajPointACCObj11_TrajPointACCObj11_Stopped_b = 0;
    byte chgEv_TrajPointACCObj11_TrajPointACCObj11_Valid_b = 0;
    byte chgEv_TrajPointACCObj11_TrajPointACCObj11_TrajEnd_b = 0;
    byte chgEv_TrajPointACCObj11_TrajPointACCObj11_Stand_b = 0;
    byte chgEv_TrajPointACCObj11_TrajPointACCObj11_dVarYv_uw = 0;
    byte chgEv_TrajPointACCObj11_TrajPointACCObj11_wExistProb_ub = 0;
    byte chgEv_TrajPointACCObj11_TrajPointACCObj11_InvDir_b = 0;
    byte chgEv_TrajPointACCObj10_TrajPointACCObj10_timestamp = 0;
    byte chgEv_TrajPointACCObj10_TrajPointACCObj10_wExistProb_ub = 0;
    byte chgEv_TrajPointACCObj10_TrajPointACCObj10_dyv_sw = 0;
    byte chgEv_TrajPointACCObj10_TrajPointACCObj10_Drive_b = 0;
    byte chgEv_TrajPointACCObj10_TrajPointACCObj10_Stopped_b = 0;
    byte chgEv_TrajPointACCObj10_TrajPointACCObj10_Stand_b = 0;
    byte chgEv_TrajPointACCObj10_TrajPointACCObj10_TrajEnd_b = 0;
    byte chgEv_TrajPointACCObj10_TrajPointACCObj10_dVarXv_uw = 0;
    byte chgEv_TrajPointACCObj10_TrajPointACCObj10_dVarYv_uw = 0;
    byte chgEv_TrajPointACCObj10_TrajPointACCObj10_dxv_sw = 0;
    byte chgEv_TrajPointACCObj10_TrajPointACCObj10_Valid_b = 0;
    byte chgEv_TrajPointACCObj10_TrajPointACCObj10_InvDir_b = 0;
    byte chgEv_TrajPointACCObj17_TrajPointACCObj17_Valid_b = 0;
    byte chgEv_TrajPointACCObj17_TrajPointACCObj17_Drive_b = 0;
    byte chgEv_TrajPointACCObj17_TrajPointACCObj17_dVarYv_uw = 0;
    byte chgEv_TrajPointACCObj17_TrajPointACCObj17_InvDir_b = 0;
    byte chgEv_TrajPointACCObj17_TrajPointACCObj17_wExistProb_ub = 0;
    byte chgEv_TrajPointACCObj17_TrajPointACCObj17_dyv_sw = 0;
    byte chgEv_TrajPointACCObj17_TrajPointACCObj17_timestamp = 0;
    byte chgEv_TrajPointACCObj17_TrajPointACCObj17_Stopped_b = 0;
    byte chgEv_TrajPointACCObj17_TrajPointACCObj17_dxv_sw = 0;
    byte chgEv_TrajPointACCObj17_TrajPointACCObj17_dVarXv_uw = 0;
    byte chgEv_TrajPointACCObj17_TrajPointACCObj17_TrajEnd_b = 0;
    byte chgEv_TrajPointACCObj17_TrajPointACCObj17_Stand_b = 0;
    byte chgEv_TrajACC_TrajACC_objType_ub = 0;
    byte chgEv_TrajACC_TrajACC_TrajHistCurrentIndex_ub = 0;
    byte chgEv_TrajPointACCObj15_TrajPointACCObj15_wExistProb_ub = 0;
    byte chgEv_TrajPointACCObj15_TrajPointACCObj15_Stand_b = 0;
    byte chgEv_TrajPointACCObj15_TrajPointACCObj15_Stopped_b = 0;
    byte chgEv_TrajPointACCObj15_TrajPointACCObj15_InvDir_b = 0;
    byte chgEv_TrajPointACCObj15_TrajPointACCObj15_dxv_sw = 0;
    byte chgEv_TrajPointACCObj15_TrajPointACCObj15_dVarXv_uw = 0;
    byte chgEv_TrajPointACCObj15_TrajPointACCObj15_timestamp = 0;
    byte chgEv_TrajPointACCObj15_TrajPointACCObj15_dyv_sw = 0;
    byte chgEv_TrajPointACCObj15_TrajPointACCObj15_TrajEnd_b = 0;
    byte chgEv_TrajPointACCObj15_TrajPointACCObj15_Drive_b = 0;
    byte chgEv_TrajPointACCObj15_TrajPointACCObj15_dVarYv_uw = 0;
    byte chgEv_TrajPointACCObj15_TrajPointACCObj15_Valid_b = 0;
    byte chgEv_TrajPointACCObj14_TrajPointACCObj14_timestamp = 0;
    byte chgEv_TrajPointACCObj14_TrajPointACCObj14_dVarXv_uw = 0;
    byte chgEv_TrajPointACCObj14_TrajPointACCObj14_Valid_b = 0;
    byte chgEv_TrajPointACCObj14_TrajPointACCObj14_dVarYv_uw = 0;
    byte chgEv_TrajPointACCObj14_TrajPointACCObj14_TrajEnd_b = 0;
    byte chgEv_TrajPointACCObj14_TrajPointACCObj14_dxv_sw = 0;
    byte chgEv_TrajPointACCObj14_TrajPointACCObj14_Stopped_b = 0;
    byte chgEv_TrajPointACCObj14_TrajPointACCObj14_wExistProb_ub = 0;
    byte chgEv_TrajPointACCObj14_TrajPointACCObj14_Stand_b = 0;
    byte chgEv_TrajPointACCObj14_TrajPointACCObj14_dyv_sw = 0;
    byte chgEv_TrajPointACCObj14_TrajPointACCObj14_InvDir_b = 0;
    byte chgEv_TrajPointACCObj14_TrajPointACCObj14_Drive_b = 0;
    byte chgEv_RDR_Status_RDR_Stat_blindness_det = 0;
    byte chgEv_RDR_Status_RDR_Stat_Error = 0;
    byte chgEv_RDR_Status_RDR_Stat_PED_Brake = 0;
    byte chgEv_RDR_Status_RDR_Stat_ObjDataAge = 0;
    byte chgEv_RDR_Status_RDR_Stat_ACCSwitchButton = 0;
    byte chgEv_RDR_Status_RDR_Stat_Avail = 0;
    byte chgEv_TrajPointACCObj9_TrajPointACCObj9_Stand_b = 0;
    byte chgEv_TrajPointACCObj9_TrajPointACCObj9_Drive_b = 0;
    byte chgEv_TrajPointACCObj9_TrajPointACCObj9_wExistProb_ub = 0;
    byte chgEv_TrajPointACCObj9_TrajPointACCObj9_TrajEnd_b = 0;
    byte chgEv_TrajPointACCObj9_TrajPointACCObj9_dVarYv_uw = 0;
    byte chgEv_TrajPointACCObj9_TrajPointACCObj9_dVarXv_uw = 0;
    byte chgEv_TrajPointACCObj9_TrajPointACCObj9_InvDir_b = 0;
    byte chgEv_TrajPointACCObj9_TrajPointACCObj9_dxv_sw = 0;
    byte chgEv_TrajPointACCObj9_TrajPointACCObj9_Stopped_b = 0;
    byte chgEv_TrajPointACCObj9_TrajPointACCObj9_dyv_sw = 0;
    byte chgEv_TrajPointACCObj9_TrajPointACCObj9_timestamp = 0;
    byte chgEv_TrajPointACCObj9_TrajPointACCObj9_Valid_b = 0;
    byte chgEv_TrajPointACCObj8_TrajPointACCObj8_dyv_sw = 0;
    byte chgEv_TrajPointACCObj8_TrajPointACCObj8_dVarYv_uw = 0;
    byte chgEv_TrajPointACCObj8_TrajPointACCObj8_timestamp = 0;
    byte chgEv_TrajPointACCObj8_TrajPointACCObj8_wExistProb_ub = 0;
    byte chgEv_TrajPointACCObj8_TrajPointACCObj8_InvDir_b = 0;
    byte chgEv_TrajPointACCObj8_TrajPointACCObj8_Stopped_b = 0;
    byte chgEv_TrajPointACCObj8_TrajPointACCObj8_Stand_b = 0;
    byte chgEv_TrajPointACCObj8_TrajPointACCObj8_dxv_sw = 0;
    byte chgEv_TrajPointACCObj8_TrajPointACCObj8_TrajEnd_b = 0;
    byte chgEv_TrajPointACCObj8_TrajPointACCObj8_dVarXv_uw = 0;
    byte chgEv_TrajPointACCObj8_TrajPointACCObj8_Valid_b = 0;
    byte chgEv_TrajPointACCObj8_TrajPointACCObj8_Drive_b = 0;
    byte chgEv_TrajPointACCObj7_TrajPointACCObj7_wExistProb_ub = 0;
    byte chgEv_TrajPointACCObj7_TrajPointACCObj7_dVarXv_uw = 0;
    byte chgEv_TrajPointACCObj7_TrajPointACCObj7_Drive_b = 0;
    byte chgEv_TrajPointACCObj7_TrajPointACCObj7_TrajEnd_b = 0;
    byte chgEv_TrajPointACCObj7_TrajPointACCObj7_timestamp = 0;
    byte chgEv_TrajPointACCObj7_TrajPointACCObj7_dVarYv_uw = 0;
    byte chgEv_TrajPointACCObj7_TrajPointACCObj7_Stand_b = 0;
    byte chgEv_TrajPointACCObj7_TrajPointACCObj7_Valid_b = 0;
    byte chgEv_TrajPointACCObj7_TrajPointACCObj7_dyv_sw = 0;
    byte chgEv_TrajPointACCObj7_TrajPointACCObj7_Stopped_b = 0;
    byte chgEv_TrajPointACCObj7_TrajPointACCObj7_dxv_sw = 0;
    byte chgEv_TrajPointACCObj7_TrajPointACCObj7_InvDir_b = 0;
    byte chgEv_TrajPointACCObj6_TrajPointACCObj6_Stand_b = 0;
    byte chgEv_TrajPointACCObj6_TrajPointACCObj6_wExistProb_ub = 0;
    byte chgEv_TrajPointACCObj6_TrajPointACCObj6_InvDir_b = 0;
    byte chgEv_TrajPointACCObj6_TrajPointACCObj6_Valid_b = 0;
    byte chgEv_TrajPointACCObj6_TrajPointACCObj6_dVarYv_uw = 0;
    byte chgEv_TrajPointACCObj6_TrajPointACCObj6_dxv_sw = 0;
    byte chgEv_TrajPointACCObj6_TrajPointACCObj6_timestamp = 0;
    byte chgEv_TrajPointACCObj6_TrajPointACCObj6_dVarXv_uw = 0;
    byte chgEv_TrajPointACCObj6_TrajPointACCObj6_Stopped_b = 0;
    byte chgEv_TrajPointACCObj6_TrajPointACCObj6_dyv_sw = 0;
    byte chgEv_TrajPointACCObj6_TrajPointACCObj6_Drive_b = 0;
    byte chgEv_TrajPointACCObj6_TrajPointACCObj6_TrajEnd_b = 0;
    byte chgEv_TrajPointACCObj5_TrajPointACCObj5_dxv_sw = 0;
    byte chgEv_TrajPointACCObj5_TrajPointACCObj5_timestamp = 0;
    byte chgEv_TrajPointACCObj5_TrajPointACCObj5_dVarYv_uw = 0;
    byte chgEv_TrajPointACCObj5_TrajPointACCObj5_InvDir_b = 0;
    byte chgEv_TrajPointACCObj5_TrajPointACCObj5_Valid_b = 0;
    byte chgEv_TrajPointACCObj5_TrajPointACCObj5_wExistProb_ub = 0;
    byte chgEv_TrajPointACCObj5_TrajPointACCObj5_TrajEnd_b = 0;
    byte chgEv_TrajPointACCObj5_TrajPointACCObj5_dVarXv_uw = 0;
    byte chgEv_TrajPointACCObj5_TrajPointACCObj5_dyv_sw = 0;
    byte chgEv_TrajPointACCObj5_TrajPointACCObj5_Drive_b = 0;
    byte chgEv_TrajPointACCObj5_TrajPointACCObj5_Stand_b = 0;
    byte chgEv_TrajPointACCObj5_TrajPointACCObj5_Stopped_b = 0;
    byte chgEv_TrajPointACCObj4_TrajPointACCObj4_Stopped_b = 0;
    byte chgEv_TrajPointACCObj4_TrajPointACCObj4_Valid_b = 0;
    byte chgEv_TrajPointACCObj4_TrajPointACCObj4_TrajEnd_b = 0;
    byte chgEv_TrajPointACCObj4_TrajPointACCObj4_Stand_b = 0;
    byte chgEv_TrajPointACCObj4_TrajPointACCObj4_timestamp = 0;
    byte chgEv_TrajPointACCObj4_TrajPointACCObj4_wExistProb_ub = 0;
    byte chgEv_TrajPointACCObj4_TrajPointACCObj4_InvDir_b = 0;
    byte chgEv_TrajPointACCObj4_TrajPointACCObj4_dVarXv_uw = 0;
    byte chgEv_TrajPointACCObj4_TrajPointACCObj4_dVarYv_uw = 0;
    byte chgEv_TrajPointACCObj4_TrajPointACCObj4_Drive_b = 0;
    byte chgEv_TrajPointACCObj4_TrajPointACCObj4_dxv_sw = 0;
    byte chgEv_TrajPointACCObj4_TrajPointACCObj4_dyv_sw = 0;
    byte chgEv_TrajPointACCObj3_TrajPointACCObj3_dyv_sw = 0;
    byte chgEv_TrajPointACCObj3_TrajPointACCObj3_wExistProb_ub = 0;
    byte chgEv_TrajPointACCObj3_TrajPointACCObj3_dVarXv_uw = 0;
    byte chgEv_TrajPointACCObj3_TrajPointACCObj3_Stand_b = 0;
    byte chgEv_TrajPointACCObj3_TrajPointACCObj3_Valid_b = 0;
    byte chgEv_TrajPointACCObj3_TrajPointACCObj3_TrajEnd_b = 0;
    byte chgEv_TrajPointACCObj3_TrajPointACCObj3_InvDir_b = 0;
    byte chgEv_TrajPointACCObj3_TrajPointACCObj3_dxv_sw = 0;
    byte chgEv_TrajPointACCObj3_TrajPointACCObj3_Drive_b = 0;
    byte chgEv_TrajPointACCObj3_TrajPointACCObj3_Stopped_b = 0;
    byte chgEv_TrajPointACCObj3_TrajPointACCObj3_dVarYv_uw = 0;
    byte chgEv_TrajPointACCObj3_TrajPointACCObj3_timestamp = 0;
    byte chgEv_TrajPointACCObj2_TrajPointACCObj2_timestamp = 0;
    byte chgEv_TrajPointACCObj2_TrajPointACCObj2_wExistProb_ub = 0;
    byte chgEv_TrajPointACCObj2_TrajPointACCObj2_Drive_b = 0;
    byte chgEv_TrajPointACCObj2_TrajPointACCObj2_dxv_sw = 0;
    byte chgEv_TrajPointACCObj2_TrajPointACCObj2_InvDir_b = 0;
    byte chgEv_TrajPointACCObj2_TrajPointACCObj2_Stopped_b = 0;
    byte chgEv_TrajPointACCObj2_TrajPointACCObj2_Stand_b = 0;
    byte chgEv_TrajPointACCObj2_TrajPointACCObj2_dyv_sw = 0;
    byte chgEv_TrajPointACCObj2_TrajPointACCObj2_dVarYv_uw = 0;
    byte chgEv_TrajPointACCObj2_TrajPointACCObj2_dVarXv_uw = 0;
    byte chgEv_TrajPointACCObj2_TrajPointACCObj2_TrajEnd_b = 0;
    byte chgEv_TrajPointACCObj2_TrajPointACCObj2_Valid_b = 0;
    byte chgEv_TrajPointACCObj1_TrajPointACCObj1_Stopped_b = 0;
    byte chgEv_TrajPointACCObj1_TrajPointACCObj1_dyv_sw = 0;
    byte chgEv_TrajPointACCObj1_TrajPointACCObj1_Stand_b = 0;
    byte chgEv_TrajPointACCObj1_TrajPointACCObj1_Drive_b = 0;
    byte chgEv_TrajPointACCObj1_TrajPointACCObj1_InvDir_b = 0;
    byte chgEv_TrajPointACCObj1_TrajPointACCObj1_dxv_sw = 0;
    byte chgEv_TrajPointACCObj1_TrajPointACCObj1_dVarXv_uw = 0;
    byte chgEv_TrajPointACCObj1_TrajPointACCObj1_Valid_b = 0;
    byte chgEv_TrajPointACCObj1_TrajPointACCObj1_dVarYv_uw = 0;
    byte chgEv_TrajPointACCObj1_TrajPointACCObj1_wExistProb_ub = 0;
    byte chgEv_TrajPointACCObj1_TrajPointACCObj1_TrajEnd_b = 0;
    byte chgEv_TrajPointACCObj1_TrajPointACCObj1_timestamp = 0;
    byte chgEv_TrajPointACCObj0_TrajPointACCObj0_timestamp = 0;
    byte chgEv_TrajPointACCObj0_TrajPointACCObj0_InvDir_b = 0;
    byte chgEv_TrajPointACCObj0_TrajPointACCObj0_Drive_b = 0;
    byte chgEv_TrajPointACCObj0_TrajPointACCObj0_TrajEnd_b = 0;
    byte chgEv_TrajPointACCObj0_TrajPointACCObj0_dyv_sw = 0;
    byte chgEv_TrajPointACCObj0_TrajPointACCObj0_dVarYv_uw = 0;
    byte chgEv_TrajPointACCObj0_TrajPointACCObj0_Valid_b = 0;
    byte chgEv_TrajPointACCObj0_TrajPointACCObj0_wExistProb_ub = 0;
    byte chgEv_TrajPointACCObj0_TrajPointACCObj0_Stopped_b = 0;
    byte chgEv_TrajPointACCObj0_TrajPointACCObj0_Stand_b = 0;
    byte chgEv_TrajPointACCObj0_TrajPointACCObj0_dxv_sw = 0;
    byte chgEv_TrajPointACCObj0_TrajPointACCObj0_dVarXv_uw = 0;
    byte chgEv_ACCObjInfo_ACCObjInfo_dxv_sw = 0;
    byte chgEv_ACCObjInfo_ACCObjInfo_Handle_ub = 0;
    byte chgEv_ACCObjInfo_ACCObjInfo_RFF_ub = 0;
    byte chgEv_ACCObjInfo_ACCObjInfo_vxv_sw = 0;
    byte chgEv_ACCObjInfo_ACCObjInfo_dWidth_sw = 0;
    byte chgEv_ACCObjInfo_ACCObjInfo_dyv_sw = 0;
    byte chgEv_ACCObjInfo_ACCObjInfo_timestamp = 0;
    byte chgEv_TIPLLaneInfo0_TIPLLaneInfo0_prob1Lane_ub = 0;
    byte chgEv_TIPLLaneInfo0_TIPLLaneInfo0_dUpperLimitLane_sw = 0;
    byte chgEv_TIPLLaneInfo0_TIPLLaneInfo0_dLowerLimitLane_sw = 0;
    byte chgEv_TIPLLaneInfo0_TIPLLaneInfo0_dRightBorder_sw = 0;
    byte chgEv_TIPLLaneInfo0_TIPLLaneInfo0_dLeftBorder_sw = 0;
    byte chgEv_TIPLLaneInfo1_TIPLLaneInfo1_dRightBorder_sw = 0;
    byte chgEv_TIPLLaneInfo1_TIPLLaneInfo1_dUpperLimitLane_sw = 0;
    byte chgEv_TIPLLaneInfo1_TIPLLaneInfo1_dLowerLimitLane_sw = 0;
    byte chgEv_TIPLLaneInfo1_TIPLLaneInfo1_dLeftBorder_sw = 0;
    byte chgEv_TIPLLaneInfo1_TIPLLaneInfo1_prob1Lane_ub = 0;
    byte chgEv_TIPLLaneInfo2_TIPLLaneInfo2_prob1Lane_ub = 0;
    byte chgEv_TIPLLaneInfo2_TIPLLaneInfo2_dUpperLimitLane_sw = 0;
    byte chgEv_TIPLLaneInfo2_TIPLLaneInfo2_dLeftBorder_sw = 0;
    byte chgEv_TIPLLaneInfo2_TIPLLaneInfo2_dRightBorder_sw = 0;
    byte chgEv_TIPLLaneInfo2_TIPLLaneInfo2_dLowerLimitLane_sw = 0;
    byte chgEv_TIPLLaneInfo3_TIPLLaneInfo3_dLowerLimitLane_sw = 0;
    byte chgEv_TIPLLaneInfo3_TIPLLaneInfo3_dRightBorder_sw = 0;
    byte chgEv_TIPLLaneInfo3_TIPLLaneInfo3_dUpperLimitLane_sw = 0;
    byte chgEv_TIPLLaneInfo3_TIPLLaneInfo3_dLeftBorder_sw = 0;
    byte chgEv_TIPLLaneInfo3_TIPLLaneInfo3_prob1Lane_ub = 0;
    byte chgEv_TIPLCourseInfo1_TIPLCourseInfo1_a1polynomCoef_sw = 0;
    byte chgEv_TIPLCourseInfo1_TIPLCourseInfo1_a0polynomCoef_sw = 0;
    byte chgEv_TIPLCourseInfo1_TIPLCourseInfo1_qCourseConform = 0;
    byte chgEv_TIPLCourseInfo1_TIPLCourseInfo1_dLowerLimit_sw = 0;
    byte chgEv_TIPLCourseInfo1_TIPLCourseInfo1_a2polynomCoef_sw = 0;
    byte chgEv_TIPLCourseInfo1_TIPLCourseInfo1_dUpperLimit_sw = 0;
    byte chgEv_TIPLCourseInfo0_TIPLCourseInfo0_qCourseConform = 0;
    byte chgEv_TIPLCourseInfo0_TIPLCourseInfo0_a0polynomCoef_sw = 0;
    byte chgEv_TIPLCourseInfo0_TIPLCourseInfo0_a2polynomCoef_sw = 0;
    byte chgEv_TIPLCourseInfo0_TIPLCourseInfo0_dUpperLimit_sw = 0;
    byte chgEv_TIPLCourseInfo0_TIPLCourseInfo0_dLowerLimit_sw = 0;
    byte chgEv_TIPLCourseInfo0_TIPLCourseInfo0_a1polynomCoef_sw = 0;
    byte chgEv_TIPLCourseInfo3_TIPLCourseInfo3_a1polynomCoef_sw = 0;
    byte chgEv_TIPLCourseInfo3_TIPLCourseInfo3_a2polynomCoef_sw = 0;
    byte chgEv_TIPLCourseInfo3_TIPLCourseInfo3_qCourseConform = 0;
    byte chgEv_TIPLCourseInfo3_TIPLCourseInfo3_dLowerLimit_sw = 0;
    byte chgEv_TIPLCourseInfo3_TIPLCourseInfo3_dUpperLimit_sw = 0;
    byte chgEv_TIPLCourseInfo3_TIPLCourseInfo3_a0polynomCoef_sw = 0;
    byte chgEv_TIPLCourseInfo2_TIPLCourseInfo2_dLowerLimit_sw = 0;
    byte chgEv_TIPLCourseInfo2_TIPLCourseInfo2_qCourseConform = 0;
    byte chgEv_TIPLCourseInfo2_TIPLCourseInfo2_a2polynomCoef_sw = 0;
    byte chgEv_TIPLCourseInfo2_TIPLCourseInfo2_a0polynomCoef_sw = 0;
    byte chgEv_TIPLCourseInfo2_TIPLCourseInfo2_a1polynomCoef_sw = 0;
    byte chgEv_TIPLCourseInfo2_TIPLCourseInfo2_dUpperLimit_sw = 0;
    byte chgEv_TIPLCourseInfo4_TIPLCourseInfo4_a2polynomCoef_sw = 0;
    byte chgEv_TIPLCourseInfo4_TIPLCourseInfo4_a1polynomCoef_sw = 0;
    byte chgEv_TIPLCourseInfo4_TIPLCourseInfo4_dUpperLimit_sw = 0;
    byte chgEv_TIPLCourseInfo4_TIPLCourseInfo4_qCourseConform = 0;
    byte chgEv_TIPLCourseInfo4_TIPLCourseInfo4_dLowerLimit_sw = 0;
    byte chgEv_TIPLCourseInfo4_TIPLCourseInfo4_a0polynomCoef_sw = 0;
    byte chgEv_ACC_0x95_ACC_AEBActive = 0;
    byte chgEv_TrajPointACCObj22_TrajPointACCObj22_wExistProb_ub = 0;
    byte chgEv_TrajPointACCObj22_TrajPointACCObj22_InvDir_b = 0;
    byte chgEv_TrajPointACCObj22_TrajPointACCObj22_Stopped_b = 0;
    byte chgEv_TrajPointACCObj22_TrajPointACCObj22_Valid_b = 0;
    byte chgEv_TrajPointACCObj22_TrajPointACCObj22_TrajEnd_b = 0;
    byte chgEv_TrajPointACCObj22_TrajPointACCObj22_dyv_sw = 0;
    byte chgEv_TrajPointACCObj22_TrajPointACCObj22_Drive_b = 0;
    byte chgEv_TrajPointACCObj22_TrajPointACCObj22_Stand_b = 0;
    byte chgEv_TrajPointACCObj22_TrajPointACCObj22_dVarXv_uw = 0;
    byte chgEv_TrajPointACCObj22_TrajPointACCObj22_timestamp = 0;
    byte chgEv_TrajPointACCObj22_TrajPointACCObj22_dVarYv_uw = 0;
    byte chgEv_TrajPointACCObj22_TrajPointACCObj22_dxv_sw = 0;
    byte chgEv_TrajPointACCObj23_TrajPointACCObj23_Stopped_b = 0;
    byte chgEv_TrajPointACCObj23_TrajPointACCObj23_InvDir_b = 0;
    byte chgEv_TrajPointACCObj23_TrajPointACCObj23_Valid_b = 0;
    byte chgEv_TrajPointACCObj23_TrajPointACCObj23_Stand_b = 0;
    byte chgEv_TrajPointACCObj23_TrajPointACCObj23_dVarYv_uw = 0;
    byte chgEv_TrajPointACCObj23_TrajPointACCObj23_dyv_sw = 0;
    byte chgEv_TrajPointACCObj23_TrajPointACCObj23_TrajEnd_b = 0;
    byte chgEv_TrajPointACCObj23_TrajPointACCObj23_dVarXv_uw = 0;
    byte chgEv_TrajPointACCObj23_TrajPointACCObj23_wExistProb_ub = 0;
    byte chgEv_TrajPointACCObj23_TrajPointACCObj23_dxv_sw = 0;
    byte chgEv_TrajPointACCObj23_TrajPointACCObj23_timestamp = 0;
    byte chgEv_TrajPointACCObj23_TrajPointACCObj23_Drive_b = 0;
    byte chgEv_TrajPointACCObj20_TrajPointACCObj20_TrajEnd_b = 0;
    byte chgEv_TrajPointACCObj20_TrajPointACCObj20_dVarXv_uw = 0;
    byte chgEv_TrajPointACCObj20_TrajPointACCObj20_Valid_b = 0;
    byte chgEv_TrajPointACCObj20_TrajPointACCObj20_Drive_b = 0;
    byte chgEv_TrajPointACCObj20_TrajPointACCObj20_Stand_b = 0;
    byte chgEv_TrajPointACCObj20_TrajPointACCObj20_dxv_sw = 0;
    byte chgEv_TrajPointACCObj20_TrajPointACCObj20_dVarYv_uw = 0;
    byte chgEv_TrajPointACCObj20_TrajPointACCObj20_InvDir_b = 0;
    byte chgEv_TrajPointACCObj20_TrajPointACCObj20_wExistProb_ub = 0;
    byte chgEv_TrajPointACCObj20_TrajPointACCObj20_timestamp = 0;
    byte chgEv_TrajPointACCObj20_TrajPointACCObj20_dyv_sw = 0;
    byte chgEv_TrajPointACCObj20_TrajPointACCObj20_Stopped_b = 0;
    byte chgEv_TrajPointACCObj21_TrajPointACCObj21_Drive_b = 0;
    byte chgEv_TrajPointACCObj21_TrajPointACCObj21_dyv_sw = 0;
    byte chgEv_TrajPointACCObj21_TrajPointACCObj21_dxv_sw = 0;
    byte chgEv_TrajPointACCObj21_TrajPointACCObj21_InvDir_b = 0;
    byte chgEv_TrajPointACCObj21_TrajPointACCObj21_Stopped_b = 0;
    byte chgEv_TrajPointACCObj21_TrajPointACCObj21_dVarXv_uw = 0;
    byte chgEv_TrajPointACCObj21_TrajPointACCObj21_timestamp = 0;
    byte chgEv_TrajPointACCObj21_TrajPointACCObj21_dVarYv_uw = 0;
    byte chgEv_TrajPointACCObj21_TrajPointACCObj21_Valid_b = 0;
    byte chgEv_TrajPointACCObj21_TrajPointACCObj21_Stand_b = 0;
    byte chgEv_TrajPointACCObj21_TrajPointACCObj21_TrajEnd_b = 0;
    byte chgEv_TrajPointACCObj21_TrajPointACCObj21_wExistProb_ub = 0;
    
    message TrajPointACCObj16        Msg_TrajPointACCObj16;
    message RDR1Header        Msg_RDR1Header;
    message OnComingObj3        Msg_OnComingObj3;
    message OnComingObj2        Msg_OnComingObj2;
    message OnComingObj1        Msg_OnComingObj1;
    message OnComingObj0        Msg_OnComingObj0;
    message TrajPointACCObj19        Msg_TrajPointACCObj19;
    message TrajPointACCObj18        Msg_TrajPointACCObj18;
    message OnGoingObj1        Msg_OnGoingObj1;
    message OnGoingObj0        Msg_OnGoingObj0;
    message TrajPointACCObj13        Msg_TrajPointACCObj13;
    message TrajPointACCObj12        Msg_TrajPointACCObj12;
    message TrajPointACCObj11        Msg_TrajPointACCObj11;
    message TrajPointACCObj10        Msg_TrajPointACCObj10;
    message TrajPointACCObj17        Msg_TrajPointACCObj17;
    message TrajACC        Msg_TrajACC;
    message TrajPointACCObj15        Msg_TrajPointACCObj15;
    message TrajPointACCObj14        Msg_TrajPointACCObj14;
    message RDR_Status        Msg_RDR_Status;
    msTimer Tm_RDR_Status;
    int Cycle_RDR_Status = 40;
    message TrajPointACCObj9        Msg_TrajPointACCObj9;
    message TrajPointACCObj8        Msg_TrajPointACCObj8;
    message TrajPointACCObj7        Msg_TrajPointACCObj7;
    message TrajPointACCObj6        Msg_TrajPointACCObj6;
    message TrajPointACCObj5        Msg_TrajPointACCObj5;
    message TrajPointACCObj4        Msg_TrajPointACCObj4;
    message TrajPointACCObj3        Msg_TrajPointACCObj3;
    message TrajPointACCObj2        Msg_TrajPointACCObj2;
    message TrajPointACCObj1        Msg_TrajPointACCObj1;
    message TrajPointACCObj0        Msg_TrajPointACCObj0;
    message ACCObjInfo        Msg_ACCObjInfo;
    message TIPLLaneInfo0        Msg_TIPLLaneInfo0;
    message TIPLLaneInfo1        Msg_TIPLLaneInfo1;
    message TIPLLaneInfo2        Msg_TIPLLaneInfo2;
    message TIPLLaneInfo3        Msg_TIPLLaneInfo3;
    message TIPLCourseInfo1        Msg_TIPLCourseInfo1;
    message TIPLCourseInfo0        Msg_TIPLCourseInfo0;
    message TIPLCourseInfo3        Msg_TIPLCourseInfo3;
    message TIPLCourseInfo2        Msg_TIPLCourseInfo2;
    message TIPLCourseInfo4        Msg_TIPLCourseInfo4;
    message ACC_0x95        Msg_ACC_0x95;
    msTimer Tm_ACC_0x95;
    int Cycle_ACC_0x95 = 20;
    message TrajPointACCObj22        Msg_TrajPointACCObj22;
    message TrajPointACCObj23        Msg_TrajPointACCObj23;
    message TrajPointACCObj20        Msg_TrajPointACCObj20;
    message TrajPointACCObj21        Msg_TrajPointACCObj21;
    
    int TrajPointACCObj16_TrajPointACCObj16_CRC_counter =0;
    int TrajPointACCObj16_TrajPointACCObj16_CRC_wrongvalctr =0;
    int TrajPointACCObj16_TrajPointACCObj16_MsgCtr_counter =0;
    int TrajPointACCObj16_TrajPointACCObj16_MsgCtr_wrongvalctr =0;
    int TrajPointACCObj16_TrajPointACCObj16_blockCtr_counter =0;
    int TrajPointACCObj16_TrajPointACCObj16_blockCtr_wrongvalctr =0;
    int RDR1Header_RDR1Header_CRC_counter =0;
    int RDR1Header_RDR1Header_CRC_wrongvalctr =0;
    int RDR1Header_RDR1Header_MsgCtr_counter =0;
    int RDR1Header_RDR1Header_MsgCtr_wrongvalctr =0;
    int RDR1Header_RDR1Header_blockCtr_counter =0;
    int RDR1Header_RDR1Header_blockCtr_wrongvalctr =0;
    int OnComingObj3_OnComingObj3_CRC_counter =0;
    int OnComingObj3_OnComingObj3_CRC_wrongvalctr =0;
    int OnComingObj3_OnComingObj3_MsgCtr_counter =0;
    int OnComingObj3_OnComingObj3_MsgCtr_wrongvalctr =0;
    int OnComingObj3_OnComingObj3_blockCtr_counter =0;
    int OnComingObj3_OnComingObj3_blockCtr_wrongvalctr =0;
    int OnComingObj2_OnComingObj2_CRC_counter =0;
    int OnComingObj2_OnComingObj2_CRC_wrongvalctr =0;
    int OnComingObj2_OnComingObj2_MsgCtr_counter =0;
    int OnComingObj2_OnComingObj2_MsgCtr_wrongvalctr =0;
    int OnComingObj2_OnComingObj2_blockCtr_counter =0;
    int OnComingObj2_OnComingObj2_blockCtr_wrongvalctr =0;
    int OnComingObj1_OnComingObj1_CRC_counter =0;
    int OnComingObj1_OnComingObj1_CRC_wrongvalctr =0;
    int OnComingObj1_OnComingObj1_MsgCtr_counter =0;
    int OnComingObj1_OnComingObj1_MsgCtr_wrongvalctr =0;
    int OnComingObj1_OnComingObj1_blockCtr_counter =0;
    int OnComingObj1_OnComingObj1_blockCtr_wrongvalctr =0;
    int OnComingObj0_OnComingObj0_CRC_counter =0;
    int OnComingObj0_OnComingObj0_CRC_wrongvalctr =0;
    int OnComingObj0_OnComingObj0_MsgCtr_counter =0;
    int OnComingObj0_OnComingObj0_MsgCtr_wrongvalctr =0;
    int OnComingObj0_OnComingObj0_blockCtr_counter =0;
    int OnComingObj0_OnComingObj0_blockCtr_wrongvalctr =0;
    int TrajPointACCObj19_TrajPointACCObj19_CRC_counter =0;
    int TrajPointACCObj19_TrajPointACCObj19_CRC_wrongvalctr =0;
    int TrajPointACCObj19_TrajPointACCObj19_MsgCtr_counter =0;
    int TrajPointACCObj19_TrajPointACCObj19_MsgCtr_wrongvalctr =0;
    int TrajPointACCObj19_TrajPointACCObj19_blockCtr_counter =0;
    int TrajPointACCObj19_TrajPointACCObj19_blockCtr_wrongvalctr =0;
    int TrajPointACCObj18_TrajPointACCObj18_CRC_counter =0;
    int TrajPointACCObj18_TrajPointACCObj18_CRC_wrongvalctr =0;
    int TrajPointACCObj18_TrajPointACCObj18_MsgCtr_counter =0;
    int TrajPointACCObj18_TrajPointACCObj18_MsgCtr_wrongvalctr =0;
    int TrajPointACCObj18_TrajPointACCObj18_blockCtr_counter =0;
    int TrajPointACCObj18_TrajPointACCObj18_blockCtr_wrongvalctr =0;
    int OnGoingObj1_OnGoingObj1_CRC_counter =0;
    int OnGoingObj1_OnGoingObj1_CRC_wrongvalctr =0;
    int OnGoingObj1_OnGoingObj1_MsgCtr_counter =0;
    int OnGoingObj1_OnGoingObj1_MsgCtr_wrongvalctr =0;
    int OnGoingObj1_OnGoingObj1_blockCtr_counter =0;
    int OnGoingObj1_OnGoingObj1_blockCtr_wrongvalctr =0;
    int OnGoingObj0_OnGoingObj0_CRC_counter =0;
    int OnGoingObj0_OnGoingObj0_CRC_wrongvalctr =0;
    int OnGoingObj0_OnGoingObj0_MsgCtr_counter =0;
    int OnGoingObj0_OnGoingObj0_MsgCtr_wrongvalctr =0;
    int OnGoingObj0_OnGoingObj0_blockCtr_counter =0;
    int OnGoingObj0_OnGoingObj0_blockCtr_wrongvalctr =0;
    int TrajPointACCObj13_TrajPointACCObj13_CRC_counter =0;
    int TrajPointACCObj13_TrajPointACCObj13_CRC_wrongvalctr =0;
    int TrajPointACCObj13_TrajPointACCObj13_MsgCtr_counter =0;
    int TrajPointACCObj13_TrajPointACCObj13_MsgCtr_wrongvalctr =0;
    int TrajPointACCObj13_TrajPointACCObj13_blockCtr_counter =0;
    int TrajPointACCObj13_TrajPointACCObj13_blockCtr_wrongvalctr =0;
    int TrajPointACCObj12_TrajPointACCObj12_CRC_counter =0;
    int TrajPointACCObj12_TrajPointACCObj12_CRC_wrongvalctr =0;
    int TrajPointACCObj12_TrajPointACCObj12_MsgCtr_counter =0;
    int TrajPointACCObj12_TrajPointACCObj12_MsgCtr_wrongvalctr =0;
    int TrajPointACCObj12_TrajPointACCObj12_blockCtr_counter =0;
    int TrajPointACCObj12_TrajPointACCObj12_blockCtr_wrongvalctr =0;
    int TrajPointACCObj11_TrajPointACCObj11_CRC_counter =0;
    int TrajPointACCObj11_TrajPointACCObj11_CRC_wrongvalctr =0;
    int TrajPointACCObj11_TrajPointACCObj11_MsgCtr_counter =0;
    int TrajPointACCObj11_TrajPointACCObj11_MsgCtr_wrongvalctr =0;
    int TrajPointACCObj11_TrajPointACCObj11_blockCtr_counter =0;
    int TrajPointACCObj11_TrajPointACCObj11_blockCtr_wrongvalctr =0;
    int TrajPointACCObj10_TrajPointACCObj10_CRC_counter =0;
    int TrajPointACCObj10_TrajPointACCObj10_CRC_wrongvalctr =0;
    int TrajPointACCObj10_TrajPointACCObj10_MsgCtr_counter =0;
    int TrajPointACCObj10_TrajPointACCObj10_MsgCtr_wrongvalctr =0;
    int TrajPointACCObj10_TrajPointACCObj10_blockCtr_counter =0;
    int TrajPointACCObj10_TrajPointACCObj10_blockCtr_wrongvalctr =0;
    int TrajPointACCObj17_TrajPointACCObj17_CRC_counter =0;
    int TrajPointACCObj17_TrajPointACCObj17_CRC_wrongvalctr =0;
    int TrajPointACCObj17_TrajPointACCObj17_MsgCtr_counter =0;
    int TrajPointACCObj17_TrajPointACCObj17_MsgCtr_wrongvalctr =0;
    int TrajPointACCObj17_TrajPointACCObj17_blockCtr_counter =0;
    int TrajPointACCObj17_TrajPointACCObj17_blockCtr_wrongvalctr =0;
    int TrajACC_TrajACC_CRC_counter =0;
    int TrajACC_TrajACC_CRC_wrongvalctr =0;
    int TrajACC_TrajACC_MsgCtr_counter =0;
    int TrajACC_TrajACC_MsgCtr_wrongvalctr =0;
    int TrajACC_TrajACC_blockCtr_counter =0;
    int TrajACC_TrajACC_blockCtr_wrongvalctr =0;
    int TrajPointACCObj15_TrajPointACCObj15_CRC_counter =0;
    int TrajPointACCObj15_TrajPointACCObj15_CRC_wrongvalctr =0;
    int TrajPointACCObj15_TrajPointACCObj15_MsgCtr_counter =0;
    int TrajPointACCObj15_TrajPointACCObj15_MsgCtr_wrongvalctr =0;
    int TrajPointACCObj15_TrajPointACCObj15_blockCtr_counter =0;
    int TrajPointACCObj15_TrajPointACCObj15_blockCtr_wrongvalctr =0;
    int TrajPointACCObj14_TrajPointACCObj14_CRC_counter =0;
    int TrajPointACCObj14_TrajPointACCObj14_CRC_wrongvalctr =0;
    int TrajPointACCObj14_TrajPointACCObj14_MsgCtr_counter =0;
    int TrajPointACCObj14_TrajPointACCObj14_MsgCtr_wrongvalctr =0;
    int TrajPointACCObj14_TrajPointACCObj14_blockCtr_counter =0;
    int TrajPointACCObj14_TrajPointACCObj14_blockCtr_wrongvalctr =0;
    int RDR_Status_RDR_Status_CRC_counter =0;
    int RDR_Status_RDR_Status_CRC_wrongvalctr =0;
    int RDR_Status_RDR_Status_MsgCtr_counter =0;
    int RDR_Status_RDR_Status_MsgCtr_wrongvalctr =0;
    int RDR_Status_RDR_Status_blockCtr_counter =0;
    int RDR_Status_RDR_Status_blockCtr_wrongvalctr =0;
    int TrajPointACCObj9_TrajPointACCObj9_CRC_counter =0;
    int TrajPointACCObj9_TrajPointACCObj9_CRC_wrongvalctr =0;
    int TrajPointACCObj9_TrajPointACCObj9_MsgCtr_counter =0;
    int TrajPointACCObj9_TrajPointACCObj9_MsgCtr_wrongvalctr =0;
    int TrajPointACCObj9_TrajPointACCObj9_blockCtr_counter =0;
    int TrajPointACCObj9_TrajPointACCObj9_blockCtr_wrongvalctr =0;
    int TrajPointACCObj8_TrajPointACCObj8_CRC_counter =0;
    int TrajPointACCObj8_TrajPointACCObj8_CRC_wrongvalctr =0;
    int TrajPointACCObj8_TrajPointACCObj8_MsgCtr_counter =0;
    int TrajPointACCObj8_TrajPointACCObj8_MsgCtr_wrongvalctr =0;
    int TrajPointACCObj8_TrajPointACCObj8_blockCtr_counter =0;
    int TrajPointACCObj8_TrajPointACCObj8_blockCtr_wrongvalctr =0;
    int TrajPointACCObj7_TrajPointACCObj7_CRC_counter =0;
    int TrajPointACCObj7_TrajPointACCObj7_CRC_wrongvalctr =0;
    int TrajPointACCObj7_TrajPointACCObj7_MsgCtr_counter =0;
    int TrajPointACCObj7_TrajPointACCObj7_MsgCtr_wrongvalctr =0;
    int TrajPointACCObj7_TrajPointACCObj7_blockCtr_counter =0;
    int TrajPointACCObj7_TrajPointACCObj7_blockCtr_wrongvalctr =0;
    int TrajPointACCObj6_TrajPointACCObj6_CRC_counter =0;
    int TrajPointACCObj6_TrajPointACCObj6_CRC_wrongvalctr =0;
    int TrajPointACCObj6_TrajPointACCObj6_MsgCtr_counter =0;
    int TrajPointACCObj6_TrajPointACCObj6_MsgCtr_wrongvalctr =0;
    int TrajPointACCObj6_TrajPointACCObj6_blockCtr_counter =0;
    int TrajPointACCObj6_TrajPointACCObj6_blockCtr_wrongvalctr =0;
    int TrajPointACCObj5_TrajPointACCObj5_CRC_counter =0;
    int TrajPointACCObj5_TrajPointACCObj5_CRC_wrongvalctr =0;
    int TrajPointACCObj5_TrajPointACCObj5_MsgCtr_counter =0;
    int TrajPointACCObj5_TrajPointACCObj5_MsgCtr_wrongvalctr =0;
    int TrajPointACCObj5_TrajPointACCObj5_blockCtr_counter =0;
    int TrajPointACCObj5_TrajPointACCObj5_blockCtr_wrongvalctr =0;
    int TrajPointACCObj4_TrajPointACCObj4_CRC_counter =0;
    int TrajPointACCObj4_TrajPointACCObj4_CRC_wrongvalctr =0;
    int TrajPointACCObj4_TrajPointACCObj4_MsgCtr_counter =0;
    int TrajPointACCObj4_TrajPointACCObj4_MsgCtr_wrongvalctr =0;
    int TrajPointACCObj4_TrajPointACCObj4_blockCtr_counter =0;
    int TrajPointACCObj4_TrajPointACCObj4_blockCtr_wrongvalctr =0;
    int TrajPointACCObj3_TrajPointACCObj3_CRC_counter =0;
    int TrajPointACCObj3_TrajPointACCObj3_CRC_wrongvalctr =0;
    int TrajPointACCObj3_TrajPointACCObj3_MsgCtr_counter =0;
    int TrajPointACCObj3_TrajPointACCObj3_MsgCtr_wrongvalctr =0;
    int TrajPointACCObj3_TrajPointACCObj3_blockCtr_counter =0;
    int TrajPointACCObj3_TrajPointACCObj3_blockCtr_wrongvalctr =0;
    int TrajPointACCObj2_TrajPointACCObj2_CRC_counter =0;
    int TrajPointACCObj2_TrajPointACCObj2_CRC_wrongvalctr =0;
    int TrajPointACCObj2_TrajPointACCObj2_MsgCtr_counter =0;
    int TrajPointACCObj2_TrajPointACCObj2_MsgCtr_wrongvalctr =0;
    int TrajPointACCObj2_TrajPointACCObj2_blockCtr_counter =0;
    int TrajPointACCObj2_TrajPointACCObj2_blockCtr_wrongvalctr =0;
    int TrajPointACCObj1_TrajPointACCObj1_CRC_counter =0;
    int TrajPointACCObj1_TrajPointACCObj1_CRC_wrongvalctr =0;
    int TrajPointACCObj1_TrajPointACCObj1_MsgCtr_counter =0;
    int TrajPointACCObj1_TrajPointACCObj1_MsgCtr_wrongvalctr =0;
    int TrajPointACCObj1_TrajPointACCObj1_blockCtr_counter =0;
    int TrajPointACCObj1_TrajPointACCObj1_blockCtr_wrongvalctr =0;
    int TrajPointACCObj0_TrajPointACCObj0_CRC_counter =0;
    int TrajPointACCObj0_TrajPointACCObj0_CRC_wrongvalctr =0;
    int TrajPointACCObj0_TrajPointACCObj0_MsgCtr_counter =0;
    int TrajPointACCObj0_TrajPointACCObj0_MsgCtr_wrongvalctr =0;
    int TrajPointACCObj0_TrajPointACCObj0_blockCtr_counter =0;
    int TrajPointACCObj0_TrajPointACCObj0_blockCtr_wrongvalctr =0;
    int ACCObjInfo_ACCObjInfo_CRC_counter =0;
    int ACCObjInfo_ACCObjInfo_CRC_wrongvalctr =0;
    int ACCObjInfo_ACCObjInfo_MsgCtr_counter =0;
    int ACCObjInfo_ACCObjInfo_MsgCtr_wrongvalctr =0;
    int ACCObjInfo_ACCObjInfo_blockCtr_counter =0;
    int ACCObjInfo_ACCObjInfo_blockCtr_wrongvalctr =0;
    int TIPLLaneInfo0_TIPLLaneInfo0_CRC_counter =0;
    int TIPLLaneInfo0_TIPLLaneInfo0_CRC_wrongvalctr =0;
    int TIPLLaneInfo0_TIPLLaneInfo0_MsgCtr_counter =0;
    int TIPLLaneInfo0_TIPLLaneInfo0_MsgCtr_wrongvalctr =0;
    int TIPLLaneInfo0_TIPLLaneInfo0_blockCtr_counter =0;
    int TIPLLaneInfo0_TIPLLaneInfo0_blockCtr_wrongvalctr =0;
    int TIPLLaneInfo1_TIPLLaneInfo1_CRC_counter =0;
    int TIPLLaneInfo1_TIPLLaneInfo1_CRC_wrongvalctr =0;
    int TIPLLaneInfo1_TIPLLaneInfo1_MsgCtr_counter =0;
    int TIPLLaneInfo1_TIPLLaneInfo1_MsgCtr_wrongvalctr =0;
    int TIPLLaneInfo1_TIPLLaneInfo1_blockCtr_counter =0;
    int TIPLLaneInfo1_TIPLLaneInfo1_blockCtr_wrongvalctr =0;
    int TIPLLaneInfo2_TIPLLaneInfo2_CRC_counter =0;
    int TIPLLaneInfo2_TIPLLaneInfo2_CRC_wrongvalctr =0;
    int TIPLLaneInfo2_TIPLLaneInfo2_MsgCtr_counter =0;
    int TIPLLaneInfo2_TIPLLaneInfo2_MsgCtr_wrongvalctr =0;
    int TIPLLaneInfo2_TIPLLaneInfo2_blockCtr_counter =0;
    int TIPLLaneInfo2_TIPLLaneInfo2_blockCtr_wrongvalctr =0;
    int TIPLLaneInfo3_TIPLLaneInfo3_CRC_counter =0;
    int TIPLLaneInfo3_TIPLLaneInfo3_CRC_wrongvalctr =0;
    int TIPLLaneInfo3_TIPLLaneInfo3_MsgCtr_counter =0;
    int TIPLLaneInfo3_TIPLLaneInfo3_MsgCtr_wrongvalctr =0;
    int TIPLLaneInfo3_TIPLLaneInfo3_blockCtr_counter =0;
    int TIPLLaneInfo3_TIPLLaneInfo3_blockCtr_wrongvalctr =0;
    int TIPLCourseInfo1_TIPLCourseInfo1_CRC_counter =0;
    int TIPLCourseInfo1_TIPLCourseInfo1_CRC_wrongvalctr =0;
    int TIPLCourseInfo1_TIPLCourseInfo1_MsgCtr_counter =0;
    int TIPLCourseInfo1_TIPLCourseInfo1_MsgCtr_wrongvalctr =0;
    int TIPLCourseInfo1_TIPLCourseInfo1_blockCtr_counter =0;
    int TIPLCourseInfo1_TIPLCourseInfo1_blockCtr_wrongvalctr =0;
    int TIPLCourseInfo0_TIPLCourseInfo0_CRC_counter =0;
    int TIPLCourseInfo0_TIPLCourseInfo0_CRC_wrongvalctr =0;
    int TIPLCourseInfo0_TIPLCourseInfo0_MsgCtr_counter =0;
    int TIPLCourseInfo0_TIPLCourseInfo0_MsgCtr_wrongvalctr =0;
    int TIPLCourseInfo0_TIPLCourseInfo0_blockCtr_counter =0;
    int TIPLCourseInfo0_TIPLCourseInfo0_blockCtr_wrongvalctr =0;
    int TIPLCourseInfo3_TIPLCourseInfo3_CRC_counter =0;
    int TIPLCourseInfo3_TIPLCourseInfo3_CRC_wrongvalctr =0;
    int TIPLCourseInfo3_TIPLCourseInfo3_MsgCtr_counter =0;
    int TIPLCourseInfo3_TIPLCourseInfo3_MsgCtr_wrongvalctr =0;
    int TIPLCourseInfo3_TIPLCourseInfo3_blockCtr_counter =0;
    int TIPLCourseInfo3_TIPLCourseInfo3_blockCtr_wrongvalctr =0;
    int TIPLCourseInfo2_TIPLCourseInfo2_CRC_counter =0;
    int TIPLCourseInfo2_TIPLCourseInfo2_CRC_wrongvalctr =0;
    int TIPLCourseInfo2_TIPLCourseInfo2_MsgCtr_counter =0;
    int TIPLCourseInfo2_TIPLCourseInfo2_MsgCtr_wrongvalctr =0;
    int TIPLCourseInfo2_TIPLCourseInfo2_blockCtr_counter =0;
    int TIPLCourseInfo2_TIPLCourseInfo2_blockCtr_wrongvalctr =0;
    int TIPLCourseInfo4_TIPLCourseInfo4_CRC_counter =0;
    int TIPLCourseInfo4_TIPLCourseInfo4_CRC_wrongvalctr =0;
    int TIPLCourseInfo4_TIPLCourseInfo4_MsgCtr_counter =0;
    int TIPLCourseInfo4_TIPLCourseInfo4_MsgCtr_wrongvalctr =0;
    int TIPLCourseInfo4_TIPLCourseInfo4_blockCtr_counter =0;
    int TIPLCourseInfo4_TIPLCourseInfo4_blockCtr_wrongvalctr =0;
    int ACC_0x95_ACC_CRCCheck_0x95_counter =0;
    int ACC_0x95_ACC_CRCCheck_0x95_wrongvalctr =0;
    int ACC_0x95_ACC_RollingCounter_0x95_counter =0;
    int ACC_0x95_ACC_RollingCounter_0x95_wrongvalctr =0;
    int TrajPointACCObj22_TrajPointACCObj22_CRC_counter =0;
    int TrajPointACCObj22_TrajPointACCObj22_CRC_wrongvalctr =0;
    int TrajPointACCObj22_TrajPointACCObj22_MsgCtr_counter =0;
    int TrajPointACCObj22_TrajPointACCObj22_MsgCtr_wrongvalctr =0;
    int TrajPointACCObj22_TrajPointACCObj22_blockCtr_counter =0;
    int TrajPointACCObj22_TrajPointACCObj22_blockCtr_wrongvalctr =0;
    int TrajPointACCObj23_TrajPointACCObj23_CRC_counter =0;
    int TrajPointACCObj23_TrajPointACCObj23_CRC_wrongvalctr =0;
    int TrajPointACCObj23_TrajPointACCObj23_MsgCtr_counter =0;
    int TrajPointACCObj23_TrajPointACCObj23_MsgCtr_wrongvalctr =0;
    int TrajPointACCObj23_TrajPointACCObj23_blockCtr_counter =0;
    int TrajPointACCObj23_TrajPointACCObj23_blockCtr_wrongvalctr =0;
    int TrajPointACCObj20_TrajPointACCObj20_CRC_counter =0;
    int TrajPointACCObj20_TrajPointACCObj20_CRC_wrongvalctr =0;
    int TrajPointACCObj20_TrajPointACCObj20_MsgCtr_counter =0;
    int TrajPointACCObj20_TrajPointACCObj20_MsgCtr_wrongvalctr =0;
    int TrajPointACCObj20_TrajPointACCObj20_blockCtr_counter =0;
    int TrajPointACCObj20_TrajPointACCObj20_blockCtr_wrongvalctr =0;
    int TrajPointACCObj21_TrajPointACCObj21_CRC_counter =0;
    int TrajPointACCObj21_TrajPointACCObj21_CRC_wrongvalctr =0;
    int TrajPointACCObj21_TrajPointACCObj21_MsgCtr_counter =0;
    int TrajPointACCObj21_TrajPointACCObj21_MsgCtr_wrongvalctr =0;
    int TrajPointACCObj21_TrajPointACCObj21_blockCtr_counter =0;
    int TrajPointACCObj21_TrajPointACCObj21_blockCtr_wrongvalctr =0;
    
    //CRC Polynomial for MQB     
    byte cb_ChkSum_POLY_MQB =0x2F;
	byte Dbc_dlc;
	int i=0;
	char CAN_DLC[7]={9,10,11,12,13,14,15};
	char CANFD_DLC[7]={12,16,20,24,32,48,64};
    

    
        byte CRC_J1850_Table[256] = {
 /*0 - 7*/  0x00, 0x1D, 0x3A, 0x27, 0x74, 0x69, 0x4E, 0x53,
 /*8 - 15*/ 0xE8, 0xF5, 0xD2, 0xCF, 0x9C, 0x81, 0xA6, 0xBB,
 /*16 - 23*/ 0xCD, 0xD0, 0xF7, 0xEA, 0xB9, 0xA4, 0x83, 0x9E,
 /*24 - 31*/ 0x25, 0x38, 0x1F, 0x02, 0x51, 0x4C, 0x6B, 0x76,
 /*32 - 39*/ 0x87, 0x9A, 0xBD, 0xA0, 0xF3, 0xEE, 0xC9, 0xD4,
 /*40 - 47*/ 0x6F, 0x72, 0x55, 0x48, 0x1B, 0x06, 0x21, 0x3C,
 /*48 - 55*/ 0x4A, 0x57, 0x70, 0x6D, 0x3E, 0x23, 0x04, 0x19,
 /*56 - 63*/ 0xA2, 0xBF, 0x98, 0x85, 0xD6, 0xCB, 0xEC, 0xF1,
 /*64 - 71*/  0x13, 0x0E, 0x29, 0x34, 0x67, 0x7A, 0x5D, 0x40,
 /*72 - 79*/ 0xFB, 0xE6, 0xC1, 0xDC, 0x8F, 0x92, 0xB5, 0xA8,
 /*80 - 87*/ 0xDE, 0xC3, 0xE4, 0xF9, 0xAA, 0xB7, 0x90, 0x8D,
 /*88 - 95*/ 0x36, 0x2B, 0x0C, 0x11, 0x42, 0x5F, 0x78, 0x65,
 /*96 - 103*/ 0x94, 0x89, 0xAE, 0xB3, 0xE0, 0xFD, 0xDA, 0xC7,
 /*104 - 111*/ 0x7C, 0x61, 0x46, 0x5B, 0x08, 0x15, 0x32, 0x2F,
 /*112 - 119*/ 0x59, 0x44, 0x63, 0x7E, 0x2D, 0x30, 0x17, 0x0A,
 /*120 - 127*/ 0xB1, 0xAC, 0x8B, 0x96, 0xC5, 0xD8, 0xFF, 0xE2,
 /*128 - 135*/ 0x26, 0x3B, 0x1C, 0x01, 0x52, 0x4F, 0x68, 0x75,
 /*136 - 143*/ 0xCE, 0xD3, 0xF4, 0xE9, 0xBA, 0xA7, 0x80, 0x9D,
 /*144 - 151*/ 0xEB, 0xF6, 0xD1, 0xCC, 0x9F, 0x82, 0xA5, 0xB8,
 /*152 - 159*/ 0x03, 0x1E, 0x39, 0x24, 0x77, 0x6A, 0x4D, 0x50,
 /*160 - 167*/ 0xA1, 0xBC, 0x9B, 0x86, 0xD5, 0xC8, 0xEF, 0xF2,
 /*168 - 175*/ 0x49, 0x54, 0x73, 0x6E, 0x3D, 0x20, 0x07, 0x1A,
 /*176 - 183*/ 0x6C, 0x71, 0x56, 0x4B, 0x18, 0x05, 0x22, 0x3F,
 /*184 - 191*/ 0x84, 0x99, 0xBE, 0xA3, 0xF0, 0xED, 0xCA, 0xD7,
 /*192 - 199*/ 0x35, 0x28, 0x0F, 0x12, 0x41, 0x5C, 0x7B, 0x66,
 /*200 - 207*/ 0xDD, 0xC0, 0xE7, 0xFA, 0xA9, 0xB4, 0x93, 0x8E,
 /*208 - 215*/ 0xF8, 0xE5, 0xC2, 0xDF, 0x8C, 0x91, 0xB6, 0xAB,
 /*216 - 223*/ 0x10, 0x0D, 0x2A, 0x37, 0x64, 0x79, 0x5E, 0x43,
 /*224 - 231*/ 0xB2, 0xAF, 0x88, 0x95, 0xC6, 0xDB, 0xFC, 0xE1,
 /*232 - 239*/ 0x5A, 0x47, 0x60, 0x7D, 0x2E, 0x33, 0x14, 0x09,
 /*240 - 247*/ 0x7F, 0x62, 0x45, 0x58, 0x0B, 0x16, 0x31, 0x2C,
 /*248 - 255*/ 0x97, 0x8A, 0xAD, 0xB0, 0xE3, 0xFE, 0xD9, 0xC4
};
         
}


on start
{
    //Initialise cycle time and message timer 
    putValue(E_pric_RadarFrontCenter_RDR_Status_cycleTm,Cycle_RDR_Status);
    SetTimer( Tm_RDR_Status,100);
    putValue(E_pric_RadarFrontCenter_RDR_Status_Tm,1);
    putValue(E_pric_RadarFrontCenter_ACC_0x95_cycleTm,Cycle_ACC_0x95);
    SetTimer( Tm_ACC_0x95,101);
    putValue(E_pric_RadarFrontCenter_ACC_0x95_Tm,1);
    
    //Initialise signals with init raw value
    Msg_TrajPointACCObj16.TrajPointACCObj16_dyv_sw   =getvalue(E_pric_RadarFrontCenter_TrajPointACCObj16_TrajPointACCObj16_dyv_sw_Rv);
    Msg_TrajPointACCObj16.TrajPointACCObj16_Stand_b   =getvalue(E_pric_RadarFrontCenter_TrajPointACCObj16_TrajPointACCObj16_Stand_b_Rv);
    Msg_TrajPointACCObj16.TrajPointACCObj16_dxv_sw   =getvalue(E_pric_RadarFrontCenter_TrajPointACCObj16_TrajPointACCObj16_dxv_sw_Rv);
    Msg_TrajPointACCObj16.TrajPointACCObj16_timestamp   =getvalue(E_pric_RadarFrontCenter_TrajPointACCObj16_TrajPointACCObj16_timestamp_Rv);
    Msg_TrajPointACCObj16.TrajPointACCObj16_Drive_b   =getvalue(E_pric_RadarFrontCenter_TrajPointACCObj16_TrajPointACCObj16_Drive_b_Rv);
    Msg_TrajPointACCObj16.TrajPointACCObj16_dVarYv_uw   =getvalue(E_pric_RadarFrontCenter_TrajPointACCObj16_TrajPointACCObj16_dVarYv_uw_Rv);
    Msg_TrajPointACCObj16.TrajPointACCObj16_dVarXv_uw   =getvalue(E_pric_RadarFrontCenter_TrajPointACCObj16_TrajPointACCObj16_dVarXv_uw_Rv);
    Msg_TrajPointACCObj16.TrajPointACCObj16_wExistProb_ub   =getvalue(E_pric_RadarFrontCenter_TrajPointACCObj16_TrajPointACCObj16_wExistProb_ub_Rv);
    Msg_TrajPointACCObj16.TrajPointACCObj16_InvDir_b   =getvalue(E_pric_RadarFrontCenter_TrajPointACCObj16_TrajPointACCObj16_InvDir_b_Rv);
    Msg_TrajPointACCObj16.TrajPointACCObj16_Valid_b   =getvalue(E_pric_RadarFrontCenter_TrajPointACCObj16_TrajPointACCObj16_Valid_b_Rv);
    Msg_TrajPointACCObj16.TrajPointACCObj16_Stopped_b   =getvalue(E_pric_RadarFrontCenter_TrajPointACCObj16_TrajPointACCObj16_Stopped_b_Rv);
    Msg_TrajPointACCObj16.TrajPointACCObj16_TrajEnd_b   =getvalue(E_pric_RadarFrontCenter_TrajPointACCObj16_TrajPointACCObj16_TrajEnd_b_Rv);
    Msg_RDR1Header.FRS_Pri_ALOD_ControlType   =getvalue(E_pric_RadarFrontCenter_RDR1Header_FRS_Pri_ALOD_ControlType_Rv);
    Msg_RDR1Header.NumVehEgoLane   =getvalue(E_pric_RadarFrontCenter_RDR1Header_NumVehEgoLane_Rv);
    Msg_RDR1Header.Status_AvoidCollision   =getvalue(E_pric_RadarFrontCenter_RDR1Header_Status_AvoidCollision_Rv);
    Msg_RDR1Header.TjaFID   =getvalue(E_pric_RadarFrontCenter_RDR1Header_TjaFID_Rv);
    Msg_RDR1Header.RDR1ObjectDataAge   =getvalue(E_pric_RadarFrontCenter_RDR1Header_RDR1ObjectDataAge_Rv);
    Msg_RDR1Header.ACC_ExitReason   =getvalue(E_pric_RadarFrontCenter_RDR1Header_ACC_ExitReason_Rv);
    Msg_RDR1Header.StatusACC   =getvalue(E_pric_RadarFrontCenter_RDR1Header_StatusACC_Rv);
    Msg_OnComingObj3.OnComingObj3_RFF_ub   =getvalue(E_pric_RadarFrontCenter_OnComingObj3_OnComingObj3_RFF_ub_Rv);
    Msg_OnComingObj3.OnComingObj3_Handle_ub   =getvalue(E_pric_RadarFrontCenter_OnComingObj3_OnComingObj3_Handle_ub_Rv);
    Msg_OnComingObj3.OnComingObj3_dyv_sw   =getvalue(E_pric_RadarFrontCenter_OnComingObj3_OnComingObj3_dyv_sw_Rv);
    Msg_OnComingObj3.OnComingObj3_vxv_sw   =getvalue(E_pric_RadarFrontCenter_OnComingObj3_OnComingObj3_vxv_sw_Rv);
    Msg_OnComingObj3.OnComingObj3_dxv_sw   =getvalue(E_pric_RadarFrontCenter_OnComingObj3_OnComingObj3_dxv_sw_Rv);
    Msg_OnComingObj3.OnComingObj3_dWidth_sw   =getvalue(E_pric_RadarFrontCenter_OnComingObj3_OnComingObj3_dWidth_sw_Rv);
    Msg_OnComingObj2.OnComingObj2_dyv_sw   =getvalue(E_pric_RadarFrontCenter_OnComingObj2_OnComingObj2_dyv_sw_Rv);
    Msg_OnComingObj2.OnComingObj2_Handle_ub   =getvalue(E_pric_RadarFrontCenter_OnComingObj2_OnComingObj2_Handle_ub_Rv);
    Msg_OnComingObj2.OnComingObj2_dWidth_sw   =getvalue(E_pric_RadarFrontCenter_OnComingObj2_OnComingObj2_dWidth_sw_Rv);
    Msg_OnComingObj2.OnComingObj2_dxv_sw   =getvalue(E_pric_RadarFrontCenter_OnComingObj2_OnComingObj2_dxv_sw_Rv);
    Msg_OnComingObj2.OnComingObj2_vxv_sw   =getvalue(E_pric_RadarFrontCenter_OnComingObj2_OnComingObj2_vxv_sw_Rv);
    Msg_OnComingObj2.OnComingObj2_RFF_ub   =getvalue(E_pric_RadarFrontCenter_OnComingObj2_OnComingObj2_RFF_ub_Rv);
    Msg_OnComingObj1.OnComingObj1_RFF_ub   =getvalue(E_pric_RadarFrontCenter_OnComingObj1_OnComingObj1_RFF_ub_Rv);
    Msg_OnComingObj1.OnComingObj1_dxv_sw   =getvalue(E_pric_RadarFrontCenter_OnComingObj1_OnComingObj1_dxv_sw_Rv);
    Msg_OnComingObj1.OnComingObj1_dWidth_sw   =getvalue(E_pric_RadarFrontCenter_OnComingObj1_OnComingObj1_dWidth_sw_Rv);
    Msg_OnComingObj1.OnComingObj1_dyv_sw   =getvalue(E_pric_RadarFrontCenter_OnComingObj1_OnComingObj1_dyv_sw_Rv);
    Msg_OnComingObj1.OnComingObj1_Handle_ub   =getvalue(E_pric_RadarFrontCenter_OnComingObj1_OnComingObj1_Handle_ub_Rv);
    Msg_OnComingObj1.OnComingObj1_vxv_sw   =getvalue(E_pric_RadarFrontCenter_OnComingObj1_OnComingObj1_vxv_sw_Rv);
    Msg_OnComingObj0.OnComingObj0_dWidth_sw   =getvalue(E_pric_RadarFrontCenter_OnComingObj0_OnComingObj0_dWidth_sw_Rv);
    Msg_OnComingObj0.OnComingObj0_dyv_sw   =getvalue(E_pric_RadarFrontCenter_OnComingObj0_OnComingObj0_dyv_sw_Rv);
    Msg_OnComingObj0.OnComingObj0_RFF_ub   =getvalue(E_pric_RadarFrontCenter_OnComingObj0_OnComingObj0_RFF_ub_Rv);
    Msg_OnComingObj0.OnComingObj0_dxv_sw   =getvalue(E_pric_RadarFrontCenter_OnComingObj0_OnComingObj0_dxv_sw_Rv);
    Msg_OnComingObj0.OnComingObj0_vxv_sw   =getvalue(E_pric_RadarFrontCenter_OnComingObj0_OnComingObj0_vxv_sw_Rv);
    Msg_OnComingObj0.OnComingObj0_Handle_ub   =getvalue(E_pric_RadarFrontCenter_OnComingObj0_OnComingObj0_Handle_ub_Rv);
    Msg_TrajPointACCObj19.TrajPointACCObj19_Drive_b   =getvalue(E_pric_RadarFrontCenter_TrajPointACCObj19_TrajPointACCObj19_Drive_b_Rv);
    Msg_TrajPointACCObj19.TrajPointACCObj19_InvDir_b   =getvalue(E_pric_RadarFrontCenter_TrajPointACCObj19_TrajPointACCObj19_InvDir_b_Rv);
    Msg_TrajPointACCObj19.TrajPointACCObj19_dyv_sw   =getvalue(E_pric_RadarFrontCenter_TrajPointACCObj19_TrajPointACCObj19_dyv_sw_Rv);
    Msg_TrajPointACCObj19.TrajPointACCObj19_Stopped_b   =getvalue(E_pric_RadarFrontCenter_TrajPointACCObj19_TrajPointACCObj19_Stopped_b_Rv);
    Msg_TrajPointACCObj19.TrajPointACCObj19_dxv_sw   =getvalue(E_pric_RadarFrontCenter_TrajPointACCObj19_TrajPointACCObj19_dxv_sw_Rv);
    Msg_TrajPointACCObj19.TrajPointACCObj19_Stand_b   =getvalue(E_pric_RadarFrontCenter_TrajPointACCObj19_TrajPointACCObj19_Stand_b_Rv);
    Msg_TrajPointACCObj19.TrajPointACCObj19_wExistProb_ub   =getvalue(E_pric_RadarFrontCenter_TrajPointACCObj19_TrajPointACCObj19_wExistProb_ub_Rv);
    Msg_TrajPointACCObj19.TrajPointACCObj19_dVarYv_uw   =getvalue(E_pric_RadarFrontCenter_TrajPointACCObj19_TrajPointACCObj19_dVarYv_uw_Rv);
    Msg_TrajPointACCObj19.TrajPointACCObj19_dVarXv_uw   =getvalue(E_pric_RadarFrontCenter_TrajPointACCObj19_TrajPointACCObj19_dVarXv_uw_Rv);
    Msg_TrajPointACCObj19.TrajPointACCObj19_Valid_b   =getvalue(E_pric_RadarFrontCenter_TrajPointACCObj19_TrajPointACCObj19_Valid_b_Rv);
    Msg_TrajPointACCObj19.TrajPointACCObj19_TrajEnd_b   =getvalue(E_pric_RadarFrontCenter_TrajPointACCObj19_TrajPointACCObj19_TrajEnd_b_Rv);
    Msg_TrajPointACCObj19.TrajPointACCObj19_timestamp   =getvalue(E_pric_RadarFrontCenter_TrajPointACCObj19_TrajPointACCObj19_timestamp_Rv);
    Msg_TrajPointACCObj18.TrajPointACCObj18_TrajEnd_b   =getvalue(E_pric_RadarFrontCenter_TrajPointACCObj18_TrajPointACCObj18_TrajEnd_b_Rv);
    Msg_TrajPointACCObj18.TrajPointACCObj18_dxv_sw   =getvalue(E_pric_RadarFrontCenter_TrajPointACCObj18_TrajPointACCObj18_dxv_sw_Rv);
    Msg_TrajPointACCObj18.TrajPointACCObj18_Valid_b   =getvalue(E_pric_RadarFrontCenter_TrajPointACCObj18_TrajPointACCObj18_Valid_b_Rv);
    Msg_TrajPointACCObj18.TrajPointACCObj18_Stopped_b   =getvalue(E_pric_RadarFrontCenter_TrajPointACCObj18_TrajPointACCObj18_Stopped_b_Rv);
    Msg_TrajPointACCObj18.TrajPointACCObj18_Stand_b   =getvalue(E_pric_RadarFrontCenter_TrajPointACCObj18_TrajPointACCObj18_Stand_b_Rv);
    Msg_TrajPointACCObj18.TrajPointACCObj18_Drive_b   =getvalue(E_pric_RadarFrontCenter_TrajPointACCObj18_TrajPointACCObj18_Drive_b_Rv);
    Msg_TrajPointACCObj18.TrajPointACCObj18_timestamp   =getvalue(E_pric_RadarFrontCenter_TrajPointACCObj18_TrajPointACCObj18_timestamp_Rv);
    Msg_TrajPointACCObj18.TrajPointACCObj18_dVarYv_uw   =getvalue(E_pric_RadarFrontCenter_TrajPointACCObj18_TrajPointACCObj18_dVarYv_uw_Rv);
    Msg_TrajPointACCObj18.TrajPointACCObj18_InvDir_b   =getvalue(E_pric_RadarFrontCenter_TrajPointACCObj18_TrajPointACCObj18_InvDir_b_Rv);
    Msg_TrajPointACCObj18.TrajPointACCObj18_dyv_sw   =getvalue(E_pric_RadarFrontCenter_TrajPointACCObj18_TrajPointACCObj18_dyv_sw_Rv);
    Msg_TrajPointACCObj18.TrajPointACCObj18_dVarXv_uw   =getvalue(E_pric_RadarFrontCenter_TrajPointACCObj18_TrajPointACCObj18_dVarXv_uw_Rv);
    Msg_TrajPointACCObj18.TrajPointACCObj18_wExistProb_ub   =getvalue(E_pric_RadarFrontCenter_TrajPointACCObj18_TrajPointACCObj18_wExistProb_ub_Rv);
    Msg_OnGoingObj1.OnGoingObj1_RFF_ub   =getvalue(E_pric_RadarFrontCenter_OnGoingObj1_OnGoingObj1_RFF_ub_Rv);
    Msg_OnGoingObj1.OnGoingObj1_dyv_sw   =getvalue(E_pric_RadarFrontCenter_OnGoingObj1_OnGoingObj1_dyv_sw_Rv);
    Msg_OnGoingObj1.OnGoingObj1_vxv_sw   =getvalue(E_pric_RadarFrontCenter_OnGoingObj1_OnGoingObj1_vxv_sw_Rv);
    Msg_OnGoingObj1.OnGoingObj1_dxv_sw   =getvalue(E_pric_RadarFrontCenter_OnGoingObj1_OnGoingObj1_dxv_sw_Rv);
    Msg_OnGoingObj1.OnGoingObj1_Handle_ub   =getvalue(E_pric_RadarFrontCenter_OnGoingObj1_OnGoingObj1_Handle_ub_Rv);
    Msg_OnGoingObj0.OnGoingObj0_dyv_sw   =getvalue(E_pric_RadarFrontCenter_OnGoingObj0_OnGoingObj0_dyv_sw_Rv);
    Msg_OnGoingObj0.OnGoingObj0_Handle_ub   =getvalue(E_pric_RadarFrontCenter_OnGoingObj0_OnGoingObj0_Handle_ub_Rv);
    Msg_OnGoingObj0.OnGoingObj0_dxv_sw   =getvalue(E_pric_RadarFrontCenter_OnGoingObj0_OnGoingObj0_dxv_sw_Rv);
    Msg_OnGoingObj0.OnGoingObj0_vxv_sw   =getvalue(E_pric_RadarFrontCenter_OnGoingObj0_OnGoingObj0_vxv_sw_Rv);
    Msg_OnGoingObj0.OnGoingObj0_RFF_ub   =getvalue(E_pric_RadarFrontCenter_OnGoingObj0_OnGoingObj0_RFF_ub_Rv);
    Msg_TrajPointACCObj13.TrajPointACCObj13_dyv_sw   =getvalue(E_pric_RadarFrontCenter_TrajPointACCObj13_TrajPointACCObj13_dyv_sw_Rv);
    Msg_TrajPointACCObj13.TrajPointACCObj13_TrajEnd_b   =getvalue(E_pric_RadarFrontCenter_TrajPointACCObj13_TrajPointACCObj13_TrajEnd_b_Rv);
    Msg_TrajPointACCObj13.TrajPointACCObj13_Drive_b   =getvalue(E_pric_RadarFrontCenter_TrajPointACCObj13_TrajPointACCObj13_Drive_b_Rv);
    Msg_TrajPointACCObj13.TrajPointACCObj13_Stand_b   =getvalue(E_pric_RadarFrontCenter_TrajPointACCObj13_TrajPointACCObj13_Stand_b_Rv);
    Msg_TrajPointACCObj13.TrajPointACCObj13_dxv_sw   =getvalue(E_pric_RadarFrontCenter_TrajPointACCObj13_TrajPointACCObj13_dxv_sw_Rv);
    Msg_TrajPointACCObj13.TrajPointACCObj13_dVarXv_uw   =getvalue(E_pric_RadarFrontCenter_TrajPointACCObj13_TrajPointACCObj13_dVarXv_uw_Rv);
    Msg_TrajPointACCObj13.TrajPointACCObj13_wExistProb_ub   =getvalue(E_pric_RadarFrontCenter_TrajPointACCObj13_TrajPointACCObj13_wExistProb_ub_Rv);
    Msg_TrajPointACCObj13.TrajPointACCObj13_Valid_b   =getvalue(E_pric_RadarFrontCenter_TrajPointACCObj13_TrajPointACCObj13_Valid_b_Rv);
    Msg_TrajPointACCObj13.TrajPointACCObj13_dVarYv_uw   =getvalue(E_pric_RadarFrontCenter_TrajPointACCObj13_TrajPointACCObj13_dVarYv_uw_Rv);
    Msg_TrajPointACCObj13.TrajPointACCObj13_InvDir_b   =getvalue(E_pric_RadarFrontCenter_TrajPointACCObj13_TrajPointACCObj13_InvDir_b_Rv);
    Msg_TrajPointACCObj13.TrajPointACCObj13_Stopped_b   =getvalue(E_pric_RadarFrontCenter_TrajPointACCObj13_TrajPointACCObj13_Stopped_b_Rv);
    Msg_TrajPointACCObj13.TrajPointACCObj13_timestamp   =getvalue(E_pric_RadarFrontCenter_TrajPointACCObj13_TrajPointACCObj13_timestamp_Rv);
    Msg_TrajPointACCObj12.TrajPointACCObj12_Valid_b   =getvalue(E_pric_RadarFrontCenter_TrajPointACCObj12_TrajPointACCObj12_Valid_b_Rv);
    Msg_TrajPointACCObj12.TrajPointACCObj12_dVarYv_uw   =getvalue(E_pric_RadarFrontCenter_TrajPointACCObj12_TrajPointACCObj12_dVarYv_uw_Rv);
    Msg_TrajPointACCObj12.TrajPointACCObj12_wExistProb_ub   =getvalue(E_pric_RadarFrontCenter_TrajPointACCObj12_TrajPointACCObj12_wExistProb_ub_Rv);
    Msg_TrajPointACCObj12.TrajPointACCObj12_InvDir_b   =getvalue(E_pric_RadarFrontCenter_TrajPointACCObj12_TrajPointACCObj12_InvDir_b_Rv);
    Msg_TrajPointACCObj12.TrajPointACCObj12_dVarXv_uw   =getvalue(E_pric_RadarFrontCenter_TrajPointACCObj12_TrajPointACCObj12_dVarXv_uw_Rv);
    Msg_TrajPointACCObj12.TrajPointACCObj12_Stopped_b   =getvalue(E_pric_RadarFrontCenter_TrajPointACCObj12_TrajPointACCObj12_Stopped_b_Rv);
    Msg_TrajPointACCObj12.TrajPointACCObj12_dyv_sw   =getvalue(E_pric_RadarFrontCenter_TrajPointACCObj12_TrajPointACCObj12_dyv_sw_Rv);
    Msg_TrajPointACCObj12.TrajPointACCObj12_dxv_sw   =getvalue(E_pric_RadarFrontCenter_TrajPointACCObj12_TrajPointACCObj12_dxv_sw_Rv);
    Msg_TrajPointACCObj12.TrajPointACCObj12_Drive_b   =getvalue(E_pric_RadarFrontCenter_TrajPointACCObj12_TrajPointACCObj12_Drive_b_Rv);
    Msg_TrajPointACCObj12.TrajPointACCObj12_timestamp   =getvalue(E_pric_RadarFrontCenter_TrajPointACCObj12_TrajPointACCObj12_timestamp_Rv);
    Msg_TrajPointACCObj12.TrajPointACCObj12_TrajEnd_b   =getvalue(E_pric_RadarFrontCenter_TrajPointACCObj12_TrajPointACCObj12_TrajEnd_b_Rv);
    Msg_TrajPointACCObj12.TrajPointACCObj12_Stand_b   =getvalue(E_pric_RadarFrontCenter_TrajPointACCObj12_TrajPointACCObj12_Stand_b_Rv);
    Msg_TrajPointACCObj11.TrajPointACCObj11_dyv_sw   =getvalue(E_pric_RadarFrontCenter_TrajPointACCObj11_TrajPointACCObj11_dyv_sw_Rv);
    Msg_TrajPointACCObj11.TrajPointACCObj11_dVarXv_uw   =getvalue(E_pric_RadarFrontCenter_TrajPointACCObj11_TrajPointACCObj11_dVarXv_uw_Rv);
    Msg_TrajPointACCObj11.TrajPointACCObj11_dxv_sw   =getvalue(E_pric_RadarFrontCenter_TrajPointACCObj11_TrajPointACCObj11_dxv_sw_Rv);
    Msg_TrajPointACCObj11.TrajPointACCObj11_Drive_b   =getvalue(E_pric_RadarFrontCenter_TrajPointACCObj11_TrajPointACCObj11_Drive_b_Rv);
    Msg_TrajPointACCObj11.TrajPointACCObj11_timestamp   =getvalue(E_pric_RadarFrontCenter_TrajPointACCObj11_TrajPointACCObj11_timestamp_Rv);
    Msg_TrajPointACCObj11.TrajPointACCObj11_Stopped_b   =getvalue(E_pric_RadarFrontCenter_TrajPointACCObj11_TrajPointACCObj11_Stopped_b_Rv);
    Msg_TrajPointACCObj11.TrajPointACCObj11_Valid_b   =getvalue(E_pric_RadarFrontCenter_TrajPointACCObj11_TrajPointACCObj11_Valid_b_Rv);
    Msg_TrajPointACCObj11.TrajPointACCObj11_TrajEnd_b   =getvalue(E_pric_RadarFrontCenter_TrajPointACCObj11_TrajPointACCObj11_TrajEnd_b_Rv);
    Msg_TrajPointACCObj11.TrajPointACCObj11_Stand_b   =getvalue(E_pric_RadarFrontCenter_TrajPointACCObj11_TrajPointACCObj11_Stand_b_Rv);
    Msg_TrajPointACCObj11.TrajPointACCObj11_dVarYv_uw   =getvalue(E_pric_RadarFrontCenter_TrajPointACCObj11_TrajPointACCObj11_dVarYv_uw_Rv);
    Msg_TrajPointACCObj11.TrajPointACCObj11_wExistProb_ub   =getvalue(E_pric_RadarFrontCenter_TrajPointACCObj11_TrajPointACCObj11_wExistProb_ub_Rv);
    Msg_TrajPointACCObj11.TrajPointACCObj11_InvDir_b   =getvalue(E_pric_RadarFrontCenter_TrajPointACCObj11_TrajPointACCObj11_InvDir_b_Rv);
    Msg_TrajPointACCObj10.TrajPointACCObj10_timestamp   =getvalue(E_pric_RadarFrontCenter_TrajPointACCObj10_TrajPointACCObj10_timestamp_Rv);
    Msg_TrajPointACCObj10.TrajPointACCObj10_wExistProb_ub   =getvalue(E_pric_RadarFrontCenter_TrajPointACCObj10_TrajPointACCObj10_wExistProb_ub_Rv);
    Msg_TrajPointACCObj10.TrajPointACCObj10_dyv_sw   =getvalue(E_pric_RadarFrontCenter_TrajPointACCObj10_TrajPointACCObj10_dyv_sw_Rv);
    Msg_TrajPointACCObj10.TrajPointACCObj10_Drive_b   =getvalue(E_pric_RadarFrontCenter_TrajPointACCObj10_TrajPointACCObj10_Drive_b_Rv);
    Msg_TrajPointACCObj10.TrajPointACCObj10_Stopped_b   =getvalue(E_pric_RadarFrontCenter_TrajPointACCObj10_TrajPointACCObj10_Stopped_b_Rv);
    Msg_TrajPointACCObj10.TrajPointACCObj10_Stand_b   =getvalue(E_pric_RadarFrontCenter_TrajPointACCObj10_TrajPointACCObj10_Stand_b_Rv);
    Msg_TrajPointACCObj10.TrajPointACCObj10_TrajEnd_b   =getvalue(E_pric_RadarFrontCenter_TrajPointACCObj10_TrajPointACCObj10_TrajEnd_b_Rv);
    Msg_TrajPointACCObj10.TrajPointACCObj10_dVarXv_uw   =getvalue(E_pric_RadarFrontCenter_TrajPointACCObj10_TrajPointACCObj10_dVarXv_uw_Rv);
    Msg_TrajPointACCObj10.TrajPointACCObj10_dVarYv_uw   =getvalue(E_pric_RadarFrontCenter_TrajPointACCObj10_TrajPointACCObj10_dVarYv_uw_Rv);
    Msg_TrajPointACCObj10.TrajPointACCObj10_dxv_sw   =getvalue(E_pric_RadarFrontCenter_TrajPointACCObj10_TrajPointACCObj10_dxv_sw_Rv);
    Msg_TrajPointACCObj10.TrajPointACCObj10_Valid_b   =getvalue(E_pric_RadarFrontCenter_TrajPointACCObj10_TrajPointACCObj10_Valid_b_Rv);
    Msg_TrajPointACCObj10.TrajPointACCObj10_InvDir_b   =getvalue(E_pric_RadarFrontCenter_TrajPointACCObj10_TrajPointACCObj10_InvDir_b_Rv);
    Msg_TrajPointACCObj17.TrajPointACCObj17_Valid_b   =getvalue(E_pric_RadarFrontCenter_TrajPointACCObj17_TrajPointACCObj17_Valid_b_Rv);
    Msg_TrajPointACCObj17.TrajPointACCObj17_Drive_b   =getvalue(E_pric_RadarFrontCenter_TrajPointACCObj17_TrajPointACCObj17_Drive_b_Rv);
    Msg_TrajPointACCObj17.TrajPointACCObj17_dVarYv_uw   =getvalue(E_pric_RadarFrontCenter_TrajPointACCObj17_TrajPointACCObj17_dVarYv_uw_Rv);
    Msg_TrajPointACCObj17.TrajPointACCObj17_InvDir_b   =getvalue(E_pric_RadarFrontCenter_TrajPointACCObj17_TrajPointACCObj17_InvDir_b_Rv);
    Msg_TrajPointACCObj17.TrajPointACCObj17_wExistProb_ub   =getvalue(E_pric_RadarFrontCenter_TrajPointACCObj17_TrajPointACCObj17_wExistProb_ub_Rv);
    Msg_TrajPointACCObj17.TrajPointACCObj17_dyv_sw   =getvalue(E_pric_RadarFrontCenter_TrajPointACCObj17_TrajPointACCObj17_dyv_sw_Rv);
    Msg_TrajPointACCObj17.TrajPointACCObj17_timestamp   =getvalue(E_pric_RadarFrontCenter_TrajPointACCObj17_TrajPointACCObj17_timestamp_Rv);
    Msg_TrajPointACCObj17.TrajPointACCObj17_Stopped_b   =getvalue(E_pric_RadarFrontCenter_TrajPointACCObj17_TrajPointACCObj17_Stopped_b_Rv);
    Msg_TrajPointACCObj17.TrajPointACCObj17_dxv_sw   =getvalue(E_pric_RadarFrontCenter_TrajPointACCObj17_TrajPointACCObj17_dxv_sw_Rv);
    Msg_TrajPointACCObj17.TrajPointACCObj17_dVarXv_uw   =getvalue(E_pric_RadarFrontCenter_TrajPointACCObj17_TrajPointACCObj17_dVarXv_uw_Rv);
    Msg_TrajPointACCObj17.TrajPointACCObj17_TrajEnd_b   =getvalue(E_pric_RadarFrontCenter_TrajPointACCObj17_TrajPointACCObj17_TrajEnd_b_Rv);
    Msg_TrajPointACCObj17.TrajPointACCObj17_Stand_b   =getvalue(E_pric_RadarFrontCenter_TrajPointACCObj17_TrajPointACCObj17_Stand_b_Rv);
    Msg_TrajACC.TrajACC_objType_ub   =getvalue(E_pric_RadarFrontCenter_TrajACC_TrajACC_objType_ub_Rv);
    Msg_TrajACC.TrajACC_TrajHistCurrentIndex_ub   =getvalue(E_pric_RadarFrontCenter_TrajACC_TrajACC_TrajHistCurrentIndex_ub_Rv);
    Msg_TrajPointACCObj15.TrajPointACCObj15_wExistProb_ub   =getvalue(E_pric_RadarFrontCenter_TrajPointACCObj15_TrajPointACCObj15_wExistProb_ub_Rv);
    Msg_TrajPointACCObj15.TrajPointACCObj15_Stand_b   =getvalue(E_pric_RadarFrontCenter_TrajPointACCObj15_TrajPointACCObj15_Stand_b_Rv);
    Msg_TrajPointACCObj15.TrajPointACCObj15_Stopped_b   =getvalue(E_pric_RadarFrontCenter_TrajPointACCObj15_TrajPointACCObj15_Stopped_b_Rv);
    Msg_TrajPointACCObj15.TrajPointACCObj15_InvDir_b   =getvalue(E_pric_RadarFrontCenter_TrajPointACCObj15_TrajPointACCObj15_InvDir_b_Rv);
    Msg_TrajPointACCObj15.TrajPointACCObj15_dxv_sw   =getvalue(E_pric_RadarFrontCenter_TrajPointACCObj15_TrajPointACCObj15_dxv_sw_Rv);
    Msg_TrajPointACCObj15.TrajPointACCObj15_dVarXv_uw   =getvalue(E_pric_RadarFrontCenter_TrajPointACCObj15_TrajPointACCObj15_dVarXv_uw_Rv);
    Msg_TrajPointACCObj15.TrajPointACCObj15_timestamp   =getvalue(E_pric_RadarFrontCenter_TrajPointACCObj15_TrajPointACCObj15_timestamp_Rv);
    Msg_TrajPointACCObj15.TrajPointACCObj15_dyv_sw   =getvalue(E_pric_RadarFrontCenter_TrajPointACCObj15_TrajPointACCObj15_dyv_sw_Rv);
    Msg_TrajPointACCObj15.TrajPointACCObj15_TrajEnd_b   =getvalue(E_pric_RadarFrontCenter_TrajPointACCObj15_TrajPointACCObj15_TrajEnd_b_Rv);
    Msg_TrajPointACCObj15.TrajPointACCObj15_Drive_b   =getvalue(E_pric_RadarFrontCenter_TrajPointACCObj15_TrajPointACCObj15_Drive_b_Rv);
    Msg_TrajPointACCObj15.TrajPointACCObj15_dVarYv_uw   =getvalue(E_pric_RadarFrontCenter_TrajPointACCObj15_TrajPointACCObj15_dVarYv_uw_Rv);
    Msg_TrajPointACCObj15.TrajPointACCObj15_Valid_b   =getvalue(E_pric_RadarFrontCenter_TrajPointACCObj15_TrajPointACCObj15_Valid_b_Rv);
    Msg_TrajPointACCObj14.TrajPointACCObj14_timestamp   =getvalue(E_pric_RadarFrontCenter_TrajPointACCObj14_TrajPointACCObj14_timestamp_Rv);
    Msg_TrajPointACCObj14.TrajPointACCObj14_dVarXv_uw   =getvalue(E_pric_RadarFrontCenter_TrajPointACCObj14_TrajPointACCObj14_dVarXv_uw_Rv);
    Msg_TrajPointACCObj14.TrajPointACCObj14_Valid_b   =getvalue(E_pric_RadarFrontCenter_TrajPointACCObj14_TrajPointACCObj14_Valid_b_Rv);
    Msg_TrajPointACCObj14.TrajPointACCObj14_dVarYv_uw   =getvalue(E_pric_RadarFrontCenter_TrajPointACCObj14_TrajPointACCObj14_dVarYv_uw_Rv);
    Msg_TrajPointACCObj14.TrajPointACCObj14_TrajEnd_b   =getvalue(E_pric_RadarFrontCenter_TrajPointACCObj14_TrajPointACCObj14_TrajEnd_b_Rv);
    Msg_TrajPointACCObj14.TrajPointACCObj14_dxv_sw   =getvalue(E_pric_RadarFrontCenter_TrajPointACCObj14_TrajPointACCObj14_dxv_sw_Rv);
    Msg_TrajPointACCObj14.TrajPointACCObj14_Stopped_b   =getvalue(E_pric_RadarFrontCenter_TrajPointACCObj14_TrajPointACCObj14_Stopped_b_Rv);
    Msg_TrajPointACCObj14.TrajPointACCObj14_wExistProb_ub   =getvalue(E_pric_RadarFrontCenter_TrajPointACCObj14_TrajPointACCObj14_wExistProb_ub_Rv);
    Msg_TrajPointACCObj14.TrajPointACCObj14_Stand_b   =getvalue(E_pric_RadarFrontCenter_TrajPointACCObj14_TrajPointACCObj14_Stand_b_Rv);
    Msg_TrajPointACCObj14.TrajPointACCObj14_dyv_sw   =getvalue(E_pric_RadarFrontCenter_TrajPointACCObj14_TrajPointACCObj14_dyv_sw_Rv);
    Msg_TrajPointACCObj14.TrajPointACCObj14_InvDir_b   =getvalue(E_pric_RadarFrontCenter_TrajPointACCObj14_TrajPointACCObj14_InvDir_b_Rv);
    Msg_TrajPointACCObj14.TrajPointACCObj14_Drive_b   =getvalue(E_pric_RadarFrontCenter_TrajPointACCObj14_TrajPointACCObj14_Drive_b_Rv);
    Msg_RDR_Status.RDR_Stat_blindness_det   =getvalue(E_pric_RadarFrontCenter_RDR_Status_RDR_Stat_blindness_det_Rv);
    Msg_RDR_Status.RDR_Stat_Error   =getvalue(E_pric_RadarFrontCenter_RDR_Status_RDR_Stat_Error_Rv);
    Msg_RDR_Status.RDR_Stat_PED_Brake   =getvalue(E_pric_RadarFrontCenter_RDR_Status_RDR_Stat_PED_Brake_Rv);
    Msg_RDR_Status.RDR_Stat_ObjDataAge   =getvalue(E_pric_RadarFrontCenter_RDR_Status_RDR_Stat_ObjDataAge_Rv);
    Msg_RDR_Status.RDR_Stat_ACCSwitchButton   =getvalue(E_pric_RadarFrontCenter_RDR_Status_RDR_Stat_ACCSwitchButton_Rv);
    Msg_RDR_Status.RDR_Stat_Avail   =getvalue(E_pric_RadarFrontCenter_RDR_Status_RDR_Stat_Avail_Rv);
    Msg_TrajPointACCObj9.TrajPointACCObj9_Stand_b   =getvalue(E_pric_RadarFrontCenter_TrajPointACCObj9_TrajPointACCObj9_Stand_b_Rv);
    Msg_TrajPointACCObj9.TrajPointACCObj9_Drive_b   =getvalue(E_pric_RadarFrontCenter_TrajPointACCObj9_TrajPointACCObj9_Drive_b_Rv);
    Msg_TrajPointACCObj9.TrajPointACCObj9_wExistProb_ub   =getvalue(E_pric_RadarFrontCenter_TrajPointACCObj9_TrajPointACCObj9_wExistProb_ub_Rv);
    Msg_TrajPointACCObj9.TrajPointACCObj9_TrajEnd_b   =getvalue(E_pric_RadarFrontCenter_TrajPointACCObj9_TrajPointACCObj9_TrajEnd_b_Rv);
    Msg_TrajPointACCObj9.TrajPointACCObj9_dVarYv_uw   =getvalue(E_pric_RadarFrontCenter_TrajPointACCObj9_TrajPointACCObj9_dVarYv_uw_Rv);
    Msg_TrajPointACCObj9.TrajPointACCObj9_dVarXv_uw   =getvalue(E_pric_RadarFrontCenter_TrajPointACCObj9_TrajPointACCObj9_dVarXv_uw_Rv);
    Msg_TrajPointACCObj9.TrajPointACCObj9_InvDir_b   =getvalue(E_pric_RadarFrontCenter_TrajPointACCObj9_TrajPointACCObj9_InvDir_b_Rv);
    Msg_TrajPointACCObj9.TrajPointACCObj9_dxv_sw   =getvalue(E_pric_RadarFrontCenter_TrajPointACCObj9_TrajPointACCObj9_dxv_sw_Rv);
    Msg_TrajPointACCObj9.TrajPointACCObj9_Stopped_b   =getvalue(E_pric_RadarFrontCenter_TrajPointACCObj9_TrajPointACCObj9_Stopped_b_Rv);
    Msg_TrajPointACCObj9.TrajPointACCObj9_dyv_sw   =getvalue(E_pric_RadarFrontCenter_TrajPointACCObj9_TrajPointACCObj9_dyv_sw_Rv);
    Msg_TrajPointACCObj9.TrajPointACCObj9_timestamp   =getvalue(E_pric_RadarFrontCenter_TrajPointACCObj9_TrajPointACCObj9_timestamp_Rv);
    Msg_TrajPointACCObj9.TrajPointACCObj9_Valid_b   =getvalue(E_pric_RadarFrontCenter_TrajPointACCObj9_TrajPointACCObj9_Valid_b_Rv);
    Msg_TrajPointACCObj8.TrajPointACCObj8_dyv_sw   =getvalue(E_pric_RadarFrontCenter_TrajPointACCObj8_TrajPointACCObj8_dyv_sw_Rv);
    Msg_TrajPointACCObj8.TrajPointACCObj8_dVarYv_uw   =getvalue(E_pric_RadarFrontCenter_TrajPointACCObj8_TrajPointACCObj8_dVarYv_uw_Rv);
    Msg_TrajPointACCObj8.TrajPointACCObj8_timestamp   =getvalue(E_pric_RadarFrontCenter_TrajPointACCObj8_TrajPointACCObj8_timestamp_Rv);
    Msg_TrajPointACCObj8.TrajPointACCObj8_wExistProb_ub   =getvalue(E_pric_RadarFrontCenter_TrajPointACCObj8_TrajPointACCObj8_wExistProb_ub_Rv);
    Msg_TrajPointACCObj8.TrajPointACCObj8_InvDir_b   =getvalue(E_pric_RadarFrontCenter_TrajPointACCObj8_TrajPointACCObj8_InvDir_b_Rv);
    Msg_TrajPointACCObj8.TrajPointACCObj8_Stopped_b   =getvalue(E_pric_RadarFrontCenter_TrajPointACCObj8_TrajPointACCObj8_Stopped_b_Rv);
    Msg_TrajPointACCObj8.TrajPointACCObj8_Stand_b   =getvalue(E_pric_RadarFrontCenter_TrajPointACCObj8_TrajPointACCObj8_Stand_b_Rv);
    Msg_TrajPointACCObj8.TrajPointACCObj8_dxv_sw   =getvalue(E_pric_RadarFrontCenter_TrajPointACCObj8_TrajPointACCObj8_dxv_sw_Rv);
    Msg_TrajPointACCObj8.TrajPointACCObj8_TrajEnd_b   =getvalue(E_pric_RadarFrontCenter_TrajPointACCObj8_TrajPointACCObj8_TrajEnd_b_Rv);
    Msg_TrajPointACCObj8.TrajPointACCObj8_dVarXv_uw   =getvalue(E_pric_RadarFrontCenter_TrajPointACCObj8_TrajPointACCObj8_dVarXv_uw_Rv);
    Msg_TrajPointACCObj8.TrajPointACCObj8_Valid_b   =getvalue(E_pric_RadarFrontCenter_TrajPointACCObj8_TrajPointACCObj8_Valid_b_Rv);
    Msg_TrajPointACCObj8.TrajPointACCObj8_Drive_b   =getvalue(E_pric_RadarFrontCenter_TrajPointACCObj8_TrajPointACCObj8_Drive_b_Rv);
    Msg_TrajPointACCObj7.TrajPointACCObj7_wExistProb_ub   =getvalue(E_pric_RadarFrontCenter_TrajPointACCObj7_TrajPointACCObj7_wExistProb_ub_Rv);
    Msg_TrajPointACCObj7.TrajPointACCObj7_dVarXv_uw   =getvalue(E_pric_RadarFrontCenter_TrajPointACCObj7_TrajPointACCObj7_dVarXv_uw_Rv);
    Msg_TrajPointACCObj7.TrajPointACCObj7_Drive_b   =getvalue(E_pric_RadarFrontCenter_TrajPointACCObj7_TrajPointACCObj7_Drive_b_Rv);
    Msg_TrajPointACCObj7.TrajPointACCObj7_TrajEnd_b   =getvalue(E_pric_RadarFrontCenter_TrajPointACCObj7_TrajPointACCObj7_TrajEnd_b_Rv);
    Msg_TrajPointACCObj7.TrajPointACCObj7_timestamp   =getvalue(E_pric_RadarFrontCenter_TrajPointACCObj7_TrajPointACCObj7_timestamp_Rv);
    Msg_TrajPointACCObj7.TrajPointACCObj7_dVarYv_uw   =getvalue(E_pric_RadarFrontCenter_TrajPointACCObj7_TrajPointACCObj7_dVarYv_uw_Rv);
    Msg_TrajPointACCObj7.TrajPointACCObj7_Stand_b   =getvalue(E_pric_RadarFrontCenter_TrajPointACCObj7_TrajPointACCObj7_Stand_b_Rv);
    Msg_TrajPointACCObj7.TrajPointACCObj7_Valid_b   =getvalue(E_pric_RadarFrontCenter_TrajPointACCObj7_TrajPointACCObj7_Valid_b_Rv);
    Msg_TrajPointACCObj7.TrajPointACCObj7_dyv_sw   =getvalue(E_pric_RadarFrontCenter_TrajPointACCObj7_TrajPointACCObj7_dyv_sw_Rv);
    Msg_TrajPointACCObj7.TrajPointACCObj7_Stopped_b   =getvalue(E_pric_RadarFrontCenter_TrajPointACCObj7_TrajPointACCObj7_Stopped_b_Rv);
    Msg_TrajPointACCObj7.TrajPointACCObj7_dxv_sw   =getvalue(E_pric_RadarFrontCenter_TrajPointACCObj7_TrajPointACCObj7_dxv_sw_Rv);
    Msg_TrajPointACCObj7.TrajPointACCObj7_InvDir_b   =getvalue(E_pric_RadarFrontCenter_TrajPointACCObj7_TrajPointACCObj7_InvDir_b_Rv);
    Msg_TrajPointACCObj6.TrajPointACCObj6_Stand_b   =getvalue(E_pric_RadarFrontCenter_TrajPointACCObj6_TrajPointACCObj6_Stand_b_Rv);
    Msg_TrajPointACCObj6.TrajPointACCObj6_wExistProb_ub   =getvalue(E_pric_RadarFrontCenter_TrajPointACCObj6_TrajPointACCObj6_wExistProb_ub_Rv);
    Msg_TrajPointACCObj6.TrajPointACCObj6_InvDir_b   =getvalue(E_pric_RadarFrontCenter_TrajPointACCObj6_TrajPointACCObj6_InvDir_b_Rv);
    Msg_TrajPointACCObj6.TrajPointACCObj6_Valid_b   =getvalue(E_pric_RadarFrontCenter_TrajPointACCObj6_TrajPointACCObj6_Valid_b_Rv);
    Msg_TrajPointACCObj6.TrajPointACCObj6_dVarYv_uw   =getvalue(E_pric_RadarFrontCenter_TrajPointACCObj6_TrajPointACCObj6_dVarYv_uw_Rv);
    Msg_TrajPointACCObj6.TrajPointACCObj6_dxv_sw   =getvalue(E_pric_RadarFrontCenter_TrajPointACCObj6_TrajPointACCObj6_dxv_sw_Rv);
    Msg_TrajPointACCObj6.TrajPointACCObj6_timestamp   =getvalue(E_pric_RadarFrontCenter_TrajPointACCObj6_TrajPointACCObj6_timestamp_Rv);
    Msg_TrajPointACCObj6.TrajPointACCObj6_dVarXv_uw   =getvalue(E_pric_RadarFrontCenter_TrajPointACCObj6_TrajPointACCObj6_dVarXv_uw_Rv);
    Msg_TrajPointACCObj6.TrajPointACCObj6_Stopped_b   =getvalue(E_pric_RadarFrontCenter_TrajPointACCObj6_TrajPointACCObj6_Stopped_b_Rv);
    Msg_TrajPointACCObj6.TrajPointACCObj6_dyv_sw   =getvalue(E_pric_RadarFrontCenter_TrajPointACCObj6_TrajPointACCObj6_dyv_sw_Rv);
    Msg_TrajPointACCObj6.TrajPointACCObj6_Drive_b   =getvalue(E_pric_RadarFrontCenter_TrajPointACCObj6_TrajPointACCObj6_Drive_b_Rv);
    Msg_TrajPointACCObj6.TrajPointACCObj6_TrajEnd_b   =getvalue(E_pric_RadarFrontCenter_TrajPointACCObj6_TrajPointACCObj6_TrajEnd_b_Rv);
    Msg_TrajPointACCObj5.TrajPointACCObj5_dxv_sw   =getvalue(E_pric_RadarFrontCenter_TrajPointACCObj5_TrajPointACCObj5_dxv_sw_Rv);
    Msg_TrajPointACCObj5.TrajPointACCObj5_timestamp   =getvalue(E_pric_RadarFrontCenter_TrajPointACCObj5_TrajPointACCObj5_timestamp_Rv);
    Msg_TrajPointACCObj5.TrajPointACCObj5_dVarYv_uw   =getvalue(E_pric_RadarFrontCenter_TrajPointACCObj5_TrajPointACCObj5_dVarYv_uw_Rv);
    Msg_TrajPointACCObj5.TrajPointACCObj5_InvDir_b   =getvalue(E_pric_RadarFrontCenter_TrajPointACCObj5_TrajPointACCObj5_InvDir_b_Rv);
    Msg_TrajPointACCObj5.TrajPointACCObj5_Valid_b   =getvalue(E_pric_RadarFrontCenter_TrajPointACCObj5_TrajPointACCObj5_Valid_b_Rv);
    Msg_TrajPointACCObj5.TrajPointACCObj5_wExistProb_ub   =getvalue(E_pric_RadarFrontCenter_TrajPointACCObj5_TrajPointACCObj5_wExistProb_ub_Rv);
    Msg_TrajPointACCObj5.TrajPointACCObj5_TrajEnd_b   =getvalue(E_pric_RadarFrontCenter_TrajPointACCObj5_TrajPointACCObj5_TrajEnd_b_Rv);
    Msg_TrajPointACCObj5.TrajPointACCObj5_dVarXv_uw   =getvalue(E_pric_RadarFrontCenter_TrajPointACCObj5_TrajPointACCObj5_dVarXv_uw_Rv);
    Msg_TrajPointACCObj5.TrajPointACCObj5_dyv_sw   =getvalue(E_pric_RadarFrontCenter_TrajPointACCObj5_TrajPointACCObj5_dyv_sw_Rv);
    Msg_TrajPointACCObj5.TrajPointACCObj5_Drive_b   =getvalue(E_pric_RadarFrontCenter_TrajPointACCObj5_TrajPointACCObj5_Drive_b_Rv);
    Msg_TrajPointACCObj5.TrajPointACCObj5_Stand_b   =getvalue(E_pric_RadarFrontCenter_TrajPointACCObj5_TrajPointACCObj5_Stand_b_Rv);
    Msg_TrajPointACCObj5.TrajPointACCObj5_Stopped_b   =getvalue(E_pric_RadarFrontCenter_TrajPointACCObj5_TrajPointACCObj5_Stopped_b_Rv);
    Msg_TrajPointACCObj4.TrajPointACCObj4_Stopped_b   =getvalue(E_pric_RadarFrontCenter_TrajPointACCObj4_TrajPointACCObj4_Stopped_b_Rv);
    Msg_TrajPointACCObj4.TrajPointACCObj4_Valid_b   =getvalue(E_pric_RadarFrontCenter_TrajPointACCObj4_TrajPointACCObj4_Valid_b_Rv);
    Msg_TrajPointACCObj4.TrajPointACCObj4_TrajEnd_b   =getvalue(E_pric_RadarFrontCenter_TrajPointACCObj4_TrajPointACCObj4_TrajEnd_b_Rv);
    Msg_TrajPointACCObj4.TrajPointACCObj4_Stand_b   =getvalue(E_pric_RadarFrontCenter_TrajPointACCObj4_TrajPointACCObj4_Stand_b_Rv);
    Msg_TrajPointACCObj4.TrajPointACCObj4_timestamp   =getvalue(E_pric_RadarFrontCenter_TrajPointACCObj4_TrajPointACCObj4_timestamp_Rv);
    Msg_TrajPointACCObj4.TrajPointACCObj4_wExistProb_ub   =getvalue(E_pric_RadarFrontCenter_TrajPointACCObj4_TrajPointACCObj4_wExistProb_ub_Rv);
    Msg_TrajPointACCObj4.TrajPointACCObj4_InvDir_b   =getvalue(E_pric_RadarFrontCenter_TrajPointACCObj4_TrajPointACCObj4_InvDir_b_Rv);
    Msg_TrajPointACCObj4.TrajPointACCObj4_dVarXv_uw   =getvalue(E_pric_RadarFrontCenter_TrajPointACCObj4_TrajPointACCObj4_dVarXv_uw_Rv);
    Msg_TrajPointACCObj4.TrajPointACCObj4_dVarYv_uw   =getvalue(E_pric_RadarFrontCenter_TrajPointACCObj4_TrajPointACCObj4_dVarYv_uw_Rv);
    Msg_TrajPointACCObj4.TrajPointACCObj4_Drive_b   =getvalue(E_pric_RadarFrontCenter_TrajPointACCObj4_TrajPointACCObj4_Drive_b_Rv);
    Msg_TrajPointACCObj4.TrajPointACCObj4_dxv_sw   =getvalue(E_pric_RadarFrontCenter_TrajPointACCObj4_TrajPointACCObj4_dxv_sw_Rv);
    Msg_TrajPointACCObj4.TrajPointACCObj4_dyv_sw   =getvalue(E_pric_RadarFrontCenter_TrajPointACCObj4_TrajPointACCObj4_dyv_sw_Rv);
    Msg_TrajPointACCObj3.TrajPointACCObj3_dyv_sw   =getvalue(E_pric_RadarFrontCenter_TrajPointACCObj3_TrajPointACCObj3_dyv_sw_Rv);
    Msg_TrajPointACCObj3.TrajPointACCObj3_wExistProb_ub   =getvalue(E_pric_RadarFrontCenter_TrajPointACCObj3_TrajPointACCObj3_wExistProb_ub_Rv);
    Msg_TrajPointACCObj3.TrajPointACCObj3_dVarXv_uw   =getvalue(E_pric_RadarFrontCenter_TrajPointACCObj3_TrajPointACCObj3_dVarXv_uw_Rv);
    Msg_TrajPointACCObj3.TrajPointACCObj3_Stand_b   =getvalue(E_pric_RadarFrontCenter_TrajPointACCObj3_TrajPointACCObj3_Stand_b_Rv);
    Msg_TrajPointACCObj3.TrajPointACCObj3_Valid_b   =getvalue(E_pric_RadarFrontCenter_TrajPointACCObj3_TrajPointACCObj3_Valid_b_Rv);
    Msg_TrajPointACCObj3.TrajPointACCObj3_TrajEnd_b   =getvalue(E_pric_RadarFrontCenter_TrajPointACCObj3_TrajPointACCObj3_TrajEnd_b_Rv);
    Msg_TrajPointACCObj3.TrajPointACCObj3_InvDir_b   =getvalue(E_pric_RadarFrontCenter_TrajPointACCObj3_TrajPointACCObj3_InvDir_b_Rv);
    Msg_TrajPointACCObj3.TrajPointACCObj3_dxv_sw   =getvalue(E_pric_RadarFrontCenter_TrajPointACCObj3_TrajPointACCObj3_dxv_sw_Rv);
    Msg_TrajPointACCObj3.TrajPointACCObj3_Drive_b   =getvalue(E_pric_RadarFrontCenter_TrajPointACCObj3_TrajPointACCObj3_Drive_b_Rv);
    Msg_TrajPointACCObj3.TrajPointACCObj3_Stopped_b   =getvalue(E_pric_RadarFrontCenter_TrajPointACCObj3_TrajPointACCObj3_Stopped_b_Rv);
    Msg_TrajPointACCObj3.TrajPointACCObj3_dVarYv_uw   =getvalue(E_pric_RadarFrontCenter_TrajPointACCObj3_TrajPointACCObj3_dVarYv_uw_Rv);
    Msg_TrajPointACCObj3.TrajPointACCObj3_timestamp   =getvalue(E_pric_RadarFrontCenter_TrajPointACCObj3_TrajPointACCObj3_timestamp_Rv);
    Msg_TrajPointACCObj2.TrajPointACCObj2_timestamp   =getvalue(E_pric_RadarFrontCenter_TrajPointACCObj2_TrajPointACCObj2_timestamp_Rv);
    Msg_TrajPointACCObj2.TrajPointACCObj2_wExistProb_ub   =getvalue(E_pric_RadarFrontCenter_TrajPointACCObj2_TrajPointACCObj2_wExistProb_ub_Rv);
    Msg_TrajPointACCObj2.TrajPointACCObj2_Drive_b   =getvalue(E_pric_RadarFrontCenter_TrajPointACCObj2_TrajPointACCObj2_Drive_b_Rv);
    Msg_TrajPointACCObj2.TrajPointACCObj2_dxv_sw   =getvalue(E_pric_RadarFrontCenter_TrajPointACCObj2_TrajPointACCObj2_dxv_sw_Rv);
    Msg_TrajPointACCObj2.TrajPointACCObj2_InvDir_b   =getvalue(E_pric_RadarFrontCenter_TrajPointACCObj2_TrajPointACCObj2_InvDir_b_Rv);
    Msg_TrajPointACCObj2.TrajPointACCObj2_Stopped_b   =getvalue(E_pric_RadarFrontCenter_TrajPointACCObj2_TrajPointACCObj2_Stopped_b_Rv);
    Msg_TrajPointACCObj2.TrajPointACCObj2_Stand_b   =getvalue(E_pric_RadarFrontCenter_TrajPointACCObj2_TrajPointACCObj2_Stand_b_Rv);
    Msg_TrajPointACCObj2.TrajPointACCObj2_dyv_sw   =getvalue(E_pric_RadarFrontCenter_TrajPointACCObj2_TrajPointACCObj2_dyv_sw_Rv);
    Msg_TrajPointACCObj2.TrajPointACCObj2_dVarYv_uw   =getvalue(E_pric_RadarFrontCenter_TrajPointACCObj2_TrajPointACCObj2_dVarYv_uw_Rv);
    Msg_TrajPointACCObj2.TrajPointACCObj2_dVarXv_uw   =getvalue(E_pric_RadarFrontCenter_TrajPointACCObj2_TrajPointACCObj2_dVarXv_uw_Rv);
    Msg_TrajPointACCObj2.TrajPointACCObj2_TrajEnd_b   =getvalue(E_pric_RadarFrontCenter_TrajPointACCObj2_TrajPointACCObj2_TrajEnd_b_Rv);
    Msg_TrajPointACCObj2.TrajPointACCObj2_Valid_b   =getvalue(E_pric_RadarFrontCenter_TrajPointACCObj2_TrajPointACCObj2_Valid_b_Rv);
    Msg_TrajPointACCObj1.TrajPointACCObj1_Stopped_b   =getvalue(E_pric_RadarFrontCenter_TrajPointACCObj1_TrajPointACCObj1_Stopped_b_Rv);
    Msg_TrajPointACCObj1.TrajPointACCObj1_dyv_sw   =getvalue(E_pric_RadarFrontCenter_TrajPointACCObj1_TrajPointACCObj1_dyv_sw_Rv);
    Msg_TrajPointACCObj1.TrajPointACCObj1_Stand_b   =getvalue(E_pric_RadarFrontCenter_TrajPointACCObj1_TrajPointACCObj1_Stand_b_Rv);
    Msg_TrajPointACCObj1.TrajPointACCObj1_Drive_b   =getvalue(E_pric_RadarFrontCenter_TrajPointACCObj1_TrajPointACCObj1_Drive_b_Rv);
    Msg_TrajPointACCObj1.TrajPointACCObj1_InvDir_b   =getvalue(E_pric_RadarFrontCenter_TrajPointACCObj1_TrajPointACCObj1_InvDir_b_Rv);
    Msg_TrajPointACCObj1.TrajPointACCObj1_dxv_sw   =getvalue(E_pric_RadarFrontCenter_TrajPointACCObj1_TrajPointACCObj1_dxv_sw_Rv);
    Msg_TrajPointACCObj1.TrajPointACCObj1_dVarXv_uw   =getvalue(E_pric_RadarFrontCenter_TrajPointACCObj1_TrajPointACCObj1_dVarXv_uw_Rv);
    Msg_TrajPointACCObj1.TrajPointACCObj1_Valid_b   =getvalue(E_pric_RadarFrontCenter_TrajPointACCObj1_TrajPointACCObj1_Valid_b_Rv);
    Msg_TrajPointACCObj1.TrajPointACCObj1_dVarYv_uw   =getvalue(E_pric_RadarFrontCenter_TrajPointACCObj1_TrajPointACCObj1_dVarYv_uw_Rv);
    Msg_TrajPointACCObj1.TrajPointACCObj1_wExistProb_ub   =getvalue(E_pric_RadarFrontCenter_TrajPointACCObj1_TrajPointACCObj1_wExistProb_ub_Rv);
    Msg_TrajPointACCObj1.TrajPointACCObj1_TrajEnd_b   =getvalue(E_pric_RadarFrontCenter_TrajPointACCObj1_TrajPointACCObj1_TrajEnd_b_Rv);
    Msg_TrajPointACCObj1.TrajPointACCObj1_timestamp   =getvalue(E_pric_RadarFrontCenter_TrajPointACCObj1_TrajPointACCObj1_timestamp_Rv);
    Msg_TrajPointACCObj0.TrajPointACCObj0_timestamp   =getvalue(E_pric_RadarFrontCenter_TrajPointACCObj0_TrajPointACCObj0_timestamp_Rv);
    Msg_TrajPointACCObj0.TrajPointACCObj0_InvDir_b   =getvalue(E_pric_RadarFrontCenter_TrajPointACCObj0_TrajPointACCObj0_InvDir_b_Rv);
    Msg_TrajPointACCObj0.TrajPointACCObj0_Drive_b   =getvalue(E_pric_RadarFrontCenter_TrajPointACCObj0_TrajPointACCObj0_Drive_b_Rv);
    Msg_TrajPointACCObj0.TrajPointACCObj0_TrajEnd_b   =getvalue(E_pric_RadarFrontCenter_TrajPointACCObj0_TrajPointACCObj0_TrajEnd_b_Rv);
    Msg_TrajPointACCObj0.TrajPointACCObj0_dyv_sw   =getvalue(E_pric_RadarFrontCenter_TrajPointACCObj0_TrajPointACCObj0_dyv_sw_Rv);
    Msg_TrajPointACCObj0.TrajPointACCObj0_dVarYv_uw   =getvalue(E_pric_RadarFrontCenter_TrajPointACCObj0_TrajPointACCObj0_dVarYv_uw_Rv);
    Msg_TrajPointACCObj0.TrajPointACCObj0_Valid_b   =getvalue(E_pric_RadarFrontCenter_TrajPointACCObj0_TrajPointACCObj0_Valid_b_Rv);
    Msg_TrajPointACCObj0.TrajPointACCObj0_wExistProb_ub   =getvalue(E_pric_RadarFrontCenter_TrajPointACCObj0_TrajPointACCObj0_wExistProb_ub_Rv);
    Msg_TrajPointACCObj0.TrajPointACCObj0_Stopped_b   =getvalue(E_pric_RadarFrontCenter_TrajPointACCObj0_TrajPointACCObj0_Stopped_b_Rv);
    Msg_TrajPointACCObj0.TrajPointACCObj0_Stand_b   =getvalue(E_pric_RadarFrontCenter_TrajPointACCObj0_TrajPointACCObj0_Stand_b_Rv);
    Msg_TrajPointACCObj0.TrajPointACCObj0_dxv_sw   =getvalue(E_pric_RadarFrontCenter_TrajPointACCObj0_TrajPointACCObj0_dxv_sw_Rv);
    Msg_TrajPointACCObj0.TrajPointACCObj0_dVarXv_uw   =getvalue(E_pric_RadarFrontCenter_TrajPointACCObj0_TrajPointACCObj0_dVarXv_uw_Rv);
    Msg_ACCObjInfo.ACCObjInfo_dxv_sw   =getvalue(E_pric_RadarFrontCenter_ACCObjInfo_ACCObjInfo_dxv_sw_Rv);
    Msg_ACCObjInfo.ACCObjInfo_Handle_ub   =getvalue(E_pric_RadarFrontCenter_ACCObjInfo_ACCObjInfo_Handle_ub_Rv);
    Msg_ACCObjInfo.ACCObjInfo_RFF_ub   =getvalue(E_pric_RadarFrontCenter_ACCObjInfo_ACCObjInfo_RFF_ub_Rv);
    Msg_ACCObjInfo.ACCObjInfo_vxv_sw   =getvalue(E_pric_RadarFrontCenter_ACCObjInfo_ACCObjInfo_vxv_sw_Rv);
    Msg_ACCObjInfo.ACCObjInfo_dWidth_sw   =getvalue(E_pric_RadarFrontCenter_ACCObjInfo_ACCObjInfo_dWidth_sw_Rv);
    Msg_ACCObjInfo.ACCObjInfo_dyv_sw   =getvalue(E_pric_RadarFrontCenter_ACCObjInfo_ACCObjInfo_dyv_sw_Rv);
    Msg_ACCObjInfo.ACCObjInfo_timestamp   =getvalue(E_pric_RadarFrontCenter_ACCObjInfo_ACCObjInfo_timestamp_Rv);
    Msg_TIPLLaneInfo0.TIPLLaneInfo0_prob1Lane_ub   =getvalue(E_pric_RadarFrontCenter_TIPLLaneInfo0_TIPLLaneInfo0_prob1Lane_ub_Rv);
    Msg_TIPLLaneInfo0.TIPLLaneInfo0_dUpperLimitLane_sw   =getvalue(E_pric_RadarFrontCenter_TIPLLaneInfo0_TIPLLaneInfo0_dUpperLimitLane_sw_Rv);
    Msg_TIPLLaneInfo0.TIPLLaneInfo0_dLowerLimitLane_sw   =getvalue(E_pric_RadarFrontCenter_TIPLLaneInfo0_TIPLLaneInfo0_dLowerLimitLane_sw_Rv);
    Msg_TIPLLaneInfo0.TIPLLaneInfo0_dRightBorder_sw   =getvalue(E_pric_RadarFrontCenter_TIPLLaneInfo0_TIPLLaneInfo0_dRightBorder_sw_Rv);
    Msg_TIPLLaneInfo0.TIPLLaneInfo0_dLeftBorder_sw   =getvalue(E_pric_RadarFrontCenter_TIPLLaneInfo0_TIPLLaneInfo0_dLeftBorder_sw_Rv);
    Msg_TIPLLaneInfo1.TIPLLaneInfo1_dRightBorder_sw   =getvalue(E_pric_RadarFrontCenter_TIPLLaneInfo1_TIPLLaneInfo1_dRightBorder_sw_Rv);
    Msg_TIPLLaneInfo1.TIPLLaneInfo1_dUpperLimitLane_sw   =getvalue(E_pric_RadarFrontCenter_TIPLLaneInfo1_TIPLLaneInfo1_dUpperLimitLane_sw_Rv);
    Msg_TIPLLaneInfo1.TIPLLaneInfo1_dLowerLimitLane_sw   =getvalue(E_pric_RadarFrontCenter_TIPLLaneInfo1_TIPLLaneInfo1_dLowerLimitLane_sw_Rv);
    Msg_TIPLLaneInfo1.TIPLLaneInfo1_dLeftBorder_sw   =getvalue(E_pric_RadarFrontCenter_TIPLLaneInfo1_TIPLLaneInfo1_dLeftBorder_sw_Rv);
    Msg_TIPLLaneInfo1.TIPLLaneInfo1_prob1Lane_ub   =getvalue(E_pric_RadarFrontCenter_TIPLLaneInfo1_TIPLLaneInfo1_prob1Lane_ub_Rv);
    Msg_TIPLLaneInfo2.TIPLLaneInfo2_prob1Lane_ub   =getvalue(E_pric_RadarFrontCenter_TIPLLaneInfo2_TIPLLaneInfo2_prob1Lane_ub_Rv);
    Msg_TIPLLaneInfo2.TIPLLaneInfo2_dUpperLimitLane_sw   =getvalue(E_pric_RadarFrontCenter_TIPLLaneInfo2_TIPLLaneInfo2_dUpperLimitLane_sw_Rv);
    Msg_TIPLLaneInfo2.TIPLLaneInfo2_dLeftBorder_sw   =getvalue(E_pric_RadarFrontCenter_TIPLLaneInfo2_TIPLLaneInfo2_dLeftBorder_sw_Rv);
    Msg_TIPLLaneInfo2.TIPLLaneInfo2_dRightBorder_sw   =getvalue(E_pric_RadarFrontCenter_TIPLLaneInfo2_TIPLLaneInfo2_dRightBorder_sw_Rv);
    Msg_TIPLLaneInfo2.TIPLLaneInfo2_dLowerLimitLane_sw   =getvalue(E_pric_RadarFrontCenter_TIPLLaneInfo2_TIPLLaneInfo2_dLowerLimitLane_sw_Rv);
    Msg_TIPLLaneInfo3.TIPLLaneInfo3_dLowerLimitLane_sw   =getvalue(E_pric_RadarFrontCenter_TIPLLaneInfo3_TIPLLaneInfo3_dLowerLimitLane_sw_Rv);
    Msg_TIPLLaneInfo3.TIPLLaneInfo3_dRightBorder_sw   =getvalue(E_pric_RadarFrontCenter_TIPLLaneInfo3_TIPLLaneInfo3_dRightBorder_sw_Rv);
    Msg_TIPLLaneInfo3.TIPLLaneInfo3_dUpperLimitLane_sw   =getvalue(E_pric_RadarFrontCenter_TIPLLaneInfo3_TIPLLaneInfo3_dUpperLimitLane_sw_Rv);
    Msg_TIPLLaneInfo3.TIPLLaneInfo3_dLeftBorder_sw   =getvalue(E_pric_RadarFrontCenter_TIPLLaneInfo3_TIPLLaneInfo3_dLeftBorder_sw_Rv);
    Msg_TIPLLaneInfo3.TIPLLaneInfo3_prob1Lane_ub   =getvalue(E_pric_RadarFrontCenter_TIPLLaneInfo3_TIPLLaneInfo3_prob1Lane_ub_Rv);
    Msg_TIPLCourseInfo1.TIPLCourseInfo1_a1polynomCoef_sw   =getvalue(E_pric_RadarFrontCenter_TIPLCourseInfo1_TIPLCourseInfo1_a1polynomCoef_sw_Rv);
    Msg_TIPLCourseInfo1.TIPLCourseInfo1_a0polynomCoef_sw   =getvalue(E_pric_RadarFrontCenter_TIPLCourseInfo1_TIPLCourseInfo1_a0polynomCoef_sw_Rv);
    Msg_TIPLCourseInfo1.TIPLCourseInfo1_qCourseConform   =getvalue(E_pric_RadarFrontCenter_TIPLCourseInfo1_TIPLCourseInfo1_qCourseConform_Rv);
    Msg_TIPLCourseInfo1.TIPLCourseInfo1_dLowerLimit_sw   =getvalue(E_pric_RadarFrontCenter_TIPLCourseInfo1_TIPLCourseInfo1_dLowerLimit_sw_Rv);
    Msg_TIPLCourseInfo1.TIPLCourseInfo1_a2polynomCoef_sw   =getvalue(E_pric_RadarFrontCenter_TIPLCourseInfo1_TIPLCourseInfo1_a2polynomCoef_sw_Rv);
    Msg_TIPLCourseInfo1.TIPLCourseInfo1_dUpperLimit_sw   =getvalue(E_pric_RadarFrontCenter_TIPLCourseInfo1_TIPLCourseInfo1_dUpperLimit_sw_Rv);
    Msg_TIPLCourseInfo0.TIPLCourseInfo0_qCourseConform   =getvalue(E_pric_RadarFrontCenter_TIPLCourseInfo0_TIPLCourseInfo0_qCourseConform_Rv);
    Msg_TIPLCourseInfo0.TIPLCourseInfo0_a0polynomCoef_sw   =getvalue(E_pric_RadarFrontCenter_TIPLCourseInfo0_TIPLCourseInfo0_a0polynomCoef_sw_Rv);
    Msg_TIPLCourseInfo0.TIPLCourseInfo0_a2polynomCoef_sw   =getvalue(E_pric_RadarFrontCenter_TIPLCourseInfo0_TIPLCourseInfo0_a2polynomCoef_sw_Rv);
    Msg_TIPLCourseInfo0.TIPLCourseInfo0_dUpperLimit_sw   =getvalue(E_pric_RadarFrontCenter_TIPLCourseInfo0_TIPLCourseInfo0_dUpperLimit_sw_Rv);
    Msg_TIPLCourseInfo0.TIPLCourseInfo0_dLowerLimit_sw   =getvalue(E_pric_RadarFrontCenter_TIPLCourseInfo0_TIPLCourseInfo0_dLowerLimit_sw_Rv);
    Msg_TIPLCourseInfo0.TIPLCourseInfo0_a1polynomCoef_sw   =getvalue(E_pric_RadarFrontCenter_TIPLCourseInfo0_TIPLCourseInfo0_a1polynomCoef_sw_Rv);
    Msg_TIPLCourseInfo3.TIPLCourseInfo3_a1polynomCoef_sw   =getvalue(E_pric_RadarFrontCenter_TIPLCourseInfo3_TIPLCourseInfo3_a1polynomCoef_sw_Rv);
    Msg_TIPLCourseInfo3.TIPLCourseInfo3_a2polynomCoef_sw   =getvalue(E_pric_RadarFrontCenter_TIPLCourseInfo3_TIPLCourseInfo3_a2polynomCoef_sw_Rv);
    Msg_TIPLCourseInfo3.TIPLCourseInfo3_qCourseConform   =getvalue(E_pric_RadarFrontCenter_TIPLCourseInfo3_TIPLCourseInfo3_qCourseConform_Rv);
    Msg_TIPLCourseInfo3.TIPLCourseInfo3_dLowerLimit_sw   =getvalue(E_pric_RadarFrontCenter_TIPLCourseInfo3_TIPLCourseInfo3_dLowerLimit_sw_Rv);
    Msg_TIPLCourseInfo3.TIPLCourseInfo3_dUpperLimit_sw   =getvalue(E_pric_RadarFrontCenter_TIPLCourseInfo3_TIPLCourseInfo3_dUpperLimit_sw_Rv);
    Msg_TIPLCourseInfo3.TIPLCourseInfo3_a0polynomCoef_sw   =getvalue(E_pric_RadarFrontCenter_TIPLCourseInfo3_TIPLCourseInfo3_a0polynomCoef_sw_Rv);
    Msg_TIPLCourseInfo2.TIPLCourseInfo2_dLowerLimit_sw   =getvalue(E_pric_RadarFrontCenter_TIPLCourseInfo2_TIPLCourseInfo2_dLowerLimit_sw_Rv);
    Msg_TIPLCourseInfo2.TIPLCourseInfo2_qCourseConform   =getvalue(E_pric_RadarFrontCenter_TIPLCourseInfo2_TIPLCourseInfo2_qCourseConform_Rv);
    Msg_TIPLCourseInfo2.TIPLCourseInfo2_a2polynomCoef_sw   =getvalue(E_pric_RadarFrontCenter_TIPLCourseInfo2_TIPLCourseInfo2_a2polynomCoef_sw_Rv);
    Msg_TIPLCourseInfo2.TIPLCourseInfo2_a0polynomCoef_sw   =getvalue(E_pric_RadarFrontCenter_TIPLCourseInfo2_TIPLCourseInfo2_a0polynomCoef_sw_Rv);
    Msg_TIPLCourseInfo2.TIPLCourseInfo2_a1polynomCoef_sw   =getvalue(E_pric_RadarFrontCenter_TIPLCourseInfo2_TIPLCourseInfo2_a1polynomCoef_sw_Rv);
    Msg_TIPLCourseInfo2.TIPLCourseInfo2_dUpperLimit_sw   =getvalue(E_pric_RadarFrontCenter_TIPLCourseInfo2_TIPLCourseInfo2_dUpperLimit_sw_Rv);
    Msg_TIPLCourseInfo4.TIPLCourseInfo4_a2polynomCoef_sw   =getvalue(E_pric_RadarFrontCenter_TIPLCourseInfo4_TIPLCourseInfo4_a2polynomCoef_sw_Rv);
    Msg_TIPLCourseInfo4.TIPLCourseInfo4_a1polynomCoef_sw   =getvalue(E_pric_RadarFrontCenter_TIPLCourseInfo4_TIPLCourseInfo4_a1polynomCoef_sw_Rv);
    Msg_TIPLCourseInfo4.TIPLCourseInfo4_dUpperLimit_sw   =getvalue(E_pric_RadarFrontCenter_TIPLCourseInfo4_TIPLCourseInfo4_dUpperLimit_sw_Rv);
    Msg_TIPLCourseInfo4.TIPLCourseInfo4_qCourseConform   =getvalue(E_pric_RadarFrontCenter_TIPLCourseInfo4_TIPLCourseInfo4_qCourseConform_Rv);
    Msg_TIPLCourseInfo4.TIPLCourseInfo4_dLowerLimit_sw   =getvalue(E_pric_RadarFrontCenter_TIPLCourseInfo4_TIPLCourseInfo4_dLowerLimit_sw_Rv);
    Msg_TIPLCourseInfo4.TIPLCourseInfo4_a0polynomCoef_sw   =getvalue(E_pric_RadarFrontCenter_TIPLCourseInfo4_TIPLCourseInfo4_a0polynomCoef_sw_Rv);
    Msg_ACC_0x95.ACC_AEBActive   =getvalue(E_pric_RadarFrontCenter_ACC_0x95_ACC_AEBActive_Rv);
    Msg_TrajPointACCObj22.TrajPointACCObj22_wExistProb_ub   =getvalue(E_pric_RadarFrontCenter_TrajPointACCObj22_TrajPointACCObj22_wExistProb_ub_Rv);
    Msg_TrajPointACCObj22.TrajPointACCObj22_InvDir_b   =getvalue(E_pric_RadarFrontCenter_TrajPointACCObj22_TrajPointACCObj22_InvDir_b_Rv);
    Msg_TrajPointACCObj22.TrajPointACCObj22_Stopped_b   =getvalue(E_pric_RadarFrontCenter_TrajPointACCObj22_TrajPointACCObj22_Stopped_b_Rv);
    Msg_TrajPointACCObj22.TrajPointACCObj22_Valid_b   =getvalue(E_pric_RadarFrontCenter_TrajPointACCObj22_TrajPointACCObj22_Valid_b_Rv);
    Msg_TrajPointACCObj22.TrajPointACCObj22_TrajEnd_b   =getvalue(E_pric_RadarFrontCenter_TrajPointACCObj22_TrajPointACCObj22_TrajEnd_b_Rv);
    Msg_TrajPointACCObj22.TrajPointACCObj22_dyv_sw   =getvalue(E_pric_RadarFrontCenter_TrajPointACCObj22_TrajPointACCObj22_dyv_sw_Rv);
    Msg_TrajPointACCObj22.TrajPointACCObj22_Drive_b   =getvalue(E_pric_RadarFrontCenter_TrajPointACCObj22_TrajPointACCObj22_Drive_b_Rv);
    Msg_TrajPointACCObj22.TrajPointACCObj22_Stand_b   =getvalue(E_pric_RadarFrontCenter_TrajPointACCObj22_TrajPointACCObj22_Stand_b_Rv);
    Msg_TrajPointACCObj22.TrajPointACCObj22_dVarXv_uw   =getvalue(E_pric_RadarFrontCenter_TrajPointACCObj22_TrajPointACCObj22_dVarXv_uw_Rv);
    Msg_TrajPointACCObj22.TrajPointACCObj22_timestamp   =getvalue(E_pric_RadarFrontCenter_TrajPointACCObj22_TrajPointACCObj22_timestamp_Rv);
    Msg_TrajPointACCObj22.TrajPointACCObj22_dVarYv_uw   =getvalue(E_pric_RadarFrontCenter_TrajPointACCObj22_TrajPointACCObj22_dVarYv_uw_Rv);
    Msg_TrajPointACCObj22.TrajPointACCObj22_dxv_sw   =getvalue(E_pric_RadarFrontCenter_TrajPointACCObj22_TrajPointACCObj22_dxv_sw_Rv);
    Msg_TrajPointACCObj23.TrajPointACCObj23_Stopped_b   =getvalue(E_pric_RadarFrontCenter_TrajPointACCObj23_TrajPointACCObj23_Stopped_b_Rv);
    Msg_TrajPointACCObj23.TrajPointACCObj23_InvDir_b   =getvalue(E_pric_RadarFrontCenter_TrajPointACCObj23_TrajPointACCObj23_InvDir_b_Rv);
    Msg_TrajPointACCObj23.TrajPointACCObj23_Valid_b   =getvalue(E_pric_RadarFrontCenter_TrajPointACCObj23_TrajPointACCObj23_Valid_b_Rv);
    Msg_TrajPointACCObj23.TrajPointACCObj23_Stand_b   =getvalue(E_pric_RadarFrontCenter_TrajPointACCObj23_TrajPointACCObj23_Stand_b_Rv);
    Msg_TrajPointACCObj23.TrajPointACCObj23_dVarYv_uw   =getvalue(E_pric_RadarFrontCenter_TrajPointACCObj23_TrajPointACCObj23_dVarYv_uw_Rv);
    Msg_TrajPointACCObj23.TrajPointACCObj23_dyv_sw   =getvalue(E_pric_RadarFrontCenter_TrajPointACCObj23_TrajPointACCObj23_dyv_sw_Rv);
    Msg_TrajPointACCObj23.TrajPointACCObj23_TrajEnd_b   =getvalue(E_pric_RadarFrontCenter_TrajPointACCObj23_TrajPointACCObj23_TrajEnd_b_Rv);
    Msg_TrajPointACCObj23.TrajPointACCObj23_dVarXv_uw   =getvalue(E_pric_RadarFrontCenter_TrajPointACCObj23_TrajPointACCObj23_dVarXv_uw_Rv);
    Msg_TrajPointACCObj23.TrajPointACCObj23_wExistProb_ub   =getvalue(E_pric_RadarFrontCenter_TrajPointACCObj23_TrajPointACCObj23_wExistProb_ub_Rv);
    Msg_TrajPointACCObj23.TrajPointACCObj23_dxv_sw   =getvalue(E_pric_RadarFrontCenter_TrajPointACCObj23_TrajPointACCObj23_dxv_sw_Rv);
    Msg_TrajPointACCObj23.TrajPointACCObj23_timestamp   =getvalue(E_pric_RadarFrontCenter_TrajPointACCObj23_TrajPointACCObj23_timestamp_Rv);
    Msg_TrajPointACCObj23.TrajPointACCObj23_Drive_b   =getvalue(E_pric_RadarFrontCenter_TrajPointACCObj23_TrajPointACCObj23_Drive_b_Rv);
    Msg_TrajPointACCObj20.TrajPointACCObj20_TrajEnd_b   =getvalue(E_pric_RadarFrontCenter_TrajPointACCObj20_TrajPointACCObj20_TrajEnd_b_Rv);
    Msg_TrajPointACCObj20.TrajPointACCObj20_dVarXv_uw   =getvalue(E_pric_RadarFrontCenter_TrajPointACCObj20_TrajPointACCObj20_dVarXv_uw_Rv);
    Msg_TrajPointACCObj20.TrajPointACCObj20_Valid_b   =getvalue(E_pric_RadarFrontCenter_TrajPointACCObj20_TrajPointACCObj20_Valid_b_Rv);
    Msg_TrajPointACCObj20.TrajPointACCObj20_Drive_b   =getvalue(E_pric_RadarFrontCenter_TrajPointACCObj20_TrajPointACCObj20_Drive_b_Rv);
    Msg_TrajPointACCObj20.TrajPointACCObj20_Stand_b   =getvalue(E_pric_RadarFrontCenter_TrajPointACCObj20_TrajPointACCObj20_Stand_b_Rv);
    Msg_TrajPointACCObj20.TrajPointACCObj20_dxv_sw   =getvalue(E_pric_RadarFrontCenter_TrajPointACCObj20_TrajPointACCObj20_dxv_sw_Rv);
    Msg_TrajPointACCObj20.TrajPointACCObj20_dVarYv_uw   =getvalue(E_pric_RadarFrontCenter_TrajPointACCObj20_TrajPointACCObj20_dVarYv_uw_Rv);
    Msg_TrajPointACCObj20.TrajPointACCObj20_InvDir_b   =getvalue(E_pric_RadarFrontCenter_TrajPointACCObj20_TrajPointACCObj20_InvDir_b_Rv);
    Msg_TrajPointACCObj20.TrajPointACCObj20_wExistProb_ub   =getvalue(E_pric_RadarFrontCenter_TrajPointACCObj20_TrajPointACCObj20_wExistProb_ub_Rv);
    Msg_TrajPointACCObj20.TrajPointACCObj20_timestamp   =getvalue(E_pric_RadarFrontCenter_TrajPointACCObj20_TrajPointACCObj20_timestamp_Rv);
    Msg_TrajPointACCObj20.TrajPointACCObj20_dyv_sw   =getvalue(E_pric_RadarFrontCenter_TrajPointACCObj20_TrajPointACCObj20_dyv_sw_Rv);
    Msg_TrajPointACCObj20.TrajPointACCObj20_Stopped_b   =getvalue(E_pric_RadarFrontCenter_TrajPointACCObj20_TrajPointACCObj20_Stopped_b_Rv);
    Msg_TrajPointACCObj21.TrajPointACCObj21_Drive_b   =getvalue(E_pric_RadarFrontCenter_TrajPointACCObj21_TrajPointACCObj21_Drive_b_Rv);
    Msg_TrajPointACCObj21.TrajPointACCObj21_dyv_sw   =getvalue(E_pric_RadarFrontCenter_TrajPointACCObj21_TrajPointACCObj21_dyv_sw_Rv);
    Msg_TrajPointACCObj21.TrajPointACCObj21_dxv_sw   =getvalue(E_pric_RadarFrontCenter_TrajPointACCObj21_TrajPointACCObj21_dxv_sw_Rv);
    Msg_TrajPointACCObj21.TrajPointACCObj21_InvDir_b   =getvalue(E_pric_RadarFrontCenter_TrajPointACCObj21_TrajPointACCObj21_InvDir_b_Rv);
    Msg_TrajPointACCObj21.TrajPointACCObj21_Stopped_b   =getvalue(E_pric_RadarFrontCenter_TrajPointACCObj21_TrajPointACCObj21_Stopped_b_Rv);
    Msg_TrajPointACCObj21.TrajPointACCObj21_dVarXv_uw   =getvalue(E_pric_RadarFrontCenter_TrajPointACCObj21_TrajPointACCObj21_dVarXv_uw_Rv);
    Msg_TrajPointACCObj21.TrajPointACCObj21_timestamp   =getvalue(E_pric_RadarFrontCenter_TrajPointACCObj21_TrajPointACCObj21_timestamp_Rv);
    Msg_TrajPointACCObj21.TrajPointACCObj21_dVarYv_uw   =getvalue(E_pric_RadarFrontCenter_TrajPointACCObj21_TrajPointACCObj21_dVarYv_uw_Rv);
    Msg_TrajPointACCObj21.TrajPointACCObj21_Valid_b   =getvalue(E_pric_RadarFrontCenter_TrajPointACCObj21_TrajPointACCObj21_Valid_b_Rv);
    Msg_TrajPointACCObj21.TrajPointACCObj21_Stand_b   =getvalue(E_pric_RadarFrontCenter_TrajPointACCObj21_TrajPointACCObj21_Stand_b_Rv);
    Msg_TrajPointACCObj21.TrajPointACCObj21_TrajEnd_b   =getvalue(E_pric_RadarFrontCenter_TrajPointACCObj21_TrajPointACCObj21_TrajEnd_b_Rv);
    Msg_TrajPointACCObj21.TrajPointACCObj21_wExistProb_ub   =getvalue(E_pric_RadarFrontCenter_TrajPointACCObj21_TrajPointACCObj21_wExistProb_ub_Rv);
}

on envVar E_pric_RadarFrontCenter_CycMsgsON
{
    // enable all the cyclic messages 
    putValue(E_pric_RadarFrontCenter_RDR_Status_Tm,1);
    putValue(E_pric_RadarFrontCenter_ACC_0x95_Tm,1);
}

on envVar E_pric_RadarFrontCenter_CycMsgsOFF
{
    // disable all the cyclic messages
    putValue(E_pric_RadarFrontCenter_RDR_Status_Tm,0);
    putValue(E_pric_RadarFrontCenter_ACC_0x95_Tm,0);
    
}
on timer Tm_RDR_Status
{
    //cyclic message timer 
    if(getValue(E_pric_RadarFrontCenter_RDR_Status_Tm) == 1)
    {
        
        //update the BZ Signal
        if(RDR_Status_RDR_Status_MsgCtr_wrongvalctr == 0)
        {
            update_RDR_Status_RDR_Status_MsgCtr_counter();
            Msg_RDR_Status.RDR_Status_MsgCtr= RDR_Status_RDR_Status_MsgCtr_counter;
        }
        else if(RDR_Status_RDR_Status_MsgCtr_wrongvalctr > 0)
        {
             RDR_Status_RDR_Status_MsgCtr_wrongvalctr--;
             // if counter becomes zero, update panel controller to zero
             if(RDR_Status_RDR_Status_MsgCtr_wrongvalctr == 0)
             {
                putValue(E_pric_RadarFrontCenter_RDR_Status_RDR_Status_MsgCtr_wrongvalctr,0);
             }
        }
        else
        {
            // do nothing
        }
        //update the BZ Signal
        if(RDR_Status_RDR_Status_blockCtr_wrongvalctr == 0)
        {
            update_RDR_Status_RDR_Status_blockCtr_counter();
            Msg_RDR_Status.RDR_Status_blockCtr= RDR_Status_RDR_Status_blockCtr_counter;
        }
        else if(RDR_Status_RDR_Status_blockCtr_wrongvalctr > 0)
        {
             RDR_Status_RDR_Status_blockCtr_wrongvalctr--;
             // if counter becomes zero, update panel controller to zero
             if(RDR_Status_RDR_Status_blockCtr_wrongvalctr == 0)
             {
                putValue(E_pric_RadarFrontCenter_RDR_Status_RDR_Status_blockCtr_wrongvalctr,0);
             }
        }
        else
        {
            // do nothing
        }
    
        update_RDR_Status_ChkSum_Checksum();
        output(Msg_RDR_Status);
        
    }
    //Reset Timer
    SetTimer(Tm_RDR_Status,Cycle_RDR_Status);
}

on envVar E_pric_RadarFrontCenter_RDR_Status_cycleTm
{
    // update the cycle time 
    Cycle_RDR_Status=getvalue(this);
}

on timer Tm_ACC_0x95
{
    //cyclic message timer 
    if(getValue(E_pric_RadarFrontCenter_ACC_0x95_Tm) == 1)
    {
        
        //update the BZ Signal
        if(ACC_0x95_ACC_RollingCounter_0x95_wrongvalctr == 0)
        {
            update_ACC_0x95_ACC_RollingCounter_0x95_counter();
            Msg_ACC_0x95.ACC_RollingCounter_0x95= ACC_0x95_ACC_RollingCounter_0x95_counter;
        }
        else if(ACC_0x95_ACC_RollingCounter_0x95_wrongvalctr > 0)
        {
             ACC_0x95_ACC_RollingCounter_0x95_wrongvalctr--;
             // if counter becomes zero, update panel controller to zero
             if(ACC_0x95_ACC_RollingCounter_0x95_wrongvalctr == 0)
             {
                putValue(E_pric_RadarFrontCenter_ACC_0x95_ACC_RollingCounter_0x95_wrongvalctr,0);
             }
        }
        else
        {
            // do nothing
        }
    
        update_ACC_0x95_ChkSum_Checksum();
        output(Msg_ACC_0x95);
        
    }
    //Reset Timer
    SetTimer(Tm_ACC_0x95,Cycle_ACC_0x95);
}
/*@@end*/

on envVar E_pric_RadarFrontCenter_ACC_0x95_cycleTm
{
    // update the cycle time 
    Cycle_ACC_0x95=getvalue(this);
}
on envVar E_pric_RadarFrontCenter_TrajPointACCObj16_tx
{
    if(getValue(this))
    {       
        
        //update the BZ Signal
        if(TrajPointACCObj16_TrajPointACCObj16_blockCtr_wrongvalctr == 0)
        {
            update_TrajPointACCObj16_TrajPointACCObj16_blockCtr_counter();
            Msg_TrajPointACCObj16.TrajPointACCObj16_blockCtr= TrajPointACCObj16_TrajPointACCObj16_blockCtr_counter;
        }
        else if(TrajPointACCObj16_TrajPointACCObj16_blockCtr_wrongvalctr > 0)
        {
             TrajPointACCObj16_TrajPointACCObj16_blockCtr_wrongvalctr--;
              // if counter becomes zero, update panel controller to zero
             if(TrajPointACCObj16_TrajPointACCObj16_blockCtr_wrongvalctr == 0)
             {
                 putValue(E_pric_RadarFrontCenter_TrajPointACCObj16_TrajPointACCObj16_blockCtr_wrongvalctr,0);
             }
        }
        else
        {
            //do nothing
        }        
        //update the BZ Signal
        if(TrajPointACCObj16_TrajPointACCObj16_MsgCtr_wrongvalctr == 0)
        {
            update_TrajPointACCObj16_TrajPointACCObj16_MsgCtr_counter();
            Msg_TrajPointACCObj16.TrajPointACCObj16_MsgCtr= TrajPointACCObj16_TrajPointACCObj16_MsgCtr_counter;
        }
        else if(TrajPointACCObj16_TrajPointACCObj16_MsgCtr_wrongvalctr > 0)
        {
             TrajPointACCObj16_TrajPointACCObj16_MsgCtr_wrongvalctr--;
              // if counter becomes zero, update panel controller to zero
             if(TrajPointACCObj16_TrajPointACCObj16_MsgCtr_wrongvalctr == 0)
             {
                 putValue(E_pric_RadarFrontCenter_TrajPointACCObj16_TrajPointACCObj16_MsgCtr_wrongvalctr,0);
             }
        }
        else
        {
            //do nothing
        }        
        //calculate the CRC checksum
        update_TrajPointACCObj16_ChkSum_Checksum();

        output(Msg_TrajPointACCObj16);        
    }
}

on envVar E_pric_RadarFrontCenter_TrajPointACCObj16_Range
{
    qword rawstatus = 0ll;
    qword rawValue = 0ll;    
    
    rawstatus = getvalue(this);    
    // set all the signals with min raw /max raw /init raw
    switch (rawstatus) 
    {
     case(0) :
        rawValue= -32768;
        putValue(E_pric_RadarFrontCenter_TrajPointACCObj16_TrajPointACCObj16_dyv_sw_Rv, rawValue);
        rawValue= 0;
        putValue(E_pric_RadarFrontCenter_TrajPointACCObj16_TrajPointACCObj16_Stand_b_Rv, rawValue);
        rawValue= -32768;
        putValue(E_pric_RadarFrontCenter_TrajPointACCObj16_TrajPointACCObj16_dxv_sw_Rv, rawValue);
        rawValue= 0;
        putValue(E_pric_RadarFrontCenter_TrajPointACCObj16_TrajPointACCObj16_timestamp_Rv, rawValue);
        rawValue= 0;
        putValue(E_pric_RadarFrontCenter_TrajPointACCObj16_TrajPointACCObj16_Drive_b_Rv, rawValue);
        rawValue= 0;
        putValue(E_pric_RadarFrontCenter_TrajPointACCObj16_TrajPointACCObj16_dVarYv_uw_Rv, rawValue);
        rawValue= 0;
        putValue(E_pric_RadarFrontCenter_TrajPointACCObj16_TrajPointACCObj16_dVarXv_uw_Rv, rawValue);
        rawValue= 0;
        putValue(E_pric_RadarFrontCenter_TrajPointACCObj16_TrajPointACCObj16_wExistProb_ub_Rv, rawValue);
        rawValue= 0;
        putValue(E_pric_RadarFrontCenter_TrajPointACCObj16_TrajPointACCObj16_InvDir_b_Rv, rawValue);
        rawValue= 0;
        putValue(E_pric_RadarFrontCenter_TrajPointACCObj16_TrajPointACCObj16_Valid_b_Rv, rawValue);
        rawValue= 0;
        putValue(E_pric_RadarFrontCenter_TrajPointACCObj16_TrajPointACCObj16_Stopped_b_Rv, rawValue);
        rawValue= 0;
        putValue(E_pric_RadarFrontCenter_TrajPointACCObj16_TrajPointACCObj16_TrajEnd_b_Rv, rawValue);
        break;
     case(1) :
        rawValue= 32767;
        putValue(E_pric_RadarFrontCenter_TrajPointACCObj16_TrajPointACCObj16_dyv_sw_Rv, rawValue);
        rawValue= 1;
        putValue(E_pric_RadarFrontCenter_TrajPointACCObj16_TrajPointACCObj16_Stand_b_Rv, rawValue);
        rawValue= 32767;
        putValue(E_pric_RadarFrontCenter_TrajPointACCObj16_TrajPointACCObj16_dxv_sw_Rv, rawValue);
        rawValue= 65536;
        putValue(E_pric_RadarFrontCenter_TrajPointACCObj16_TrajPointACCObj16_timestamp_Rv, rawValue);
        rawValue= 1;
        putValue(E_pric_RadarFrontCenter_TrajPointACCObj16_TrajPointACCObj16_Drive_b_Rv, rawValue);
        rawValue= 65534;
        putValue(E_pric_RadarFrontCenter_TrajPointACCObj16_TrajPointACCObj16_dVarYv_uw_Rv, rawValue);
        rawValue= 65534;
        putValue(E_pric_RadarFrontCenter_TrajPointACCObj16_TrajPointACCObj16_dVarXv_uw_Rv, rawValue);
        rawValue= 255;
        putValue(E_pric_RadarFrontCenter_TrajPointACCObj16_TrajPointACCObj16_wExistProb_ub_Rv, rawValue);
        rawValue= 1;
        putValue(E_pric_RadarFrontCenter_TrajPointACCObj16_TrajPointACCObj16_InvDir_b_Rv, rawValue);
        rawValue= 1;
        putValue(E_pric_RadarFrontCenter_TrajPointACCObj16_TrajPointACCObj16_Valid_b_Rv, rawValue);
        rawValue= 1;
        putValue(E_pric_RadarFrontCenter_TrajPointACCObj16_TrajPointACCObj16_Stopped_b_Rv, rawValue);
        rawValue= 1;
        putValue(E_pric_RadarFrontCenter_TrajPointACCObj16_TrajPointACCObj16_TrajEnd_b_Rv, rawValue);
        break;
     default :
        rawValue= -32768;
        putValue(E_pric_RadarFrontCenter_TrajPointACCObj16_TrajPointACCObj16_dyv_sw_Rv, rawValue);
        rawValue= 0;
        putValue(E_pric_RadarFrontCenter_TrajPointACCObj16_TrajPointACCObj16_Stand_b_Rv, rawValue);
        rawValue= -32768;
        putValue(E_pric_RadarFrontCenter_TrajPointACCObj16_TrajPointACCObj16_dxv_sw_Rv, rawValue);
        rawValue= 0;
        putValue(E_pric_RadarFrontCenter_TrajPointACCObj16_TrajPointACCObj16_timestamp_Rv, rawValue);
        rawValue= 0;
        putValue(E_pric_RadarFrontCenter_TrajPointACCObj16_TrajPointACCObj16_Drive_b_Rv, rawValue);
        rawValue= 0;
        putValue(E_pric_RadarFrontCenter_TrajPointACCObj16_TrajPointACCObj16_dVarYv_uw_Rv, rawValue);
        rawValue= 0;
        putValue(E_pric_RadarFrontCenter_TrajPointACCObj16_TrajPointACCObj16_dVarXv_uw_Rv, rawValue);
        rawValue= 0;
        putValue(E_pric_RadarFrontCenter_TrajPointACCObj16_TrajPointACCObj16_wExistProb_ub_Rv, rawValue);
        rawValue= 0;
        putValue(E_pric_RadarFrontCenter_TrajPointACCObj16_TrajPointACCObj16_InvDir_b_Rv, rawValue);
        rawValue= 0;
        putValue(E_pric_RadarFrontCenter_TrajPointACCObj16_TrajPointACCObj16_Valid_b_Rv, rawValue);
        rawValue= 0;
        putValue(E_pric_RadarFrontCenter_TrajPointACCObj16_TrajPointACCObj16_Stopped_b_Rv, rawValue);
        rawValue= 0;
        putValue(E_pric_RadarFrontCenter_TrajPointACCObj16_TrajPointACCObj16_TrajEnd_b_Rv, rawValue);
      break;
   }
}

on envVar E_pric_RadarFrontCenter_TrajPointACCObj16_Dlc
{
    if(getValue(E_pric_RadarFrontCenter_TrajPointACCObj16_enDlc))
    {
        Msg_TrajPointACCObj16.dlc =getValue(this);
    }
    else
    {
       Dbc_dlc = 16;
	   Msg_TrajPointACCObj16.dlc = Calc_Canfd_dlc(Dbc_dlc);
	   	
  }
}

on envVar E_pric_RadarFrontCenter_TrajPointACCObj16_enDlc
{
    //For Messages with DLC = 8, set wrong DLC to smaller than defined DLC
    //For Messages with DLC < 8 set wrong DLC to smaller/longer than defined DLC
    if(getValue(this))
    {
        Msg_TrajPointACCObj16.dlc =getValue(E_pric_RadarFrontCenter_TrajPointACCObj16_Dlc);
    }
    else
    {
       Dbc_dlc = 16;
	   Msg_TrajPointACCObj16.dlc = Calc_Canfd_dlc(Dbc_dlc);
			
    }
}

on envVar E_pric_RadarFrontCenter_TrajPointACCObj16_TrajPointACCObj16_CRC_wrongvalctr
{
    //update disturb count
    //disturb value range:(-1 = always send wrong value),( X>0 ,x is the number of Messages with wrong CHK sent)
    TrajPointACCObj16_TrajPointACCObj16_CRC_wrongvalctr =getValue(this);    
}
on envVar E_pric_RadarFrontCenter_TrajPointACCObj16_TrajPointACCObj16_MsgCtr_wrongvalctr
{
    //update disturb count
    //disturb value range:(-1 = always send wrong value),( X>0 ,x is the number of Messages with wrong CHK sent)
    TrajPointACCObj16_TrajPointACCObj16_MsgCtr_wrongvalctr =getValue(this);    
}
on envVar E_pric_RadarFrontCenter_TrajPointACCObj16_TrajPointACCObj16_blockCtr_wrongvalctr
{
    //update disturb count
    //disturb value range:(-1 = always send wrong value),( X>0 ,x is the number of Messages with wrong CHK sent)
    TrajPointACCObj16_TrajPointACCObj16_blockCtr_wrongvalctr =getValue(this);    
}

on envVar E_pric_RadarFrontCenter_TrajPointACCObj16_TrajPointACCObj16_dyv_sw_Rv
{
    qword rawValue = 0ll;
    float rawValue_float = 0.0;
    float phyValue = 0.0;        

    //set the signal with updated raw value
    {
        rawValue = getvalue(this);
        if(chgEv_TrajPointACCObj16_TrajPointACCObj16_dyv_sw == 0)
        {
            //type conversion to float
            rawValue_float = rawValue;        
            // raw to physical conversion
            phyValue = ((rawValue_float *0.0078125)+(0));
            putValue(E_pric_RadarFrontCenter_TrajPointACCObj16_TrajPointACCObj16_dyv_sw_Pv, phyValue);
            chgEv_TrajPointACCObj16_TrajPointACCObj16_dyv_sw = 1;
        }
        else
        {
            chgEv_TrajPointACCObj16_TrajPointACCObj16_dyv_sw = 0;
        }    
        //update the signal value
        Msg_TrajPointACCObj16.TrajPointACCObj16_dyv_sw=rawValue;        
    }                                                                           
}

on envVar E_pric_RadarFrontCenter_TrajPointACCObj16_TrajPointACCObj16_dyv_sw_Pv
{
    qword rawValue = 0ll;
    float phyValue = 0.0;
    
    //update the raw value with physical value 
    {
        if(chgEv_TrajPointACCObj16_TrajPointACCObj16_dyv_sw == 0)
        {
            phyValue = getvalue(this);
            // physical to raw conversion
            rawValue = ((phyValue -(0))/0.0078125);
            putValue(E_pric_RadarFrontCenter_TrajPointACCObj16_TrajPointACCObj16_dyv_sw_Rv, rawValue);
            chgEv_TrajPointACCObj16_TrajPointACCObj16_dyv_sw = 1;  
        }
        else
        {
            chgEv_TrajPointACCObj16_TrajPointACCObj16_dyv_sw = 0;
        }
    }
}


 
on envVar E_pric_RadarFrontCenter_TrajPointACCObj16_TrajPointACCObj16_Stand_b_Rv
{
    qword rawValue = 0ll;
    float rawValue_float = 0.0;
    float phyValue = 0.0;        

    //set the signal with updated raw value
    if(getValue(E_pric_RadarFrontCenter_TrajPointACCObj16_TrajPointACCObj16_Stand_b_SetVt)==0)
    {
        rawValue = getvalue(this);
        if(chgEv_TrajPointACCObj16_TrajPointACCObj16_Stand_b == 0)
        {
            //type conversion to float
            rawValue_float = rawValue;        
            // raw to physical conversion
            phyValue = ((rawValue_float *1)+(0));
            putValue(E_pric_RadarFrontCenter_TrajPointACCObj16_TrajPointACCObj16_Stand_b_Pv, phyValue);
            chgEv_TrajPointACCObj16_TrajPointACCObj16_Stand_b = 1;
        }
        else
        {
            chgEv_TrajPointACCObj16_TrajPointACCObj16_Stand_b = 0;
        }    
        //update the signal value
        Msg_TrajPointACCObj16.TrajPointACCObj16_Stand_b=rawValue;        
    }                                                                           
}

on envVar E_pric_RadarFrontCenter_TrajPointACCObj16_TrajPointACCObj16_Stand_b_Pv
{
    qword rawValue = 0ll;
    float phyValue = 0.0;
    
    //update the raw value with physical value 
    if(getValue(E_pric_RadarFrontCenter_TrajPointACCObj16_TrajPointACCObj16_Stand_b_SetVt)==0)
    {
        if(chgEv_TrajPointACCObj16_TrajPointACCObj16_Stand_b == 0)
        {
            phyValue = getvalue(this);
            // physical to raw conversion
            rawValue = ((phyValue -(0))/1);
            putValue(E_pric_RadarFrontCenter_TrajPointACCObj16_TrajPointACCObj16_Stand_b_Rv, rawValue);
            chgEv_TrajPointACCObj16_TrajPointACCObj16_Stand_b = 1;  
        }
        else
        {
            chgEv_TrajPointACCObj16_TrajPointACCObj16_Stand_b = 0;
        }
    }
}

on envVar E_pric_RadarFrontCenter_TrajPointACCObj16_TrajPointACCObj16_Stand_b_Vt
{
    qword rawValue = 0ll;
    if(getValue(E_pric_RadarFrontCenter_TrajPointACCObj16_TrajPointACCObj16_Stand_b_SetVt))
    {
        //update the signal value
        Msg_TrajPointACCObj16.TrajPointACCObj16_Stand_b=getValue(this);
    }
}

on envVar E_pric_RadarFrontCenter_TrajPointACCObj16_TrajPointACCObj16_Stand_b_SetVt
{
    if(getValue(E_pric_RadarFrontCenter_TrajPointACCObj16_TrajPointACCObj16_Stand_b_SetVt))
    {
        //update the signal value
        Msg_TrajPointACCObj16.TrajPointACCObj16_Stand_b=getvalue(E_pric_RadarFrontCenter_TrajPointACCObj16_TrajPointACCObj16_Stand_b_Vt);
    }
    else
    {
        Msg_TrajPointACCObj16.TrajPointACCObj16_Stand_b=getValue(E_pric_RadarFrontCenter_TrajPointACCObj16_TrajPointACCObj16_Stand_b_Rv);
    }
}
 
on envVar E_pric_RadarFrontCenter_TrajPointACCObj16_TrajPointACCObj16_dxv_sw_Rv
{
    qword rawValue = 0ll;
    float rawValue_float = 0.0;
    float phyValue = 0.0;        

    //set the signal with updated raw value
    {
        rawValue = getvalue(this);
        if(chgEv_TrajPointACCObj16_TrajPointACCObj16_dxv_sw == 0)
        {
            //type conversion to float
            rawValue_float = rawValue;        
            // raw to physical conversion
            phyValue = ((rawValue_float *0.0078125)+(0));
            putValue(E_pric_RadarFrontCenter_TrajPointACCObj16_TrajPointACCObj16_dxv_sw_Pv, phyValue);
            chgEv_TrajPointACCObj16_TrajPointACCObj16_dxv_sw = 1;
        }
        else
        {
            chgEv_TrajPointACCObj16_TrajPointACCObj16_dxv_sw = 0;
        }    
        //update the signal value
        Msg_TrajPointACCObj16.TrajPointACCObj16_dxv_sw=rawValue;        
    }                                                                           
}

on envVar E_pric_RadarFrontCenter_TrajPointACCObj16_TrajPointACCObj16_dxv_sw_Pv
{
    qword rawValue = 0ll;
    float phyValue = 0.0;
    
    //update the raw value with physical value 
    {
        if(chgEv_TrajPointACCObj16_TrajPointACCObj16_dxv_sw == 0)
        {
            phyValue = getvalue(this);
            // physical to raw conversion
            rawValue = ((phyValue -(0))/0.0078125);
            putValue(E_pric_RadarFrontCenter_TrajPointACCObj16_TrajPointACCObj16_dxv_sw_Rv, rawValue);
            chgEv_TrajPointACCObj16_TrajPointACCObj16_dxv_sw = 1;  
        }
        else
        {
            chgEv_TrajPointACCObj16_TrajPointACCObj16_dxv_sw = 0;
        }
    }
}


 
on envVar E_pric_RadarFrontCenter_TrajPointACCObj16_TrajPointACCObj16_timestamp_Rv
{
    qword rawValue = 0ll;
    float rawValue_float = 0.0;
    float phyValue = 0.0;        

    //set the signal with updated raw value
    {
        rawValue = getvalue(this);
        if(chgEv_TrajPointACCObj16_TrajPointACCObj16_timestamp == 0)
        {
            //type conversion to float
            rawValue_float = rawValue;        
            // raw to physical conversion
            phyValue = ((rawValue_float *0.000488281)+(0));
            putValue(E_pric_RadarFrontCenter_TrajPointACCObj16_TrajPointACCObj16_timestamp_Pv, phyValue);
            chgEv_TrajPointACCObj16_TrajPointACCObj16_timestamp = 1;
        }
        else
        {
            chgEv_TrajPointACCObj16_TrajPointACCObj16_timestamp = 0;
        }    
        //update the signal value
        Msg_TrajPointACCObj16.TrajPointACCObj16_timestamp=rawValue;        
    }                                                                           
}

on envVar E_pric_RadarFrontCenter_TrajPointACCObj16_TrajPointACCObj16_timestamp_Pv
{
    qword rawValue = 0ll;
    float phyValue = 0.0;
    
    //update the raw value with physical value 
    {
        if(chgEv_TrajPointACCObj16_TrajPointACCObj16_timestamp == 0)
        {
            phyValue = getvalue(this);
            // physical to raw conversion
            rawValue = ((phyValue -(0))/0.000488281);
            putValue(E_pric_RadarFrontCenter_TrajPointACCObj16_TrajPointACCObj16_timestamp_Rv, rawValue);
            chgEv_TrajPointACCObj16_TrajPointACCObj16_timestamp = 1;  
        }
        else
        {
            chgEv_TrajPointACCObj16_TrajPointACCObj16_timestamp = 0;
        }
    }
}


 
on envVar E_pric_RadarFrontCenter_TrajPointACCObj16_TrajPointACCObj16_Drive_b_Rv
{
    qword rawValue = 0ll;
    float rawValue_float = 0.0;
    float phyValue = 0.0;        

    //set the signal with updated raw value
    if(getValue(E_pric_RadarFrontCenter_TrajPointACCObj16_TrajPointACCObj16_Drive_b_SetVt)==0)
    {
        rawValue = getvalue(this);
        if(chgEv_TrajPointACCObj16_TrajPointACCObj16_Drive_b == 0)
        {
            //type conversion to float
            rawValue_float = rawValue;        
            // raw to physical conversion
            phyValue = ((rawValue_float *1)+(0));
            putValue(E_pric_RadarFrontCenter_TrajPointACCObj16_TrajPointACCObj16_Drive_b_Pv, phyValue);
            chgEv_TrajPointACCObj16_TrajPointACCObj16_Drive_b = 1;
        }
        else
        {
            chgEv_TrajPointACCObj16_TrajPointACCObj16_Drive_b = 0;
        }    
        //update the signal value
        Msg_TrajPointACCObj16.TrajPointACCObj16_Drive_b=rawValue;        
    }                                                                           
}

on envVar E_pric_RadarFrontCenter_TrajPointACCObj16_TrajPointACCObj16_Drive_b_Pv
{
    qword rawValue = 0ll;
    float phyValue = 0.0;
    
    //update the raw value with physical value 
    if(getValue(E_pric_RadarFrontCenter_TrajPointACCObj16_TrajPointACCObj16_Drive_b_SetVt)==0)
    {
        if(chgEv_TrajPointACCObj16_TrajPointACCObj16_Drive_b == 0)
        {
            phyValue = getvalue(this);
            // physical to raw conversion
            rawValue = ((phyValue -(0))/1);
            putValue(E_pric_RadarFrontCenter_TrajPointACCObj16_TrajPointACCObj16_Drive_b_Rv, rawValue);
            chgEv_TrajPointACCObj16_TrajPointACCObj16_Drive_b = 1;  
        }
        else
        {
            chgEv_TrajPointACCObj16_TrajPointACCObj16_Drive_b = 0;
        }
    }
}

on envVar E_pric_RadarFrontCenter_TrajPointACCObj16_TrajPointACCObj16_Drive_b_Vt
{
    qword rawValue = 0ll;
    if(getValue(E_pric_RadarFrontCenter_TrajPointACCObj16_TrajPointACCObj16_Drive_b_SetVt))
    {
        //update the signal value
        Msg_TrajPointACCObj16.TrajPointACCObj16_Drive_b=getValue(this);
    }
}

on envVar E_pric_RadarFrontCenter_TrajPointACCObj16_TrajPointACCObj16_Drive_b_SetVt
{
    if(getValue(E_pric_RadarFrontCenter_TrajPointACCObj16_TrajPointACCObj16_Drive_b_SetVt))
    {
        //update the signal value
        Msg_TrajPointACCObj16.TrajPointACCObj16_Drive_b=getvalue(E_pric_RadarFrontCenter_TrajPointACCObj16_TrajPointACCObj16_Drive_b_Vt);
    }
    else
    {
        Msg_TrajPointACCObj16.TrajPointACCObj16_Drive_b=getValue(E_pric_RadarFrontCenter_TrajPointACCObj16_TrajPointACCObj16_Drive_b_Rv);
    }
}
 
on envVar E_pric_RadarFrontCenter_TrajPointACCObj16_TrajPointACCObj16_dVarYv_uw_Rv
{
    qword rawValue = 0ll;
    float rawValue_float = 0.0;
    float phyValue = 0.0;        

    //set the signal with updated raw value
    {
        rawValue = getvalue(this);
        if(chgEv_TrajPointACCObj16_TrajPointACCObj16_dVarYv_uw == 0)
        {
            //type conversion to float
            rawValue_float = rawValue;        
            // raw to physical conversion
            phyValue = ((rawValue_float *0.00195313)+(0));
            putValue(E_pric_RadarFrontCenter_TrajPointACCObj16_TrajPointACCObj16_dVarYv_uw_Pv, phyValue);
            chgEv_TrajPointACCObj16_TrajPointACCObj16_dVarYv_uw = 1;
        }
        else
        {
            chgEv_TrajPointACCObj16_TrajPointACCObj16_dVarYv_uw = 0;
        }    
        //update the signal value
        Msg_TrajPointACCObj16.TrajPointACCObj16_dVarYv_uw=rawValue;        
    }                                                                           
}

on envVar E_pric_RadarFrontCenter_TrajPointACCObj16_TrajPointACCObj16_dVarYv_uw_Pv
{
    qword rawValue = 0ll;
    float phyValue = 0.0;
    
    //update the raw value with physical value 
    {
        if(chgEv_TrajPointACCObj16_TrajPointACCObj16_dVarYv_uw == 0)
        {
            phyValue = getvalue(this);
            // physical to raw conversion
            rawValue = ((phyValue -(0))/0.00195313);
            putValue(E_pric_RadarFrontCenter_TrajPointACCObj16_TrajPointACCObj16_dVarYv_uw_Rv, rawValue);
            chgEv_TrajPointACCObj16_TrajPointACCObj16_dVarYv_uw = 1;  
        }
        else
        {
            chgEv_TrajPointACCObj16_TrajPointACCObj16_dVarYv_uw = 0;
        }
    }
}


 
on envVar E_pric_RadarFrontCenter_TrajPointACCObj16_TrajPointACCObj16_dVarXv_uw_Rv
{
    qword rawValue = 0ll;
    float rawValue_float = 0.0;
    float phyValue = 0.0;        

    //set the signal with updated raw value
    {
        rawValue = getvalue(this);
        if(chgEv_TrajPointACCObj16_TrajPointACCObj16_dVarXv_uw == 0)
        {
            //type conversion to float
            rawValue_float = rawValue;        
            // raw to physical conversion
            phyValue = ((rawValue_float *0.00195313)+(0));
            putValue(E_pric_RadarFrontCenter_TrajPointACCObj16_TrajPointACCObj16_dVarXv_uw_Pv, phyValue);
            chgEv_TrajPointACCObj16_TrajPointACCObj16_dVarXv_uw = 1;
        }
        else
        {
            chgEv_TrajPointACCObj16_TrajPointACCObj16_dVarXv_uw = 0;
        }    
        //update the signal value
        Msg_TrajPointACCObj16.TrajPointACCObj16_dVarXv_uw=rawValue;        
    }                                                                           
}

on envVar E_pric_RadarFrontCenter_TrajPointACCObj16_TrajPointACCObj16_dVarXv_uw_Pv
{
    qword rawValue = 0ll;
    float phyValue = 0.0;
    
    //update the raw value with physical value 
    {
        if(chgEv_TrajPointACCObj16_TrajPointACCObj16_dVarXv_uw == 0)
        {
            phyValue = getvalue(this);
            // physical to raw conversion
            rawValue = ((phyValue -(0))/0.00195313);
            putValue(E_pric_RadarFrontCenter_TrajPointACCObj16_TrajPointACCObj16_dVarXv_uw_Rv, rawValue);
            chgEv_TrajPointACCObj16_TrajPointACCObj16_dVarXv_uw = 1;  
        }
        else
        {
            chgEv_TrajPointACCObj16_TrajPointACCObj16_dVarXv_uw = 0;
        }
    }
}


 
on envVar E_pric_RadarFrontCenter_TrajPointACCObj16_TrajPointACCObj16_wExistProb_ub_Rv
{
    qword rawValue = 0ll;
    float rawValue_float = 0.0;
    float phyValue = 0.0;        

    //set the signal with updated raw value
    {
        rawValue = getvalue(this);
        if(chgEv_TrajPointACCObj16_TrajPointACCObj16_wExistProb_ub == 0)
        {
            //type conversion to float
            rawValue_float = rawValue;        
            // raw to physical conversion
            phyValue = ((rawValue_float *0.00390625)+(0));
            putValue(E_pric_RadarFrontCenter_TrajPointACCObj16_TrajPointACCObj16_wExistProb_ub_Pv, phyValue);
            chgEv_TrajPointACCObj16_TrajPointACCObj16_wExistProb_ub = 1;
        }
        else
        {
            chgEv_TrajPointACCObj16_TrajPointACCObj16_wExistProb_ub = 0;
        }    
        //update the signal value
        Msg_TrajPointACCObj16.TrajPointACCObj16_wExistProb_ub=rawValue;        
    }                                                                           
}

on envVar E_pric_RadarFrontCenter_TrajPointACCObj16_TrajPointACCObj16_wExistProb_ub_Pv
{
    qword rawValue = 0ll;
    float phyValue = 0.0;
    
    //update the raw value with physical value 
    {
        if(chgEv_TrajPointACCObj16_TrajPointACCObj16_wExistProb_ub == 0)
        {
            phyValue = getvalue(this);
            // physical to raw conversion
            rawValue = ((phyValue -(0))/0.00390625);
            putValue(E_pric_RadarFrontCenter_TrajPointACCObj16_TrajPointACCObj16_wExistProb_ub_Rv, rawValue);
            chgEv_TrajPointACCObj16_TrajPointACCObj16_wExistProb_ub = 1;  
        }
        else
        {
            chgEv_TrajPointACCObj16_TrajPointACCObj16_wExistProb_ub = 0;
        }
    }
}


 
on envVar E_pric_RadarFrontCenter_TrajPointACCObj16_TrajPointACCObj16_InvDir_b_Rv
{
    qword rawValue = 0ll;
    float rawValue_float = 0.0;
    float phyValue = 0.0;        

    //set the signal with updated raw value
    if(getValue(E_pric_RadarFrontCenter_TrajPointACCObj16_TrajPointACCObj16_InvDir_b_SetVt)==0)
    {
        rawValue = getvalue(this);
        if(chgEv_TrajPointACCObj16_TrajPointACCObj16_InvDir_b == 0)
        {
            //type conversion to float
            rawValue_float = rawValue;        
            // raw to physical conversion
            phyValue = ((rawValue_float *1)+(0));
            putValue(E_pric_RadarFrontCenter_TrajPointACCObj16_TrajPointACCObj16_InvDir_b_Pv, phyValue);
            chgEv_TrajPointACCObj16_TrajPointACCObj16_InvDir_b = 1;
        }
        else
        {
            chgEv_TrajPointACCObj16_TrajPointACCObj16_InvDir_b = 0;
        }    
        //update the signal value
        Msg_TrajPointACCObj16.TrajPointACCObj16_InvDir_b=rawValue;        
    }                                                                           
}

on envVar E_pric_RadarFrontCenter_TrajPointACCObj16_TrajPointACCObj16_InvDir_b_Pv
{
    qword rawValue = 0ll;
    float phyValue = 0.0;
    
    //update the raw value with physical value 
    if(getValue(E_pric_RadarFrontCenter_TrajPointACCObj16_TrajPointACCObj16_InvDir_b_SetVt)==0)
    {
        if(chgEv_TrajPointACCObj16_TrajPointACCObj16_InvDir_b == 0)
        {
            phyValue = getvalue(this);
            // physical to raw conversion
            rawValue = ((phyValue -(0))/1);
            putValue(E_pric_RadarFrontCenter_TrajPointACCObj16_TrajPointACCObj16_InvDir_b_Rv, rawValue);
            chgEv_TrajPointACCObj16_TrajPointACCObj16_InvDir_b = 1;  
        }
        else
        {
            chgEv_TrajPointACCObj16_TrajPointACCObj16_InvDir_b = 0;
        }
    }
}

on envVar E_pric_RadarFrontCenter_TrajPointACCObj16_TrajPointACCObj16_InvDir_b_Vt
{
    qword rawValue = 0ll;
    if(getValue(E_pric_RadarFrontCenter_TrajPointACCObj16_TrajPointACCObj16_InvDir_b_SetVt))
    {
        //update the signal value
        Msg_TrajPointACCObj16.TrajPointACCObj16_InvDir_b=getValue(this);
    }
}

on envVar E_pric_RadarFrontCenter_TrajPointACCObj16_TrajPointACCObj16_InvDir_b_SetVt
{
    if(getValue(E_pric_RadarFrontCenter_TrajPointACCObj16_TrajPointACCObj16_InvDir_b_SetVt))
    {
        //update the signal value
        Msg_TrajPointACCObj16.TrajPointACCObj16_InvDir_b=getvalue(E_pric_RadarFrontCenter_TrajPointACCObj16_TrajPointACCObj16_InvDir_b_Vt);
    }
    else
    {
        Msg_TrajPointACCObj16.TrajPointACCObj16_InvDir_b=getValue(E_pric_RadarFrontCenter_TrajPointACCObj16_TrajPointACCObj16_InvDir_b_Rv);
    }
}
 
on envVar E_pric_RadarFrontCenter_TrajPointACCObj16_TrajPointACCObj16_Valid_b_Rv
{
    qword rawValue = 0ll;
    float rawValue_float = 0.0;
    float phyValue = 0.0;        

    //set the signal with updated raw value
    if(getValue(E_pric_RadarFrontCenter_TrajPointACCObj16_TrajPointACCObj16_Valid_b_SetVt)==0)
    {
        rawValue = getvalue(this);
        if(chgEv_TrajPointACCObj16_TrajPointACCObj16_Valid_b == 0)
        {
            //type conversion to float
            rawValue_float = rawValue;        
            // raw to physical conversion
            phyValue = ((rawValue_float *1)+(0));
            putValue(E_pric_RadarFrontCenter_TrajPointACCObj16_TrajPointACCObj16_Valid_b_Pv, phyValue);
            chgEv_TrajPointACCObj16_TrajPointACCObj16_Valid_b = 1;
        }
        else
        {
            chgEv_TrajPointACCObj16_TrajPointACCObj16_Valid_b = 0;
        }    
        //update the signal value
        Msg_TrajPointACCObj16.TrajPointACCObj16_Valid_b=rawValue;        
    }                                                                           
}

on envVar E_pric_RadarFrontCenter_TrajPointACCObj16_TrajPointACCObj16_Valid_b_Pv
{
    qword rawValue = 0ll;
    float phyValue = 0.0;
    
    //update the raw value with physical value 
    if(getValue(E_pric_RadarFrontCenter_TrajPointACCObj16_TrajPointACCObj16_Valid_b_SetVt)==0)
    {
        if(chgEv_TrajPointACCObj16_TrajPointACCObj16_Valid_b == 0)
        {
            phyValue = getvalue(this);
            // physical to raw conversion
            rawValue = ((phyValue -(0))/1);
            putValue(E_pric_RadarFrontCenter_TrajPointACCObj16_TrajPointACCObj16_Valid_b_Rv, rawValue);
            chgEv_TrajPointACCObj16_TrajPointACCObj16_Valid_b = 1;  
        }
        else
        {
            chgEv_TrajPointACCObj16_TrajPointACCObj16_Valid_b = 0;
        }
    }
}

on envVar E_pric_RadarFrontCenter_TrajPointACCObj16_TrajPointACCObj16_Valid_b_Vt
{
    qword rawValue = 0ll;
    if(getValue(E_pric_RadarFrontCenter_TrajPointACCObj16_TrajPointACCObj16_Valid_b_SetVt))
    {
        //update the signal value
        Msg_TrajPointACCObj16.TrajPointACCObj16_Valid_b=getValue(this);
    }
}

on envVar E_pric_RadarFrontCenter_TrajPointACCObj16_TrajPointACCObj16_Valid_b_SetVt
{
    if(getValue(E_pric_RadarFrontCenter_TrajPointACCObj16_TrajPointACCObj16_Valid_b_SetVt))
    {
        //update the signal value
        Msg_TrajPointACCObj16.TrajPointACCObj16_Valid_b=getvalue(E_pric_RadarFrontCenter_TrajPointACCObj16_TrajPointACCObj16_Valid_b_Vt);
    }
    else
    {
        Msg_TrajPointACCObj16.TrajPointACCObj16_Valid_b=getValue(E_pric_RadarFrontCenter_TrajPointACCObj16_TrajPointACCObj16_Valid_b_Rv);
    }
}
 
on envVar E_pric_RadarFrontCenter_TrajPointACCObj16_TrajPointACCObj16_Stopped_b_Rv
{
    qword rawValue = 0ll;
    float rawValue_float = 0.0;
    float phyValue = 0.0;        

    //set the signal with updated raw value
    if(getValue(E_pric_RadarFrontCenter_TrajPointACCObj16_TrajPointACCObj16_Stopped_b_SetVt)==0)
    {
        rawValue = getvalue(this);
        if(chgEv_TrajPointACCObj16_TrajPointACCObj16_Stopped_b == 0)
        {
            //type conversion to float
            rawValue_float = rawValue;        
            // raw to physical conversion
            phyValue = ((rawValue_float *1)+(0));
            putValue(E_pric_RadarFrontCenter_TrajPointACCObj16_TrajPointACCObj16_Stopped_b_Pv, phyValue);
            chgEv_TrajPointACCObj16_TrajPointACCObj16_Stopped_b = 1;
        }
        else
        {
            chgEv_TrajPointACCObj16_TrajPointACCObj16_Stopped_b = 0;
        }    
        //update the signal value
        Msg_TrajPointACCObj16.TrajPointACCObj16_Stopped_b=rawValue;        
    }                                                                           
}

on envVar E_pric_RadarFrontCenter_TrajPointACCObj16_TrajPointACCObj16_Stopped_b_Pv
{
    qword rawValue = 0ll;
    float phyValue = 0.0;
    
    //update the raw value with physical value 
    if(getValue(E_pric_RadarFrontCenter_TrajPointACCObj16_TrajPointACCObj16_Stopped_b_SetVt)==0)
    {
        if(chgEv_TrajPointACCObj16_TrajPointACCObj16_Stopped_b == 0)
        {
            phyValue = getvalue(this);
            // physical to raw conversion
            rawValue = ((phyValue -(0))/1);
            putValue(E_pric_RadarFrontCenter_TrajPointACCObj16_TrajPointACCObj16_Stopped_b_Rv, rawValue);
            chgEv_TrajPointACCObj16_TrajPointACCObj16_Stopped_b = 1;  
        }
        else
        {
            chgEv_TrajPointACCObj16_TrajPointACCObj16_Stopped_b = 0;
        }
    }
}

on envVar E_pric_RadarFrontCenter_TrajPointACCObj16_TrajPointACCObj16_Stopped_b_Vt
{
    qword rawValue = 0ll;
    if(getValue(E_pric_RadarFrontCenter_TrajPointACCObj16_TrajPointACCObj16_Stopped_b_SetVt))
    {
        //update the signal value
        Msg_TrajPointACCObj16.TrajPointACCObj16_Stopped_b=getValue(this);
    }
}

on envVar E_pric_RadarFrontCenter_TrajPointACCObj16_TrajPointACCObj16_Stopped_b_SetVt
{
    if(getValue(E_pric_RadarFrontCenter_TrajPointACCObj16_TrajPointACCObj16_Stopped_b_SetVt))
    {
        //update the signal value
        Msg_TrajPointACCObj16.TrajPointACCObj16_Stopped_b=getvalue(E_pric_RadarFrontCenter_TrajPointACCObj16_TrajPointACCObj16_Stopped_b_Vt);
    }
    else
    {
        Msg_TrajPointACCObj16.TrajPointACCObj16_Stopped_b=getValue(E_pric_RadarFrontCenter_TrajPointACCObj16_TrajPointACCObj16_Stopped_b_Rv);
    }
}
 
on envVar E_pric_RadarFrontCenter_TrajPointACCObj16_TrajPointACCObj16_TrajEnd_b_Rv
{
    qword rawValue = 0ll;
    float rawValue_float = 0.0;
    float phyValue = 0.0;        

    //set the signal with updated raw value
    if(getValue(E_pric_RadarFrontCenter_TrajPointACCObj16_TrajPointACCObj16_TrajEnd_b_SetVt)==0)
    {
        rawValue = getvalue(this);
        if(chgEv_TrajPointACCObj16_TrajPointACCObj16_TrajEnd_b == 0)
        {
            //type conversion to float
            rawValue_float = rawValue;        
            // raw to physical conversion
            phyValue = ((rawValue_float *1)+(0));
            putValue(E_pric_RadarFrontCenter_TrajPointACCObj16_TrajPointACCObj16_TrajEnd_b_Pv, phyValue);
            chgEv_TrajPointACCObj16_TrajPointACCObj16_TrajEnd_b = 1;
        }
        else
        {
            chgEv_TrajPointACCObj16_TrajPointACCObj16_TrajEnd_b = 0;
        }    
        //update the signal value
        Msg_TrajPointACCObj16.TrajPointACCObj16_TrajEnd_b=rawValue;        
    }                                                                           
}

on envVar E_pric_RadarFrontCenter_TrajPointACCObj16_TrajPointACCObj16_TrajEnd_b_Pv
{
    qword rawValue = 0ll;
    float phyValue = 0.0;
    
    //update the raw value with physical value 
    if(getValue(E_pric_RadarFrontCenter_TrajPointACCObj16_TrajPointACCObj16_TrajEnd_b_SetVt)==0)
    {
        if(chgEv_TrajPointACCObj16_TrajPointACCObj16_TrajEnd_b == 0)
        {
            phyValue = getvalue(this);
            // physical to raw conversion
            rawValue = ((phyValue -(0))/1);
            putValue(E_pric_RadarFrontCenter_TrajPointACCObj16_TrajPointACCObj16_TrajEnd_b_Rv, rawValue);
            chgEv_TrajPointACCObj16_TrajPointACCObj16_TrajEnd_b = 1;  
        }
        else
        {
            chgEv_TrajPointACCObj16_TrajPointACCObj16_TrajEnd_b = 0;
        }
    }
}

on envVar E_pric_RadarFrontCenter_TrajPointACCObj16_TrajPointACCObj16_TrajEnd_b_Vt
{
    qword rawValue = 0ll;
    if(getValue(E_pric_RadarFrontCenter_TrajPointACCObj16_TrajPointACCObj16_TrajEnd_b_SetVt))
    {
        //update the signal value
        Msg_TrajPointACCObj16.TrajPointACCObj16_TrajEnd_b=getValue(this);
    }
}

on envVar E_pric_RadarFrontCenter_TrajPointACCObj16_TrajPointACCObj16_TrajEnd_b_SetVt
{
    if(getValue(E_pric_RadarFrontCenter_TrajPointACCObj16_TrajPointACCObj16_TrajEnd_b_SetVt))
    {
        //update the signal value
        Msg_TrajPointACCObj16.TrajPointACCObj16_TrajEnd_b=getvalue(E_pric_RadarFrontCenter_TrajPointACCObj16_TrajPointACCObj16_TrajEnd_b_Vt);
    }
    else
    {
        Msg_TrajPointACCObj16.TrajPointACCObj16_TrajEnd_b=getValue(E_pric_RadarFrontCenter_TrajPointACCObj16_TrajPointACCObj16_TrajEnd_b_Rv);
    }
}
 
on envVar E_pric_RadarFrontCenter_RDR1Header_tx
{
    if(getValue(this))
    {       
        
        //update the BZ Signal
        if(RDR1Header_RDR1Header_MsgCtr_wrongvalctr == 0)
        {
            update_RDR1Header_RDR1Header_MsgCtr_counter();
            Msg_RDR1Header.RDR1Header_MsgCtr= RDR1Header_RDR1Header_MsgCtr_counter;
        }
        else if(RDR1Header_RDR1Header_MsgCtr_wrongvalctr > 0)
        {
             RDR1Header_RDR1Header_MsgCtr_wrongvalctr--;
              // if counter becomes zero, update panel controller to zero
             if(RDR1Header_RDR1Header_MsgCtr_wrongvalctr == 0)
             {
                 putValue(E_pric_RadarFrontCenter_RDR1Header_RDR1Header_MsgCtr_wrongvalctr,0);
             }
        }
        else
        {
            //do nothing
        }        
        //update the BZ Signal
        if(RDR1Header_RDR1Header_blockCtr_wrongvalctr == 0)
        {
            update_RDR1Header_RDR1Header_blockCtr_counter();
            Msg_RDR1Header.RDR1Header_blockCtr= RDR1Header_RDR1Header_blockCtr_counter;
        }
        else if(RDR1Header_RDR1Header_blockCtr_wrongvalctr > 0)
        {
             RDR1Header_RDR1Header_blockCtr_wrongvalctr--;
              // if counter becomes zero, update panel controller to zero
             if(RDR1Header_RDR1Header_blockCtr_wrongvalctr == 0)
             {
                 putValue(E_pric_RadarFrontCenter_RDR1Header_RDR1Header_blockCtr_wrongvalctr,0);
             }
        }
        else
        {
            //do nothing
        }        
        //calculate the CRC checksum
        update_RDR1Header_ChkSum_Checksum();

        output(Msg_RDR1Header);        
    }
}

on envVar E_pric_RadarFrontCenter_RDR1Header_Range
{
    qword rawstatus = 0ll;
    qword rawValue = 0ll;    
    
    rawstatus = getvalue(this);    
    // set all the signals with min raw /max raw /init raw
    switch (rawstatus) 
    {
     case(0) :
        rawValue= 0;
        putValue(E_pric_RadarFrontCenter_RDR1Header_FRS_Pri_ALOD_ControlType_Rv, rawValue);
        rawValue= 0;
        putValue(E_pric_RadarFrontCenter_RDR1Header_NumVehEgoLane_Rv, rawValue);
        rawValue= 0;
        putValue(E_pric_RadarFrontCenter_RDR1Header_Status_AvoidCollision_Rv, rawValue);
        rawValue= 0;
        putValue(E_pric_RadarFrontCenter_RDR1Header_TjaFID_Rv, rawValue);
        rawValue= 0;
        putValue(E_pric_RadarFrontCenter_RDR1Header_RDR1ObjectDataAge_Rv, rawValue);
        rawValue= 0;
        putValue(E_pric_RadarFrontCenter_RDR1Header_ACC_ExitReason_Rv, rawValue);
        rawValue= 0;
        putValue(E_pric_RadarFrontCenter_RDR1Header_StatusACC_Rv, rawValue);
        break;
     case(1) :
        rawValue= 7;
        putValue(E_pric_RadarFrontCenter_RDR1Header_FRS_Pri_ALOD_ControlType_Rv, rawValue);
        rawValue= 3;
        putValue(E_pric_RadarFrontCenter_RDR1Header_NumVehEgoLane_Rv, rawValue);
        rawValue= 3;
        putValue(E_pric_RadarFrontCenter_RDR1Header_Status_AvoidCollision_Rv, rawValue);
        rawValue= 1;
        putValue(E_pric_RadarFrontCenter_RDR1Header_TjaFID_Rv, rawValue);
        rawValue= 1022;
        putValue(E_pric_RadarFrontCenter_RDR1Header_RDR1ObjectDataAge_Rv, rawValue);
        rawValue= 7;
        putValue(E_pric_RadarFrontCenter_RDR1Header_ACC_ExitReason_Rv, rawValue);
        rawValue= 15;
        putValue(E_pric_RadarFrontCenter_RDR1Header_StatusACC_Rv, rawValue);
        break;
     default :
        rawValue= 0;
        putValue(E_pric_RadarFrontCenter_RDR1Header_FRS_Pri_ALOD_ControlType_Rv, rawValue);
        rawValue= 0;
        putValue(E_pric_RadarFrontCenter_RDR1Header_NumVehEgoLane_Rv, rawValue);
        rawValue= 0;
        putValue(E_pric_RadarFrontCenter_RDR1Header_Status_AvoidCollision_Rv, rawValue);
        rawValue= 0;
        putValue(E_pric_RadarFrontCenter_RDR1Header_TjaFID_Rv, rawValue);
        rawValue= 0;
        putValue(E_pric_RadarFrontCenter_RDR1Header_RDR1ObjectDataAge_Rv, rawValue);
        rawValue= 0;
        putValue(E_pric_RadarFrontCenter_RDR1Header_ACC_ExitReason_Rv, rawValue);
        rawValue= 0;
        putValue(E_pric_RadarFrontCenter_RDR1Header_StatusACC_Rv, rawValue);
      break;
   }
}

on envVar E_pric_RadarFrontCenter_RDR1Header_Dlc
{
    if(getValue(E_pric_RadarFrontCenter_RDR1Header_enDlc))
    {
        Msg_RDR1Header.dlc =getValue(this);
    }
    else
    {
       Dbc_dlc = 8;
	   Msg_RDR1Header.dlc = Calc_Canfd_dlc(Dbc_dlc);
	   	
  }
}

on envVar E_pric_RadarFrontCenter_RDR1Header_enDlc
{
    //For Messages with DLC = 8, set wrong DLC to smaller than defined DLC
    //For Messages with DLC < 8 set wrong DLC to smaller/longer than defined DLC
    if(getValue(this))
    {
        Msg_RDR1Header.dlc =getValue(E_pric_RadarFrontCenter_RDR1Header_Dlc);
    }
    else
    {
       Dbc_dlc = 8;
	   Msg_RDR1Header.dlc = Calc_Canfd_dlc(Dbc_dlc);
			
    }
}

on envVar E_pric_RadarFrontCenter_RDR1Header_RDR1Header_CRC_wrongvalctr
{
    //update disturb count
    //disturb value range:(-1 = always send wrong value),( X>0 ,x is the number of Messages with wrong CHK sent)
    RDR1Header_RDR1Header_CRC_wrongvalctr =getValue(this);    
}
on envVar E_pric_RadarFrontCenter_RDR1Header_RDR1Header_MsgCtr_wrongvalctr
{
    //update disturb count
    //disturb value range:(-1 = always send wrong value),( X>0 ,x is the number of Messages with wrong CHK sent)
    RDR1Header_RDR1Header_MsgCtr_wrongvalctr =getValue(this);    
}
on envVar E_pric_RadarFrontCenter_RDR1Header_RDR1Header_blockCtr_wrongvalctr
{
    //update disturb count
    //disturb value range:(-1 = always send wrong value),( X>0 ,x is the number of Messages with wrong CHK sent)
    RDR1Header_RDR1Header_blockCtr_wrongvalctr =getValue(this);    
}

on envVar E_pric_RadarFrontCenter_RDR1Header_FRS_Pri_ALOD_ControlType_Rv
{
    qword rawValue = 0ll;
    float rawValue_float = 0.0;
    float phyValue = 0.0;        

    //set the signal with updated raw value
    {
        rawValue = getvalue(this);
        if(chgEv_RDR1Header_FRS_Pri_ALOD_ControlType == 0)
        {
            //type conversion to float
            rawValue_float = rawValue;        
            // raw to physical conversion
            phyValue = ((rawValue_float *1)+(0));
            putValue(E_pric_RadarFrontCenter_RDR1Header_FRS_Pri_ALOD_ControlType_Pv, phyValue);
            chgEv_RDR1Header_FRS_Pri_ALOD_ControlType = 1;
        }
        else
        {
            chgEv_RDR1Header_FRS_Pri_ALOD_ControlType = 0;
        }    
        //update the signal value
        Msg_RDR1Header.FRS_Pri_ALOD_ControlType=rawValue;        
    }                                                                           
}

on envVar E_pric_RadarFrontCenter_RDR1Header_FRS_Pri_ALOD_ControlType_Pv
{
    qword rawValue = 0ll;
    float phyValue = 0.0;
    
    //update the raw value with physical value 
    {
        if(chgEv_RDR1Header_FRS_Pri_ALOD_ControlType == 0)
        {
            phyValue = getvalue(this);
            // physical to raw conversion
            rawValue = ((phyValue -(0))/1);
            putValue(E_pric_RadarFrontCenter_RDR1Header_FRS_Pri_ALOD_ControlType_Rv, rawValue);
            chgEv_RDR1Header_FRS_Pri_ALOD_ControlType = 1;  
        }
        else
        {
            chgEv_RDR1Header_FRS_Pri_ALOD_ControlType = 0;
        }
    }
}


 
on envVar E_pric_RadarFrontCenter_RDR1Header_NumVehEgoLane_Rv
{
    qword rawValue = 0ll;
    float rawValue_float = 0.0;
    float phyValue = 0.0;        

    //set the signal with updated raw value
    {
        rawValue = getvalue(this);
        if(chgEv_RDR1Header_NumVehEgoLane == 0)
        {
            //type conversion to float
            rawValue_float = rawValue;        
            // raw to physical conversion
            phyValue = ((rawValue_float *1)+(0));
            putValue(E_pric_RadarFrontCenter_RDR1Header_NumVehEgoLane_Pv, phyValue);
            chgEv_RDR1Header_NumVehEgoLane = 1;
        }
        else
        {
            chgEv_RDR1Header_NumVehEgoLane = 0;
        }    
        //update the signal value
        Msg_RDR1Header.NumVehEgoLane=rawValue;        
    }                                                                           
}

on envVar E_pric_RadarFrontCenter_RDR1Header_NumVehEgoLane_Pv
{
    qword rawValue = 0ll;
    float phyValue = 0.0;
    
    //update the raw value with physical value 
    {
        if(chgEv_RDR1Header_NumVehEgoLane == 0)
        {
            phyValue = getvalue(this);
            // physical to raw conversion
            rawValue = ((phyValue -(0))/1);
            putValue(E_pric_RadarFrontCenter_RDR1Header_NumVehEgoLane_Rv, rawValue);
            chgEv_RDR1Header_NumVehEgoLane = 1;  
        }
        else
        {
            chgEv_RDR1Header_NumVehEgoLane = 0;
        }
    }
}


 
/*@@envVar:E_pric_RadarFrontCenter_RDR1Header_Status_AvoidCollision_Rv:*/
on envVar E_pric_RadarFrontCenter_RDR1Header_Status_AvoidCollision_Rv
{
    qword rawValue = 0ll;
    float rawValue_float = 0.0;
    float phyValue = 0.0;        

    //set the signal with updated raw value
    if(getValue(E_pric_RadarFrontCenter_RDR1Header_Status_AvoidCollision_SetVt)==0)
    {
        rawValue = getvalue(this);
        if(chgEv_RDR1Header_Status_AvoidCollision == 0)
        {
            //type conversion to float
            rawValue_float = rawValue;        
            // raw to physical conversion
            phyValue = ((rawValue_float *1)+(0));
            putValue(E_pric_RadarFrontCenter_RDR1Header_Status_AvoidCollision_Pv, phyValue);
            chgEv_RDR1Header_Status_AvoidCollision = 1;
        }
        else
        {
            chgEv_RDR1Header_Status_AvoidCollision = 0;
        }    
        //update the signal value
        Msg_RDR1Header.Status_AvoidCollision=rawValue;        
    }                                                                           
}
/*@@end*/

/*@@envVar:E_pric_RadarFrontCenter_RDR1Header_Status_AvoidCollision_Pv:*/
on envVar E_pric_RadarFrontCenter_RDR1Header_Status_AvoidCollision_Pv
{
    qword rawValue = 0ll;
    float phyValue = 0.0;
    
    //update the raw value with physical value 
    if(getValue(E_pric_RadarFrontCenter_RDR1Header_Status_AvoidCollision_SetVt)==0)
    {
        if(chgEv_RDR1Header_Status_AvoidCollision == 0)
        {
            phyValue = getvalue(this);
            // physical to raw conversion
            rawValue = ((phyValue -(0))/1);
            putValue(E_pric_RadarFrontCenter_RDR1Header_Status_AvoidCollision_Rv, rawValue);
            chgEv_RDR1Header_Status_AvoidCollision = 1;  
        }
        else
        {
            chgEv_RDR1Header_Status_AvoidCollision = 0;
        }
    }
}
/*@@end*/

/*@@envVar:E_pric_RadarFrontCenter_RDR1Header_Status_AvoidCollision_Vt:*/
on envVar E_pric_RadarFrontCenter_RDR1Header_Status_AvoidCollision_Vt
{
    qword rawValue = 0ll;
    if(getValue(E_pric_RadarFrontCenter_RDR1Header_Status_AvoidCollision_SetVt))
    {
        //update the signal value
        Msg_RDR1Header.Status_AvoidCollision=getValue(this);
    }
}
/*@@end*/

/*@@envVar:E_pric_RadarFrontCenter_RDR1Header_Status_AvoidCollision_SetVt:*/
on envVar E_pric_RadarFrontCenter_RDR1Header_Status_AvoidCollision_SetVt
{
    if(getValue(E_pric_RadarFrontCenter_RDR1Header_Status_AvoidCollision_SetVt))
    {
        //update the signal value
        Msg_RDR1Header.Status_AvoidCollision=getvalue(E_pric_RadarFrontCenter_RDR1Header_Status_AvoidCollision_Vt);
    }
    else
    {
        Msg_RDR1Header.Status_AvoidCollision=getValue(E_pric_RadarFrontCenter_RDR1Header_Status_AvoidCollision_Rv);
    }
}
/*@@end*/
 
/*@@envVar:E_pric_RadarFrontCenter_RDR1Header_TjaFID_Rv:*/
on envVar E_pric_RadarFrontCenter_RDR1Header_TjaFID_Rv
{
    qword rawValue = 0ll;
    float rawValue_float = 0.0;
    float phyValue = 0.0;        

    //set the signal with updated raw value
    {
        rawValue = getvalue(this);
        if(chgEv_RDR1Header_TjaFID == 0)
        {
            //type conversion to float
            rawValue_float = rawValue;        
            // raw to physical conversion
            phyValue = ((rawValue_float *1)+(0));
            putValue(E_pric_RadarFrontCenter_RDR1Header_TjaFID_Pv, phyValue);
            chgEv_RDR1Header_TjaFID = 1;
        }
        else
        {
            chgEv_RDR1Header_TjaFID = 0;
        }    
        //update the signal value
        Msg_RDR1Header.TjaFID=rawValue;        
    }                                                                           
}

on envVar E_pric_RadarFrontCenter_RDR1Header_TjaFID_Pv
{
    qword rawValue = 0ll;
    float phyValue = 0.0;
    
    //update the raw value with physical value 
    {
        if(chgEv_RDR1Header_TjaFID == 0)
        {
            phyValue = getvalue(this);
            // physical to raw conversion
            rawValue = ((phyValue -(0))/1);
            putValue(E_pric_RadarFrontCenter_RDR1Header_TjaFID_Rv, rawValue);
            chgEv_RDR1Header_TjaFID = 1;  
        }
        else
        {
            chgEv_RDR1Header_TjaFID = 0;
        }
    }
}


 
on envVar E_pric_RadarFrontCenter_RDR1Header_RDR1ObjectDataAge_Rv
{
    qword rawValue = 0ll;
    float rawValue_float = 0.0;
    float phyValue = 0.0;        

    //set the signal with updated raw value
    {
        rawValue = getvalue(this);
        if(chgEv_RDR1Header_RDR1ObjectDataAge == 0)
        {
            //type conversion to float
            rawValue_float = rawValue;        
            // raw to physical conversion
            phyValue = ((rawValue_float *0.000976562)+(0));
            putValue(E_pric_RadarFrontCenter_RDR1Header_RDR1ObjectDataAge_Pv, phyValue);
            chgEv_RDR1Header_RDR1ObjectDataAge = 1;
        }
        else
        {
            chgEv_RDR1Header_RDR1ObjectDataAge = 0;
        }    
        //update the signal value
        Msg_RDR1Header.RDR1ObjectDataAge=rawValue;        
    }                                                                           
}

on envVar E_pric_RadarFrontCenter_RDR1Header_RDR1ObjectDataAge_Pv
{
    qword rawValue = 0ll;
    float phyValue = 0.0;
    
    //update the raw value with physical value 
    {
        if(chgEv_RDR1Header_RDR1ObjectDataAge == 0)
        {
            phyValue = getvalue(this);
            // physical to raw conversion
            rawValue = ((phyValue -(0))/0.000976562);
            putValue(E_pric_RadarFrontCenter_RDR1Header_RDR1ObjectDataAge_Rv, rawValue);
            chgEv_RDR1Header_RDR1ObjectDataAge = 1;  
        }
        else
        {
            chgEv_RDR1Header_RDR1ObjectDataAge = 0;
        }
    }
}


 
/*@@envVar:E_pric_RadarFrontCenter_RDR1Header_ACC_ExitReason_Rv:*/
on envVar E_pric_RadarFrontCenter_RDR1Header_ACC_ExitReason_Rv
{
    qword rawValue = 0ll;
    float rawValue_float = 0.0;
    float phyValue = 0.0;        

    //set the signal with updated raw value
    if(getValue(E_pric_RadarFrontCenter_RDR1Header_ACC_ExitReason_SetVt)==0)
    {
        rawValue = getvalue(this);
        if(chgEv_RDR1Header_ACC_ExitReason == 0)
        {
            //type conversion to float
            rawValue_float = rawValue;        
            // raw to physical conversion
            phyValue = ((rawValue_float *1)+(0));
            putValue(E_pric_RadarFrontCenter_RDR1Header_ACC_ExitReason_Pv, phyValue);
            chgEv_RDR1Header_ACC_ExitReason = 1;
        }
        else
        {
            chgEv_RDR1Header_ACC_ExitReason = 0;
        }    
        //update the signal value
        Msg_RDR1Header.ACC_ExitReason=rawValue;        
    }                                                                           
}
/*@@end*/

/*@@envVar:E_pric_RadarFrontCenter_RDR1Header_ACC_ExitReason_Pv:*/
on envVar E_pric_RadarFrontCenter_RDR1Header_ACC_ExitReason_Pv
{
    qword rawValue = 0ll;
    float phyValue = 0.0;
    
    //update the raw value with physical value 
    if(getValue(E_pric_RadarFrontCenter_RDR1Header_ACC_ExitReason_SetVt)==0)
    {
        if(chgEv_RDR1Header_ACC_ExitReason == 0)
        {
            phyValue = getvalue(this);
            // physical to raw conversion
            rawValue = ((phyValue -(0))/1);
            putValue(E_pric_RadarFrontCenter_RDR1Header_ACC_ExitReason_Rv, rawValue);
            chgEv_RDR1Header_ACC_ExitReason = 1;  
        }
        else
        {
            chgEv_RDR1Header_ACC_ExitReason = 0;
        }
    }
}
/*@@end*/

/*@@envVar:E_pric_RadarFrontCenter_RDR1Header_ACC_ExitReason_Vt:*/
on envVar E_pric_RadarFrontCenter_RDR1Header_ACC_ExitReason_Vt
{
    qword rawValue = 0ll;
    if(getValue(E_pric_RadarFrontCenter_RDR1Header_ACC_ExitReason_SetVt))
    {
        //update the signal value
        Msg_RDR1Header.ACC_ExitReason=getValue(this);
    }
}
/*@@end*/

/*@@envVar:E_pric_RadarFrontCenter_RDR1Header_ACC_ExitReason_SetVt:*/
on envVar E_pric_RadarFrontCenter_RDR1Header_ACC_ExitReason_SetVt
{
    if(getValue(E_pric_RadarFrontCenter_RDR1Header_ACC_ExitReason_SetVt))
    {
        //update the signal value
        Msg_RDR1Header.ACC_ExitReason=getvalue(E_pric_RadarFrontCenter_RDR1Header_ACC_ExitReason_Vt);
    }
    else
    {
        Msg_RDR1Header.ACC_ExitReason=getValue(E_pric_RadarFrontCenter_RDR1Header_ACC_ExitReason_Rv);
    }
}
/*@@end*/
 
/*@@envVar:E_pric_RadarFrontCenter_RDR1Header_StatusACC_Rv:*/
on envVar E_pric_RadarFrontCenter_RDR1Header_StatusACC_Rv
{
    qword rawValue = 0ll;
    float rawValue_float = 0.0;
    float phyValue = 0.0;        

    //set the signal with updated raw value
    if(getValue(E_pric_RadarFrontCenter_RDR1Header_StatusACC_SetVt)==0)
    {
        rawValue = getvalue(this);
        if(chgEv_RDR1Header_StatusACC == 0)
        {
            //type conversion to float
            rawValue_float = rawValue;        
            // raw to physical conversion
            phyValue = ((rawValue_float *1)+(0));
            putValue(E_pric_RadarFrontCenter_RDR1Header_StatusACC_Pv, phyValue);
            chgEv_RDR1Header_StatusACC = 1;
        }
        else
        {
            chgEv_RDR1Header_StatusACC = 0;
        }    
        //update the signal value
        Msg_RDR1Header.StatusACC=rawValue;        
    }                                                                           
}

on envVar E_pric_RadarFrontCenter_RDR1Header_StatusACC_Pv
{
    qword rawValue = 0ll;
    float phyValue = 0.0;
    
    //update the raw value with physical value 
    if(getValue(E_pric_RadarFrontCenter_RDR1Header_StatusACC_SetVt)==0)
    {
        if(chgEv_RDR1Header_StatusACC == 0)
        {
            phyValue = getvalue(this);
            // physical to raw conversion
            rawValue = ((phyValue -(0))/1);
            putValue(E_pric_RadarFrontCenter_RDR1Header_StatusACC_Rv, rawValue);
            chgEv_RDR1Header_StatusACC = 1;  
        }
        else
        {
            chgEv_RDR1Header_StatusACC = 0;
        }
    }
}

on envVar E_pric_RadarFrontCenter_RDR1Header_StatusACC_Vt
{
    qword rawValue = 0ll;
    if(getValue(E_pric_RadarFrontCenter_RDR1Header_StatusACC_SetVt))
    {
        //update the signal value
        Msg_RDR1Header.StatusACC=getValue(this);
    }
}

on envVar E_pric_RadarFrontCenter_RDR1Header_StatusACC_SetVt
{
    if(getValue(E_pric_RadarFrontCenter_RDR1Header_StatusACC_SetVt))
    {
        //update the signal value
        Msg_RDR1Header.StatusACC=getvalue(E_pric_RadarFrontCenter_RDR1Header_StatusACC_Vt);
    }
    else
    {
        Msg_RDR1Header.StatusACC=getValue(E_pric_RadarFrontCenter_RDR1Header_StatusACC_Rv);
    }
}
 
on envVar E_pric_RadarFrontCenter_OnComingObj3_tx
{
    if(getValue(this))
    {       
        
        //update the BZ Signal
        if(OnComingObj3_OnComingObj3_blockCtr_wrongvalctr == 0)
        {
            update_OnComingObj3_OnComingObj3_blockCtr_counter();
            Msg_OnComingObj3.OnComingObj3_blockCtr= OnComingObj3_OnComingObj3_blockCtr_counter;
        }
        else if(OnComingObj3_OnComingObj3_blockCtr_wrongvalctr > 0)
        {
             OnComingObj3_OnComingObj3_blockCtr_wrongvalctr--;
              // if counter becomes zero, update panel controller to zero
             if(OnComingObj3_OnComingObj3_blockCtr_wrongvalctr == 0)
             {
                 putValue(E_pric_RadarFrontCenter_OnComingObj3_OnComingObj3_blockCtr_wrongvalctr,0);
             }
        }
        else
        {
            //do nothing
        }        
        //update the BZ Signal
        if(OnComingObj3_OnComingObj3_MsgCtr_wrongvalctr == 0)
        {
            update_OnComingObj3_OnComingObj3_MsgCtr_counter();
            Msg_OnComingObj3.OnComingObj3_MsgCtr= OnComingObj3_OnComingObj3_MsgCtr_counter;
        }
        else if(OnComingObj3_OnComingObj3_MsgCtr_wrongvalctr > 0)
        {
             OnComingObj3_OnComingObj3_MsgCtr_wrongvalctr--;
              // if counter becomes zero, update panel controller to zero
             if(OnComingObj3_OnComingObj3_MsgCtr_wrongvalctr == 0)
             {
                 putValue(E_pric_RadarFrontCenter_OnComingObj3_OnComingObj3_MsgCtr_wrongvalctr,0);
             }
        }
        else
        {
            //do nothing
        }        
        //calculate the CRC checksum
        update_OnComingObj3_ChkSum_Checksum();

        output(Msg_OnComingObj3);        
    }
}

on envVar E_pric_RadarFrontCenter_OnComingObj3_Range
{
    qword rawstatus = 0ll;
    qword rawValue = 0ll;    
    
    rawstatus = getvalue(this);    
    // set all the signals with min raw /max raw /init raw
    switch (rawstatus) 
    {
     case(0) :
        rawValue= 0;
        putValue(E_pric_RadarFrontCenter_OnComingObj3_OnComingObj3_RFF_ub_Rv, rawValue);
        rawValue= 0;
        putValue(E_pric_RadarFrontCenter_OnComingObj3_OnComingObj3_Handle_ub_Rv, rawValue);
        rawValue= -32768;
        putValue(E_pric_RadarFrontCenter_OnComingObj3_OnComingObj3_dyv_sw_Rv, rawValue);
        rawValue= -32768;
        putValue(E_pric_RadarFrontCenter_OnComingObj3_OnComingObj3_vxv_sw_Rv, rawValue);
        rawValue= -32768;
        putValue(E_pric_RadarFrontCenter_OnComingObj3_OnComingObj3_dxv_sw_Rv, rawValue);
        rawValue= -32768;
        putValue(E_pric_RadarFrontCenter_OnComingObj3_OnComingObj3_dWidth_sw_Rv, rawValue);
        break;
     case(1) :
        rawValue= 255;
        putValue(E_pric_RadarFrontCenter_OnComingObj3_OnComingObj3_RFF_ub_Rv, rawValue);
        rawValue= 255;
        putValue(E_pric_RadarFrontCenter_OnComingObj3_OnComingObj3_Handle_ub_Rv, rawValue);
        rawValue= 32767;
        putValue(E_pric_RadarFrontCenter_OnComingObj3_OnComingObj3_dyv_sw_Rv, rawValue);
        rawValue= 32767;
        putValue(E_pric_RadarFrontCenter_OnComingObj3_OnComingObj3_vxv_sw_Rv, rawValue);
        rawValue= 32767;
        putValue(E_pric_RadarFrontCenter_OnComingObj3_OnComingObj3_dxv_sw_Rv, rawValue);
        rawValue= 32767;
        putValue(E_pric_RadarFrontCenter_OnComingObj3_OnComingObj3_dWidth_sw_Rv, rawValue);
        break;
     default :
        rawValue= 0;
        putValue(E_pric_RadarFrontCenter_OnComingObj3_OnComingObj3_RFF_ub_Rv, rawValue);
        rawValue= 0;
        putValue(E_pric_RadarFrontCenter_OnComingObj3_OnComingObj3_Handle_ub_Rv, rawValue);
        rawValue= -32768;
        putValue(E_pric_RadarFrontCenter_OnComingObj3_OnComingObj3_dyv_sw_Rv, rawValue);
        rawValue= -32768;
        putValue(E_pric_RadarFrontCenter_OnComingObj3_OnComingObj3_vxv_sw_Rv, rawValue);
        rawValue= -32768;
        putValue(E_pric_RadarFrontCenter_OnComingObj3_OnComingObj3_dxv_sw_Rv, rawValue);
        rawValue= -32768;
        putValue(E_pric_RadarFrontCenter_OnComingObj3_OnComingObj3_dWidth_sw_Rv, rawValue);
      break;
   }
}

on envVar E_pric_RadarFrontCenter_OnComingObj3_Dlc
{
    if(getValue(E_pric_RadarFrontCenter_OnComingObj3_enDlc))
    {
        Msg_OnComingObj3.dlc =getValue(this);
    }
    else
    {
       Dbc_dlc = 12;
	   Msg_OnComingObj3.dlc = Calc_Canfd_dlc(Dbc_dlc);
	   	
  }
}

on envVar E_pric_RadarFrontCenter_OnComingObj3_enDlc
{
    //For Messages with DLC = 8, set wrong DLC to smaller than defined DLC
    //For Messages with DLC < 8 set wrong DLC to smaller/longer than defined DLC
    if(getValue(this))
    {
        Msg_OnComingObj3.dlc =getValue(E_pric_RadarFrontCenter_OnComingObj3_Dlc);
    }
    else
    {
       Dbc_dlc = 12;
	   Msg_OnComingObj3.dlc = Calc_Canfd_dlc(Dbc_dlc);
			
    }
}

on envVar E_pric_RadarFrontCenter_OnComingObj3_OnComingObj3_CRC_wrongvalctr
{
    //update disturb count
    //disturb value range:(-1 = always send wrong value),( X>0 ,x is the number of Messages with wrong CHK sent)
    OnComingObj3_OnComingObj3_CRC_wrongvalctr =getValue(this);    
}
on envVar E_pric_RadarFrontCenter_OnComingObj3_OnComingObj3_MsgCtr_wrongvalctr
{
    //update disturb count
    //disturb value range:(-1 = always send wrong value),( X>0 ,x is the number of Messages with wrong CHK sent)
    OnComingObj3_OnComingObj3_MsgCtr_wrongvalctr =getValue(this);    
}
on envVar E_pric_RadarFrontCenter_OnComingObj3_OnComingObj3_blockCtr_wrongvalctr
{
    //update disturb count
    //disturb value range:(-1 = always send wrong value),( X>0 ,x is the number of Messages with wrong CHK sent)
    OnComingObj3_OnComingObj3_blockCtr_wrongvalctr =getValue(this);    
}

on envVar E_pric_RadarFrontCenter_OnComingObj3_OnComingObj3_RFF_ub_Rv
{
    qword rawValue = 0ll;
    float rawValue_float = 0.0;
    float phyValue = 0.0;        

    //set the signal with updated raw value
    if(getValue(E_pric_RadarFrontCenter_OnComingObj3_OnComingObj3_RFF_ub_SetVt)==0)
    {
        rawValue = getvalue(this);
        if(chgEv_OnComingObj3_OnComingObj3_RFF_ub == 0)
        {
            //type conversion to float
            rawValue_float = rawValue;        
            // raw to physical conversion
            phyValue = ((rawValue_float *1)+(0));
            putValue(E_pric_RadarFrontCenter_OnComingObj3_OnComingObj3_RFF_ub_Pv, phyValue);
            chgEv_OnComingObj3_OnComingObj3_RFF_ub = 1;
        }
        else
        {
            chgEv_OnComingObj3_OnComingObj3_RFF_ub = 0;
        }    
        //update the signal value
        Msg_OnComingObj3.OnComingObj3_RFF_ub=rawValue;        
    }                                                                           
}

on envVar E_pric_RadarFrontCenter_OnComingObj3_OnComingObj3_RFF_ub_Pv
{
    qword rawValue = 0ll;
    float phyValue = 0.0;
    
    //update the raw value with physical value 
    if(getValue(E_pric_RadarFrontCenter_OnComingObj3_OnComingObj3_RFF_ub_SetVt)==0)
    {
        if(chgEv_OnComingObj3_OnComingObj3_RFF_ub == 0)
        {
            phyValue = getvalue(this);
            // physical to raw conversion
            rawValue = ((phyValue -(0))/1);
            putValue(E_pric_RadarFrontCenter_OnComingObj3_OnComingObj3_RFF_ub_Rv, rawValue);
            chgEv_OnComingObj3_OnComingObj3_RFF_ub = 1;  
        }
        else
        {
            chgEv_OnComingObj3_OnComingObj3_RFF_ub = 0;
        }
    }
}

on envVar E_pric_RadarFrontCenter_OnComingObj3_OnComingObj3_RFF_ub_Vt
{
    qword rawValue = 0ll;
    if(getValue(E_pric_RadarFrontCenter_OnComingObj3_OnComingObj3_RFF_ub_SetVt))
    {
        //update the signal value
        Msg_OnComingObj3.OnComingObj3_RFF_ub=getValue(this);
    }
}

on envVar E_pric_RadarFrontCenter_OnComingObj3_OnComingObj3_RFF_ub_SetVt
{
    if(getValue(E_pric_RadarFrontCenter_OnComingObj3_OnComingObj3_RFF_ub_SetVt))
    {
        //update the signal value
        Msg_OnComingObj3.OnComingObj3_RFF_ub=getvalue(E_pric_RadarFrontCenter_OnComingObj3_OnComingObj3_RFF_ub_Vt);
    }
    else
    {
        Msg_OnComingObj3.OnComingObj3_RFF_ub=getValue(E_pric_RadarFrontCenter_OnComingObj3_OnComingObj3_RFF_ub_Rv);
    }
}
 
on envVar E_pric_RadarFrontCenter_OnComingObj3_OnComingObj3_Handle_ub_Rv
{
    qword rawValue = 0ll;
    float rawValue_float = 0.0;
    float phyValue = 0.0;        

    //set the signal with updated raw value
    if(getValue(E_pric_RadarFrontCenter_OnComingObj3_OnComingObj3_Handle_ub_SetVt)==0)
    {
        rawValue = getvalue(this);
        if(chgEv_OnComingObj3_OnComingObj3_Handle_ub == 0)
        {
            //type conversion to float
            rawValue_float = rawValue;        
            // raw to physical conversion
            phyValue = ((rawValue_float *1)+(0));
            putValue(E_pric_RadarFrontCenter_OnComingObj3_OnComingObj3_Handle_ub_Pv, phyValue);
            chgEv_OnComingObj3_OnComingObj3_Handle_ub = 1;
        }
        else
        {
            chgEv_OnComingObj3_OnComingObj3_Handle_ub = 0;
        }    
        //update the signal value
        Msg_OnComingObj3.OnComingObj3_Handle_ub=rawValue;        
    }                                                                           
}

on envVar E_pric_RadarFrontCenter_OnComingObj3_OnComingObj3_Handle_ub_Pv
{
    qword rawValue = 0ll;
    float phyValue = 0.0;
    
    //update the raw value with physical value 
    if(getValue(E_pric_RadarFrontCenter_OnComingObj3_OnComingObj3_Handle_ub_SetVt)==0)
    {
        if(chgEv_OnComingObj3_OnComingObj3_Handle_ub == 0)
        {
            phyValue = getvalue(this);
            // physical to raw conversion
            rawValue = ((phyValue -(0))/1);
            putValue(E_pric_RadarFrontCenter_OnComingObj3_OnComingObj3_Handle_ub_Rv, rawValue);
            chgEv_OnComingObj3_OnComingObj3_Handle_ub = 1;  
        }
        else
        {
            chgEv_OnComingObj3_OnComingObj3_Handle_ub = 0;
        }
    }
}

on envVar E_pric_RadarFrontCenter_OnComingObj3_OnComingObj3_Handle_ub_Vt
{
    qword rawValue = 0ll;
    if(getValue(E_pric_RadarFrontCenter_OnComingObj3_OnComingObj3_Handle_ub_SetVt))
    {
        //update the signal value
        Msg_OnComingObj3.OnComingObj3_Handle_ub=getValue(this);
    }
}

on envVar E_pric_RadarFrontCenter_OnComingObj3_OnComingObj3_Handle_ub_SetVt
{
    if(getValue(E_pric_RadarFrontCenter_OnComingObj3_OnComingObj3_Handle_ub_SetVt))
    {
        //update the signal value
        Msg_OnComingObj3.OnComingObj3_Handle_ub=getvalue(E_pric_RadarFrontCenter_OnComingObj3_OnComingObj3_Handle_ub_Vt);
    }
    else
    {
        Msg_OnComingObj3.OnComingObj3_Handle_ub=getValue(E_pric_RadarFrontCenter_OnComingObj3_OnComingObj3_Handle_ub_Rv);
    }
}
 
on envVar E_pric_RadarFrontCenter_OnComingObj3_OnComingObj3_dyv_sw_Rv
{
    qword rawValue = 0ll;
    float rawValue_float = 0.0;
    float phyValue = 0.0;        

    //set the signal with updated raw value
    {
        rawValue = getvalue(this);
        if(chgEv_OnComingObj3_OnComingObj3_dyv_sw == 0)
        {
            //type conversion to float
            rawValue_float = rawValue;        
            // raw to physical conversion
            phyValue = ((rawValue_float *0.0078125)+(0));
            putValue(E_pric_RadarFrontCenter_OnComingObj3_OnComingObj3_dyv_sw_Pv, phyValue);
            chgEv_OnComingObj3_OnComingObj3_dyv_sw = 1;
        }
        else
        {
            chgEv_OnComingObj3_OnComingObj3_dyv_sw = 0;
        }    
        //update the signal value
        Msg_OnComingObj3.OnComingObj3_dyv_sw=rawValue;        
    }                                                                           
}

on envVar E_pric_RadarFrontCenter_OnComingObj3_OnComingObj3_dyv_sw_Pv
{
    qword rawValue = 0ll;
    float phyValue = 0.0;
    
    //update the raw value with physical value 
    {
        if(chgEv_OnComingObj3_OnComingObj3_dyv_sw == 0)
        {
            phyValue = getvalue(this);
            // physical to raw conversion
            rawValue = ((phyValue -(0))/0.0078125);
            putValue(E_pric_RadarFrontCenter_OnComingObj3_OnComingObj3_dyv_sw_Rv, rawValue);
            chgEv_OnComingObj3_OnComingObj3_dyv_sw = 1;  
        }
        else
        {
            chgEv_OnComingObj3_OnComingObj3_dyv_sw = 0;
        }
    }
}


 
on envVar E_pric_RadarFrontCenter_OnComingObj3_OnComingObj3_vxv_sw_Rv
{
    qword rawValue = 0ll;
    float rawValue_float = 0.0;
    float phyValue = 0.0;        

    //set the signal with updated raw value
    {
        rawValue = getvalue(this);
        if(chgEv_OnComingObj3_OnComingObj3_vxv_sw == 0)
        {
            //type conversion to float
            rawValue_float = rawValue;        
            // raw to physical conversion
            phyValue = ((rawValue_float *0.00390625)+(0));
            putValue(E_pric_RadarFrontCenter_OnComingObj3_OnComingObj3_vxv_sw_Pv, phyValue);
            chgEv_OnComingObj3_OnComingObj3_vxv_sw = 1;
        }
        else
        {
            chgEv_OnComingObj3_OnComingObj3_vxv_sw = 0;
        }    
        //update the signal value
        Msg_OnComingObj3.OnComingObj3_vxv_sw=rawValue;        
    }                                                                           
}

on envVar E_pric_RadarFrontCenter_OnComingObj3_OnComingObj3_vxv_sw_Pv
{
    qword rawValue = 0ll;
    float phyValue = 0.0;
    
    //update the raw value with physical value 
    {
        if(chgEv_OnComingObj3_OnComingObj3_vxv_sw == 0)
        {
            phyValue = getvalue(this);
            // physical to raw conversion
            rawValue = ((phyValue -(0))/0.00390625);
            putValue(E_pric_RadarFrontCenter_OnComingObj3_OnComingObj3_vxv_sw_Rv, rawValue);
            chgEv_OnComingObj3_OnComingObj3_vxv_sw = 1;  
        }
        else
        {
            chgEv_OnComingObj3_OnComingObj3_vxv_sw = 0;
        }
    }
}


 
on envVar E_pric_RadarFrontCenter_OnComingObj3_OnComingObj3_dxv_sw_Rv
{
    qword rawValue = 0ll;
    float rawValue_float = 0.0;
    float phyValue = 0.0;        

    //set the signal with updated raw value
    {
        rawValue = getvalue(this);
        if(chgEv_OnComingObj3_OnComingObj3_dxv_sw == 0)
        {
            //type conversion to float
            rawValue_float = rawValue;        
            // raw to physical conversion
            phyValue = ((rawValue_float *0.0078125)+(0));
            putValue(E_pric_RadarFrontCenter_OnComingObj3_OnComingObj3_dxv_sw_Pv, phyValue);
            chgEv_OnComingObj3_OnComingObj3_dxv_sw = 1;
        }
        else
        {
            chgEv_OnComingObj3_OnComingObj3_dxv_sw = 0;
        }    
        //update the signal value
        Msg_OnComingObj3.OnComingObj3_dxv_sw=rawValue;        
    }                                                                           
}

on envVar E_pric_RadarFrontCenter_OnComingObj3_OnComingObj3_dxv_sw_Pv
{
    qword rawValue = 0ll;
    float phyValue = 0.0;
    
    //update the raw value with physical value 
    {
        if(chgEv_OnComingObj3_OnComingObj3_dxv_sw == 0)
        {
            phyValue = getvalue(this);
            // physical to raw conversion
            rawValue = ((phyValue -(0))/0.0078125);
            putValue(E_pric_RadarFrontCenter_OnComingObj3_OnComingObj3_dxv_sw_Rv, rawValue);
            chgEv_OnComingObj3_OnComingObj3_dxv_sw = 1;  
        }
        else
        {
            chgEv_OnComingObj3_OnComingObj3_dxv_sw = 0;
        }
    }
}


 
on envVar E_pric_RadarFrontCenter_OnComingObj3_OnComingObj3_dWidth_sw_Rv
{
    qword rawValue = 0ll;
    float rawValue_float = 0.0;
    float phyValue = 0.0;        

    //set the signal with updated raw value
    {
        rawValue = getvalue(this);
        if(chgEv_OnComingObj3_OnComingObj3_dWidth_sw == 0)
        {
            //type conversion to float
            rawValue_float = rawValue;        
            // raw to physical conversion
            phyValue = ((rawValue_float *0.0078125)+(0));
            putValue(E_pric_RadarFrontCenter_OnComingObj3_OnComingObj3_dWidth_sw_Pv, phyValue);
            chgEv_OnComingObj3_OnComingObj3_dWidth_sw = 1;
        }
        else
        {
            chgEv_OnComingObj3_OnComingObj3_dWidth_sw = 0;
        }    
        //update the signal value
        Msg_OnComingObj3.OnComingObj3_dWidth_sw=rawValue;        
    }                                                                           
}

on envVar E_pric_RadarFrontCenter_OnComingObj3_OnComingObj3_dWidth_sw_Pv
{
    qword rawValue = 0ll;
    float phyValue = 0.0;
    
    //update the raw value with physical value 
    {
        if(chgEv_OnComingObj3_OnComingObj3_dWidth_sw == 0)
        {
            phyValue = getvalue(this);
            // physical to raw conversion
            rawValue = ((phyValue -(0))/0.0078125);
            putValue(E_pric_RadarFrontCenter_OnComingObj3_OnComingObj3_dWidth_sw_Rv, rawValue);
            chgEv_OnComingObj3_OnComingObj3_dWidth_sw = 1;  
        }
        else
        {
            chgEv_OnComingObj3_OnComingObj3_dWidth_sw = 0;
        }
    }
}


 
on envVar E_pric_RadarFrontCenter_OnComingObj2_tx
{
    if(getValue(this))
    {       
        
        //update the BZ Signal
        if(OnComingObj2_OnComingObj2_MsgCtr_wrongvalctr == 0)
        {
            update_OnComingObj2_OnComingObj2_MsgCtr_counter();
            Msg_OnComingObj2.OnComingObj2_MsgCtr= OnComingObj2_OnComingObj2_MsgCtr_counter;
        }
        else if(OnComingObj2_OnComingObj2_MsgCtr_wrongvalctr > 0)
        {
             OnComingObj2_OnComingObj2_MsgCtr_wrongvalctr--;
              // if counter becomes zero, update panel controller to zero
             if(OnComingObj2_OnComingObj2_MsgCtr_wrongvalctr == 0)
             {
                 putValue(E_pric_RadarFrontCenter_OnComingObj2_OnComingObj2_MsgCtr_wrongvalctr,0);
             }
        }
        else
        {
            //do nothing
        }        
        //update the BZ Signal
        if(OnComingObj2_OnComingObj2_blockCtr_wrongvalctr == 0)
        {
            update_OnComingObj2_OnComingObj2_blockCtr_counter();
            Msg_OnComingObj2.OnComingObj2_blockCtr= OnComingObj2_OnComingObj2_blockCtr_counter;
        }
        else if(OnComingObj2_OnComingObj2_blockCtr_wrongvalctr > 0)
        {
             OnComingObj2_OnComingObj2_blockCtr_wrongvalctr--;
              // if counter becomes zero, update panel controller to zero
             if(OnComingObj2_OnComingObj2_blockCtr_wrongvalctr == 0)
             {
                 putValue(E_pric_RadarFrontCenter_OnComingObj2_OnComingObj2_blockCtr_wrongvalctr,0);
             }
        }
        else
        {
            //do nothing
        }        
        //calculate the CRC checksum
        update_OnComingObj2_ChkSum_Checksum();

        output(Msg_OnComingObj2);        
    }
}

on envVar E_pric_RadarFrontCenter_OnComingObj2_Range
{
    qword rawstatus = 0ll;
    qword rawValue = 0ll;    
    
    rawstatus = getvalue(this);    
    // set all the signals with min raw /max raw /init raw
    switch (rawstatus) 
    {
     case(0) :
        rawValue= -32768;
        putValue(E_pric_RadarFrontCenter_OnComingObj2_OnComingObj2_dyv_sw_Rv, rawValue);
        rawValue= 0;
        putValue(E_pric_RadarFrontCenter_OnComingObj2_OnComingObj2_Handle_ub_Rv, rawValue);
        rawValue= -32768;
        putValue(E_pric_RadarFrontCenter_OnComingObj2_OnComingObj2_dWidth_sw_Rv, rawValue);
        rawValue= -32768;
        putValue(E_pric_RadarFrontCenter_OnComingObj2_OnComingObj2_dxv_sw_Rv, rawValue);
        rawValue= -32768;
        putValue(E_pric_RadarFrontCenter_OnComingObj2_OnComingObj2_vxv_sw_Rv, rawValue);
        rawValue= 0;
        putValue(E_pric_RadarFrontCenter_OnComingObj2_OnComingObj2_RFF_ub_Rv, rawValue);
        break;
     case(1) :
        rawValue= 32767;
        putValue(E_pric_RadarFrontCenter_OnComingObj2_OnComingObj2_dyv_sw_Rv, rawValue);
        rawValue= 255;
        putValue(E_pric_RadarFrontCenter_OnComingObj2_OnComingObj2_Handle_ub_Rv, rawValue);
        rawValue= 32767;
        putValue(E_pric_RadarFrontCenter_OnComingObj2_OnComingObj2_dWidth_sw_Rv, rawValue);
        rawValue= 32767;
        putValue(E_pric_RadarFrontCenter_OnComingObj2_OnComingObj2_dxv_sw_Rv, rawValue);
        rawValue= 32767;
        putValue(E_pric_RadarFrontCenter_OnComingObj2_OnComingObj2_vxv_sw_Rv, rawValue);
        rawValue= 255;
        putValue(E_pric_RadarFrontCenter_OnComingObj2_OnComingObj2_RFF_ub_Rv, rawValue);
        break;
     default :
        rawValue= -32768;
        putValue(E_pric_RadarFrontCenter_OnComingObj2_OnComingObj2_dyv_sw_Rv, rawValue);
        rawValue= 0;
        putValue(E_pric_RadarFrontCenter_OnComingObj2_OnComingObj2_Handle_ub_Rv, rawValue);
        rawValue= -32768;
        putValue(E_pric_RadarFrontCenter_OnComingObj2_OnComingObj2_dWidth_sw_Rv, rawValue);
        rawValue= -32768;
        putValue(E_pric_RadarFrontCenter_OnComingObj2_OnComingObj2_dxv_sw_Rv, rawValue);
        rawValue= -32768;
        putValue(E_pric_RadarFrontCenter_OnComingObj2_OnComingObj2_vxv_sw_Rv, rawValue);
        rawValue= 0;
        putValue(E_pric_RadarFrontCenter_OnComingObj2_OnComingObj2_RFF_ub_Rv, rawValue);
      break;
   }
}

on envVar E_pric_RadarFrontCenter_OnComingObj2_Dlc
{
    if(getValue(E_pric_RadarFrontCenter_OnComingObj2_enDlc))
    {
        Msg_OnComingObj2.dlc =getValue(this);
    }
    else
    {
       Dbc_dlc = 12;
	   Msg_OnComingObj2.dlc = Calc_Canfd_dlc(Dbc_dlc);
	   	
  }
}

on envVar E_pric_RadarFrontCenter_OnComingObj2_enDlc
{
    //For Messages with DLC = 8, set wrong DLC to smaller than defined DLC
    //For Messages with DLC < 8 set wrong DLC to smaller/longer than defined DLC
    if(getValue(this))
    {
        Msg_OnComingObj2.dlc =getValue(E_pric_RadarFrontCenter_OnComingObj2_Dlc);
    }
    else
    {
       Dbc_dlc = 12;
	   Msg_OnComingObj2.dlc = Calc_Canfd_dlc(Dbc_dlc);
			
    }
}

on envVar E_pric_RadarFrontCenter_OnComingObj2_OnComingObj2_CRC_wrongvalctr
{
    //update disturb count
    //disturb value range:(-1 = always send wrong value),( X>0 ,x is the number of Messages with wrong CHK sent)
    OnComingObj2_OnComingObj2_CRC_wrongvalctr =getValue(this);    
}
on envVar E_pric_RadarFrontCenter_OnComingObj2_OnComingObj2_MsgCtr_wrongvalctr
{
    //update disturb count
    //disturb value range:(-1 = always send wrong value),( X>0 ,x is the number of Messages with wrong CHK sent)
    OnComingObj2_OnComingObj2_MsgCtr_wrongvalctr =getValue(this);    
}
on envVar E_pric_RadarFrontCenter_OnComingObj2_OnComingObj2_blockCtr_wrongvalctr
{
    //update disturb count
    //disturb value range:(-1 = always send wrong value),( X>0 ,x is the number of Messages with wrong CHK sent)
    OnComingObj2_OnComingObj2_blockCtr_wrongvalctr =getValue(this);    
}

on envVar E_pric_RadarFrontCenter_OnComingObj2_OnComingObj2_dyv_sw_Rv
{
    qword rawValue = 0ll;
    float rawValue_float = 0.0;
    float phyValue = 0.0;        

    //set the signal with updated raw value
    {
        rawValue = getvalue(this);
        if(chgEv_OnComingObj2_OnComingObj2_dyv_sw == 0)
        {
            //type conversion to float
            rawValue_float = rawValue;        
            // raw to physical conversion
            phyValue = ((rawValue_float *0.0078125)+(0));
            putValue(E_pric_RadarFrontCenter_OnComingObj2_OnComingObj2_dyv_sw_Pv, phyValue);
            chgEv_OnComingObj2_OnComingObj2_dyv_sw = 1;
        }
        else
        {
            chgEv_OnComingObj2_OnComingObj2_dyv_sw = 0;
        }    
        //update the signal value
        Msg_OnComingObj2.OnComingObj2_dyv_sw=rawValue;        
    }                                                                           
}

on envVar E_pric_RadarFrontCenter_OnComingObj2_OnComingObj2_dyv_sw_Pv
{
    qword rawValue = 0ll;
    float phyValue = 0.0;
    
    //update the raw value with physical value 
    {
        if(chgEv_OnComingObj2_OnComingObj2_dyv_sw == 0)
        {
            phyValue = getvalue(this);
            // physical to raw conversion
            rawValue = ((phyValue -(0))/0.0078125);
            putValue(E_pric_RadarFrontCenter_OnComingObj2_OnComingObj2_dyv_sw_Rv, rawValue);
            chgEv_OnComingObj2_OnComingObj2_dyv_sw = 1;  
        }
        else
        {
            chgEv_OnComingObj2_OnComingObj2_dyv_sw = 0;
        }
    }
}


 
on envVar E_pric_RadarFrontCenter_OnComingObj2_OnComingObj2_Handle_ub_Rv
{
    qword rawValue = 0ll;
    float rawValue_float = 0.0;
    float phyValue = 0.0;        

    //set the signal with updated raw value
    if(getValue(E_pric_RadarFrontCenter_OnComingObj2_OnComingObj2_Handle_ub_SetVt)==0)
    {
        rawValue = getvalue(this);
        if(chgEv_OnComingObj2_OnComingObj2_Handle_ub == 0)
        {
            //type conversion to float
            rawValue_float = rawValue;        
            // raw to physical conversion
            phyValue = ((rawValue_float *1)+(0));
            putValue(E_pric_RadarFrontCenter_OnComingObj2_OnComingObj2_Handle_ub_Pv, phyValue);
            chgEv_OnComingObj2_OnComingObj2_Handle_ub = 1;
        }
        else
        {
            chgEv_OnComingObj2_OnComingObj2_Handle_ub = 0;
        }    
        //update the signal value
        Msg_OnComingObj2.OnComingObj2_Handle_ub=rawValue;        
    }                                                                           
}

on envVar E_pric_RadarFrontCenter_OnComingObj2_OnComingObj2_Handle_ub_Pv
{
    qword rawValue = 0ll;
    float phyValue = 0.0;
    
    //update the raw value with physical value 
    if(getValue(E_pric_RadarFrontCenter_OnComingObj2_OnComingObj2_Handle_ub_SetVt)==0)
    {
        if(chgEv_OnComingObj2_OnComingObj2_Handle_ub == 0)
        {
            phyValue = getvalue(this);
            // physical to raw conversion
            rawValue = ((phyValue -(0))/1);
            putValue(E_pric_RadarFrontCenter_OnComingObj2_OnComingObj2_Handle_ub_Rv, rawValue);
            chgEv_OnComingObj2_OnComingObj2_Handle_ub = 1;  
        }
        else
        {
            chgEv_OnComingObj2_OnComingObj2_Handle_ub = 0;
        }
    }
}

on envVar E_pric_RadarFrontCenter_OnComingObj2_OnComingObj2_Handle_ub_Vt
{
    qword rawValue = 0ll;
    if(getValue(E_pric_RadarFrontCenter_OnComingObj2_OnComingObj2_Handle_ub_SetVt))
    {
        //update the signal value
        Msg_OnComingObj2.OnComingObj2_Handle_ub=getValue(this);
    }
}

on envVar E_pric_RadarFrontCenter_OnComingObj2_OnComingObj2_Handle_ub_SetVt
{
    if(getValue(E_pric_RadarFrontCenter_OnComingObj2_OnComingObj2_Handle_ub_SetVt))
    {
        //update the signal value
        Msg_OnComingObj2.OnComingObj2_Handle_ub=getvalue(E_pric_RadarFrontCenter_OnComingObj2_OnComingObj2_Handle_ub_Vt);
    }
    else
    {
        Msg_OnComingObj2.OnComingObj2_Handle_ub=getValue(E_pric_RadarFrontCenter_OnComingObj2_OnComingObj2_Handle_ub_Rv);
    }
}
 
on envVar E_pric_RadarFrontCenter_OnComingObj2_OnComingObj2_dWidth_sw_Rv
{
    qword rawValue = 0ll;
    float rawValue_float = 0.0;
    float phyValue = 0.0;        

    //set the signal with updated raw value
    {
        rawValue = getvalue(this);
        if(chgEv_OnComingObj2_OnComingObj2_dWidth_sw == 0)
        {
            //type conversion to float
            rawValue_float = rawValue;        
            // raw to physical conversion
            phyValue = ((rawValue_float *0.0078125)+(0));
            putValue(E_pric_RadarFrontCenter_OnComingObj2_OnComingObj2_dWidth_sw_Pv, phyValue);
            chgEv_OnComingObj2_OnComingObj2_dWidth_sw = 1;
        }
        else
        {
            chgEv_OnComingObj2_OnComingObj2_dWidth_sw = 0;
        }    
        //update the signal value
        Msg_OnComingObj2.OnComingObj2_dWidth_sw=rawValue;        
    }                                                                           
}

on envVar E_pric_RadarFrontCenter_OnComingObj2_OnComingObj2_dWidth_sw_Pv
{
    qword rawValue = 0ll;
    float phyValue = 0.0;
    
    //update the raw value with physical value 
    {
        if(chgEv_OnComingObj2_OnComingObj2_dWidth_sw == 0)
        {
            phyValue = getvalue(this);
            // physical to raw conversion
            rawValue = ((phyValue -(0))/0.0078125);
            putValue(E_pric_RadarFrontCenter_OnComingObj2_OnComingObj2_dWidth_sw_Rv, rawValue);
            chgEv_OnComingObj2_OnComingObj2_dWidth_sw = 1;  
        }
        else
        {
            chgEv_OnComingObj2_OnComingObj2_dWidth_sw = 0;
        }
    }
}


 
on envVar E_pric_RadarFrontCenter_OnComingObj2_OnComingObj2_dxv_sw_Rv
{
    qword rawValue = 0ll;
    float rawValue_float = 0.0;
    float phyValue = 0.0;        

    //set the signal with updated raw value
    {
        rawValue = getvalue(this);
        if(chgEv_OnComingObj2_OnComingObj2_dxv_sw == 0)
        {
            //type conversion to float
            rawValue_float = rawValue;        
            // raw to physical conversion
            phyValue = ((rawValue_float *0.0078125)+(0));
            putValue(E_pric_RadarFrontCenter_OnComingObj2_OnComingObj2_dxv_sw_Pv, phyValue);
            chgEv_OnComingObj2_OnComingObj2_dxv_sw = 1;
        }
        else
        {
            chgEv_OnComingObj2_OnComingObj2_dxv_sw = 0;
        }    
        //update the signal value
        Msg_OnComingObj2.OnComingObj2_dxv_sw=rawValue;        
    }                                                                           
}

on envVar E_pric_RadarFrontCenter_OnComingObj2_OnComingObj2_dxv_sw_Pv
{
    qword rawValue = 0ll;
    float phyValue = 0.0;
    
    //update the raw value with physical value 
    {
        if(chgEv_OnComingObj2_OnComingObj2_dxv_sw == 0)
        {
            phyValue = getvalue(this);
            // physical to raw conversion
            rawValue = ((phyValue -(0))/0.0078125);
            putValue(E_pric_RadarFrontCenter_OnComingObj2_OnComingObj2_dxv_sw_Rv, rawValue);
            chgEv_OnComingObj2_OnComingObj2_dxv_sw = 1;  
        }
        else
        {
            chgEv_OnComingObj2_OnComingObj2_dxv_sw = 0;
        }
    }
}


 
on envVar E_pric_RadarFrontCenter_OnComingObj2_OnComingObj2_vxv_sw_Rv
{
    qword rawValue = 0ll;
    float rawValue_float = 0.0;
    float phyValue = 0.0;        

    //set the signal with updated raw value
    {
        rawValue = getvalue(this);
        if(chgEv_OnComingObj2_OnComingObj2_vxv_sw == 0)
        {
            //type conversion to float
            rawValue_float = rawValue;        
            // raw to physical conversion
            phyValue = ((rawValue_float *0.00390625)+(0));
            putValue(E_pric_RadarFrontCenter_OnComingObj2_OnComingObj2_vxv_sw_Pv, phyValue);
            chgEv_OnComingObj2_OnComingObj2_vxv_sw = 1;
        }
        else
        {
            chgEv_OnComingObj2_OnComingObj2_vxv_sw = 0;
        }    
        //update the signal value
        Msg_OnComingObj2.OnComingObj2_vxv_sw=rawValue;        
    }                                                                           
}

on envVar E_pric_RadarFrontCenter_OnComingObj2_OnComingObj2_vxv_sw_Pv
{
    qword rawValue = 0ll;
    float phyValue = 0.0;
    
    //update the raw value with physical value 
    {
        if(chgEv_OnComingObj2_OnComingObj2_vxv_sw == 0)
        {
            phyValue = getvalue(this);
            // physical to raw conversion
            rawValue = ((phyValue -(0))/0.00390625);
            putValue(E_pric_RadarFrontCenter_OnComingObj2_OnComingObj2_vxv_sw_Rv, rawValue);
            chgEv_OnComingObj2_OnComingObj2_vxv_sw = 1;  
        }
        else
        {
            chgEv_OnComingObj2_OnComingObj2_vxv_sw = 0;
        }
    }
}


 
on envVar E_pric_RadarFrontCenter_OnComingObj2_OnComingObj2_RFF_ub_Rv
{
    qword rawValue = 0ll;
    float rawValue_float = 0.0;
    float phyValue = 0.0;        

    //set the signal with updated raw value
    if(getValue(E_pric_RadarFrontCenter_OnComingObj2_OnComingObj2_RFF_ub_SetVt)==0)
    {
        rawValue = getvalue(this);
        if(chgEv_OnComingObj2_OnComingObj2_RFF_ub == 0)
        {
            //type conversion to float
            rawValue_float = rawValue;        
            // raw to physical conversion
            phyValue = ((rawValue_float *1)+(0));
            putValue(E_pric_RadarFrontCenter_OnComingObj2_OnComingObj2_RFF_ub_Pv, phyValue);
            chgEv_OnComingObj2_OnComingObj2_RFF_ub = 1;
        }
        else
        {
            chgEv_OnComingObj2_OnComingObj2_RFF_ub = 0;
        }    
        //update the signal value
        Msg_OnComingObj2.OnComingObj2_RFF_ub=rawValue;        
    }                                                                           
}

on envVar E_pric_RadarFrontCenter_OnComingObj2_OnComingObj2_RFF_ub_Pv
{
    qword rawValue = 0ll;
    float phyValue = 0.0;
    
    //update the raw value with physical value 
    if(getValue(E_pric_RadarFrontCenter_OnComingObj2_OnComingObj2_RFF_ub_SetVt)==0)
    {
        if(chgEv_OnComingObj2_OnComingObj2_RFF_ub == 0)
        {
            phyValue = getvalue(this);
            // physical to raw conversion
            rawValue = ((phyValue -(0))/1);
            putValue(E_pric_RadarFrontCenter_OnComingObj2_OnComingObj2_RFF_ub_Rv, rawValue);
            chgEv_OnComingObj2_OnComingObj2_RFF_ub = 1;  
        }
        else
        {
            chgEv_OnComingObj2_OnComingObj2_RFF_ub = 0;
        }
    }
}

on envVar E_pric_RadarFrontCenter_OnComingObj2_OnComingObj2_RFF_ub_Vt
{
    qword rawValue = 0ll;
    if(getValue(E_pric_RadarFrontCenter_OnComingObj2_OnComingObj2_RFF_ub_SetVt))
    {
        //update the signal value
        Msg_OnComingObj2.OnComingObj2_RFF_ub=getValue(this);
    }
}

on envVar E_pric_RadarFrontCenter_OnComingObj2_OnComingObj2_RFF_ub_SetVt
{
    if(getValue(E_pric_RadarFrontCenter_OnComingObj2_OnComingObj2_RFF_ub_SetVt))
    {
        //update the signal value
        Msg_OnComingObj2.OnComingObj2_RFF_ub=getvalue(E_pric_RadarFrontCenter_OnComingObj2_OnComingObj2_RFF_ub_Vt);
    }
    else
    {
        Msg_OnComingObj2.OnComingObj2_RFF_ub=getValue(E_pric_RadarFrontCenter_OnComingObj2_OnComingObj2_RFF_ub_Rv);
    }
}
 
on envVar E_pric_RadarFrontCenter_OnComingObj1_tx
{
    if(getValue(this))
    {       
        
        //update the BZ Signal
        if(OnComingObj1_OnComingObj1_blockCtr_wrongvalctr == 0)
        {
            update_OnComingObj1_OnComingObj1_blockCtr_counter();
            Msg_OnComingObj1.OnComingObj1_blockCtr= OnComingObj1_OnComingObj1_blockCtr_counter;
        }
        else if(OnComingObj1_OnComingObj1_blockCtr_wrongvalctr > 0)
        {
             OnComingObj1_OnComingObj1_blockCtr_wrongvalctr--;
              // if counter becomes zero, update panel controller to zero
             if(OnComingObj1_OnComingObj1_blockCtr_wrongvalctr == 0)
             {
                 putValue(E_pric_RadarFrontCenter_OnComingObj1_OnComingObj1_blockCtr_wrongvalctr,0);
             }
        }
        else
        {
            //do nothing
        }        
        //update the BZ Signal
        if(OnComingObj1_OnComingObj1_MsgCtr_wrongvalctr == 0)
        {
            update_OnComingObj1_OnComingObj1_MsgCtr_counter();
            Msg_OnComingObj1.OnComingObj1_MsgCtr= OnComingObj1_OnComingObj1_MsgCtr_counter;
        }
        else if(OnComingObj1_OnComingObj1_MsgCtr_wrongvalctr > 0)
        {
             OnComingObj1_OnComingObj1_MsgCtr_wrongvalctr--;
              // if counter becomes zero, update panel controller to zero
             if(OnComingObj1_OnComingObj1_MsgCtr_wrongvalctr == 0)
             {
                 putValue(E_pric_RadarFrontCenter_OnComingObj1_OnComingObj1_MsgCtr_wrongvalctr,0);
             }
        }
        else
        {
            //do nothing
        }        
        //calculate the CRC checksum
        update_OnComingObj1_ChkSum_Checksum();

        output(Msg_OnComingObj1);        
    }
}

on envVar E_pric_RadarFrontCenter_OnComingObj1_Range
{
    qword rawstatus = 0ll;
    qword rawValue = 0ll;    
    
    rawstatus = getvalue(this);    
    // set all the signals with min raw /max raw /init raw
    switch (rawstatus) 
    {
     case(0) :
        rawValue= 0;
        putValue(E_pric_RadarFrontCenter_OnComingObj1_OnComingObj1_RFF_ub_Rv, rawValue);
        rawValue= -32768;
        putValue(E_pric_RadarFrontCenter_OnComingObj1_OnComingObj1_dxv_sw_Rv, rawValue);
        rawValue= -32768;
        putValue(E_pric_RadarFrontCenter_OnComingObj1_OnComingObj1_dWidth_sw_Rv, rawValue);
        rawValue= -32768;
        putValue(E_pric_RadarFrontCenter_OnComingObj1_OnComingObj1_dyv_sw_Rv, rawValue);
        rawValue= 0;
        putValue(E_pric_RadarFrontCenter_OnComingObj1_OnComingObj1_Handle_ub_Rv, rawValue);
        rawValue= -32768;
        putValue(E_pric_RadarFrontCenter_OnComingObj1_OnComingObj1_vxv_sw_Rv, rawValue);
        break;
     case(1) :
        rawValue= 255;
        putValue(E_pric_RadarFrontCenter_OnComingObj1_OnComingObj1_RFF_ub_Rv, rawValue);
        rawValue= 32767;
        putValue(E_pric_RadarFrontCenter_OnComingObj1_OnComingObj1_dxv_sw_Rv, rawValue);
        rawValue= 32767;
        putValue(E_pric_RadarFrontCenter_OnComingObj1_OnComingObj1_dWidth_sw_Rv, rawValue);
        rawValue= 32767;
        putValue(E_pric_RadarFrontCenter_OnComingObj1_OnComingObj1_dyv_sw_Rv, rawValue);
        rawValue= 255;
        putValue(E_pric_RadarFrontCenter_OnComingObj1_OnComingObj1_Handle_ub_Rv, rawValue);
        rawValue= 32767;
        putValue(E_pric_RadarFrontCenter_OnComingObj1_OnComingObj1_vxv_sw_Rv, rawValue);
        break;
     default :
        rawValue= 0;
        putValue(E_pric_RadarFrontCenter_OnComingObj1_OnComingObj1_RFF_ub_Rv, rawValue);
        rawValue= -32768;
        putValue(E_pric_RadarFrontCenter_OnComingObj1_OnComingObj1_dxv_sw_Rv, rawValue);
        rawValue= -32768;
        putValue(E_pric_RadarFrontCenter_OnComingObj1_OnComingObj1_dWidth_sw_Rv, rawValue);
        rawValue= -32768;
        putValue(E_pric_RadarFrontCenter_OnComingObj1_OnComingObj1_dyv_sw_Rv, rawValue);
        rawValue= 0;
        putValue(E_pric_RadarFrontCenter_OnComingObj1_OnComingObj1_Handle_ub_Rv, rawValue);
        rawValue= -32768;
        putValue(E_pric_RadarFrontCenter_OnComingObj1_OnComingObj1_vxv_sw_Rv, rawValue);
      break;
   }
}

on envVar E_pric_RadarFrontCenter_OnComingObj1_Dlc
{
    if(getValue(E_pric_RadarFrontCenter_OnComingObj1_enDlc))
    {
        Msg_OnComingObj1.dlc =getValue(this);
    }
    else
    {
       Dbc_dlc = 12;
	   Msg_OnComingObj1.dlc = Calc_Canfd_dlc(Dbc_dlc);
	   	
  }
}

on envVar E_pric_RadarFrontCenter_OnComingObj1_enDlc
{
    //For Messages with DLC = 8, set wrong DLC to smaller than defined DLC
    //For Messages with DLC < 8 set wrong DLC to smaller/longer than defined DLC
    if(getValue(this))
    {
        Msg_OnComingObj1.dlc =getValue(E_pric_RadarFrontCenter_OnComingObj1_Dlc);
    }
    else
    {
       Dbc_dlc = 12;
	   Msg_OnComingObj1.dlc = Calc_Canfd_dlc(Dbc_dlc);
			
    }
}

on envVar E_pric_RadarFrontCenter_OnComingObj1_OnComingObj1_CRC_wrongvalctr
{
    //update disturb count
    //disturb value range:(-1 = always send wrong value),( X>0 ,x is the number of Messages with wrong CHK sent)
    OnComingObj1_OnComingObj1_CRC_wrongvalctr =getValue(this);    
}
on envVar E_pric_RadarFrontCenter_OnComingObj1_OnComingObj1_MsgCtr_wrongvalctr
{
    //update disturb count
    //disturb value range:(-1 = always send wrong value),( X>0 ,x is the number of Messages with wrong CHK sent)
    OnComingObj1_OnComingObj1_MsgCtr_wrongvalctr =getValue(this);    
}
on envVar E_pric_RadarFrontCenter_OnComingObj1_OnComingObj1_blockCtr_wrongvalctr
{
    //update disturb count
    //disturb value range:(-1 = always send wrong value),( X>0 ,x is the number of Messages with wrong CHK sent)
    OnComingObj1_OnComingObj1_blockCtr_wrongvalctr =getValue(this);    
}

on envVar E_pric_RadarFrontCenter_OnComingObj1_OnComingObj1_RFF_ub_Rv
{
    qword rawValue = 0ll;
    float rawValue_float = 0.0;
    float phyValue = 0.0;        

    //set the signal with updated raw value
    if(getValue(E_pric_RadarFrontCenter_OnComingObj1_OnComingObj1_RFF_ub_SetVt)==0)
    {
        rawValue = getvalue(this);
        if(chgEv_OnComingObj1_OnComingObj1_RFF_ub == 0)
        {
            //type conversion to float
            rawValue_float = rawValue;        
            // raw to physical conversion
            phyValue = ((rawValue_float *1)+(0));
            putValue(E_pric_RadarFrontCenter_OnComingObj1_OnComingObj1_RFF_ub_Pv, phyValue);
            chgEv_OnComingObj1_OnComingObj1_RFF_ub = 1;
        }
        else
        {
            chgEv_OnComingObj1_OnComingObj1_RFF_ub = 0;
        }    
        //update the signal value
        Msg_OnComingObj1.OnComingObj1_RFF_ub=rawValue;        
    }                                                                           
}

on envVar E_pric_RadarFrontCenter_OnComingObj1_OnComingObj1_RFF_ub_Pv
{
    qword rawValue = 0ll;
    float phyValue = 0.0;
    
    //update the raw value with physical value 
    if(getValue(E_pric_RadarFrontCenter_OnComingObj1_OnComingObj1_RFF_ub_SetVt)==0)
    {
        if(chgEv_OnComingObj1_OnComingObj1_RFF_ub == 0)
        {
            phyValue = getvalue(this);
            // physical to raw conversion
            rawValue = ((phyValue -(0))/1);
            putValue(E_pric_RadarFrontCenter_OnComingObj1_OnComingObj1_RFF_ub_Rv, rawValue);
            chgEv_OnComingObj1_OnComingObj1_RFF_ub = 1;  
        }
        else
        {
            chgEv_OnComingObj1_OnComingObj1_RFF_ub = 0;
        }
    }
}

on envVar E_pric_RadarFrontCenter_OnComingObj1_OnComingObj1_RFF_ub_Vt
{
    qword rawValue = 0ll;
    if(getValue(E_pric_RadarFrontCenter_OnComingObj1_OnComingObj1_RFF_ub_SetVt))
    {
        //update the signal value
        Msg_OnComingObj1.OnComingObj1_RFF_ub=getValue(this);
    }
}

on envVar E_pric_RadarFrontCenter_OnComingObj1_OnComingObj1_RFF_ub_SetVt
{
    if(getValue(E_pric_RadarFrontCenter_OnComingObj1_OnComingObj1_RFF_ub_SetVt))
    {
        //update the signal value
        Msg_OnComingObj1.OnComingObj1_RFF_ub=getvalue(E_pric_RadarFrontCenter_OnComingObj1_OnComingObj1_RFF_ub_Vt);
    }
    else
    {
        Msg_OnComingObj1.OnComingObj1_RFF_ub=getValue(E_pric_RadarFrontCenter_OnComingObj1_OnComingObj1_RFF_ub_Rv);
    }
}
 
on envVar E_pric_RadarFrontCenter_OnComingObj1_OnComingObj1_dxv_sw_Rv
{
    qword rawValue = 0ll;
    float rawValue_float = 0.0;
    float phyValue = 0.0;        

    //set the signal with updated raw value
    {
        rawValue = getvalue(this);
        if(chgEv_OnComingObj1_OnComingObj1_dxv_sw == 0)
        {
            //type conversion to float
            rawValue_float = rawValue;        
            // raw to physical conversion
            phyValue = ((rawValue_float *0.0078125)+(0));
            putValue(E_pric_RadarFrontCenter_OnComingObj1_OnComingObj1_dxv_sw_Pv, phyValue);
            chgEv_OnComingObj1_OnComingObj1_dxv_sw = 1;
        }
        else
        {
            chgEv_OnComingObj1_OnComingObj1_dxv_sw = 0;
        }    
        //update the signal value
        Msg_OnComingObj1.OnComingObj1_dxv_sw=rawValue;        
    }                                                                           
}

on envVar E_pric_RadarFrontCenter_OnComingObj1_OnComingObj1_dxv_sw_Pv
{
    qword rawValue = 0ll;
    float phyValue = 0.0;
    
    //update the raw value with physical value 
    {
        if(chgEv_OnComingObj1_OnComingObj1_dxv_sw == 0)
        {
            phyValue = getvalue(this);
            // physical to raw conversion
            rawValue = ((phyValue -(0))/0.0078125);
            putValue(E_pric_RadarFrontCenter_OnComingObj1_OnComingObj1_dxv_sw_Rv, rawValue);
            chgEv_OnComingObj1_OnComingObj1_dxv_sw = 1;  
        }
        else
        {
            chgEv_OnComingObj1_OnComingObj1_dxv_sw = 0;
        }
    }
}


 
on envVar E_pric_RadarFrontCenter_OnComingObj1_OnComingObj1_dWidth_sw_Rv
{
    qword rawValue = 0ll;
    float rawValue_float = 0.0;
    float phyValue = 0.0;        

    //set the signal with updated raw value
    {
        rawValue = getvalue(this);
        if(chgEv_OnComingObj1_OnComingObj1_dWidth_sw == 0)
        {
            //type conversion to float
            rawValue_float = rawValue;        
            // raw to physical conversion
            phyValue = ((rawValue_float *0.0078125)+(0));
            putValue(E_pric_RadarFrontCenter_OnComingObj1_OnComingObj1_dWidth_sw_Pv, phyValue);
            chgEv_OnComingObj1_OnComingObj1_dWidth_sw = 1;
        }
        else
        {
            chgEv_OnComingObj1_OnComingObj1_dWidth_sw = 0;
        }    
        //update the signal value
        Msg_OnComingObj1.OnComingObj1_dWidth_sw=rawValue;        
    }                                                                           
}

on envVar E_pric_RadarFrontCenter_OnComingObj1_OnComingObj1_dWidth_sw_Pv
{
    qword rawValue = 0ll;
    float phyValue = 0.0;
    
    //update the raw value with physical value 
    {
        if(chgEv_OnComingObj1_OnComingObj1_dWidth_sw == 0)
        {
            phyValue = getvalue(this);
            // physical to raw conversion
            rawValue = ((phyValue -(0))/0.0078125);
            putValue(E_pric_RadarFrontCenter_OnComingObj1_OnComingObj1_dWidth_sw_Rv, rawValue);
            chgEv_OnComingObj1_OnComingObj1_dWidth_sw = 1;  
        }
        else
        {
            chgEv_OnComingObj1_OnComingObj1_dWidth_sw = 0;
        }
    }
}


 
on envVar E_pric_RadarFrontCenter_OnComingObj1_OnComingObj1_dyv_sw_Rv
{
    qword rawValue = 0ll;
    float rawValue_float = 0.0;
    float phyValue = 0.0;        

    //set the signal with updated raw value
    {
        rawValue = getvalue(this);
        if(chgEv_OnComingObj1_OnComingObj1_dyv_sw == 0)
        {
            //type conversion to float
            rawValue_float = rawValue;        
            // raw to physical conversion
            phyValue = ((rawValue_float *0.0078125)+(0));
            putValue(E_pric_RadarFrontCenter_OnComingObj1_OnComingObj1_dyv_sw_Pv, phyValue);
            chgEv_OnComingObj1_OnComingObj1_dyv_sw = 1;
        }
        else
        {
            chgEv_OnComingObj1_OnComingObj1_dyv_sw = 0;
        }    
        //update the signal value
        Msg_OnComingObj1.OnComingObj1_dyv_sw=rawValue;        
    }                                                                           
}

on envVar E_pric_RadarFrontCenter_OnComingObj1_OnComingObj1_dyv_sw_Pv
{
    qword rawValue = 0ll;
    float phyValue = 0.0;
    
    //update the raw value with physical value 
    {
        if(chgEv_OnComingObj1_OnComingObj1_dyv_sw == 0)
        {
            phyValue = getvalue(this);
            // physical to raw conversion
            rawValue = ((phyValue -(0))/0.0078125);
            putValue(E_pric_RadarFrontCenter_OnComingObj1_OnComingObj1_dyv_sw_Rv, rawValue);
            chgEv_OnComingObj1_OnComingObj1_dyv_sw = 1;  
        }
        else
        {
            chgEv_OnComingObj1_OnComingObj1_dyv_sw = 0;
        }
    }
}


 
on envVar E_pric_RadarFrontCenter_OnComingObj1_OnComingObj1_Handle_ub_Rv
{
    qword rawValue = 0ll;
    float rawValue_float = 0.0;
    float phyValue = 0.0;        

    //set the signal with updated raw value
    if(getValue(E_pric_RadarFrontCenter_OnComingObj1_OnComingObj1_Handle_ub_SetVt)==0)
    {
        rawValue = getvalue(this);
        if(chgEv_OnComingObj1_OnComingObj1_Handle_ub == 0)
        {
            //type conversion to float
            rawValue_float = rawValue;        
            // raw to physical conversion
            phyValue = ((rawValue_float *1)+(0));
            putValue(E_pric_RadarFrontCenter_OnComingObj1_OnComingObj1_Handle_ub_Pv, phyValue);
            chgEv_OnComingObj1_OnComingObj1_Handle_ub = 1;
        }
        else
        {
            chgEv_OnComingObj1_OnComingObj1_Handle_ub = 0;
        }    
        //update the signal value
        Msg_OnComingObj1.OnComingObj1_Handle_ub=rawValue;        
    }                                                                           
}

on envVar E_pric_RadarFrontCenter_OnComingObj1_OnComingObj1_Handle_ub_Pv
{
    qword rawValue = 0ll;
    float phyValue = 0.0;
    
    //update the raw value with physical value 
    if(getValue(E_pric_RadarFrontCenter_OnComingObj1_OnComingObj1_Handle_ub_SetVt)==0)
    {
        if(chgEv_OnComingObj1_OnComingObj1_Handle_ub == 0)
        {
            phyValue = getvalue(this);
            // physical to raw conversion
            rawValue = ((phyValue -(0))/1);
            putValue(E_pric_RadarFrontCenter_OnComingObj1_OnComingObj1_Handle_ub_Rv, rawValue);
            chgEv_OnComingObj1_OnComingObj1_Handle_ub = 1;  
        }
        else
        {
            chgEv_OnComingObj1_OnComingObj1_Handle_ub = 0;
        }
    }
}

on envVar E_pric_RadarFrontCenter_OnComingObj1_OnComingObj1_Handle_ub_Vt
{
    qword rawValue = 0ll;
    if(getValue(E_pric_RadarFrontCenter_OnComingObj1_OnComingObj1_Handle_ub_SetVt))
    {
        //update the signal value
        Msg_OnComingObj1.OnComingObj1_Handle_ub=getValue(this);
    }
}

on envVar E_pric_RadarFrontCenter_OnComingObj1_OnComingObj1_Handle_ub_SetVt
{
    if(getValue(E_pric_RadarFrontCenter_OnComingObj1_OnComingObj1_Handle_ub_SetVt))
    {
        //update the signal value
        Msg_OnComingObj1.OnComingObj1_Handle_ub=getvalue(E_pric_RadarFrontCenter_OnComingObj1_OnComingObj1_Handle_ub_Vt);
    }
    else
    {
        Msg_OnComingObj1.OnComingObj1_Handle_ub=getValue(E_pric_RadarFrontCenter_OnComingObj1_OnComingObj1_Handle_ub_Rv);
    }
}
 
on envVar E_pric_RadarFrontCenter_OnComingObj1_OnComingObj1_vxv_sw_Rv
{
    qword rawValue = 0ll;
    float rawValue_float = 0.0;
    float phyValue = 0.0;        

    //set the signal with updated raw value
    {
        rawValue = getvalue(this);
        if(chgEv_OnComingObj1_OnComingObj1_vxv_sw == 0)
        {
            //type conversion to float
            rawValue_float = rawValue;        
            // raw to physical conversion
            phyValue = ((rawValue_float *0.00390625)+(0));
            putValue(E_pric_RadarFrontCenter_OnComingObj1_OnComingObj1_vxv_sw_Pv, phyValue);
            chgEv_OnComingObj1_OnComingObj1_vxv_sw = 1;
        }
        else
        {
            chgEv_OnComingObj1_OnComingObj1_vxv_sw = 0;
        }    
        //update the signal value
        Msg_OnComingObj1.OnComingObj1_vxv_sw=rawValue;        
    }                                                                           
}

on envVar E_pric_RadarFrontCenter_OnComingObj1_OnComingObj1_vxv_sw_Pv
{
    qword rawValue = 0ll;
    float phyValue = 0.0;
    
    //update the raw value with physical value 
    {
        if(chgEv_OnComingObj1_OnComingObj1_vxv_sw == 0)
        {
            phyValue = getvalue(this);
            // physical to raw conversion
            rawValue = ((phyValue -(0))/0.00390625);
            putValue(E_pric_RadarFrontCenter_OnComingObj1_OnComingObj1_vxv_sw_Rv, rawValue);
            chgEv_OnComingObj1_OnComingObj1_vxv_sw = 1;  
        }
        else
        {
            chgEv_OnComingObj1_OnComingObj1_vxv_sw = 0;
        }
    }
}


 
on envVar E_pric_RadarFrontCenter_OnComingObj0_tx
{
    if(getValue(this))
    {       
        
        //update the BZ Signal
        if(OnComingObj0_OnComingObj0_MsgCtr_wrongvalctr == 0)
        {
            update_OnComingObj0_OnComingObj0_MsgCtr_counter();
            Msg_OnComingObj0.OnComingObj0_MsgCtr= OnComingObj0_OnComingObj0_MsgCtr_counter;
        }
        else if(OnComingObj0_OnComingObj0_MsgCtr_wrongvalctr > 0)
        {
             OnComingObj0_OnComingObj0_MsgCtr_wrongvalctr--;
              // if counter becomes zero, update panel controller to zero
             if(OnComingObj0_OnComingObj0_MsgCtr_wrongvalctr == 0)
             {
                 putValue(E_pric_RadarFrontCenter_OnComingObj0_OnComingObj0_MsgCtr_wrongvalctr,0);
             }
        }
        else
        {
            //do nothing
        }        
        //update the BZ Signal
        if(OnComingObj0_OnComingObj0_blockCtr_wrongvalctr == 0)
        {
            update_OnComingObj0_OnComingObj0_blockCtr_counter();
            Msg_OnComingObj0.OnComingObj0_blockCtr= OnComingObj0_OnComingObj0_blockCtr_counter;
        }
        else if(OnComingObj0_OnComingObj0_blockCtr_wrongvalctr > 0)
        {
             OnComingObj0_OnComingObj0_blockCtr_wrongvalctr--;
              // if counter becomes zero, update panel controller to zero
             if(OnComingObj0_OnComingObj0_blockCtr_wrongvalctr == 0)
             {
                 putValue(E_pric_RadarFrontCenter_OnComingObj0_OnComingObj0_blockCtr_wrongvalctr,0);
             }
        }
        else
        {
            //do nothing
        }        
        //calculate the CRC checksum
        update_OnComingObj0_ChkSum_Checksum();

        output(Msg_OnComingObj0);        
    }
}

on envVar E_pric_RadarFrontCenter_OnComingObj0_Range
{
    qword rawstatus = 0ll;
    qword rawValue = 0ll;    
    
    rawstatus = getvalue(this);    
    // set all the signals with min raw /max raw /init raw
    switch (rawstatus) 
    {
     case(0) :
        rawValue= -32768;
        putValue(E_pric_RadarFrontCenter_OnComingObj0_OnComingObj0_dWidth_sw_Rv, rawValue);
        rawValue= -32768;
        putValue(E_pric_RadarFrontCenter_OnComingObj0_OnComingObj0_dyv_sw_Rv, rawValue);
        rawValue= 0;
        putValue(E_pric_RadarFrontCenter_OnComingObj0_OnComingObj0_RFF_ub_Rv, rawValue);
        rawValue= -32768;
        putValue(E_pric_RadarFrontCenter_OnComingObj0_OnComingObj0_dxv_sw_Rv, rawValue);
        rawValue= -32768;
        putValue(E_pric_RadarFrontCenter_OnComingObj0_OnComingObj0_vxv_sw_Rv, rawValue);
        rawValue= 0;
        putValue(E_pric_RadarFrontCenter_OnComingObj0_OnComingObj0_Handle_ub_Rv, rawValue);
        break;
     case(1) :
        rawValue= 32767;
        putValue(E_pric_RadarFrontCenter_OnComingObj0_OnComingObj0_dWidth_sw_Rv, rawValue);
        rawValue= 32767;
        putValue(E_pric_RadarFrontCenter_OnComingObj0_OnComingObj0_dyv_sw_Rv, rawValue);
        rawValue= 255;
        putValue(E_pric_RadarFrontCenter_OnComingObj0_OnComingObj0_RFF_ub_Rv, rawValue);
        rawValue= 32767;
        putValue(E_pric_RadarFrontCenter_OnComingObj0_OnComingObj0_dxv_sw_Rv, rawValue);
        rawValue= 32767;
        putValue(E_pric_RadarFrontCenter_OnComingObj0_OnComingObj0_vxv_sw_Rv, rawValue);
        rawValue= 255;
        putValue(E_pric_RadarFrontCenter_OnComingObj0_OnComingObj0_Handle_ub_Rv, rawValue);
        break;
     default :
        rawValue= -32768;
        putValue(E_pric_RadarFrontCenter_OnComingObj0_OnComingObj0_dWidth_sw_Rv, rawValue);
        rawValue= -32768;
        putValue(E_pric_RadarFrontCenter_OnComingObj0_OnComingObj0_dyv_sw_Rv, rawValue);
        rawValue= 0;
        putValue(E_pric_RadarFrontCenter_OnComingObj0_OnComingObj0_RFF_ub_Rv, rawValue);
        rawValue= -32768;
        putValue(E_pric_RadarFrontCenter_OnComingObj0_OnComingObj0_dxv_sw_Rv, rawValue);
        rawValue= -32768;
        putValue(E_pric_RadarFrontCenter_OnComingObj0_OnComingObj0_vxv_sw_Rv, rawValue);
        rawValue= 0;
        putValue(E_pric_RadarFrontCenter_OnComingObj0_OnComingObj0_Handle_ub_Rv, rawValue);
      break;
   }
}

on envVar E_pric_RadarFrontCenter_OnComingObj0_Dlc
{
    if(getValue(E_pric_RadarFrontCenter_OnComingObj0_enDlc))
    {
        Msg_OnComingObj0.dlc =getValue(this);
    }
    else
    {
       Dbc_dlc = 12;
	   Msg_OnComingObj0.dlc = Calc_Canfd_dlc(Dbc_dlc);
	   	
  }
}

on envVar E_pric_RadarFrontCenter_OnComingObj0_enDlc
{
    //For Messages with DLC = 8, set wrong DLC to smaller than defined DLC
    //For Messages with DLC < 8 set wrong DLC to smaller/longer than defined DLC
    if(getValue(this))
    {
        Msg_OnComingObj0.dlc =getValue(E_pric_RadarFrontCenter_OnComingObj0_Dlc);
    }
    else
    {
       Dbc_dlc = 12;
	   Msg_OnComingObj0.dlc = Calc_Canfd_dlc(Dbc_dlc);
			
    }
}

on envVar E_pric_RadarFrontCenter_OnComingObj0_OnComingObj0_CRC_wrongvalctr
{
    //update disturb count
    //disturb value range:(-1 = always send wrong value),( X>0 ,x is the number of Messages with wrong CHK sent)
    OnComingObj0_OnComingObj0_CRC_wrongvalctr =getValue(this);    
}
on envVar E_pric_RadarFrontCenter_OnComingObj0_OnComingObj0_MsgCtr_wrongvalctr
{
    //update disturb count
    //disturb value range:(-1 = always send wrong value),( X>0 ,x is the number of Messages with wrong CHK sent)
    OnComingObj0_OnComingObj0_MsgCtr_wrongvalctr =getValue(this);    
}
on envVar E_pric_RadarFrontCenter_OnComingObj0_OnComingObj0_blockCtr_wrongvalctr
{
    //update disturb count
    //disturb value range:(-1 = always send wrong value),( X>0 ,x is the number of Messages with wrong CHK sent)
    OnComingObj0_OnComingObj0_blockCtr_wrongvalctr =getValue(this);    
}

on envVar E_pric_RadarFrontCenter_OnComingObj0_OnComingObj0_dWidth_sw_Rv
{
    qword rawValue = 0ll;
    float rawValue_float = 0.0;
    float phyValue = 0.0;        

    //set the signal with updated raw value
    {
        rawValue = getvalue(this);
        if(chgEv_OnComingObj0_OnComingObj0_dWidth_sw == 0)
        {
            //type conversion to float
            rawValue_float = rawValue;        
            // raw to physical conversion
            phyValue = ((rawValue_float *0.0078125)+(0));
            putValue(E_pric_RadarFrontCenter_OnComingObj0_OnComingObj0_dWidth_sw_Pv, phyValue);
            chgEv_OnComingObj0_OnComingObj0_dWidth_sw = 1;
        }
        else
        {
            chgEv_OnComingObj0_OnComingObj0_dWidth_sw = 0;
        }    
        //update the signal value
        Msg_OnComingObj0.OnComingObj0_dWidth_sw=rawValue;        
    }                                                                           
}

on envVar E_pric_RadarFrontCenter_OnComingObj0_OnComingObj0_dWidth_sw_Pv
{
    qword rawValue = 0ll;
    float phyValue = 0.0;
    
    //update the raw value with physical value 
    {
        if(chgEv_OnComingObj0_OnComingObj0_dWidth_sw == 0)
        {
            phyValue = getvalue(this);
            // physical to raw conversion
            rawValue = ((phyValue -(0))/0.0078125);
            putValue(E_pric_RadarFrontCenter_OnComingObj0_OnComingObj0_dWidth_sw_Rv, rawValue);
            chgEv_OnComingObj0_OnComingObj0_dWidth_sw = 1;  
        }
        else
        {
            chgEv_OnComingObj0_OnComingObj0_dWidth_sw = 0;
        }
    }
}


 
on envVar E_pric_RadarFrontCenter_OnComingObj0_OnComingObj0_dyv_sw_Rv
{
    qword rawValue = 0ll;
    float rawValue_float = 0.0;
    float phyValue = 0.0;        

    //set the signal with updated raw value
    {
        rawValue = getvalue(this);
        if(chgEv_OnComingObj0_OnComingObj0_dyv_sw == 0)
        {
            //type conversion to float
            rawValue_float = rawValue;        
            // raw to physical conversion
            phyValue = ((rawValue_float *0.0078125)+(0));
            putValue(E_pric_RadarFrontCenter_OnComingObj0_OnComingObj0_dyv_sw_Pv, phyValue);
            chgEv_OnComingObj0_OnComingObj0_dyv_sw = 1;
        }
        else
        {
            chgEv_OnComingObj0_OnComingObj0_dyv_sw = 0;
        }    
        //update the signal value
        Msg_OnComingObj0.OnComingObj0_dyv_sw=rawValue;        
    }                                                                           
}

on envVar E_pric_RadarFrontCenter_OnComingObj0_OnComingObj0_dyv_sw_Pv
{
    qword rawValue = 0ll;
    float phyValue = 0.0;
    
    //update the raw value with physical value 
    {
        if(chgEv_OnComingObj0_OnComingObj0_dyv_sw == 0)
        {
            phyValue = getvalue(this);
            // physical to raw conversion
            rawValue = ((phyValue -(0))/0.0078125);
            putValue(E_pric_RadarFrontCenter_OnComingObj0_OnComingObj0_dyv_sw_Rv, rawValue);
            chgEv_OnComingObj0_OnComingObj0_dyv_sw = 1;  
        }
        else
        {
            chgEv_OnComingObj0_OnComingObj0_dyv_sw = 0;
        }
    }
}


 
on envVar E_pric_RadarFrontCenter_OnComingObj0_OnComingObj0_RFF_ub_Rv
{
    qword rawValue = 0ll;
    float rawValue_float = 0.0;
    float phyValue = 0.0;        

    //set the signal with updated raw value
    if(getValue(E_pric_RadarFrontCenter_OnComingObj0_OnComingObj0_RFF_ub_SetVt)==0)
    {
        rawValue = getvalue(this);
        if(chgEv_OnComingObj0_OnComingObj0_RFF_ub == 0)
        {
            //type conversion to float
            rawValue_float = rawValue;        
            // raw to physical conversion
            phyValue = ((rawValue_float *1)+(0));
            putValue(E_pric_RadarFrontCenter_OnComingObj0_OnComingObj0_RFF_ub_Pv, phyValue);
            chgEv_OnComingObj0_OnComingObj0_RFF_ub = 1;
        }
        else
        {
            chgEv_OnComingObj0_OnComingObj0_RFF_ub = 0;
        }    
        //update the signal value
        Msg_OnComingObj0.OnComingObj0_RFF_ub=rawValue;        
    }                                                                           
}

on envVar E_pric_RadarFrontCenter_OnComingObj0_OnComingObj0_RFF_ub_Pv
{
    qword rawValue = 0ll;
    float phyValue = 0.0;
    
    //update the raw value with physical value 
    if(getValue(E_pric_RadarFrontCenter_OnComingObj0_OnComingObj0_RFF_ub_SetVt)==0)
    {
        if(chgEv_OnComingObj0_OnComingObj0_RFF_ub == 0)
        {
            phyValue = getvalue(this);
            // physical to raw conversion
            rawValue = ((phyValue -(0))/1);
            putValue(E_pric_RadarFrontCenter_OnComingObj0_OnComingObj0_RFF_ub_Rv, rawValue);
            chgEv_OnComingObj0_OnComingObj0_RFF_ub = 1;  
        }
        else
        {
            chgEv_OnComingObj0_OnComingObj0_RFF_ub = 0;
        }
    }
}

on envVar E_pric_RadarFrontCenter_OnComingObj0_OnComingObj0_RFF_ub_Vt
{
    qword rawValue = 0ll;
    if(getValue(E_pric_RadarFrontCenter_OnComingObj0_OnComingObj0_RFF_ub_SetVt))
    {
        //update the signal value
        Msg_OnComingObj0.OnComingObj0_RFF_ub=getValue(this);
    }
}

on envVar E_pric_RadarFrontCenter_OnComingObj0_OnComingObj0_RFF_ub_SetVt
{
    if(getValue(E_pric_RadarFrontCenter_OnComingObj0_OnComingObj0_RFF_ub_SetVt))
    {
        //update the signal value
        Msg_OnComingObj0.OnComingObj0_RFF_ub=getvalue(E_pric_RadarFrontCenter_OnComingObj0_OnComingObj0_RFF_ub_Vt);
    }
    else
    {
        Msg_OnComingObj0.OnComingObj0_RFF_ub=getValue(E_pric_RadarFrontCenter_OnComingObj0_OnComingObj0_RFF_ub_Rv);
    }
}
 
on envVar E_pric_RadarFrontCenter_OnComingObj0_OnComingObj0_dxv_sw_Rv
{
    qword rawValue = 0ll;
    float rawValue_float = 0.0;
    float phyValue = 0.0;        

    //set the signal with updated raw value
    {
        rawValue = getvalue(this);
        if(chgEv_OnComingObj0_OnComingObj0_dxv_sw == 0)
        {
            //type conversion to float
            rawValue_float = rawValue;        
            // raw to physical conversion
            phyValue = ((rawValue_float *0.0078125)+(0));
            putValue(E_pric_RadarFrontCenter_OnComingObj0_OnComingObj0_dxv_sw_Pv, phyValue);
            chgEv_OnComingObj0_OnComingObj0_dxv_sw = 1;
        }
        else
        {
            chgEv_OnComingObj0_OnComingObj0_dxv_sw = 0;
        }    
        //update the signal value
        Msg_OnComingObj0.OnComingObj0_dxv_sw=rawValue;        
    }                                                                           
}

on envVar E_pric_RadarFrontCenter_OnComingObj0_OnComingObj0_dxv_sw_Pv
{
    qword rawValue = 0ll;
    float phyValue = 0.0;
    
    //update the raw value with physical value 
    {
        if(chgEv_OnComingObj0_OnComingObj0_dxv_sw == 0)
        {
            phyValue = getvalue(this);
            // physical to raw conversion
            rawValue = ((phyValue -(0))/0.0078125);
            putValue(E_pric_RadarFrontCenter_OnComingObj0_OnComingObj0_dxv_sw_Rv, rawValue);
            chgEv_OnComingObj0_OnComingObj0_dxv_sw = 1;  
        }
        else
        {
            chgEv_OnComingObj0_OnComingObj0_dxv_sw = 0;
        }
    }
}


 
on envVar E_pric_RadarFrontCenter_OnComingObj0_OnComingObj0_vxv_sw_Rv
{
    qword rawValue = 0ll;
    float rawValue_float = 0.0;
    float phyValue = 0.0;        

    //set the signal with updated raw value
    {
        rawValue = getvalue(this);
        if(chgEv_OnComingObj0_OnComingObj0_vxv_sw == 0)
        {
            //type conversion to float
            rawValue_float = rawValue;        
            // raw to physical conversion
            phyValue = ((rawValue_float *0.00390625)+(0));
            putValue(E_pric_RadarFrontCenter_OnComingObj0_OnComingObj0_vxv_sw_Pv, phyValue);
            chgEv_OnComingObj0_OnComingObj0_vxv_sw = 1;
        }
        else
        {
            chgEv_OnComingObj0_OnComingObj0_vxv_sw = 0;
        }    
        //update the signal value
        Msg_OnComingObj0.OnComingObj0_vxv_sw=rawValue;        
    }                                                                           
}

on envVar E_pric_RadarFrontCenter_OnComingObj0_OnComingObj0_vxv_sw_Pv
{
    qword rawValue = 0ll;
    float phyValue = 0.0;
    
    //update the raw value with physical value 
    {
        if(chgEv_OnComingObj0_OnComingObj0_vxv_sw == 0)
        {
            phyValue = getvalue(this);
            // physical to raw conversion
            rawValue = ((phyValue -(0))/0.00390625);
            putValue(E_pric_RadarFrontCenter_OnComingObj0_OnComingObj0_vxv_sw_Rv, rawValue);
            chgEv_OnComingObj0_OnComingObj0_vxv_sw = 1;  
        }
        else
        {
            chgEv_OnComingObj0_OnComingObj0_vxv_sw = 0;
        }
    }
}


 
on envVar E_pric_RadarFrontCenter_OnComingObj0_OnComingObj0_Handle_ub_Rv
{
    qword rawValue = 0ll;
    float rawValue_float = 0.0;
    float phyValue = 0.0;        

    //set the signal with updated raw value
    if(getValue(E_pric_RadarFrontCenter_OnComingObj0_OnComingObj0_Handle_ub_SetVt)==0)
    {
        rawValue = getvalue(this);
        if(chgEv_OnComingObj0_OnComingObj0_Handle_ub == 0)
        {
            //type conversion to float
            rawValue_float = rawValue;        
            // raw to physical conversion
            phyValue = ((rawValue_float *1)+(0));
            putValue(E_pric_RadarFrontCenter_OnComingObj0_OnComingObj0_Handle_ub_Pv, phyValue);
            chgEv_OnComingObj0_OnComingObj0_Handle_ub = 1;
        }
        else
        {
            chgEv_OnComingObj0_OnComingObj0_Handle_ub = 0;
        }    
        //update the signal value
        Msg_OnComingObj0.OnComingObj0_Handle_ub=rawValue;        
    }                                                                           
}

on envVar E_pric_RadarFrontCenter_OnComingObj0_OnComingObj0_Handle_ub_Pv
{
    qword rawValue = 0ll;
    float phyValue = 0.0;
    
    //update the raw value with physical value 
    if(getValue(E_pric_RadarFrontCenter_OnComingObj0_OnComingObj0_Handle_ub_SetVt)==0)
    {
        if(chgEv_OnComingObj0_OnComingObj0_Handle_ub == 0)
        {
            phyValue = getvalue(this);
            // physical to raw conversion
            rawValue = ((phyValue -(0))/1);
            putValue(E_pric_RadarFrontCenter_OnComingObj0_OnComingObj0_Handle_ub_Rv, rawValue);
            chgEv_OnComingObj0_OnComingObj0_Handle_ub = 1;  
        }
        else
        {
            chgEv_OnComingObj0_OnComingObj0_Handle_ub = 0;
        }
    }
}

on envVar E_pric_RadarFrontCenter_OnComingObj0_OnComingObj0_Handle_ub_Vt
{
    qword rawValue = 0ll;
    if(getValue(E_pric_RadarFrontCenter_OnComingObj0_OnComingObj0_Handle_ub_SetVt))
    {
        //update the signal value
        Msg_OnComingObj0.OnComingObj0_Handle_ub=getValue(this);
    }
}

on envVar E_pric_RadarFrontCenter_OnComingObj0_OnComingObj0_Handle_ub_SetVt
{
    if(getValue(E_pric_RadarFrontCenter_OnComingObj0_OnComingObj0_Handle_ub_SetVt))
    {
        //update the signal value
        Msg_OnComingObj0.OnComingObj0_Handle_ub=getvalue(E_pric_RadarFrontCenter_OnComingObj0_OnComingObj0_Handle_ub_Vt);
    }
    else
    {
        Msg_OnComingObj0.OnComingObj0_Handle_ub=getValue(E_pric_RadarFrontCenter_OnComingObj0_OnComingObj0_Handle_ub_Rv);
    }
}
 
on envVar E_pric_RadarFrontCenter_TrajPointACCObj19_tx
{
    if(getValue(this))
    {       
        
        //update the BZ Signal
        if(TrajPointACCObj19_TrajPointACCObj19_blockCtr_wrongvalctr == 0)
        {
            update_TrajPointACCObj19_TrajPointACCObj19_blockCtr_counter();
            Msg_TrajPointACCObj19.TrajPointACCObj19_blockCtr= TrajPointACCObj19_TrajPointACCObj19_blockCtr_counter;
        }
        else if(TrajPointACCObj19_TrajPointACCObj19_blockCtr_wrongvalctr > 0)
        {
             TrajPointACCObj19_TrajPointACCObj19_blockCtr_wrongvalctr--;
              // if counter becomes zero, update panel controller to zero
             if(TrajPointACCObj19_TrajPointACCObj19_blockCtr_wrongvalctr == 0)
             {
                 putValue(E_pric_RadarFrontCenter_TrajPointACCObj19_TrajPointACCObj19_blockCtr_wrongvalctr,0);
             }
        }
        else
        {
            //do nothing
        }        
        //update the BZ Signal
        if(TrajPointACCObj19_TrajPointACCObj19_MsgCtr_wrongvalctr == 0)
        {
            update_TrajPointACCObj19_TrajPointACCObj19_MsgCtr_counter();
            Msg_TrajPointACCObj19.TrajPointACCObj19_MsgCtr= TrajPointACCObj19_TrajPointACCObj19_MsgCtr_counter;
        }
        else if(TrajPointACCObj19_TrajPointACCObj19_MsgCtr_wrongvalctr > 0)
        {
             TrajPointACCObj19_TrajPointACCObj19_MsgCtr_wrongvalctr--;
              // if counter becomes zero, update panel controller to zero
             if(TrajPointACCObj19_TrajPointACCObj19_MsgCtr_wrongvalctr == 0)
             {
                 putValue(E_pric_RadarFrontCenter_TrajPointACCObj19_TrajPointACCObj19_MsgCtr_wrongvalctr,0);
             }
        }
        else
        {
            //do nothing
        }        
        //calculate the CRC checksum
        update_TrajPointACCObj19_ChkSum_Checksum();

        output(Msg_TrajPointACCObj19);        
    }
}

on envVar E_pric_RadarFrontCenter_TrajPointACCObj19_Range
{
    qword rawstatus = 0ll;
    qword rawValue = 0ll;    
    
    rawstatus = getvalue(this);    
    // set all the signals with min raw /max raw /init raw
    switch (rawstatus) 
    {
     case(0) :
        rawValue= 0;
        putValue(E_pric_RadarFrontCenter_TrajPointACCObj19_TrajPointACCObj19_Drive_b_Rv, rawValue);
        rawValue= 0;
        putValue(E_pric_RadarFrontCenter_TrajPointACCObj19_TrajPointACCObj19_InvDir_b_Rv, rawValue);
        rawValue= -32768;
        putValue(E_pric_RadarFrontCenter_TrajPointACCObj19_TrajPointACCObj19_dyv_sw_Rv, rawValue);
        rawValue= 0;
        putValue(E_pric_RadarFrontCenter_TrajPointACCObj19_TrajPointACCObj19_Stopped_b_Rv, rawValue);
        rawValue= -32768;
        putValue(E_pric_RadarFrontCenter_TrajPointACCObj19_TrajPointACCObj19_dxv_sw_Rv, rawValue);
        rawValue= 0;
        putValue(E_pric_RadarFrontCenter_TrajPointACCObj19_TrajPointACCObj19_Stand_b_Rv, rawValue);
        rawValue= 0;
        putValue(E_pric_RadarFrontCenter_TrajPointACCObj19_TrajPointACCObj19_wExistProb_ub_Rv, rawValue);
        rawValue= 0;
        putValue(E_pric_RadarFrontCenter_TrajPointACCObj19_TrajPointACCObj19_dVarYv_uw_Rv, rawValue);
        rawValue= 0;
        putValue(E_pric_RadarFrontCenter_TrajPointACCObj19_TrajPointACCObj19_dVarXv_uw_Rv, rawValue);
        rawValue= 0;
        putValue(E_pric_RadarFrontCenter_TrajPointACCObj19_TrajPointACCObj19_Valid_b_Rv, rawValue);
        rawValue= 0;
        putValue(E_pric_RadarFrontCenter_TrajPointACCObj19_TrajPointACCObj19_TrajEnd_b_Rv, rawValue);
        rawValue= 0;
        putValue(E_pric_RadarFrontCenter_TrajPointACCObj19_TrajPointACCObj19_timestamp_Rv, rawValue);
        break;
     case(1) :
        rawValue= 1;
        putValue(E_pric_RadarFrontCenter_TrajPointACCObj19_TrajPointACCObj19_Drive_b_Rv, rawValue);
        rawValue= 1;
        putValue(E_pric_RadarFrontCenter_TrajPointACCObj19_TrajPointACCObj19_InvDir_b_Rv, rawValue);
        rawValue= 32767;
        putValue(E_pric_RadarFrontCenter_TrajPointACCObj19_TrajPointACCObj19_dyv_sw_Rv, rawValue);
        rawValue= 1;
        putValue(E_pric_RadarFrontCenter_TrajPointACCObj19_TrajPointACCObj19_Stopped_b_Rv, rawValue);
        rawValue= 32767;
        putValue(E_pric_RadarFrontCenter_TrajPointACCObj19_TrajPointACCObj19_dxv_sw_Rv, rawValue);
        rawValue= 1;
        putValue(E_pric_RadarFrontCenter_TrajPointACCObj19_TrajPointACCObj19_Stand_b_Rv, rawValue);
        rawValue= 255;
        putValue(E_pric_RadarFrontCenter_TrajPointACCObj19_TrajPointACCObj19_wExistProb_ub_Rv, rawValue);
        rawValue= 65534;
        putValue(E_pric_RadarFrontCenter_TrajPointACCObj19_TrajPointACCObj19_dVarYv_uw_Rv, rawValue);
        rawValue= 65534;
        putValue(E_pric_RadarFrontCenter_TrajPointACCObj19_TrajPointACCObj19_dVarXv_uw_Rv, rawValue);
        rawValue= 1;
        putValue(E_pric_RadarFrontCenter_TrajPointACCObj19_TrajPointACCObj19_Valid_b_Rv, rawValue);
        rawValue= 1;
        putValue(E_pric_RadarFrontCenter_TrajPointACCObj19_TrajPointACCObj19_TrajEnd_b_Rv, rawValue);
        rawValue= 65536;
        putValue(E_pric_RadarFrontCenter_TrajPointACCObj19_TrajPointACCObj19_timestamp_Rv, rawValue);
        break;
     default :
        rawValue= 0;
        putValue(E_pric_RadarFrontCenter_TrajPointACCObj19_TrajPointACCObj19_Drive_b_Rv, rawValue);
        rawValue= 0;
        putValue(E_pric_RadarFrontCenter_TrajPointACCObj19_TrajPointACCObj19_InvDir_b_Rv, rawValue);
        rawValue= -32768;
        putValue(E_pric_RadarFrontCenter_TrajPointACCObj19_TrajPointACCObj19_dyv_sw_Rv, rawValue);
        rawValue= 0;
        putValue(E_pric_RadarFrontCenter_TrajPointACCObj19_TrajPointACCObj19_Stopped_b_Rv, rawValue);
        rawValue= -32768;
        putValue(E_pric_RadarFrontCenter_TrajPointACCObj19_TrajPointACCObj19_dxv_sw_Rv, rawValue);
        rawValue= 0;
        putValue(E_pric_RadarFrontCenter_TrajPointACCObj19_TrajPointACCObj19_Stand_b_Rv, rawValue);
        rawValue= 0;
        putValue(E_pric_RadarFrontCenter_TrajPointACCObj19_TrajPointACCObj19_wExistProb_ub_Rv, rawValue);
        rawValue= 0;
        putValue(E_pric_RadarFrontCenter_TrajPointACCObj19_TrajPointACCObj19_dVarYv_uw_Rv, rawValue);
        rawValue= 0;
        putValue(E_pric_RadarFrontCenter_TrajPointACCObj19_TrajPointACCObj19_dVarXv_uw_Rv, rawValue);
        rawValue= 0;
        putValue(E_pric_RadarFrontCenter_TrajPointACCObj19_TrajPointACCObj19_Valid_b_Rv, rawValue);
        rawValue= 0;
        putValue(E_pric_RadarFrontCenter_TrajPointACCObj19_TrajPointACCObj19_TrajEnd_b_Rv, rawValue);
        rawValue= 0;
        putValue(E_pric_RadarFrontCenter_TrajPointACCObj19_TrajPointACCObj19_timestamp_Rv, rawValue);
      break;
   }
}

on envVar E_pric_RadarFrontCenter_TrajPointACCObj19_Dlc
{
    if(getValue(E_pric_RadarFrontCenter_TrajPointACCObj19_enDlc))
    {
        Msg_TrajPointACCObj19.dlc =getValue(this);
    }
    else
    {
       Dbc_dlc = 16;
	   Msg_TrajPointACCObj19.dlc = Calc_Canfd_dlc(Dbc_dlc);
	   	
  }
}

on envVar E_pric_RadarFrontCenter_TrajPointACCObj19_enDlc
{
    //For Messages with DLC = 8, set wrong DLC to smaller than defined DLC
    //For Messages with DLC < 8 set wrong DLC to smaller/longer than defined DLC
    if(getValue(this))
    {
        Msg_TrajPointACCObj19.dlc =getValue(E_pric_RadarFrontCenter_TrajPointACCObj19_Dlc);
    }
    else
    {
       Dbc_dlc = 16;
	   Msg_TrajPointACCObj19.dlc = Calc_Canfd_dlc(Dbc_dlc);
			
    }
}

on envVar E_pric_RadarFrontCenter_TrajPointACCObj19_TrajPointACCObj19_CRC_wrongvalctr
{
    //update disturb count
    //disturb value range:(-1 = always send wrong value),( X>0 ,x is the number of Messages with wrong CHK sent)
    TrajPointACCObj19_TrajPointACCObj19_CRC_wrongvalctr =getValue(this);    
}
on envVar E_pric_RadarFrontCenter_TrajPointACCObj19_TrajPointACCObj19_MsgCtr_wrongvalctr
{
    //update disturb count
    //disturb value range:(-1 = always send wrong value),( X>0 ,x is the number of Messages with wrong CHK sent)
    TrajPointACCObj19_TrajPointACCObj19_MsgCtr_wrongvalctr =getValue(this);    
}
on envVar E_pric_RadarFrontCenter_TrajPointACCObj19_TrajPointACCObj19_blockCtr_wrongvalctr
{
    //update disturb count
    //disturb value range:(-1 = always send wrong value),( X>0 ,x is the number of Messages with wrong CHK sent)
    TrajPointACCObj19_TrajPointACCObj19_blockCtr_wrongvalctr =getValue(this);    
}

on envVar E_pric_RadarFrontCenter_TrajPointACCObj19_TrajPointACCObj19_Drive_b_Rv
{
    qword rawValue = 0ll;
    float rawValue_float = 0.0;
    float phyValue = 0.0;        

    //set the signal with updated raw value
    if(getValue(E_pric_RadarFrontCenter_TrajPointACCObj19_TrajPointACCObj19_Drive_b_SetVt)==0)
    {
        rawValue = getvalue(this);
        if(chgEv_TrajPointACCObj19_TrajPointACCObj19_Drive_b == 0)
        {
            //type conversion to float
            rawValue_float = rawValue;        
            // raw to physical conversion
            phyValue = ((rawValue_float *1)+(0));
            putValue(E_pric_RadarFrontCenter_TrajPointACCObj19_TrajPointACCObj19_Drive_b_Pv, phyValue);
            chgEv_TrajPointACCObj19_TrajPointACCObj19_Drive_b = 1;
        }
        else
        {
            chgEv_TrajPointACCObj19_TrajPointACCObj19_Drive_b = 0;
        }    
        //update the signal value
        Msg_TrajPointACCObj19.TrajPointACCObj19_Drive_b=rawValue;        
    }                                                                           
}

on envVar E_pric_RadarFrontCenter_TrajPointACCObj19_TrajPointACCObj19_Drive_b_Pv
{
    qword rawValue = 0ll;
    float phyValue = 0.0;
    
    //update the raw value with physical value 
    if(getValue(E_pric_RadarFrontCenter_TrajPointACCObj19_TrajPointACCObj19_Drive_b_SetVt)==0)
    {
        if(chgEv_TrajPointACCObj19_TrajPointACCObj19_Drive_b == 0)
        {
            phyValue = getvalue(this);
            // physical to raw conversion
            rawValue = ((phyValue -(0))/1);
            putValue(E_pric_RadarFrontCenter_TrajPointACCObj19_TrajPointACCObj19_Drive_b_Rv, rawValue);
            chgEv_TrajPointACCObj19_TrajPointACCObj19_Drive_b = 1;  
        }
        else
        {
            chgEv_TrajPointACCObj19_TrajPointACCObj19_Drive_b = 0;
        }
    }
}

on envVar E_pric_RadarFrontCenter_TrajPointACCObj19_TrajPointACCObj19_Drive_b_Vt
{
    qword rawValue = 0ll;
    if(getValue(E_pric_RadarFrontCenter_TrajPointACCObj19_TrajPointACCObj19_Drive_b_SetVt))
    {
        //update the signal value
        Msg_TrajPointACCObj19.TrajPointACCObj19_Drive_b=getValue(this);
    }
}

on envVar E_pric_RadarFrontCenter_TrajPointACCObj19_TrajPointACCObj19_Drive_b_SetVt
{
    if(getValue(E_pric_RadarFrontCenter_TrajPointACCObj19_TrajPointACCObj19_Drive_b_SetVt))
    {
        //update the signal value
        Msg_TrajPointACCObj19.TrajPointACCObj19_Drive_b=getvalue(E_pric_RadarFrontCenter_TrajPointACCObj19_TrajPointACCObj19_Drive_b_Vt);
    }
    else
    {
        Msg_TrajPointACCObj19.TrajPointACCObj19_Drive_b=getValue(E_pric_RadarFrontCenter_TrajPointACCObj19_TrajPointACCObj19_Drive_b_Rv);
    }
}
 
on envVar E_pric_RadarFrontCenter_TrajPointACCObj19_TrajPointACCObj19_InvDir_b_Rv
{
    qword rawValue = 0ll;
    float rawValue_float = 0.0;
    float phyValue = 0.0;        

    //set the signal with updated raw value
    if(getValue(E_pric_RadarFrontCenter_TrajPointACCObj19_TrajPointACCObj19_InvDir_b_SetVt)==0)
    {
        rawValue = getvalue(this);
        if(chgEv_TrajPointACCObj19_TrajPointACCObj19_InvDir_b == 0)
        {
            //type conversion to float
            rawValue_float = rawValue;        
            // raw to physical conversion
            phyValue = ((rawValue_float *1)+(0));
            putValue(E_pric_RadarFrontCenter_TrajPointACCObj19_TrajPointACCObj19_InvDir_b_Pv, phyValue);
            chgEv_TrajPointACCObj19_TrajPointACCObj19_InvDir_b = 1;
        }
        else
        {
            chgEv_TrajPointACCObj19_TrajPointACCObj19_InvDir_b = 0;
        }    
        //update the signal value
        Msg_TrajPointACCObj19.TrajPointACCObj19_InvDir_b=rawValue;        
    }                                                                           
}

on envVar E_pric_RadarFrontCenter_TrajPointACCObj19_TrajPointACCObj19_InvDir_b_Pv
{
    qword rawValue = 0ll;
    float phyValue = 0.0;
    
    //update the raw value with physical value 
    if(getValue(E_pric_RadarFrontCenter_TrajPointACCObj19_TrajPointACCObj19_InvDir_b_SetVt)==0)
    {
        if(chgEv_TrajPointACCObj19_TrajPointACCObj19_InvDir_b == 0)
        {
            phyValue = getvalue(this);
            // physical to raw conversion
            rawValue = ((phyValue -(0))/1);
            putValue(E_pric_RadarFrontCenter_TrajPointACCObj19_TrajPointACCObj19_InvDir_b_Rv, rawValue);
            chgEv_TrajPointACCObj19_TrajPointACCObj19_InvDir_b = 1;  
        }
        else
        {
            chgEv_TrajPointACCObj19_TrajPointACCObj19_InvDir_b = 0;
        }
    }
}

on envVar E_pric_RadarFrontCenter_TrajPointACCObj19_TrajPointACCObj19_InvDir_b_Vt
{
    qword rawValue = 0ll;
    if(getValue(E_pric_RadarFrontCenter_TrajPointACCObj19_TrajPointACCObj19_InvDir_b_SetVt))
    {
        //update the signal value
        Msg_TrajPointACCObj19.TrajPointACCObj19_InvDir_b=getValue(this);
    }
}

on envVar E_pric_RadarFrontCenter_TrajPointACCObj19_TrajPointACCObj19_InvDir_b_SetVt
{
    if(getValue(E_pric_RadarFrontCenter_TrajPointACCObj19_TrajPointACCObj19_InvDir_b_SetVt))
    {
        //update the signal value
        Msg_TrajPointACCObj19.TrajPointACCObj19_InvDir_b=getvalue(E_pric_RadarFrontCenter_TrajPointACCObj19_TrajPointACCObj19_InvDir_b_Vt);
    }
    else
    {
        Msg_TrajPointACCObj19.TrajPointACCObj19_InvDir_b=getValue(E_pric_RadarFrontCenter_TrajPointACCObj19_TrajPointACCObj19_InvDir_b_Rv);
    }
}
 
on envVar E_pric_RadarFrontCenter_TrajPointACCObj19_TrajPointACCObj19_dyv_sw_Rv
{
    qword rawValue = 0ll;
    float rawValue_float = 0.0;
    float phyValue = 0.0;        

    //set the signal with updated raw value
    {
        rawValue = getvalue(this);
        if(chgEv_TrajPointACCObj19_TrajPointACCObj19_dyv_sw == 0)
        {
            //type conversion to float
            rawValue_float = rawValue;        
            // raw to physical conversion
            phyValue = ((rawValue_float *0.0078125)+(0));
            putValue(E_pric_RadarFrontCenter_TrajPointACCObj19_TrajPointACCObj19_dyv_sw_Pv, phyValue);
            chgEv_TrajPointACCObj19_TrajPointACCObj19_dyv_sw = 1;
        }
        else
        {
            chgEv_TrajPointACCObj19_TrajPointACCObj19_dyv_sw = 0;
        }    
        //update the signal value
        Msg_TrajPointACCObj19.TrajPointACCObj19_dyv_sw=rawValue;        
    }                                                                           
}

on envVar E_pric_RadarFrontCenter_TrajPointACCObj19_TrajPointACCObj19_dyv_sw_Pv
{
    qword rawValue = 0ll;
    float phyValue = 0.0;
    
    //update the raw value with physical value 
    {
        if(chgEv_TrajPointACCObj19_TrajPointACCObj19_dyv_sw == 0)
        {
            phyValue = getvalue(this);
            // physical to raw conversion
            rawValue = ((phyValue -(0))/0.0078125);
            putValue(E_pric_RadarFrontCenter_TrajPointACCObj19_TrajPointACCObj19_dyv_sw_Rv, rawValue);
            chgEv_TrajPointACCObj19_TrajPointACCObj19_dyv_sw = 1;  
        }
        else
        {
            chgEv_TrajPointACCObj19_TrajPointACCObj19_dyv_sw = 0;
        }
    }
}


 
on envVar E_pric_RadarFrontCenter_TrajPointACCObj19_TrajPointACCObj19_Stopped_b_Rv
{
    qword rawValue = 0ll;
    float rawValue_float = 0.0;
    float phyValue = 0.0;        

    //set the signal with updated raw value
    if(getValue(E_pric_RadarFrontCenter_TrajPointACCObj19_TrajPointACCObj19_Stopped_b_SetVt)==0)
    {
        rawValue = getvalue(this);
        if(chgEv_TrajPointACCObj19_TrajPointACCObj19_Stopped_b == 0)
        {
            //type conversion to float
            rawValue_float = rawValue;        
            // raw to physical conversion
            phyValue = ((rawValue_float *1)+(0));
            putValue(E_pric_RadarFrontCenter_TrajPointACCObj19_TrajPointACCObj19_Stopped_b_Pv, phyValue);
            chgEv_TrajPointACCObj19_TrajPointACCObj19_Stopped_b = 1;
        }
        else
        {
            chgEv_TrajPointACCObj19_TrajPointACCObj19_Stopped_b = 0;
        }    
        //update the signal value
        Msg_TrajPointACCObj19.TrajPointACCObj19_Stopped_b=rawValue;        
    }                                                                           
}

on envVar E_pric_RadarFrontCenter_TrajPointACCObj19_TrajPointACCObj19_Stopped_b_Pv
{
    qword rawValue = 0ll;
    float phyValue = 0.0;
    
    //update the raw value with physical value 
    if(getValue(E_pric_RadarFrontCenter_TrajPointACCObj19_TrajPointACCObj19_Stopped_b_SetVt)==0)
    {
        if(chgEv_TrajPointACCObj19_TrajPointACCObj19_Stopped_b == 0)
        {
            phyValue = getvalue(this);
            // physical to raw conversion
            rawValue = ((phyValue -(0))/1);
            putValue(E_pric_RadarFrontCenter_TrajPointACCObj19_TrajPointACCObj19_Stopped_b_Rv, rawValue);
            chgEv_TrajPointACCObj19_TrajPointACCObj19_Stopped_b = 1;  
        }
        else
        {
            chgEv_TrajPointACCObj19_TrajPointACCObj19_Stopped_b = 0;
        }
    }
}

on envVar E_pric_RadarFrontCenter_TrajPointACCObj19_TrajPointACCObj19_Stopped_b_Vt
{
    qword rawValue = 0ll;
    if(getValue(E_pric_RadarFrontCenter_TrajPointACCObj19_TrajPointACCObj19_Stopped_b_SetVt))
    {
        //update the signal value
        Msg_TrajPointACCObj19.TrajPointACCObj19_Stopped_b=getValue(this);
    }
}

on envVar E_pric_RadarFrontCenter_TrajPointACCObj19_TrajPointACCObj19_Stopped_b_SetVt
{
    if(getValue(E_pric_RadarFrontCenter_TrajPointACCObj19_TrajPointACCObj19_Stopped_b_SetVt))
    {
        //update the signal value
        Msg_TrajPointACCObj19.TrajPointACCObj19_Stopped_b=getvalue(E_pric_RadarFrontCenter_TrajPointACCObj19_TrajPointACCObj19_Stopped_b_Vt);
    }
    else
    {
        Msg_TrajPointACCObj19.TrajPointACCObj19_Stopped_b=getValue(E_pric_RadarFrontCenter_TrajPointACCObj19_TrajPointACCObj19_Stopped_b_Rv);
    }
}
 
on envVar E_pric_RadarFrontCenter_TrajPointACCObj19_TrajPointACCObj19_dxv_sw_Rv
{
    qword rawValue = 0ll;
    float rawValue_float = 0.0;
    float phyValue = 0.0;        

    //set the signal with updated raw value
    {
        rawValue = getvalue(this);
        if(chgEv_TrajPointACCObj19_TrajPointACCObj19_dxv_sw == 0)
        {
            //type conversion to float
            rawValue_float = rawValue;        
            // raw to physical conversion
            phyValue = ((rawValue_float *0.0078125)+(0));
            putValue(E_pric_RadarFrontCenter_TrajPointACCObj19_TrajPointACCObj19_dxv_sw_Pv, phyValue);
            chgEv_TrajPointACCObj19_TrajPointACCObj19_dxv_sw = 1;
        }
        else
        {
            chgEv_TrajPointACCObj19_TrajPointACCObj19_dxv_sw = 0;
        }    
        //update the signal value
        Msg_TrajPointACCObj19.TrajPointACCObj19_dxv_sw=rawValue;        
    }                                                                           
}

on envVar E_pric_RadarFrontCenter_TrajPointACCObj19_TrajPointACCObj19_dxv_sw_Pv
{
    qword rawValue = 0ll;
    float phyValue = 0.0;
    
    //update the raw value with physical value 
    {
        if(chgEv_TrajPointACCObj19_TrajPointACCObj19_dxv_sw == 0)
        {
            phyValue = getvalue(this);
            // physical to raw conversion
            rawValue = ((phyValue -(0))/0.0078125);
            putValue(E_pric_RadarFrontCenter_TrajPointACCObj19_TrajPointACCObj19_dxv_sw_Rv, rawValue);
            chgEv_TrajPointACCObj19_TrajPointACCObj19_dxv_sw = 1;  
        }
        else
        {
            chgEv_TrajPointACCObj19_TrajPointACCObj19_dxv_sw = 0;
        }
    }
}


 
on envVar E_pric_RadarFrontCenter_TrajPointACCObj19_TrajPointACCObj19_Stand_b_Rv
{
    qword rawValue = 0ll;
    float rawValue_float = 0.0;
    float phyValue = 0.0;        

    //set the signal with updated raw value
    if(getValue(E_pric_RadarFrontCenter_TrajPointACCObj19_TrajPointACCObj19_Stand_b_SetVt)==0)
    {
        rawValue = getvalue(this);
        if(chgEv_TrajPointACCObj19_TrajPointACCObj19_Stand_b == 0)
        {
            //type conversion to float
            rawValue_float = rawValue;        
            // raw to physical conversion
            phyValue = ((rawValue_float *1)+(0));
            putValue(E_pric_RadarFrontCenter_TrajPointACCObj19_TrajPointACCObj19_Stand_b_Pv, phyValue);
            chgEv_TrajPointACCObj19_TrajPointACCObj19_Stand_b = 1;
        }
        else
        {
            chgEv_TrajPointACCObj19_TrajPointACCObj19_Stand_b = 0;
        }    
        //update the signal value
        Msg_TrajPointACCObj19.TrajPointACCObj19_Stand_b=rawValue;        
    }                                                                           
}

on envVar E_pric_RadarFrontCenter_TrajPointACCObj19_TrajPointACCObj19_Stand_b_Pv
{
    qword rawValue = 0ll;
    float phyValue = 0.0;
    
    //update the raw value with physical value 
    if(getValue(E_pric_RadarFrontCenter_TrajPointACCObj19_TrajPointACCObj19_Stand_b_SetVt)==0)
    {
        if(chgEv_TrajPointACCObj19_TrajPointACCObj19_Stand_b == 0)
        {
            phyValue = getvalue(this);
            // physical to raw conversion
            rawValue = ((phyValue -(0))/1);
            putValue(E_pric_RadarFrontCenter_TrajPointACCObj19_TrajPointACCObj19_Stand_b_Rv, rawValue);
            chgEv_TrajPointACCObj19_TrajPointACCObj19_Stand_b = 1;  
        }
        else
        {
            chgEv_TrajPointACCObj19_TrajPointACCObj19_Stand_b = 0;
        }
    }
}

on envVar E_pric_RadarFrontCenter_TrajPointACCObj19_TrajPointACCObj19_Stand_b_Vt
{
    qword rawValue = 0ll;
    if(getValue(E_pric_RadarFrontCenter_TrajPointACCObj19_TrajPointACCObj19_Stand_b_SetVt))
    {
        //update the signal value
        Msg_TrajPointACCObj19.TrajPointACCObj19_Stand_b=getValue(this);
    }
}

on envVar E_pric_RadarFrontCenter_TrajPointACCObj19_TrajPointACCObj19_Stand_b_SetVt
{
    if(getValue(E_pric_RadarFrontCenter_TrajPointACCObj19_TrajPointACCObj19_Stand_b_SetVt))
    {
        //update the signal value
        Msg_TrajPointACCObj19.TrajPointACCObj19_Stand_b=getvalue(E_pric_RadarFrontCenter_TrajPointACCObj19_TrajPointACCObj19_Stand_b_Vt);
    }
    else
    {
        Msg_TrajPointACCObj19.TrajPointACCObj19_Stand_b=getValue(E_pric_RadarFrontCenter_TrajPointACCObj19_TrajPointACCObj19_Stand_b_Rv);
    }
}
 
on envVar E_pric_RadarFrontCenter_TrajPointACCObj19_TrajPointACCObj19_wExistProb_ub_Rv
{
    qword rawValue = 0ll;
    float rawValue_float = 0.0;
    float phyValue = 0.0;        

    //set the signal with updated raw value
    {
        rawValue = getvalue(this);
        if(chgEv_TrajPointACCObj19_TrajPointACCObj19_wExistProb_ub == 0)
        {
            //type conversion to float
            rawValue_float = rawValue;        
            // raw to physical conversion
            phyValue = ((rawValue_float *0.00390625)+(0));
            putValue(E_pric_RadarFrontCenter_TrajPointACCObj19_TrajPointACCObj19_wExistProb_ub_Pv, phyValue);
            chgEv_TrajPointACCObj19_TrajPointACCObj19_wExistProb_ub = 1;
        }
        else
        {
            chgEv_TrajPointACCObj19_TrajPointACCObj19_wExistProb_ub = 0;
        }    
        //update the signal value
        Msg_TrajPointACCObj19.TrajPointACCObj19_wExistProb_ub=rawValue;        
    }                                                                           
}

on envVar E_pric_RadarFrontCenter_TrajPointACCObj19_TrajPointACCObj19_wExistProb_ub_Pv
{
    qword rawValue = 0ll;
    float phyValue = 0.0;
    
    //update the raw value with physical value 
    {
        if(chgEv_TrajPointACCObj19_TrajPointACCObj19_wExistProb_ub == 0)
        {
            phyValue = getvalue(this);
            // physical to raw conversion
            rawValue = ((phyValue -(0))/0.00390625);
            putValue(E_pric_RadarFrontCenter_TrajPointACCObj19_TrajPointACCObj19_wExistProb_ub_Rv, rawValue);
            chgEv_TrajPointACCObj19_TrajPointACCObj19_wExistProb_ub = 1;  
        }
        else
        {
            chgEv_TrajPointACCObj19_TrajPointACCObj19_wExistProb_ub = 0;
        }
    }
}


 
on envVar E_pric_RadarFrontCenter_TrajPointACCObj19_TrajPointACCObj19_dVarYv_uw_Rv
{
    qword rawValue = 0ll;
    float rawValue_float = 0.0;
    float phyValue = 0.0;        

    //set the signal with updated raw value
    {
        rawValue = getvalue(this);
        if(chgEv_TrajPointACCObj19_TrajPointACCObj19_dVarYv_uw == 0)
        {
            //type conversion to float
            rawValue_float = rawValue;        
            // raw to physical conversion
            phyValue = ((rawValue_float *0.00195313)+(0));
            putValue(E_pric_RadarFrontCenter_TrajPointACCObj19_TrajPointACCObj19_dVarYv_uw_Pv, phyValue);
            chgEv_TrajPointACCObj19_TrajPointACCObj19_dVarYv_uw = 1;
        }
        else
        {
            chgEv_TrajPointACCObj19_TrajPointACCObj19_dVarYv_uw = 0;
        }    
        //update the signal value
        Msg_TrajPointACCObj19.TrajPointACCObj19_dVarYv_uw=rawValue;        
    }                                                                           
}

on envVar E_pric_RadarFrontCenter_TrajPointACCObj19_TrajPointACCObj19_dVarYv_uw_Pv
{
    qword rawValue = 0ll;
    float phyValue = 0.0;
    
    //update the raw value with physical value 
    {
        if(chgEv_TrajPointACCObj19_TrajPointACCObj19_dVarYv_uw == 0)
        {
            phyValue = getvalue(this);
            // physical to raw conversion
            rawValue = ((phyValue -(0))/0.00195313);
            putValue(E_pric_RadarFrontCenter_TrajPointACCObj19_TrajPointACCObj19_dVarYv_uw_Rv, rawValue);
            chgEv_TrajPointACCObj19_TrajPointACCObj19_dVarYv_uw = 1;  
        }
        else
        {
            chgEv_TrajPointACCObj19_TrajPointACCObj19_dVarYv_uw = 0;
        }
    }
}


 
on envVar E_pric_RadarFrontCenter_TrajPointACCObj19_TrajPointACCObj19_dVarXv_uw_Rv
{
    qword rawValue = 0ll;
    float rawValue_float = 0.0;
    float phyValue = 0.0;        

    //set the signal with updated raw value
    {
        rawValue = getvalue(this);
        if(chgEv_TrajPointACCObj19_TrajPointACCObj19_dVarXv_uw == 0)
        {
            //type conversion to float
            rawValue_float = rawValue;        
            // raw to physical conversion
            phyValue = ((rawValue_float *0.00195313)+(0));
            putValue(E_pric_RadarFrontCenter_TrajPointACCObj19_TrajPointACCObj19_dVarXv_uw_Pv, phyValue);
            chgEv_TrajPointACCObj19_TrajPointACCObj19_dVarXv_uw = 1;
        }
        else
        {
            chgEv_TrajPointACCObj19_TrajPointACCObj19_dVarXv_uw = 0;
        }    
        //update the signal value
        Msg_TrajPointACCObj19.TrajPointACCObj19_dVarXv_uw=rawValue;        
    }                                                                           
}

on envVar E_pric_RadarFrontCenter_TrajPointACCObj19_TrajPointACCObj19_dVarXv_uw_Pv
{
    qword rawValue = 0ll;
    float phyValue = 0.0;
    
    //update the raw value with physical value 
    {
        if(chgEv_TrajPointACCObj19_TrajPointACCObj19_dVarXv_uw == 0)
        {
            phyValue = getvalue(this);
            // physical to raw conversion
            rawValue = ((phyValue -(0))/0.00195313);
            putValue(E_pric_RadarFrontCenter_TrajPointACCObj19_TrajPointACCObj19_dVarXv_uw_Rv, rawValue);
            chgEv_TrajPointACCObj19_TrajPointACCObj19_dVarXv_uw = 1;  
        }
        else
        {
            chgEv_TrajPointACCObj19_TrajPointACCObj19_dVarXv_uw = 0;
        }
    }
}


 
on envVar E_pric_RadarFrontCenter_TrajPointACCObj19_TrajPointACCObj19_Valid_b_Rv
{
    qword rawValue = 0ll;
    float rawValue_float = 0.0;
    float phyValue = 0.0;        

    //set the signal with updated raw value
    if(getValue(E_pric_RadarFrontCenter_TrajPointACCObj19_TrajPointACCObj19_Valid_b_SetVt)==0)
    {
        rawValue = getvalue(this);
        if(chgEv_TrajPointACCObj19_TrajPointACCObj19_Valid_b == 0)
        {
            //type conversion to float
            rawValue_float = rawValue;        
            // raw to physical conversion
            phyValue = ((rawValue_float *1)+(0));
            putValue(E_pric_RadarFrontCenter_TrajPointACCObj19_TrajPointACCObj19_Valid_b_Pv, phyValue);
            chgEv_TrajPointACCObj19_TrajPointACCObj19_Valid_b = 1;
        }
        else
        {
            chgEv_TrajPointACCObj19_TrajPointACCObj19_Valid_b = 0;
        }    
        //update the signal value
        Msg_TrajPointACCObj19.TrajPointACCObj19_Valid_b=rawValue;        
    }                                                                           
}

on envVar E_pric_RadarFrontCenter_TrajPointACCObj19_TrajPointACCObj19_Valid_b_Pv
{
    qword rawValue = 0ll;
    float phyValue = 0.0;
    
    //update the raw value with physical value 
    if(getValue(E_pric_RadarFrontCenter_TrajPointACCObj19_TrajPointACCObj19_Valid_b_SetVt)==0)
    {
        if(chgEv_TrajPointACCObj19_TrajPointACCObj19_Valid_b == 0)
        {
            phyValue = getvalue(this);
            // physical to raw conversion
            rawValue = ((phyValue -(0))/1);
            putValue(E_pric_RadarFrontCenter_TrajPointACCObj19_TrajPointACCObj19_Valid_b_Rv, rawValue);
            chgEv_TrajPointACCObj19_TrajPointACCObj19_Valid_b = 1;  
        }
        else
        {
            chgEv_TrajPointACCObj19_TrajPointACCObj19_Valid_b = 0;
        }
    }
}

on envVar E_pric_RadarFrontCenter_TrajPointACCObj19_TrajPointACCObj19_Valid_b_Vt
{
    qword rawValue = 0ll;
    if(getValue(E_pric_RadarFrontCenter_TrajPointACCObj19_TrajPointACCObj19_Valid_b_SetVt))
    {
        //update the signal value
        Msg_TrajPointACCObj19.TrajPointACCObj19_Valid_b=getValue(this);
    }
}

on envVar E_pric_RadarFrontCenter_TrajPointACCObj19_TrajPointACCObj19_Valid_b_SetVt
{
    if(getValue(E_pric_RadarFrontCenter_TrajPointACCObj19_TrajPointACCObj19_Valid_b_SetVt))
    {
        //update the signal value
        Msg_TrajPointACCObj19.TrajPointACCObj19_Valid_b=getvalue(E_pric_RadarFrontCenter_TrajPointACCObj19_TrajPointACCObj19_Valid_b_Vt);
    }
    else
    {
        Msg_TrajPointACCObj19.TrajPointACCObj19_Valid_b=getValue(E_pric_RadarFrontCenter_TrajPointACCObj19_TrajPointACCObj19_Valid_b_Rv);
    }
}
 
on envVar E_pric_RadarFrontCenter_TrajPointACCObj19_TrajPointACCObj19_TrajEnd_b_Rv
{
    qword rawValue = 0ll;
    float rawValue_float = 0.0;
    float phyValue = 0.0;        

    //set the signal with updated raw value
    if(getValue(E_pric_RadarFrontCenter_TrajPointACCObj19_TrajPointACCObj19_TrajEnd_b_SetVt)==0)
    {
        rawValue = getvalue(this);
        if(chgEv_TrajPointACCObj19_TrajPointACCObj19_TrajEnd_b == 0)
        {
            //type conversion to float
            rawValue_float = rawValue;        
            // raw to physical conversion
            phyValue = ((rawValue_float *1)+(0));
            putValue(E_pric_RadarFrontCenter_TrajPointACCObj19_TrajPointACCObj19_TrajEnd_b_Pv, phyValue);
            chgEv_TrajPointACCObj19_TrajPointACCObj19_TrajEnd_b = 1;
        }
        else
        {
            chgEv_TrajPointACCObj19_TrajPointACCObj19_TrajEnd_b = 0;
        }    
        //update the signal value
        Msg_TrajPointACCObj19.TrajPointACCObj19_TrajEnd_b=rawValue;        
    }                                                                           
}

on envVar E_pric_RadarFrontCenter_TrajPointACCObj19_TrajPointACCObj19_TrajEnd_b_Pv
{
    qword rawValue = 0ll;
    float phyValue = 0.0;
    
    //update the raw value with physical value 
    if(getValue(E_pric_RadarFrontCenter_TrajPointACCObj19_TrajPointACCObj19_TrajEnd_b_SetVt)==0)
    {
        if(chgEv_TrajPointACCObj19_TrajPointACCObj19_TrajEnd_b == 0)
        {
            phyValue = getvalue(this);
            // physical to raw conversion
            rawValue = ((phyValue -(0))/1);
            putValue(E_pric_RadarFrontCenter_TrajPointACCObj19_TrajPointACCObj19_TrajEnd_b_Rv, rawValue);
            chgEv_TrajPointACCObj19_TrajPointACCObj19_TrajEnd_b = 1;  
        }
        else
        {
            chgEv_TrajPointACCObj19_TrajPointACCObj19_TrajEnd_b = 0;
        }
    }
}

on envVar E_pric_RadarFrontCenter_TrajPointACCObj19_TrajPointACCObj19_TrajEnd_b_Vt
{
    qword rawValue = 0ll;
    if(getValue(E_pric_RadarFrontCenter_TrajPointACCObj19_TrajPointACCObj19_TrajEnd_b_SetVt))
    {
        //update the signal value
        Msg_TrajPointACCObj19.TrajPointACCObj19_TrajEnd_b=getValue(this);
    }
}

on envVar E_pric_RadarFrontCenter_TrajPointACCObj19_TrajPointACCObj19_TrajEnd_b_SetVt
{
    if(getValue(E_pric_RadarFrontCenter_TrajPointACCObj19_TrajPointACCObj19_TrajEnd_b_SetVt))
    {
        //update the signal value
        Msg_TrajPointACCObj19.TrajPointACCObj19_TrajEnd_b=getvalue(E_pric_RadarFrontCenter_TrajPointACCObj19_TrajPointACCObj19_TrajEnd_b_Vt);
    }
    else
    {
        Msg_TrajPointACCObj19.TrajPointACCObj19_TrajEnd_b=getValue(E_pric_RadarFrontCenter_TrajPointACCObj19_TrajPointACCObj19_TrajEnd_b_Rv);
    }
}
 
on envVar E_pric_RadarFrontCenter_TrajPointACCObj19_TrajPointACCObj19_timestamp_Rv
{
    qword rawValue = 0ll;
    float rawValue_float = 0.0;
    float phyValue = 0.0;        

    //set the signal with updated raw value
    {
        rawValue = getvalue(this);
        if(chgEv_TrajPointACCObj19_TrajPointACCObj19_timestamp == 0)
        {
            //type conversion to float
            rawValue_float = rawValue;        
            // raw to physical conversion
            phyValue = ((rawValue_float *0.000488281)+(0));
            putValue(E_pric_RadarFrontCenter_TrajPointACCObj19_TrajPointACCObj19_timestamp_Pv, phyValue);
            chgEv_TrajPointACCObj19_TrajPointACCObj19_timestamp = 1;
        }
        else
        {
            chgEv_TrajPointACCObj19_TrajPointACCObj19_timestamp = 0;
        }    
        //update the signal value
        Msg_TrajPointACCObj19.TrajPointACCObj19_timestamp=rawValue;        
    }                                                                           
}

on envVar E_pric_RadarFrontCenter_TrajPointACCObj19_TrajPointACCObj19_timestamp_Pv
{
    qword rawValue = 0ll;
    float phyValue = 0.0;
    
    //update the raw value with physical value 
    {
        if(chgEv_TrajPointACCObj19_TrajPointACCObj19_timestamp == 0)
        {
            phyValue = getvalue(this);
            // physical to raw conversion
            rawValue = ((phyValue -(0))/0.000488281);
            putValue(E_pric_RadarFrontCenter_TrajPointACCObj19_TrajPointACCObj19_timestamp_Rv, rawValue);
            chgEv_TrajPointACCObj19_TrajPointACCObj19_timestamp = 1;  
        }
        else
        {
            chgEv_TrajPointACCObj19_TrajPointACCObj19_timestamp = 0;
        }
    }
}


 
on envVar E_pric_RadarFrontCenter_TrajPointACCObj18_tx
{
    if(getValue(this))
    {       
        
        //update the BZ Signal
        if(TrajPointACCObj18_TrajPointACCObj18_blockCtr_wrongvalctr == 0)
        {
            update_TrajPointACCObj18_TrajPointACCObj18_blockCtr_counter();
            Msg_TrajPointACCObj18.TrajPointACCObj18_blockCtr= TrajPointACCObj18_TrajPointACCObj18_blockCtr_counter;
        }
        else if(TrajPointACCObj18_TrajPointACCObj18_blockCtr_wrongvalctr > 0)
        {
             TrajPointACCObj18_TrajPointACCObj18_blockCtr_wrongvalctr--;
              // if counter becomes zero, update panel controller to zero
             if(TrajPointACCObj18_TrajPointACCObj18_blockCtr_wrongvalctr == 0)
             {
                 putValue(E_pric_RadarFrontCenter_TrajPointACCObj18_TrajPointACCObj18_blockCtr_wrongvalctr,0);
             }
        }
        else
        {
            //do nothing
        }        
        //update the BZ Signal
        if(TrajPointACCObj18_TrajPointACCObj18_MsgCtr_wrongvalctr == 0)
        {
            update_TrajPointACCObj18_TrajPointACCObj18_MsgCtr_counter();
            Msg_TrajPointACCObj18.TrajPointACCObj18_MsgCtr= TrajPointACCObj18_TrajPointACCObj18_MsgCtr_counter;
        }
        else if(TrajPointACCObj18_TrajPointACCObj18_MsgCtr_wrongvalctr > 0)
        {
             TrajPointACCObj18_TrajPointACCObj18_MsgCtr_wrongvalctr--;
              // if counter becomes zero, update panel controller to zero
             if(TrajPointACCObj18_TrajPointACCObj18_MsgCtr_wrongvalctr == 0)
             {
                 putValue(E_pric_RadarFrontCenter_TrajPointACCObj18_TrajPointACCObj18_MsgCtr_wrongvalctr,0);
             }
        }
        else
        {
            //do nothing
        }        
        //calculate the CRC checksum
        update_TrajPointACCObj18_ChkSum_Checksum();

        output(Msg_TrajPointACCObj18);        
    }
}

on envVar E_pric_RadarFrontCenter_TrajPointACCObj18_Range
{
    qword rawstatus = 0ll;
    qword rawValue = 0ll;    
    
    rawstatus = getvalue(this);    
    // set all the signals with min raw /max raw /init raw
    switch (rawstatus) 
    {
     case(0) :
        rawValue= 0;
        putValue(E_pric_RadarFrontCenter_TrajPointACCObj18_TrajPointACCObj18_TrajEnd_b_Rv, rawValue);
        rawValue= -32768;
        putValue(E_pric_RadarFrontCenter_TrajPointACCObj18_TrajPointACCObj18_dxv_sw_Rv, rawValue);
        rawValue= 0;
        putValue(E_pric_RadarFrontCenter_TrajPointACCObj18_TrajPointACCObj18_Valid_b_Rv, rawValue);
        rawValue= 0;
        putValue(E_pric_RadarFrontCenter_TrajPointACCObj18_TrajPointACCObj18_Stopped_b_Rv, rawValue);
        rawValue= 0;
        putValue(E_pric_RadarFrontCenter_TrajPointACCObj18_TrajPointACCObj18_Stand_b_Rv, rawValue);
        rawValue= 0;
        putValue(E_pric_RadarFrontCenter_TrajPointACCObj18_TrajPointACCObj18_Drive_b_Rv, rawValue);
        rawValue= 0;
        putValue(E_pric_RadarFrontCenter_TrajPointACCObj18_TrajPointACCObj18_timestamp_Rv, rawValue);
        rawValue= 0;
        putValue(E_pric_RadarFrontCenter_TrajPointACCObj18_TrajPointACCObj18_dVarYv_uw_Rv, rawValue);
        rawValue= 0;
        putValue(E_pric_RadarFrontCenter_TrajPointACCObj18_TrajPointACCObj18_InvDir_b_Rv, rawValue);
        rawValue= -32768;
        putValue(E_pric_RadarFrontCenter_TrajPointACCObj18_TrajPointACCObj18_dyv_sw_Rv, rawValue);
        rawValue= 0;
        putValue(E_pric_RadarFrontCenter_TrajPointACCObj18_TrajPointACCObj18_dVarXv_uw_Rv, rawValue);
        rawValue= 0;
        putValue(E_pric_RadarFrontCenter_TrajPointACCObj18_TrajPointACCObj18_wExistProb_ub_Rv, rawValue);
        break;
     case(1) :
        rawValue= 1;
        putValue(E_pric_RadarFrontCenter_TrajPointACCObj18_TrajPointACCObj18_TrajEnd_b_Rv, rawValue);
        rawValue= 32767;
        putValue(E_pric_RadarFrontCenter_TrajPointACCObj18_TrajPointACCObj18_dxv_sw_Rv, rawValue);
        rawValue= 1;
        putValue(E_pric_RadarFrontCenter_TrajPointACCObj18_TrajPointACCObj18_Valid_b_Rv, rawValue);
        rawValue= 1;
        putValue(E_pric_RadarFrontCenter_TrajPointACCObj18_TrajPointACCObj18_Stopped_b_Rv, rawValue);
        rawValue= 1;
        putValue(E_pric_RadarFrontCenter_TrajPointACCObj18_TrajPointACCObj18_Stand_b_Rv, rawValue);
        rawValue= 1;
        putValue(E_pric_RadarFrontCenter_TrajPointACCObj18_TrajPointACCObj18_Drive_b_Rv, rawValue);
        rawValue= 65536;
        putValue(E_pric_RadarFrontCenter_TrajPointACCObj18_TrajPointACCObj18_timestamp_Rv, rawValue);
        rawValue= 65534;
        putValue(E_pric_RadarFrontCenter_TrajPointACCObj18_TrajPointACCObj18_dVarYv_uw_Rv, rawValue);
        rawValue= 1;
        putValue(E_pric_RadarFrontCenter_TrajPointACCObj18_TrajPointACCObj18_InvDir_b_Rv, rawValue);
        rawValue= 32767;
        putValue(E_pric_RadarFrontCenter_TrajPointACCObj18_TrajPointACCObj18_dyv_sw_Rv, rawValue);
        rawValue= 65534;
        putValue(E_pric_RadarFrontCenter_TrajPointACCObj18_TrajPointACCObj18_dVarXv_uw_Rv, rawValue);
        rawValue= 255;
        putValue(E_pric_RadarFrontCenter_TrajPointACCObj18_TrajPointACCObj18_wExistProb_ub_Rv, rawValue);
        break;
     default :
        rawValue= 0;
        putValue(E_pric_RadarFrontCenter_TrajPointACCObj18_TrajPointACCObj18_TrajEnd_b_Rv, rawValue);
        rawValue= -32768;
        putValue(E_pric_RadarFrontCenter_TrajPointACCObj18_TrajPointACCObj18_dxv_sw_Rv, rawValue);
        rawValue= 0;
        putValue(E_pric_RadarFrontCenter_TrajPointACCObj18_TrajPointACCObj18_Valid_b_Rv, rawValue);
        rawValue= 0;
        putValue(E_pric_RadarFrontCenter_TrajPointACCObj18_TrajPointACCObj18_Stopped_b_Rv, rawValue);
        rawValue= 0;
        putValue(E_pric_RadarFrontCenter_TrajPointACCObj18_TrajPointACCObj18_Stand_b_Rv, rawValue);
        rawValue= 0;
        putValue(E_pric_RadarFrontCenter_TrajPointACCObj18_TrajPointACCObj18_Drive_b_Rv, rawValue);
        rawValue= 0;
        putValue(E_pric_RadarFrontCenter_TrajPointACCObj18_TrajPointACCObj18_timestamp_Rv, rawValue);
        rawValue= 0;
        putValue(E_pric_RadarFrontCenter_TrajPointACCObj18_TrajPointACCObj18_dVarYv_uw_Rv, rawValue);
        rawValue= 0;
        putValue(E_pric_RadarFrontCenter_TrajPointACCObj18_TrajPointACCObj18_InvDir_b_Rv, rawValue);
        rawValue= -32768;
        putValue(E_pric_RadarFrontCenter_TrajPointACCObj18_TrajPointACCObj18_dyv_sw_Rv, rawValue);
        rawValue= 0;
        putValue(E_pric_RadarFrontCenter_TrajPointACCObj18_TrajPointACCObj18_dVarXv_uw_Rv, rawValue);
        rawValue= 0;
        putValue(E_pric_RadarFrontCenter_TrajPointACCObj18_TrajPointACCObj18_wExistProb_ub_Rv, rawValue);
      break;
   }
}

on envVar E_pric_RadarFrontCenter_TrajPointACCObj18_Dlc
{
    if(getValue(E_pric_RadarFrontCenter_TrajPointACCObj18_enDlc))
    {
        Msg_TrajPointACCObj18.dlc =getValue(this);
    }
    else
    {
       Dbc_dlc = 16;
	   Msg_TrajPointACCObj18.dlc = Calc_Canfd_dlc(Dbc_dlc);
	   	
  }
}

on envVar E_pric_RadarFrontCenter_TrajPointACCObj18_enDlc
{
    //For Messages with DLC = 8, set wrong DLC to smaller than defined DLC
    //For Messages with DLC < 8 set wrong DLC to smaller/longer than defined DLC
    if(getValue(this))
    {
        Msg_TrajPointACCObj18.dlc =getValue(E_pric_RadarFrontCenter_TrajPointACCObj18_Dlc);
    }
    else
    {
       Dbc_dlc = 16;
	   Msg_TrajPointACCObj18.dlc = Calc_Canfd_dlc(Dbc_dlc);
			
    }
}

on envVar E_pric_RadarFrontCenter_TrajPointACCObj18_TrajPointACCObj18_CRC_wrongvalctr
{
    //update disturb count
    //disturb value range:(-1 = always send wrong value),( X>0 ,x is the number of Messages with wrong CHK sent)
    TrajPointACCObj18_TrajPointACCObj18_CRC_wrongvalctr =getValue(this);    
}
on envVar E_pric_RadarFrontCenter_TrajPointACCObj18_TrajPointACCObj18_MsgCtr_wrongvalctr
{
    //update disturb count
    //disturb value range:(-1 = always send wrong value),( X>0 ,x is the number of Messages with wrong CHK sent)
    TrajPointACCObj18_TrajPointACCObj18_MsgCtr_wrongvalctr =getValue(this);    
}
on envVar E_pric_RadarFrontCenter_TrajPointACCObj18_TrajPointACCObj18_blockCtr_wrongvalctr
{
    //update disturb count
    //disturb value range:(-1 = always send wrong value),( X>0 ,x is the number of Messages with wrong CHK sent)
    TrajPointACCObj18_TrajPointACCObj18_blockCtr_wrongvalctr =getValue(this);    
}

on envVar E_pric_RadarFrontCenter_TrajPointACCObj18_TrajPointACCObj18_TrajEnd_b_Rv
{
    qword rawValue = 0ll;
    float rawValue_float = 0.0;
    float phyValue = 0.0;        

    //set the signal with updated raw value
    if(getValue(E_pric_RadarFrontCenter_TrajPointACCObj18_TrajPointACCObj18_TrajEnd_b_SetVt)==0)
    {
        rawValue = getvalue(this);
        if(chgEv_TrajPointACCObj18_TrajPointACCObj18_TrajEnd_b == 0)
        {
            //type conversion to float
            rawValue_float = rawValue;        
            // raw to physical conversion
            phyValue = ((rawValue_float *1)+(0));
            putValue(E_pric_RadarFrontCenter_TrajPointACCObj18_TrajPointACCObj18_TrajEnd_b_Pv, phyValue);
            chgEv_TrajPointACCObj18_TrajPointACCObj18_TrajEnd_b = 1;
        }
        else
        {
            chgEv_TrajPointACCObj18_TrajPointACCObj18_TrajEnd_b = 0;
        }    
        //update the signal value
        Msg_TrajPointACCObj18.TrajPointACCObj18_TrajEnd_b=rawValue;        
    }                                                                           
}

on envVar E_pric_RadarFrontCenter_TrajPointACCObj18_TrajPointACCObj18_TrajEnd_b_Pv
{
    qword rawValue = 0ll;
    float phyValue = 0.0;
    
    //update the raw value with physical value 
    if(getValue(E_pric_RadarFrontCenter_TrajPointACCObj18_TrajPointACCObj18_TrajEnd_b_SetVt)==0)
    {
        if(chgEv_TrajPointACCObj18_TrajPointACCObj18_TrajEnd_b == 0)
        {
            phyValue = getvalue(this);
            // physical to raw conversion
            rawValue = ((phyValue -(0))/1);
            putValue(E_pric_RadarFrontCenter_TrajPointACCObj18_TrajPointACCObj18_TrajEnd_b_Rv, rawValue);
            chgEv_TrajPointACCObj18_TrajPointACCObj18_TrajEnd_b = 1;  
        }
        else
        {
            chgEv_TrajPointACCObj18_TrajPointACCObj18_TrajEnd_b = 0;
        }
    }
}

on envVar E_pric_RadarFrontCenter_TrajPointACCObj18_TrajPointACCObj18_TrajEnd_b_Vt
{
    qword rawValue = 0ll;
    if(getValue(E_pric_RadarFrontCenter_TrajPointACCObj18_TrajPointACCObj18_TrajEnd_b_SetVt))
    {
        //update the signal value
        Msg_TrajPointACCObj18.TrajPointACCObj18_TrajEnd_b=getValue(this);
    }
}

on envVar E_pric_RadarFrontCenter_TrajPointACCObj18_TrajPointACCObj18_TrajEnd_b_SetVt
{
    if(getValue(E_pric_RadarFrontCenter_TrajPointACCObj18_TrajPointACCObj18_TrajEnd_b_SetVt))
    {
        //update the signal value
        Msg_TrajPointACCObj18.TrajPointACCObj18_TrajEnd_b=getvalue(E_pric_RadarFrontCenter_TrajPointACCObj18_TrajPointACCObj18_TrajEnd_b_Vt);
    }
    else
    {
        Msg_TrajPointACCObj18.TrajPointACCObj18_TrajEnd_b=getValue(E_pric_RadarFrontCenter_TrajPointACCObj18_TrajPointACCObj18_TrajEnd_b_Rv);
    }
}
 
on envVar E_pric_RadarFrontCenter_TrajPointACCObj18_TrajPointACCObj18_dxv_sw_Rv
{
    qword rawValue = 0ll;
    float rawValue_float = 0.0;
    float phyValue = 0.0;        

    //set the signal with updated raw value
    {
        rawValue = getvalue(this);
        if(chgEv_TrajPointACCObj18_TrajPointACCObj18_dxv_sw == 0)
        {
            //type conversion to float
            rawValue_float = rawValue;        
            // raw to physical conversion
            phyValue = ((rawValue_float *0.0078125)+(0));
            putValue(E_pric_RadarFrontCenter_TrajPointACCObj18_TrajPointACCObj18_dxv_sw_Pv, phyValue);
            chgEv_TrajPointACCObj18_TrajPointACCObj18_dxv_sw = 1;
        }
        else
        {
            chgEv_TrajPointACCObj18_TrajPointACCObj18_dxv_sw = 0;
        }    
        //update the signal value
        Msg_TrajPointACCObj18.TrajPointACCObj18_dxv_sw=rawValue;        
    }                                                                           
}

on envVar E_pric_RadarFrontCenter_TrajPointACCObj18_TrajPointACCObj18_dxv_sw_Pv
{
    qword rawValue = 0ll;
    float phyValue = 0.0;
    
    //update the raw value with physical value 
    {
        if(chgEv_TrajPointACCObj18_TrajPointACCObj18_dxv_sw == 0)
        {
            phyValue = getvalue(this);
            // physical to raw conversion
            rawValue = ((phyValue -(0))/0.0078125);
            putValue(E_pric_RadarFrontCenter_TrajPointACCObj18_TrajPointACCObj18_dxv_sw_Rv, rawValue);
            chgEv_TrajPointACCObj18_TrajPointACCObj18_dxv_sw = 1;  
        }
        else
        {
            chgEv_TrajPointACCObj18_TrajPointACCObj18_dxv_sw = 0;
        }
    }
}


 
on envVar E_pric_RadarFrontCenter_TrajPointACCObj18_TrajPointACCObj18_Valid_b_Rv
{
    qword rawValue = 0ll;
    float rawValue_float = 0.0;
    float phyValue = 0.0;        

    //set the signal with updated raw value
    if(getValue(E_pric_RadarFrontCenter_TrajPointACCObj18_TrajPointACCObj18_Valid_b_SetVt)==0)
    {
        rawValue = getvalue(this);
        if(chgEv_TrajPointACCObj18_TrajPointACCObj18_Valid_b == 0)
        {
            //type conversion to float
            rawValue_float = rawValue;        
            // raw to physical conversion
            phyValue = ((rawValue_float *1)+(0));
            putValue(E_pric_RadarFrontCenter_TrajPointACCObj18_TrajPointACCObj18_Valid_b_Pv, phyValue);
            chgEv_TrajPointACCObj18_TrajPointACCObj18_Valid_b = 1;
        }
        else
        {
            chgEv_TrajPointACCObj18_TrajPointACCObj18_Valid_b = 0;
        }    
        //update the signal value
        Msg_TrajPointACCObj18.TrajPointACCObj18_Valid_b=rawValue;        
    }                                                                           
}

on envVar E_pric_RadarFrontCenter_TrajPointACCObj18_TrajPointACCObj18_Valid_b_Pv
{
    qword rawValue = 0ll;
    float phyValue = 0.0;
    
    //update the raw value with physical value 
    if(getValue(E_pric_RadarFrontCenter_TrajPointACCObj18_TrajPointACCObj18_Valid_b_SetVt)==0)
    {
        if(chgEv_TrajPointACCObj18_TrajPointACCObj18_Valid_b == 0)
        {
            phyValue = getvalue(this);
            // physical to raw conversion
            rawValue = ((phyValue -(0))/1);
            putValue(E_pric_RadarFrontCenter_TrajPointACCObj18_TrajPointACCObj18_Valid_b_Rv, rawValue);
            chgEv_TrajPointACCObj18_TrajPointACCObj18_Valid_b = 1;  
        }
        else
        {
            chgEv_TrajPointACCObj18_TrajPointACCObj18_Valid_b = 0;
        }
    }
}

on envVar E_pric_RadarFrontCenter_TrajPointACCObj18_TrajPointACCObj18_Valid_b_Vt
{
    qword rawValue = 0ll;
    if(getValue(E_pric_RadarFrontCenter_TrajPointACCObj18_TrajPointACCObj18_Valid_b_SetVt))
    {
        //update the signal value
        Msg_TrajPointACCObj18.TrajPointACCObj18_Valid_b=getValue(this);
    }
}

on envVar E_pric_RadarFrontCenter_TrajPointACCObj18_TrajPointACCObj18_Valid_b_SetVt
{
    if(getValue(E_pric_RadarFrontCenter_TrajPointACCObj18_TrajPointACCObj18_Valid_b_SetVt))
    {
        //update the signal value
        Msg_TrajPointACCObj18.TrajPointACCObj18_Valid_b=getvalue(E_pric_RadarFrontCenter_TrajPointACCObj18_TrajPointACCObj18_Valid_b_Vt);
    }
    else
    {
        Msg_TrajPointACCObj18.TrajPointACCObj18_Valid_b=getValue(E_pric_RadarFrontCenter_TrajPointACCObj18_TrajPointACCObj18_Valid_b_Rv);
    }
}
 
on envVar E_pric_RadarFrontCenter_TrajPointACCObj18_TrajPointACCObj18_Stopped_b_Rv
{
    qword rawValue = 0ll;
    float rawValue_float = 0.0;
    float phyValue = 0.0;        

    //set the signal with updated raw value
    if(getValue(E_pric_RadarFrontCenter_TrajPointACCObj18_TrajPointACCObj18_Stopped_b_SetVt)==0)
    {
        rawValue = getvalue(this);
        if(chgEv_TrajPointACCObj18_TrajPointACCObj18_Stopped_b == 0)
        {
            //type conversion to float
            rawValue_float = rawValue;        
            // raw to physical conversion
            phyValue = ((rawValue_float *1)+(0));
            putValue(E_pric_RadarFrontCenter_TrajPointACCObj18_TrajPointACCObj18_Stopped_b_Pv, phyValue);
            chgEv_TrajPointACCObj18_TrajPointACCObj18_Stopped_b = 1;
        }
        else
        {
            chgEv_TrajPointACCObj18_TrajPointACCObj18_Stopped_b = 0;
        }    
        //update the signal value
        Msg_TrajPointACCObj18.TrajPointACCObj18_Stopped_b=rawValue;        
    }                                                                           
}

on envVar E_pric_RadarFrontCenter_TrajPointACCObj18_TrajPointACCObj18_Stopped_b_Pv
{
    qword rawValue = 0ll;
    float phyValue = 0.0;
    
    //update the raw value with physical value 
    if(getValue(E_pric_RadarFrontCenter_TrajPointACCObj18_TrajPointACCObj18_Stopped_b_SetVt)==0)
    {
        if(chgEv_TrajPointACCObj18_TrajPointACCObj18_Stopped_b == 0)
        {
            phyValue = getvalue(this);
            // physical to raw conversion
            rawValue = ((phyValue -(0))/1);
            putValue(E_pric_RadarFrontCenter_TrajPointACCObj18_TrajPointACCObj18_Stopped_b_Rv, rawValue);
            chgEv_TrajPointACCObj18_TrajPointACCObj18_Stopped_b = 1;  
        }
        else
        {
            chgEv_TrajPointACCObj18_TrajPointACCObj18_Stopped_b = 0;
        }
    }
}

on envVar E_pric_RadarFrontCenter_TrajPointACCObj18_TrajPointACCObj18_Stopped_b_Vt
{
    qword rawValue = 0ll;
    if(getValue(E_pric_RadarFrontCenter_TrajPointACCObj18_TrajPointACCObj18_Stopped_b_SetVt))
    {
        //update the signal value
        Msg_TrajPointACCObj18.TrajPointACCObj18_Stopped_b=getValue(this);
    }
}

on envVar E_pric_RadarFrontCenter_TrajPointACCObj18_TrajPointACCObj18_Stopped_b_SetVt
{
    if(getValue(E_pric_RadarFrontCenter_TrajPointACCObj18_TrajPointACCObj18_Stopped_b_SetVt))
    {
        //update the signal value
        Msg_TrajPointACCObj18.TrajPointACCObj18_Stopped_b=getvalue(E_pric_RadarFrontCenter_TrajPointACCObj18_TrajPointACCObj18_Stopped_b_Vt);
    }
    else
    {
        Msg_TrajPointACCObj18.TrajPointACCObj18_Stopped_b=getValue(E_pric_RadarFrontCenter_TrajPointACCObj18_TrajPointACCObj18_Stopped_b_Rv);
    }
}
 
on envVar E_pric_RadarFrontCenter_TrajPointACCObj18_TrajPointACCObj18_Stand_b_Rv
{
    qword rawValue = 0ll;
    float rawValue_float = 0.0;
    float phyValue = 0.0;        

    //set the signal with updated raw value
    if(getValue(E_pric_RadarFrontCenter_TrajPointACCObj18_TrajPointACCObj18_Stand_b_SetVt)==0)
    {
        rawValue = getvalue(this);
        if(chgEv_TrajPointACCObj18_TrajPointACCObj18_Stand_b == 0)
        {
            //type conversion to float
            rawValue_float = rawValue;        
            // raw to physical conversion
            phyValue = ((rawValue_float *1)+(0));
            putValue(E_pric_RadarFrontCenter_TrajPointACCObj18_TrajPointACCObj18_Stand_b_Pv, phyValue);
            chgEv_TrajPointACCObj18_TrajPointACCObj18_Stand_b = 1;
        }
        else
        {
            chgEv_TrajPointACCObj18_TrajPointACCObj18_Stand_b = 0;
        }    
        //update the signal value
        Msg_TrajPointACCObj18.TrajPointACCObj18_Stand_b=rawValue;        
    }                                                                           
}

on envVar E_pric_RadarFrontCenter_TrajPointACCObj18_TrajPointACCObj18_Stand_b_Pv
{
    qword rawValue = 0ll;
    float phyValue = 0.0;
    
    //update the raw value with physical value 
    if(getValue(E_pric_RadarFrontCenter_TrajPointACCObj18_TrajPointACCObj18_Stand_b_SetVt)==0)
    {
        if(chgEv_TrajPointACCObj18_TrajPointACCObj18_Stand_b == 0)
        {
            phyValue = getvalue(this);
            // physical to raw conversion
            rawValue = ((phyValue -(0))/1);
            putValue(E_pric_RadarFrontCenter_TrajPointACCObj18_TrajPointACCObj18_Stand_b_Rv, rawValue);
            chgEv_TrajPointACCObj18_TrajPointACCObj18_Stand_b = 1;  
        }
        else
        {
            chgEv_TrajPointACCObj18_TrajPointACCObj18_Stand_b = 0;
        }
    }
}

on envVar E_pric_RadarFrontCenter_TrajPointACCObj18_TrajPointACCObj18_Stand_b_Vt
{
    qword rawValue = 0ll;
    if(getValue(E_pric_RadarFrontCenter_TrajPointACCObj18_TrajPointACCObj18_Stand_b_SetVt))
    {
        //update the signal value
        Msg_TrajPointACCObj18.TrajPointACCObj18_Stand_b=getValue(this);
    }
}

on envVar E_pric_RadarFrontCenter_TrajPointACCObj18_TrajPointACCObj18_Stand_b_SetVt
{
    if(getValue(E_pric_RadarFrontCenter_TrajPointACCObj18_TrajPointACCObj18_Stand_b_SetVt))
    {
        //update the signal value
        Msg_TrajPointACCObj18.TrajPointACCObj18_Stand_b=getvalue(E_pric_RadarFrontCenter_TrajPointACCObj18_TrajPointACCObj18_Stand_b_Vt);
    }
    else
    {
        Msg_TrajPointACCObj18.TrajPointACCObj18_Stand_b=getValue(E_pric_RadarFrontCenter_TrajPointACCObj18_TrajPointACCObj18_Stand_b_Rv);
    }
}
 
on envVar E_pric_RadarFrontCenter_TrajPointACCObj18_TrajPointACCObj18_Drive_b_Rv
{
    qword rawValue = 0ll;
    float rawValue_float = 0.0;
    float phyValue = 0.0;        

    //set the signal with updated raw value
    if(getValue(E_pric_RadarFrontCenter_TrajPointACCObj18_TrajPointACCObj18_Drive_b_SetVt)==0)
    {
        rawValue = getvalue(this);
        if(chgEv_TrajPointACCObj18_TrajPointACCObj18_Drive_b == 0)
        {
            //type conversion to float
            rawValue_float = rawValue;        
            // raw to physical conversion
            phyValue = ((rawValue_float *1)+(0));
            putValue(E_pric_RadarFrontCenter_TrajPointACCObj18_TrajPointACCObj18_Drive_b_Pv, phyValue);
            chgEv_TrajPointACCObj18_TrajPointACCObj18_Drive_b = 1;
        }
        else
        {
            chgEv_TrajPointACCObj18_TrajPointACCObj18_Drive_b = 0;
        }    
        //update the signal value
        Msg_TrajPointACCObj18.TrajPointACCObj18_Drive_b=rawValue;        
    }                                                                           
}

on envVar E_pric_RadarFrontCenter_TrajPointACCObj18_TrajPointACCObj18_Drive_b_Pv
{
    qword rawValue = 0ll;
    float phyValue = 0.0;
    
    //update the raw value with physical value 
    if(getValue(E_pric_RadarFrontCenter_TrajPointACCObj18_TrajPointACCObj18_Drive_b_SetVt)==0)
    {
        if(chgEv_TrajPointACCObj18_TrajPointACCObj18_Drive_b == 0)
        {
            phyValue = getvalue(this);
            // physical to raw conversion
            rawValue = ((phyValue -(0))/1);
            putValue(E_pric_RadarFrontCenter_TrajPointACCObj18_TrajPointACCObj18_Drive_b_Rv, rawValue);
            chgEv_TrajPointACCObj18_TrajPointACCObj18_Drive_b = 1;  
        }
        else
        {
            chgEv_TrajPointACCObj18_TrajPointACCObj18_Drive_b = 0;
        }
    }
}

on envVar E_pric_RadarFrontCenter_TrajPointACCObj18_TrajPointACCObj18_Drive_b_Vt
{
    qword rawValue = 0ll;
    if(getValue(E_pric_RadarFrontCenter_TrajPointACCObj18_TrajPointACCObj18_Drive_b_SetVt))
    {
        //update the signal value
        Msg_TrajPointACCObj18.TrajPointACCObj18_Drive_b=getValue(this);
    }
}

on envVar E_pric_RadarFrontCenter_TrajPointACCObj18_TrajPointACCObj18_Drive_b_SetVt
{
    if(getValue(E_pric_RadarFrontCenter_TrajPointACCObj18_TrajPointACCObj18_Drive_b_SetVt))
    {
        //update the signal value
        Msg_TrajPointACCObj18.TrajPointACCObj18_Drive_b=getvalue(E_pric_RadarFrontCenter_TrajPointACCObj18_TrajPointACCObj18_Drive_b_Vt);
    }
    else
    {
        Msg_TrajPointACCObj18.TrajPointACCObj18_Drive_b=getValue(E_pric_RadarFrontCenter_TrajPointACCObj18_TrajPointACCObj18_Drive_b_Rv);
    }
}
 
on envVar E_pric_RadarFrontCenter_TrajPointACCObj18_TrajPointACCObj18_timestamp_Rv
{
    qword rawValue = 0ll;
    float rawValue_float = 0.0;
    float phyValue = 0.0;        

    //set the signal with updated raw value
    {
        rawValue = getvalue(this);
        if(chgEv_TrajPointACCObj18_TrajPointACCObj18_timestamp == 0)
        {
            //type conversion to float
            rawValue_float = rawValue;        
            // raw to physical conversion
            phyValue = ((rawValue_float *0.000488281)+(0));
            putValue(E_pric_RadarFrontCenter_TrajPointACCObj18_TrajPointACCObj18_timestamp_Pv, phyValue);
            chgEv_TrajPointACCObj18_TrajPointACCObj18_timestamp = 1;
        }
        else
        {
            chgEv_TrajPointACCObj18_TrajPointACCObj18_timestamp = 0;
        }    
        //update the signal value
        Msg_TrajPointACCObj18.TrajPointACCObj18_timestamp=rawValue;        
    }                                                                           
}

on envVar E_pric_RadarFrontCenter_TrajPointACCObj18_TrajPointACCObj18_timestamp_Pv
{
    qword rawValue = 0ll;
    float phyValue = 0.0;
    
    //update the raw value with physical value 
    {
        if(chgEv_TrajPointACCObj18_TrajPointACCObj18_timestamp == 0)
        {
            phyValue = getvalue(this);
            // physical to raw conversion
            rawValue = ((phyValue -(0))/0.000488281);
            putValue(E_pric_RadarFrontCenter_TrajPointACCObj18_TrajPointACCObj18_timestamp_Rv, rawValue);
            chgEv_TrajPointACCObj18_TrajPointACCObj18_timestamp = 1;  
        }
        else
        {
            chgEv_TrajPointACCObj18_TrajPointACCObj18_timestamp = 0;
        }
    }
}


 
on envVar E_pric_RadarFrontCenter_TrajPointACCObj18_TrajPointACCObj18_dVarYv_uw_Rv
{
    qword rawValue = 0ll;
    float rawValue_float = 0.0;
    float phyValue = 0.0;        

    //set the signal with updated raw value
    {
        rawValue = getvalue(this);
        if(chgEv_TrajPointACCObj18_TrajPointACCObj18_dVarYv_uw == 0)
        {
            //type conversion to float
            rawValue_float = rawValue;        
            // raw to physical conversion
            phyValue = ((rawValue_float *0.00195313)+(0));
            putValue(E_pric_RadarFrontCenter_TrajPointACCObj18_TrajPointACCObj18_dVarYv_uw_Pv, phyValue);
            chgEv_TrajPointACCObj18_TrajPointACCObj18_dVarYv_uw = 1;
        }
        else
        {
            chgEv_TrajPointACCObj18_TrajPointACCObj18_dVarYv_uw = 0;
        }    
        //update the signal value
        Msg_TrajPointACCObj18.TrajPointACCObj18_dVarYv_uw=rawValue;        
    }                                                                           
}

on envVar E_pric_RadarFrontCenter_TrajPointACCObj18_TrajPointACCObj18_dVarYv_uw_Pv
{
    qword rawValue = 0ll;
    float phyValue = 0.0;
    
    //update the raw value with physical value 
    {
        if(chgEv_TrajPointACCObj18_TrajPointACCObj18_dVarYv_uw == 0)
        {
            phyValue = getvalue(this);
            // physical to raw conversion
            rawValue = ((phyValue -(0))/0.00195313);
            putValue(E_pric_RadarFrontCenter_TrajPointACCObj18_TrajPointACCObj18_dVarYv_uw_Rv, rawValue);
            chgEv_TrajPointACCObj18_TrajPointACCObj18_dVarYv_uw = 1;  
        }
        else
        {
            chgEv_TrajPointACCObj18_TrajPointACCObj18_dVarYv_uw = 0;
        }
    }
}


 
on envVar E_pric_RadarFrontCenter_TrajPointACCObj18_TrajPointACCObj18_InvDir_b_Rv
{
    qword rawValue = 0ll;
    float rawValue_float = 0.0;
    float phyValue = 0.0;        

    //set the signal with updated raw value
    if(getValue(E_pric_RadarFrontCenter_TrajPointACCObj18_TrajPointACCObj18_InvDir_b_SetVt)==0)
    {
        rawValue = getvalue(this);
        if(chgEv_TrajPointACCObj18_TrajPointACCObj18_InvDir_b == 0)
        {
            //type conversion to float
            rawValue_float = rawValue;        
            // raw to physical conversion
            phyValue = ((rawValue_float *1)+(0));
            putValue(E_pric_RadarFrontCenter_TrajPointACCObj18_TrajPointACCObj18_InvDir_b_Pv, phyValue);
            chgEv_TrajPointACCObj18_TrajPointACCObj18_InvDir_b = 1;
        }
        else
        {
            chgEv_TrajPointACCObj18_TrajPointACCObj18_InvDir_b = 0;
        }    
        //update the signal value
        Msg_TrajPointACCObj18.TrajPointACCObj18_InvDir_b=rawValue;        
    }                                                                           
}

on envVar E_pric_RadarFrontCenter_TrajPointACCObj18_TrajPointACCObj18_InvDir_b_Pv
{
    qword rawValue = 0ll;
    float phyValue = 0.0;
    
    //update the raw value with physical value 
    if(getValue(E_pric_RadarFrontCenter_TrajPointACCObj18_TrajPointACCObj18_InvDir_b_SetVt)==0)
    {
        if(chgEv_TrajPointACCObj18_TrajPointACCObj18_InvDir_b == 0)
        {
            phyValue = getvalue(this);
            // physical to raw conversion
            rawValue = ((phyValue -(0))/1);
            putValue(E_pric_RadarFrontCenter_TrajPointACCObj18_TrajPointACCObj18_InvDir_b_Rv, rawValue);
            chgEv_TrajPointACCObj18_TrajPointACCObj18_InvDir_b = 1;  
        }
        else
        {
            chgEv_TrajPointACCObj18_TrajPointACCObj18_InvDir_b = 0;
        }
    }
}

on envVar E_pric_RadarFrontCenter_TrajPointACCObj18_TrajPointACCObj18_InvDir_b_Vt
{
    qword rawValue = 0ll;
    if(getValue(E_pric_RadarFrontCenter_TrajPointACCObj18_TrajPointACCObj18_InvDir_b_SetVt))
    {
        //update the signal value
        Msg_TrajPointACCObj18.TrajPointACCObj18_InvDir_b=getValue(this);
    }
}

on envVar E_pric_RadarFrontCenter_TrajPointACCObj18_TrajPointACCObj18_InvDir_b_SetVt
{
    if(getValue(E_pric_RadarFrontCenter_TrajPointACCObj18_TrajPointACCObj18_InvDir_b_SetVt))
    {
        //update the signal value
        Msg_TrajPointACCObj18.TrajPointACCObj18_InvDir_b=getvalue(E_pric_RadarFrontCenter_TrajPointACCObj18_TrajPointACCObj18_InvDir_b_Vt);
    }
    else
    {
        Msg_TrajPointACCObj18.TrajPointACCObj18_InvDir_b=getValue(E_pric_RadarFrontCenter_TrajPointACCObj18_TrajPointACCObj18_InvDir_b_Rv);
    }
}
 
on envVar E_pric_RadarFrontCenter_TrajPointACCObj18_TrajPointACCObj18_dyv_sw_Rv
{
    qword rawValue = 0ll;
    float rawValue_float = 0.0;
    float phyValue = 0.0;        

    //set the signal with updated raw value
    {
        rawValue = getvalue(this);
        if(chgEv_TrajPointACCObj18_TrajPointACCObj18_dyv_sw == 0)
        {
            //type conversion to float
            rawValue_float = rawValue;        
            // raw to physical conversion
            phyValue = ((rawValue_float *0.0078125)+(0));
            putValue(E_pric_RadarFrontCenter_TrajPointACCObj18_TrajPointACCObj18_dyv_sw_Pv, phyValue);
            chgEv_TrajPointACCObj18_TrajPointACCObj18_dyv_sw = 1;
        }
        else
        {
            chgEv_TrajPointACCObj18_TrajPointACCObj18_dyv_sw = 0;
        }    
        //update the signal value
        Msg_TrajPointACCObj18.TrajPointACCObj18_dyv_sw=rawValue;        
    }                                                                           
}

on envVar E_pric_RadarFrontCenter_TrajPointACCObj18_TrajPointACCObj18_dyv_sw_Pv
{
    qword rawValue = 0ll;
    float phyValue = 0.0;
    
    //update the raw value with physical value 
    {
        if(chgEv_TrajPointACCObj18_TrajPointACCObj18_dyv_sw == 0)
        {
            phyValue = getvalue(this);
            // physical to raw conversion
            rawValue = ((phyValue -(0))/0.0078125);
            putValue(E_pric_RadarFrontCenter_TrajPointACCObj18_TrajPointACCObj18_dyv_sw_Rv, rawValue);
            chgEv_TrajPointACCObj18_TrajPointACCObj18_dyv_sw = 1;  
        }
        else
        {
            chgEv_TrajPointACCObj18_TrajPointACCObj18_dyv_sw = 0;
        }
    }
}


 
on envVar E_pric_RadarFrontCenter_TrajPointACCObj18_TrajPointACCObj18_dVarXv_uw_Rv
{
    qword rawValue = 0ll;
    float rawValue_float = 0.0;
    float phyValue = 0.0;        

    //set the signal with updated raw value
    {
        rawValue = getvalue(this);
        if(chgEv_TrajPointACCObj18_TrajPointACCObj18_dVarXv_uw == 0)
        {
            //type conversion to float
            rawValue_float = rawValue;        
            // raw to physical conversion
            phyValue = ((rawValue_float *0.00195313)+(0));
            putValue(E_pric_RadarFrontCenter_TrajPointACCObj18_TrajPointACCObj18_dVarXv_uw_Pv, phyValue);
            chgEv_TrajPointACCObj18_TrajPointACCObj18_dVarXv_uw = 1;
        }
        else
        {
            chgEv_TrajPointACCObj18_TrajPointACCObj18_dVarXv_uw = 0;
        }    
        //update the signal value
        Msg_TrajPointACCObj18.TrajPointACCObj18_dVarXv_uw=rawValue;        
    }                                                                           
}

on envVar E_pric_RadarFrontCenter_TrajPointACCObj18_TrajPointACCObj18_dVarXv_uw_Pv
{
    qword rawValue = 0ll;
    float phyValue = 0.0;
    
    //update the raw value with physical value 
    {
        if(chgEv_TrajPointACCObj18_TrajPointACCObj18_dVarXv_uw == 0)
        {
            phyValue = getvalue(this);
            // physical to raw conversion
            rawValue = ((phyValue -(0))/0.00195313);
            putValue(E_pric_RadarFrontCenter_TrajPointACCObj18_TrajPointACCObj18_dVarXv_uw_Rv, rawValue);
            chgEv_TrajPointACCObj18_TrajPointACCObj18_dVarXv_uw = 1;  
        }
        else
        {
            chgEv_TrajPointACCObj18_TrajPointACCObj18_dVarXv_uw = 0;
        }
    }
}


 
on envVar E_pric_RadarFrontCenter_TrajPointACCObj18_TrajPointACCObj18_wExistProb_ub_Rv
{
    qword rawValue = 0ll;
    float rawValue_float = 0.0;
    float phyValue = 0.0;        

    //set the signal with updated raw value
    {
        rawValue = getvalue(this);
        if(chgEv_TrajPointACCObj18_TrajPointACCObj18_wExistProb_ub == 0)
        {
            //type conversion to float
            rawValue_float = rawValue;        
            // raw to physical conversion
            phyValue = ((rawValue_float *0.00390625)+(0));
            putValue(E_pric_RadarFrontCenter_TrajPointACCObj18_TrajPointACCObj18_wExistProb_ub_Pv, phyValue);
            chgEv_TrajPointACCObj18_TrajPointACCObj18_wExistProb_ub = 1;
        }
        else
        {
            chgEv_TrajPointACCObj18_TrajPointACCObj18_wExistProb_ub = 0;
        }    
        //update the signal value
        Msg_TrajPointACCObj18.TrajPointACCObj18_wExistProb_ub=rawValue;        
    }                                                                           
}

on envVar E_pric_RadarFrontCenter_TrajPointACCObj18_TrajPointACCObj18_wExistProb_ub_Pv
{
    qword rawValue = 0ll;
    float phyValue = 0.0;
    
    //update the raw value with physical value 
    {
        if(chgEv_TrajPointACCObj18_TrajPointACCObj18_wExistProb_ub == 0)
        {
            phyValue = getvalue(this);
            // physical to raw conversion
            rawValue = ((phyValue -(0))/0.00390625);
            putValue(E_pric_RadarFrontCenter_TrajPointACCObj18_TrajPointACCObj18_wExistProb_ub_Rv, rawValue);
            chgEv_TrajPointACCObj18_TrajPointACCObj18_wExistProb_ub = 1;  
        }
        else
        {
            chgEv_TrajPointACCObj18_TrajPointACCObj18_wExistProb_ub = 0;
        }
    }
}


 
on envVar E_pric_RadarFrontCenter_OnGoingObj1_tx
{
    if(getValue(this))
    {       
        
        //update the BZ Signal
        if(OnGoingObj1_OnGoingObj1_blockCtr_wrongvalctr == 0)
        {
            update_OnGoingObj1_OnGoingObj1_blockCtr_counter();
            Msg_OnGoingObj1.OnGoingObj1_blockCtr= OnGoingObj1_OnGoingObj1_blockCtr_counter;
        }
        else if(OnGoingObj1_OnGoingObj1_blockCtr_wrongvalctr > 0)
        {
             OnGoingObj1_OnGoingObj1_blockCtr_wrongvalctr--;
              // if counter becomes zero, update panel controller to zero
             if(OnGoingObj1_OnGoingObj1_blockCtr_wrongvalctr == 0)
             {
                 putValue(E_pric_RadarFrontCenter_OnGoingObj1_OnGoingObj1_blockCtr_wrongvalctr,0);
             }
        }
        else
        {
            //do nothing
        }        
        //update the BZ Signal
        if(OnGoingObj1_OnGoingObj1_MsgCtr_wrongvalctr == 0)
        {
            update_OnGoingObj1_OnGoingObj1_MsgCtr_counter();
            Msg_OnGoingObj1.OnGoingObj1_MsgCtr= OnGoingObj1_OnGoingObj1_MsgCtr_counter;
        }
        else if(OnGoingObj1_OnGoingObj1_MsgCtr_wrongvalctr > 0)
        {
             OnGoingObj1_OnGoingObj1_MsgCtr_wrongvalctr--;
              // if counter becomes zero, update panel controller to zero
             if(OnGoingObj1_OnGoingObj1_MsgCtr_wrongvalctr == 0)
             {
                 putValue(E_pric_RadarFrontCenter_OnGoingObj1_OnGoingObj1_MsgCtr_wrongvalctr,0);
             }
        }
        else
        {
            //do nothing
        }        
        //calculate the CRC checksum
        update_OnGoingObj1_ChkSum_Checksum();

        output(Msg_OnGoingObj1);        
    }
}

on envVar E_pric_RadarFrontCenter_OnGoingObj1_Range
{
    qword rawstatus = 0ll;
    qword rawValue = 0ll;    
    
    rawstatus = getvalue(this);    
    // set all the signals with min raw /max raw /init raw
    switch (rawstatus) 
    {
     case(0) :
        rawValue= 0;
        putValue(E_pric_RadarFrontCenter_OnGoingObj1_OnGoingObj1_RFF_ub_Rv, rawValue);
        rawValue= -32768;
        putValue(E_pric_RadarFrontCenter_OnGoingObj1_OnGoingObj1_dyv_sw_Rv, rawValue);
        rawValue= -32768;
        putValue(E_pric_RadarFrontCenter_OnGoingObj1_OnGoingObj1_vxv_sw_Rv, rawValue);
        rawValue= -32768;
        putValue(E_pric_RadarFrontCenter_OnGoingObj1_OnGoingObj1_dxv_sw_Rv, rawValue);
        rawValue= 0;
        putValue(E_pric_RadarFrontCenter_OnGoingObj1_OnGoingObj1_Handle_ub_Rv, rawValue);
        break;
     case(1) :
        rawValue= 255;
        putValue(E_pric_RadarFrontCenter_OnGoingObj1_OnGoingObj1_RFF_ub_Rv, rawValue);
        rawValue= 32767;
        putValue(E_pric_RadarFrontCenter_OnGoingObj1_OnGoingObj1_dyv_sw_Rv, rawValue);
        rawValue= 32767;
        putValue(E_pric_RadarFrontCenter_OnGoingObj1_OnGoingObj1_vxv_sw_Rv, rawValue);
        rawValue= 32767;
        putValue(E_pric_RadarFrontCenter_OnGoingObj1_OnGoingObj1_dxv_sw_Rv, rawValue);
        rawValue= 255;
        putValue(E_pric_RadarFrontCenter_OnGoingObj1_OnGoingObj1_Handle_ub_Rv, rawValue);
        break;
     default :
        rawValue= 0;
        putValue(E_pric_RadarFrontCenter_OnGoingObj1_OnGoingObj1_RFF_ub_Rv, rawValue);
        rawValue= -32768;
        putValue(E_pric_RadarFrontCenter_OnGoingObj1_OnGoingObj1_dyv_sw_Rv, rawValue);
        rawValue= -32768;
        putValue(E_pric_RadarFrontCenter_OnGoingObj1_OnGoingObj1_vxv_sw_Rv, rawValue);
        rawValue= -32768;
        putValue(E_pric_RadarFrontCenter_OnGoingObj1_OnGoingObj1_dxv_sw_Rv, rawValue);
        rawValue= 0;
        putValue(E_pric_RadarFrontCenter_OnGoingObj1_OnGoingObj1_Handle_ub_Rv, rawValue);
      break;
   }
}

on envVar E_pric_RadarFrontCenter_OnGoingObj1_Dlc
{
    if(getValue(E_pric_RadarFrontCenter_OnGoingObj1_enDlc))
    {
        Msg_OnGoingObj1.dlc =getValue(this);
    }
    else
    {
       Dbc_dlc = 12;
	   Msg_OnGoingObj1.dlc = Calc_Canfd_dlc(Dbc_dlc);
	   	
  }
}

on envVar E_pric_RadarFrontCenter_OnGoingObj1_enDlc
{
    //For Messages with DLC = 8, set wrong DLC to smaller than defined DLC
    //For Messages with DLC < 8 set wrong DLC to smaller/longer than defined DLC
    if(getValue(this))
    {
        Msg_OnGoingObj1.dlc =getValue(E_pric_RadarFrontCenter_OnGoingObj1_Dlc);
    }
    else
    {
       Dbc_dlc = 12;
	   Msg_OnGoingObj1.dlc = Calc_Canfd_dlc(Dbc_dlc);
			
    }
}

on envVar E_pric_RadarFrontCenter_OnGoingObj1_OnGoingObj1_CRC_wrongvalctr
{
    //update disturb count
    //disturb value range:(-1 = always send wrong value),( X>0 ,x is the number of Messages with wrong CHK sent)
    OnGoingObj1_OnGoingObj1_CRC_wrongvalctr =getValue(this);    
}
on envVar E_pric_RadarFrontCenter_OnGoingObj1_OnGoingObj1_MsgCtr_wrongvalctr
{
    //update disturb count
    //disturb value range:(-1 = always send wrong value),( X>0 ,x is the number of Messages with wrong CHK sent)
    OnGoingObj1_OnGoingObj1_MsgCtr_wrongvalctr =getValue(this);    
}
on envVar E_pric_RadarFrontCenter_OnGoingObj1_OnGoingObj1_blockCtr_wrongvalctr
{
    //update disturb count
    //disturb value range:(-1 = always send wrong value),( X>0 ,x is the number of Messages with wrong CHK sent)
    OnGoingObj1_OnGoingObj1_blockCtr_wrongvalctr =getValue(this);    
}

on envVar E_pric_RadarFrontCenter_OnGoingObj1_OnGoingObj1_RFF_ub_Rv
{
    qword rawValue = 0ll;
    float rawValue_float = 0.0;
    float phyValue = 0.0;        

    //set the signal with updated raw value
    if(getValue(E_pric_RadarFrontCenter_OnGoingObj1_OnGoingObj1_RFF_ub_SetVt)==0)
    {
        rawValue = getvalue(this);
        if(chgEv_OnGoingObj1_OnGoingObj1_RFF_ub == 0)
        {
            //type conversion to float
            rawValue_float = rawValue;        
            // raw to physical conversion
            phyValue = ((rawValue_float *1)+(0));
            putValue(E_pric_RadarFrontCenter_OnGoingObj1_OnGoingObj1_RFF_ub_Pv, phyValue);
            chgEv_OnGoingObj1_OnGoingObj1_RFF_ub = 1;
        }
        else
        {
            chgEv_OnGoingObj1_OnGoingObj1_RFF_ub = 0;
        }    
        //update the signal value
        Msg_OnGoingObj1.OnGoingObj1_RFF_ub=rawValue;        
    }                                                                           
}

on envVar E_pric_RadarFrontCenter_OnGoingObj1_OnGoingObj1_RFF_ub_Pv
{
    qword rawValue = 0ll;
    float phyValue = 0.0;
    
    //update the raw value with physical value 
    if(getValue(E_pric_RadarFrontCenter_OnGoingObj1_OnGoingObj1_RFF_ub_SetVt)==0)
    {
        if(chgEv_OnGoingObj1_OnGoingObj1_RFF_ub == 0)
        {
            phyValue = getvalue(this);
            // physical to raw conversion
            rawValue = ((phyValue -(0))/1);
            putValue(E_pric_RadarFrontCenter_OnGoingObj1_OnGoingObj1_RFF_ub_Rv, rawValue);
            chgEv_OnGoingObj1_OnGoingObj1_RFF_ub = 1;  
        }
        else
        {
            chgEv_OnGoingObj1_OnGoingObj1_RFF_ub = 0;
        }
    }
}

on envVar E_pric_RadarFrontCenter_OnGoingObj1_OnGoingObj1_RFF_ub_Vt
{
    qword rawValue = 0ll;
    if(getValue(E_pric_RadarFrontCenter_OnGoingObj1_OnGoingObj1_RFF_ub_SetVt))
    {
        //update the signal value
        Msg_OnGoingObj1.OnGoingObj1_RFF_ub=getValue(this);
    }
}

on envVar E_pric_RadarFrontCenter_OnGoingObj1_OnGoingObj1_RFF_ub_SetVt
{
    if(getValue(E_pric_RadarFrontCenter_OnGoingObj1_OnGoingObj1_RFF_ub_SetVt))
    {
        //update the signal value
        Msg_OnGoingObj1.OnGoingObj1_RFF_ub=getvalue(E_pric_RadarFrontCenter_OnGoingObj1_OnGoingObj1_RFF_ub_Vt);
    }
    else
    {
        Msg_OnGoingObj1.OnGoingObj1_RFF_ub=getValue(E_pric_RadarFrontCenter_OnGoingObj1_OnGoingObj1_RFF_ub_Rv);
    }
}
 
on envVar E_pric_RadarFrontCenter_OnGoingObj1_OnGoingObj1_dyv_sw_Rv
{
    qword rawValue = 0ll;
    float rawValue_float = 0.0;
    float phyValue = 0.0;        

    //set the signal with updated raw value
    {
        rawValue = getvalue(this);
        if(chgEv_OnGoingObj1_OnGoingObj1_dyv_sw == 0)
        {
            //type conversion to float
            rawValue_float = rawValue;        
            // raw to physical conversion
            phyValue = ((rawValue_float *0.0078125)+(0));
            putValue(E_pric_RadarFrontCenter_OnGoingObj1_OnGoingObj1_dyv_sw_Pv, phyValue);
            chgEv_OnGoingObj1_OnGoingObj1_dyv_sw = 1;
        }
        else
        {
            chgEv_OnGoingObj1_OnGoingObj1_dyv_sw = 0;
        }    
        //update the signal value
        Msg_OnGoingObj1.OnGoingObj1_dyv_sw=rawValue;        
    }                                                                           
}

on envVar E_pric_RadarFrontCenter_OnGoingObj1_OnGoingObj1_dyv_sw_Pv
{
    qword rawValue = 0ll;
    float phyValue = 0.0;
    
    //update the raw value with physical value 
    {
        if(chgEv_OnGoingObj1_OnGoingObj1_dyv_sw == 0)
        {
            phyValue = getvalue(this);
            // physical to raw conversion
            rawValue = ((phyValue -(0))/0.0078125);
            putValue(E_pric_RadarFrontCenter_OnGoingObj1_OnGoingObj1_dyv_sw_Rv, rawValue);
            chgEv_OnGoingObj1_OnGoingObj1_dyv_sw = 1;  
        }
        else
        {
            chgEv_OnGoingObj1_OnGoingObj1_dyv_sw = 0;
        }
    }
}


 
on envVar E_pric_RadarFrontCenter_OnGoingObj1_OnGoingObj1_vxv_sw_Rv
{
    qword rawValue = 0ll;
    float rawValue_float = 0.0;
    float phyValue = 0.0;        

    //set the signal with updated raw value
    {
        rawValue = getvalue(this);
        if(chgEv_OnGoingObj1_OnGoingObj1_vxv_sw == 0)
        {
            //type conversion to float
            rawValue_float = rawValue;        
            // raw to physical conversion
            phyValue = ((rawValue_float *0.00390625)+(0));
            putValue(E_pric_RadarFrontCenter_OnGoingObj1_OnGoingObj1_vxv_sw_Pv, phyValue);
            chgEv_OnGoingObj1_OnGoingObj1_vxv_sw = 1;
        }
        else
        {
            chgEv_OnGoingObj1_OnGoingObj1_vxv_sw = 0;
        }    
        //update the signal value
        Msg_OnGoingObj1.OnGoingObj1_vxv_sw=rawValue;        
    }                                                                           
}

on envVar E_pric_RadarFrontCenter_OnGoingObj1_OnGoingObj1_vxv_sw_Pv
{
    qword rawValue = 0ll;
    float phyValue = 0.0;
    
    //update the raw value with physical value 
    {
        if(chgEv_OnGoingObj1_OnGoingObj1_vxv_sw == 0)
        {
            phyValue = getvalue(this);
            // physical to raw conversion
            rawValue = ((phyValue -(0))/0.00390625);
            putValue(E_pric_RadarFrontCenter_OnGoingObj1_OnGoingObj1_vxv_sw_Rv, rawValue);
            chgEv_OnGoingObj1_OnGoingObj1_vxv_sw = 1;  
        }
        else
        {
            chgEv_OnGoingObj1_OnGoingObj1_vxv_sw = 0;
        }
    }
}


 
on envVar E_pric_RadarFrontCenter_OnGoingObj1_OnGoingObj1_dxv_sw_Rv
{
    qword rawValue = 0ll;
    float rawValue_float = 0.0;
    float phyValue = 0.0;        

    //set the signal with updated raw value
    {
        rawValue = getvalue(this);
        if(chgEv_OnGoingObj1_OnGoingObj1_dxv_sw == 0)
        {
            //type conversion to float
            rawValue_float = rawValue;        
            // raw to physical conversion
            phyValue = ((rawValue_float *0.0078125)+(0));
            putValue(E_pric_RadarFrontCenter_OnGoingObj1_OnGoingObj1_dxv_sw_Pv, phyValue);
            chgEv_OnGoingObj1_OnGoingObj1_dxv_sw = 1;
        }
        else
        {
            chgEv_OnGoingObj1_OnGoingObj1_dxv_sw = 0;
        }    
        //update the signal value
        Msg_OnGoingObj1.OnGoingObj1_dxv_sw=rawValue;        
    }                                                                           
}

on envVar E_pric_RadarFrontCenter_OnGoingObj1_OnGoingObj1_dxv_sw_Pv
{
    qword rawValue = 0ll;
    float phyValue = 0.0;
    
    //update the raw value with physical value 
    {
        if(chgEv_OnGoingObj1_OnGoingObj1_dxv_sw == 0)
        {
            phyValue = getvalue(this);
            // physical to raw conversion
            rawValue = ((phyValue -(0))/0.0078125);
            putValue(E_pric_RadarFrontCenter_OnGoingObj1_OnGoingObj1_dxv_sw_Rv, rawValue);
            chgEv_OnGoingObj1_OnGoingObj1_dxv_sw = 1;  
        }
        else
        {
            chgEv_OnGoingObj1_OnGoingObj1_dxv_sw = 0;
        }
    }
}


 
on envVar E_pric_RadarFrontCenter_OnGoingObj1_OnGoingObj1_Handle_ub_Rv
{
    qword rawValue = 0ll;
    float rawValue_float = 0.0;
    float phyValue = 0.0;        

    //set the signal with updated raw value
    if(getValue(E_pric_RadarFrontCenter_OnGoingObj1_OnGoingObj1_Handle_ub_SetVt)==0)
    {
        rawValue = getvalue(this);
        if(chgEv_OnGoingObj1_OnGoingObj1_Handle_ub == 0)
        {
            //type conversion to float
            rawValue_float = rawValue;        
            // raw to physical conversion
            phyValue = ((rawValue_float *1)+(0));
            putValue(E_pric_RadarFrontCenter_OnGoingObj1_OnGoingObj1_Handle_ub_Pv, phyValue);
            chgEv_OnGoingObj1_OnGoingObj1_Handle_ub = 1;
        }
        else
        {
            chgEv_OnGoingObj1_OnGoingObj1_Handle_ub = 0;
        }    
        //update the signal value
        Msg_OnGoingObj1.OnGoingObj1_Handle_ub=rawValue;        
    }                                                                           
}

on envVar E_pric_RadarFrontCenter_OnGoingObj1_OnGoingObj1_Handle_ub_Pv
{
    qword rawValue = 0ll;
    float phyValue = 0.0;
    
    //update the raw value with physical value 
    if(getValue(E_pric_RadarFrontCenter_OnGoingObj1_OnGoingObj1_Handle_ub_SetVt)==0)
    {
        if(chgEv_OnGoingObj1_OnGoingObj1_Handle_ub == 0)
        {
            phyValue = getvalue(this);
            // physical to raw conversion
            rawValue = ((phyValue -(0))/1);
            putValue(E_pric_RadarFrontCenter_OnGoingObj1_OnGoingObj1_Handle_ub_Rv, rawValue);
            chgEv_OnGoingObj1_OnGoingObj1_Handle_ub = 1;  
        }
        else
        {
            chgEv_OnGoingObj1_OnGoingObj1_Handle_ub = 0;
        }
    }
}

on envVar E_pric_RadarFrontCenter_OnGoingObj1_OnGoingObj1_Handle_ub_Vt
{
    qword rawValue = 0ll;
    if(getValue(E_pric_RadarFrontCenter_OnGoingObj1_OnGoingObj1_Handle_ub_SetVt))
    {
        //update the signal value
        Msg_OnGoingObj1.OnGoingObj1_Handle_ub=getValue(this);
    }
}

on envVar E_pric_RadarFrontCenter_OnGoingObj1_OnGoingObj1_Handle_ub_SetVt
{
    if(getValue(E_pric_RadarFrontCenter_OnGoingObj1_OnGoingObj1_Handle_ub_SetVt))
    {
        //update the signal value
        Msg_OnGoingObj1.OnGoingObj1_Handle_ub=getvalue(E_pric_RadarFrontCenter_OnGoingObj1_OnGoingObj1_Handle_ub_Vt);
    }
    else
    {
        Msg_OnGoingObj1.OnGoingObj1_Handle_ub=getValue(E_pric_RadarFrontCenter_OnGoingObj1_OnGoingObj1_Handle_ub_Rv);
    }
}
 
on envVar E_pric_RadarFrontCenter_OnGoingObj0_tx
{
    if(getValue(this))
    {       
        
        //update the BZ Signal
        if(OnGoingObj0_OnGoingObj0_MsgCtr_wrongvalctr == 0)
        {
            update_OnGoingObj0_OnGoingObj0_MsgCtr_counter();
            Msg_OnGoingObj0.OnGoingObj0_MsgCtr= OnGoingObj0_OnGoingObj0_MsgCtr_counter;
        }
        else if(OnGoingObj0_OnGoingObj0_MsgCtr_wrongvalctr > 0)
        {
             OnGoingObj0_OnGoingObj0_MsgCtr_wrongvalctr--;
              // if counter becomes zero, update panel controller to zero
             if(OnGoingObj0_OnGoingObj0_MsgCtr_wrongvalctr == 0)
             {
                 putValue(E_pric_RadarFrontCenter_OnGoingObj0_OnGoingObj0_MsgCtr_wrongvalctr,0);
             }
        }
        else
        {
            //do nothing
        }        
        //update the BZ Signal
        if(OnGoingObj0_OnGoingObj0_blockCtr_wrongvalctr == 0)
        {
            update_OnGoingObj0_OnGoingObj0_blockCtr_counter();
            Msg_OnGoingObj0.OnGoingObj0_blockCtr= OnGoingObj0_OnGoingObj0_blockCtr_counter;
        }
        else if(OnGoingObj0_OnGoingObj0_blockCtr_wrongvalctr > 0)
        {
             OnGoingObj0_OnGoingObj0_blockCtr_wrongvalctr--;
              // if counter becomes zero, update panel controller to zero
             if(OnGoingObj0_OnGoingObj0_blockCtr_wrongvalctr == 0)
             {
                 putValue(E_pric_RadarFrontCenter_OnGoingObj0_OnGoingObj0_blockCtr_wrongvalctr,0);
             }
        }
        else
        {
            //do nothing
        }        
        //calculate the CRC checksum
        update_OnGoingObj0_ChkSum_Checksum();

        output(Msg_OnGoingObj0);        
    }
}

on envVar E_pric_RadarFrontCenter_OnGoingObj0_Range
{
    qword rawstatus = 0ll;
    qword rawValue = 0ll;    
    
    rawstatus = getvalue(this);    
    // set all the signals with min raw /max raw /init raw
    switch (rawstatus) 
    {
     case(0) :
        rawValue= -32768;
        putValue(E_pric_RadarFrontCenter_OnGoingObj0_OnGoingObj0_dyv_sw_Rv, rawValue);
        rawValue= 0;
        putValue(E_pric_RadarFrontCenter_OnGoingObj0_OnGoingObj0_Handle_ub_Rv, rawValue);
        rawValue= -32768;
        putValue(E_pric_RadarFrontCenter_OnGoingObj0_OnGoingObj0_dxv_sw_Rv, rawValue);
        rawValue= -32768;
        putValue(E_pric_RadarFrontCenter_OnGoingObj0_OnGoingObj0_vxv_sw_Rv, rawValue);
        rawValue= 0;
        putValue(E_pric_RadarFrontCenter_OnGoingObj0_OnGoingObj0_RFF_ub_Rv, rawValue);
        break;
     case(1) :
        rawValue= 32767;
        putValue(E_pric_RadarFrontCenter_OnGoingObj0_OnGoingObj0_dyv_sw_Rv, rawValue);
        rawValue= 255;
        putValue(E_pric_RadarFrontCenter_OnGoingObj0_OnGoingObj0_Handle_ub_Rv, rawValue);
        rawValue= 32767;
        putValue(E_pric_RadarFrontCenter_OnGoingObj0_OnGoingObj0_dxv_sw_Rv, rawValue);
        rawValue= 32767;
        putValue(E_pric_RadarFrontCenter_OnGoingObj0_OnGoingObj0_vxv_sw_Rv, rawValue);
        rawValue= 255;
        putValue(E_pric_RadarFrontCenter_OnGoingObj0_OnGoingObj0_RFF_ub_Rv, rawValue);
        break;
     default :
        rawValue= -32768;
        putValue(E_pric_RadarFrontCenter_OnGoingObj0_OnGoingObj0_dyv_sw_Rv, rawValue);
        rawValue= 0;
        putValue(E_pric_RadarFrontCenter_OnGoingObj0_OnGoingObj0_Handle_ub_Rv, rawValue);
        rawValue= -32768;
        putValue(E_pric_RadarFrontCenter_OnGoingObj0_OnGoingObj0_dxv_sw_Rv, rawValue);
        rawValue= -32768;
        putValue(E_pric_RadarFrontCenter_OnGoingObj0_OnGoingObj0_vxv_sw_Rv, rawValue);
        rawValue= 0;
        putValue(E_pric_RadarFrontCenter_OnGoingObj0_OnGoingObj0_RFF_ub_Rv, rawValue);
      break;
   }
}

on envVar E_pric_RadarFrontCenter_OnGoingObj0_Dlc
{
    if(getValue(E_pric_RadarFrontCenter_OnGoingObj0_enDlc))
    {
        Msg_OnGoingObj0.dlc =getValue(this);
    }
    else
    {
       Dbc_dlc = 12;
	   Msg_OnGoingObj0.dlc = Calc_Canfd_dlc(Dbc_dlc);
	   	
  }
}

on envVar E_pric_RadarFrontCenter_OnGoingObj0_enDlc
{
    //For Messages with DLC = 8, set wrong DLC to smaller than defined DLC
    //For Messages with DLC < 8 set wrong DLC to smaller/longer than defined DLC
    if(getValue(this))
    {
        Msg_OnGoingObj0.dlc =getValue(E_pric_RadarFrontCenter_OnGoingObj0_Dlc);
    }
    else
    {
       Dbc_dlc = 12;
	   Msg_OnGoingObj0.dlc = Calc_Canfd_dlc(Dbc_dlc);
			
    }
}

on envVar E_pric_RadarFrontCenter_OnGoingObj0_OnGoingObj0_CRC_wrongvalctr
{
    //update disturb count
    //disturb value range:(-1 = always send wrong value),( X>0 ,x is the number of Messages with wrong CHK sent)
    OnGoingObj0_OnGoingObj0_CRC_wrongvalctr =getValue(this);    
}
on envVar E_pric_RadarFrontCenter_OnGoingObj0_OnGoingObj0_MsgCtr_wrongvalctr
{
    //update disturb count
    //disturb value range:(-1 = always send wrong value),( X>0 ,x is the number of Messages with wrong CHK sent)
    OnGoingObj0_OnGoingObj0_MsgCtr_wrongvalctr =getValue(this);    
}
on envVar E_pric_RadarFrontCenter_OnGoingObj0_OnGoingObj0_blockCtr_wrongvalctr
{
    //update disturb count
    //disturb value range:(-1 = always send wrong value),( X>0 ,x is the number of Messages with wrong CHK sent)
    OnGoingObj0_OnGoingObj0_blockCtr_wrongvalctr =getValue(this);    
}

on envVar E_pric_RadarFrontCenter_OnGoingObj0_OnGoingObj0_dyv_sw_Rv
{
    qword rawValue = 0ll;
    float rawValue_float = 0.0;
    float phyValue = 0.0;        

    //set the signal with updated raw value
    {
        rawValue = getvalue(this);
        if(chgEv_OnGoingObj0_OnGoingObj0_dyv_sw == 0)
        {
            //type conversion to float
            rawValue_float = rawValue;        
            // raw to physical conversion
            phyValue = ((rawValue_float *0.0078125)+(0));
            putValue(E_pric_RadarFrontCenter_OnGoingObj0_OnGoingObj0_dyv_sw_Pv, phyValue);
            chgEv_OnGoingObj0_OnGoingObj0_dyv_sw = 1;
        }
        else
        {
            chgEv_OnGoingObj0_OnGoingObj0_dyv_sw = 0;
        }    
        //update the signal value
        Msg_OnGoingObj0.OnGoingObj0_dyv_sw=rawValue;        
    }                                                                           
}

on envVar E_pric_RadarFrontCenter_OnGoingObj0_OnGoingObj0_dyv_sw_Pv
{
    qword rawValue = 0ll;
    float phyValue = 0.0;
    
    //update the raw value with physical value 
    {
        if(chgEv_OnGoingObj0_OnGoingObj0_dyv_sw == 0)
        {
            phyValue = getvalue(this);
            // physical to raw conversion
            rawValue = ((phyValue -(0))/0.0078125);
            putValue(E_pric_RadarFrontCenter_OnGoingObj0_OnGoingObj0_dyv_sw_Rv, rawValue);
            chgEv_OnGoingObj0_OnGoingObj0_dyv_sw = 1;  
        }
        else
        {
            chgEv_OnGoingObj0_OnGoingObj0_dyv_sw = 0;
        }
    }
}


 
on envVar E_pric_RadarFrontCenter_OnGoingObj0_OnGoingObj0_Handle_ub_Rv
{
    qword rawValue = 0ll;
    float rawValue_float = 0.0;
    float phyValue = 0.0;        

    //set the signal with updated raw value
    if(getValue(E_pric_RadarFrontCenter_OnGoingObj0_OnGoingObj0_Handle_ub_SetVt)==0)
    {
        rawValue = getvalue(this);
        if(chgEv_OnGoingObj0_OnGoingObj0_Handle_ub == 0)
        {
            //type conversion to float
            rawValue_float = rawValue;        
            // raw to physical conversion
            phyValue = ((rawValue_float *1)+(0));
            putValue(E_pric_RadarFrontCenter_OnGoingObj0_OnGoingObj0_Handle_ub_Pv, phyValue);
            chgEv_OnGoingObj0_OnGoingObj0_Handle_ub = 1;
        }
        else
        {
            chgEv_OnGoingObj0_OnGoingObj0_Handle_ub = 0;
        }    
        //update the signal value
        Msg_OnGoingObj0.OnGoingObj0_Handle_ub=rawValue;        
    }                                                                           
}

on envVar E_pric_RadarFrontCenter_OnGoingObj0_OnGoingObj0_Handle_ub_Pv
{
    qword rawValue = 0ll;
    float phyValue = 0.0;
    
    //update the raw value with physical value 
    if(getValue(E_pric_RadarFrontCenter_OnGoingObj0_OnGoingObj0_Handle_ub_SetVt)==0)
    {
        if(chgEv_OnGoingObj0_OnGoingObj0_Handle_ub == 0)
        {
            phyValue = getvalue(this);
            // physical to raw conversion
            rawValue = ((phyValue -(0))/1);
            putValue(E_pric_RadarFrontCenter_OnGoingObj0_OnGoingObj0_Handle_ub_Rv, rawValue);
            chgEv_OnGoingObj0_OnGoingObj0_Handle_ub = 1;  
        }
        else
        {
            chgEv_OnGoingObj0_OnGoingObj0_Handle_ub = 0;
        }
    }
}

on envVar E_pric_RadarFrontCenter_OnGoingObj0_OnGoingObj0_Handle_ub_Vt
{
    qword rawValue = 0ll;
    if(getValue(E_pric_RadarFrontCenter_OnGoingObj0_OnGoingObj0_Handle_ub_SetVt))
    {
        //update the signal value
        Msg_OnGoingObj0.OnGoingObj0_Handle_ub=getValue(this);
    }
}

on envVar E_pric_RadarFrontCenter_OnGoingObj0_OnGoingObj0_Handle_ub_SetVt
{
    if(getValue(E_pric_RadarFrontCenter_OnGoingObj0_OnGoingObj0_Handle_ub_SetVt))
    {
        //update the signal value
        Msg_OnGoingObj0.OnGoingObj0_Handle_ub=getvalue(E_pric_RadarFrontCenter_OnGoingObj0_OnGoingObj0_Handle_ub_Vt);
    }
    else
    {
        Msg_OnGoingObj0.OnGoingObj0_Handle_ub=getValue(E_pric_RadarFrontCenter_OnGoingObj0_OnGoingObj0_Handle_ub_Rv);
    }
}
 
on envVar E_pric_RadarFrontCenter_OnGoingObj0_OnGoingObj0_dxv_sw_Rv
{
    qword rawValue = 0ll;
    float rawValue_float = 0.0;
    float phyValue = 0.0;        

    //set the signal with updated raw value
    {
        rawValue = getvalue(this);
        if(chgEv_OnGoingObj0_OnGoingObj0_dxv_sw == 0)
        {
            //type conversion to float
            rawValue_float = rawValue;        
            // raw to physical conversion
            phyValue = ((rawValue_float *0.0078125)+(0));
            putValue(E_pric_RadarFrontCenter_OnGoingObj0_OnGoingObj0_dxv_sw_Pv, phyValue);
            chgEv_OnGoingObj0_OnGoingObj0_dxv_sw = 1;
        }
        else
        {
            chgEv_OnGoingObj0_OnGoingObj0_dxv_sw = 0;
        }    
        //update the signal value
        Msg_OnGoingObj0.OnGoingObj0_dxv_sw=rawValue;        
    }                                                                           
}

on envVar E_pric_RadarFrontCenter_OnGoingObj0_OnGoingObj0_dxv_sw_Pv
{
    qword rawValue = 0ll;
    float phyValue = 0.0;
    
    //update the raw value with physical value 
    {
        if(chgEv_OnGoingObj0_OnGoingObj0_dxv_sw == 0)
        {
            phyValue = getvalue(this);
            // physical to raw conversion
            rawValue = ((phyValue -(0))/0.0078125);
            putValue(E_pric_RadarFrontCenter_OnGoingObj0_OnGoingObj0_dxv_sw_Rv, rawValue);
            chgEv_OnGoingObj0_OnGoingObj0_dxv_sw = 1;  
        }
        else
        {
            chgEv_OnGoingObj0_OnGoingObj0_dxv_sw = 0;
        }
    }
}


 
on envVar E_pric_RadarFrontCenter_OnGoingObj0_OnGoingObj0_vxv_sw_Rv
{
    qword rawValue = 0ll;
    float rawValue_float = 0.0;
    float phyValue = 0.0;        

    //set the signal with updated raw value
    {
        rawValue = getvalue(this);
        if(chgEv_OnGoingObj0_OnGoingObj0_vxv_sw == 0)
        {
            //type conversion to float
            rawValue_float = rawValue;        
            // raw to physical conversion
            phyValue = ((rawValue_float *0.00390625)+(0));
            putValue(E_pric_RadarFrontCenter_OnGoingObj0_OnGoingObj0_vxv_sw_Pv, phyValue);
            chgEv_OnGoingObj0_OnGoingObj0_vxv_sw = 1;
        }
        else
        {
            chgEv_OnGoingObj0_OnGoingObj0_vxv_sw = 0;
        }    
        //update the signal value
        Msg_OnGoingObj0.OnGoingObj0_vxv_sw=rawValue;        
    }                                                                           
}

on envVar E_pric_RadarFrontCenter_OnGoingObj0_OnGoingObj0_vxv_sw_Pv
{
    qword rawValue = 0ll;
    float phyValue = 0.0;
    
    //update the raw value with physical value 
    {
        if(chgEv_OnGoingObj0_OnGoingObj0_vxv_sw == 0)
        {
            phyValue = getvalue(this);
            // physical to raw conversion
            rawValue = ((phyValue -(0))/0.00390625);
            putValue(E_pric_RadarFrontCenter_OnGoingObj0_OnGoingObj0_vxv_sw_Rv, rawValue);
            chgEv_OnGoingObj0_OnGoingObj0_vxv_sw = 1;  
        }
        else
        {
            chgEv_OnGoingObj0_OnGoingObj0_vxv_sw = 0;
        }
    }
}


 
on envVar E_pric_RadarFrontCenter_OnGoingObj0_OnGoingObj0_RFF_ub_Rv
{
    qword rawValue = 0ll;
    float rawValue_float = 0.0;
    float phyValue = 0.0;        

    //set the signal with updated raw value
    if(getValue(E_pric_RadarFrontCenter_OnGoingObj0_OnGoingObj0_RFF_ub_SetVt)==0)
    {
        rawValue = getvalue(this);
        if(chgEv_OnGoingObj0_OnGoingObj0_RFF_ub == 0)
        {
            //type conversion to float
            rawValue_float = rawValue;        
            // raw to physical conversion
            phyValue = ((rawValue_float *1)+(0));
            putValue(E_pric_RadarFrontCenter_OnGoingObj0_OnGoingObj0_RFF_ub_Pv, phyValue);
            chgEv_OnGoingObj0_OnGoingObj0_RFF_ub = 1;
        }
        else
        {
            chgEv_OnGoingObj0_OnGoingObj0_RFF_ub = 0;
        }    
        //update the signal value
        Msg_OnGoingObj0.OnGoingObj0_RFF_ub=rawValue;        
    }                                                                           
}

on envVar E_pric_RadarFrontCenter_OnGoingObj0_OnGoingObj0_RFF_ub_Pv
{
    qword rawValue = 0ll;
    float phyValue = 0.0;
    
    //update the raw value with physical value 
    if(getValue(E_pric_RadarFrontCenter_OnGoingObj0_OnGoingObj0_RFF_ub_SetVt)==0)
    {
        if(chgEv_OnGoingObj0_OnGoingObj0_RFF_ub == 0)
        {
            phyValue = getvalue(this);
            // physical to raw conversion
            rawValue = ((phyValue -(0))/1);
            putValue(E_pric_RadarFrontCenter_OnGoingObj0_OnGoingObj0_RFF_ub_Rv, rawValue);
            chgEv_OnGoingObj0_OnGoingObj0_RFF_ub = 1;  
        }
        else
        {
            chgEv_OnGoingObj0_OnGoingObj0_RFF_ub = 0;
        }
    }
}

on envVar E_pric_RadarFrontCenter_OnGoingObj0_OnGoingObj0_RFF_ub_Vt
{
    qword rawValue = 0ll;
    if(getValue(E_pric_RadarFrontCenter_OnGoingObj0_OnGoingObj0_RFF_ub_SetVt))
    {
        //update the signal value
        Msg_OnGoingObj0.OnGoingObj0_RFF_ub=getValue(this);
    }
}

on envVar E_pric_RadarFrontCenter_OnGoingObj0_OnGoingObj0_RFF_ub_SetVt
{
    if(getValue(E_pric_RadarFrontCenter_OnGoingObj0_OnGoingObj0_RFF_ub_SetVt))
    {
        //update the signal value
        Msg_OnGoingObj0.OnGoingObj0_RFF_ub=getvalue(E_pric_RadarFrontCenter_OnGoingObj0_OnGoingObj0_RFF_ub_Vt);
    }
    else
    {
        Msg_OnGoingObj0.OnGoingObj0_RFF_ub=getValue(E_pric_RadarFrontCenter_OnGoingObj0_OnGoingObj0_RFF_ub_Rv);
    }
}
 
on envVar E_pric_RadarFrontCenter_TrajPointACCObj13_tx
{
    if(getValue(this))
    {       
        
        //update the BZ Signal
        if(TrajPointACCObj13_TrajPointACCObj13_MsgCtr_wrongvalctr == 0)
        {
            update_TrajPointACCObj13_TrajPointACCObj13_MsgCtr_counter();
            Msg_TrajPointACCObj13.TrajPointACCObj13_MsgCtr= TrajPointACCObj13_TrajPointACCObj13_MsgCtr_counter;
        }
        else if(TrajPointACCObj13_TrajPointACCObj13_MsgCtr_wrongvalctr > 0)
        {
             TrajPointACCObj13_TrajPointACCObj13_MsgCtr_wrongvalctr--;
              // if counter becomes zero, update panel controller to zero
             if(TrajPointACCObj13_TrajPointACCObj13_MsgCtr_wrongvalctr == 0)
             {
                 putValue(E_pric_RadarFrontCenter_TrajPointACCObj13_TrajPointACCObj13_MsgCtr_wrongvalctr,0);
             }
        }
        else
        {
            //do nothing
        }        
        //update the BZ Signal
        if(TrajPointACCObj13_TrajPointACCObj13_blockCtr_wrongvalctr == 0)
        {
            update_TrajPointACCObj13_TrajPointACCObj13_blockCtr_counter();
            Msg_TrajPointACCObj13.TrajPointACCObj13_blockCtr= TrajPointACCObj13_TrajPointACCObj13_blockCtr_counter;
        }
        else if(TrajPointACCObj13_TrajPointACCObj13_blockCtr_wrongvalctr > 0)
        {
             TrajPointACCObj13_TrajPointACCObj13_blockCtr_wrongvalctr--;
              // if counter becomes zero, update panel controller to zero
             if(TrajPointACCObj13_TrajPointACCObj13_blockCtr_wrongvalctr == 0)
             {
                 putValue(E_pric_RadarFrontCenter_TrajPointACCObj13_TrajPointACCObj13_blockCtr_wrongvalctr,0);
             }
        }
        else
        {
            //do nothing
        }        
        //calculate the CRC checksum
        update_TrajPointACCObj13_ChkSum_Checksum();

        output(Msg_TrajPointACCObj13);        
    }
}

on envVar E_pric_RadarFrontCenter_TrajPointACCObj13_Range
{
    qword rawstatus = 0ll;
    qword rawValue = 0ll;    
    
    rawstatus = getvalue(this);    
    // set all the signals with min raw /max raw /init raw
    switch (rawstatus) 
    {
     case(0) :
        rawValue= -32768;
        putValue(E_pric_RadarFrontCenter_TrajPointACCObj13_TrajPointACCObj13_dyv_sw_Rv, rawValue);
        rawValue= 0;
        putValue(E_pric_RadarFrontCenter_TrajPointACCObj13_TrajPointACCObj13_TrajEnd_b_Rv, rawValue);
        rawValue= 0;
        putValue(E_pric_RadarFrontCenter_TrajPointACCObj13_TrajPointACCObj13_Drive_b_Rv, rawValue);
        rawValue= 0;
        putValue(E_pric_RadarFrontCenter_TrajPointACCObj13_TrajPointACCObj13_Stand_b_Rv, rawValue);
        rawValue= -32768;
        putValue(E_pric_RadarFrontCenter_TrajPointACCObj13_TrajPointACCObj13_dxv_sw_Rv, rawValue);
        rawValue= 0;
        putValue(E_pric_RadarFrontCenter_TrajPointACCObj13_TrajPointACCObj13_dVarXv_uw_Rv, rawValue);
        rawValue= 0;
        putValue(E_pric_RadarFrontCenter_TrajPointACCObj13_TrajPointACCObj13_wExistProb_ub_Rv, rawValue);
        rawValue= 0;
        putValue(E_pric_RadarFrontCenter_TrajPointACCObj13_TrajPointACCObj13_Valid_b_Rv, rawValue);
        rawValue= 0;
        putValue(E_pric_RadarFrontCenter_TrajPointACCObj13_TrajPointACCObj13_dVarYv_uw_Rv, rawValue);
        rawValue= 0;
        putValue(E_pric_RadarFrontCenter_TrajPointACCObj13_TrajPointACCObj13_InvDir_b_Rv, rawValue);
        rawValue= 0;
        putValue(E_pric_RadarFrontCenter_TrajPointACCObj13_TrajPointACCObj13_Stopped_b_Rv, rawValue);
        rawValue= 0;
        putValue(E_pric_RadarFrontCenter_TrajPointACCObj13_TrajPointACCObj13_timestamp_Rv, rawValue);
        break;
     case(1) :
        rawValue= 32767;
        putValue(E_pric_RadarFrontCenter_TrajPointACCObj13_TrajPointACCObj13_dyv_sw_Rv, rawValue);
        rawValue= 1;
        putValue(E_pric_RadarFrontCenter_TrajPointACCObj13_TrajPointACCObj13_TrajEnd_b_Rv, rawValue);
        rawValue= 1;
        putValue(E_pric_RadarFrontCenter_TrajPointACCObj13_TrajPointACCObj13_Drive_b_Rv, rawValue);
        rawValue= 1;
        putValue(E_pric_RadarFrontCenter_TrajPointACCObj13_TrajPointACCObj13_Stand_b_Rv, rawValue);
        rawValue= 32767;
        putValue(E_pric_RadarFrontCenter_TrajPointACCObj13_TrajPointACCObj13_dxv_sw_Rv, rawValue);
        rawValue= 65534;
        putValue(E_pric_RadarFrontCenter_TrajPointACCObj13_TrajPointACCObj13_dVarXv_uw_Rv, rawValue);
        rawValue= 255;
        putValue(E_pric_RadarFrontCenter_TrajPointACCObj13_TrajPointACCObj13_wExistProb_ub_Rv, rawValue);
        rawValue= 1;
        putValue(E_pric_RadarFrontCenter_TrajPointACCObj13_TrajPointACCObj13_Valid_b_Rv, rawValue);
        rawValue= 65534;
        putValue(E_pric_RadarFrontCenter_TrajPointACCObj13_TrajPointACCObj13_dVarYv_uw_Rv, rawValue);
        rawValue= 1;
        putValue(E_pric_RadarFrontCenter_TrajPointACCObj13_TrajPointACCObj13_InvDir_b_Rv, rawValue);
        rawValue= 1;
        putValue(E_pric_RadarFrontCenter_TrajPointACCObj13_TrajPointACCObj13_Stopped_b_Rv, rawValue);
        rawValue= 65536;
        putValue(E_pric_RadarFrontCenter_TrajPointACCObj13_TrajPointACCObj13_timestamp_Rv, rawValue);
        break;
     default :
        rawValue= -32768;
        putValue(E_pric_RadarFrontCenter_TrajPointACCObj13_TrajPointACCObj13_dyv_sw_Rv, rawValue);
        rawValue= 0;
        putValue(E_pric_RadarFrontCenter_TrajPointACCObj13_TrajPointACCObj13_TrajEnd_b_Rv, rawValue);
        rawValue= 0;
        putValue(E_pric_RadarFrontCenter_TrajPointACCObj13_TrajPointACCObj13_Drive_b_Rv, rawValue);
        rawValue= 0;
        putValue(E_pric_RadarFrontCenter_TrajPointACCObj13_TrajPointACCObj13_Stand_b_Rv, rawValue);
        rawValue= -32768;
        putValue(E_pric_RadarFrontCenter_TrajPointACCObj13_TrajPointACCObj13_dxv_sw_Rv, rawValue);
        rawValue= 0;
        putValue(E_pric_RadarFrontCenter_TrajPointACCObj13_TrajPointACCObj13_dVarXv_uw_Rv, rawValue);
        rawValue= 0;
        putValue(E_pric_RadarFrontCenter_TrajPointACCObj13_TrajPointACCObj13_wExistProb_ub_Rv, rawValue);
        rawValue= 0;
        putValue(E_pric_RadarFrontCenter_TrajPointACCObj13_TrajPointACCObj13_Valid_b_Rv, rawValue);
        rawValue= 0;
        putValue(E_pric_RadarFrontCenter_TrajPointACCObj13_TrajPointACCObj13_dVarYv_uw_Rv, rawValue);
        rawValue= 0;
        putValue(E_pric_RadarFrontCenter_TrajPointACCObj13_TrajPointACCObj13_InvDir_b_Rv, rawValue);
        rawValue= 0;
        putValue(E_pric_RadarFrontCenter_TrajPointACCObj13_TrajPointACCObj13_Stopped_b_Rv, rawValue);
        rawValue= 0;
        putValue(E_pric_RadarFrontCenter_TrajPointACCObj13_TrajPointACCObj13_timestamp_Rv, rawValue);
      break;
   }
}

on envVar E_pric_RadarFrontCenter_TrajPointACCObj13_Dlc
{
    if(getValue(E_pric_RadarFrontCenter_TrajPointACCObj13_enDlc))
    {
        Msg_TrajPointACCObj13.dlc =getValue(this);
    }
    else
    {
       Dbc_dlc = 16;
	   Msg_TrajPointACCObj13.dlc = Calc_Canfd_dlc(Dbc_dlc);
	   	
  }
}

on envVar E_pric_RadarFrontCenter_TrajPointACCObj13_enDlc
{
    //For Messages with DLC = 8, set wrong DLC to smaller than defined DLC
    //For Messages with DLC < 8 set wrong DLC to smaller/longer than defined DLC
    if(getValue(this))
    {
        Msg_TrajPointACCObj13.dlc =getValue(E_pric_RadarFrontCenter_TrajPointACCObj13_Dlc);
    }
    else
    {
       Dbc_dlc = 16;
	   Msg_TrajPointACCObj13.dlc = Calc_Canfd_dlc(Dbc_dlc);
			
    }
}

on envVar E_pric_RadarFrontCenter_TrajPointACCObj13_TrajPointACCObj13_CRC_wrongvalctr
{
    //update disturb count
    //disturb value range:(-1 = always send wrong value),( X>0 ,x is the number of Messages with wrong CHK sent)
    TrajPointACCObj13_TrajPointACCObj13_CRC_wrongvalctr =getValue(this);    
}
on envVar E_pric_RadarFrontCenter_TrajPointACCObj13_TrajPointACCObj13_MsgCtr_wrongvalctr
{
    //update disturb count
    //disturb value range:(-1 = always send wrong value),( X>0 ,x is the number of Messages with wrong CHK sent)
    TrajPointACCObj13_TrajPointACCObj13_MsgCtr_wrongvalctr =getValue(this);    
}
on envVar E_pric_RadarFrontCenter_TrajPointACCObj13_TrajPointACCObj13_blockCtr_wrongvalctr
{
    //update disturb count
    //disturb value range:(-1 = always send wrong value),( X>0 ,x is the number of Messages with wrong CHK sent)
    TrajPointACCObj13_TrajPointACCObj13_blockCtr_wrongvalctr =getValue(this);    
}

on envVar E_pric_RadarFrontCenter_TrajPointACCObj13_TrajPointACCObj13_dyv_sw_Rv
{
    qword rawValue = 0ll;
    float rawValue_float = 0.0;
    float phyValue = 0.0;        

    //set the signal with updated raw value
    {
        rawValue = getvalue(this);
        if(chgEv_TrajPointACCObj13_TrajPointACCObj13_dyv_sw == 0)
        {
            //type conversion to float
            rawValue_float = rawValue;        
            // raw to physical conversion
            phyValue = ((rawValue_float *0.0078125)+(0));
            putValue(E_pric_RadarFrontCenter_TrajPointACCObj13_TrajPointACCObj13_dyv_sw_Pv, phyValue);
            chgEv_TrajPointACCObj13_TrajPointACCObj13_dyv_sw = 1;
        }
        else
        {
            chgEv_TrajPointACCObj13_TrajPointACCObj13_dyv_sw = 0;
        }    
        //update the signal value
        Msg_TrajPointACCObj13.TrajPointACCObj13_dyv_sw=rawValue;        
    }                                                                           
}

on envVar E_pric_RadarFrontCenter_TrajPointACCObj13_TrajPointACCObj13_dyv_sw_Pv
{
    qword rawValue = 0ll;
    float phyValue = 0.0;
    
    //update the raw value with physical value 
    {
        if(chgEv_TrajPointACCObj13_TrajPointACCObj13_dyv_sw == 0)
        {
            phyValue = getvalue(this);
            // physical to raw conversion
            rawValue = ((phyValue -(0))/0.0078125);
            putValue(E_pric_RadarFrontCenter_TrajPointACCObj13_TrajPointACCObj13_dyv_sw_Rv, rawValue);
            chgEv_TrajPointACCObj13_TrajPointACCObj13_dyv_sw = 1;  
        }
        else
        {
            chgEv_TrajPointACCObj13_TrajPointACCObj13_dyv_sw = 0;
        }
    }
}


 
on envVar E_pric_RadarFrontCenter_TrajPointACCObj13_TrajPointACCObj13_TrajEnd_b_Rv
{
    qword rawValue = 0ll;
    float rawValue_float = 0.0;
    float phyValue = 0.0;        

    //set the signal with updated raw value
    if(getValue(E_pric_RadarFrontCenter_TrajPointACCObj13_TrajPointACCObj13_TrajEnd_b_SetVt)==0)
    {
        rawValue = getvalue(this);
        if(chgEv_TrajPointACCObj13_TrajPointACCObj13_TrajEnd_b == 0)
        {
            //type conversion to float
            rawValue_float = rawValue;        
            // raw to physical conversion
            phyValue = ((rawValue_float *1)+(0));
            putValue(E_pric_RadarFrontCenter_TrajPointACCObj13_TrajPointACCObj13_TrajEnd_b_Pv, phyValue);
            chgEv_TrajPointACCObj13_TrajPointACCObj13_TrajEnd_b = 1;
        }
        else
        {
            chgEv_TrajPointACCObj13_TrajPointACCObj13_TrajEnd_b = 0;
        }    
        //update the signal value
        Msg_TrajPointACCObj13.TrajPointACCObj13_TrajEnd_b=rawValue;        
    }                                                                           
}

on envVar E_pric_RadarFrontCenter_TrajPointACCObj13_TrajPointACCObj13_TrajEnd_b_Pv
{
    qword rawValue = 0ll;
    float phyValue = 0.0;
    
    //update the raw value with physical value 
    if(getValue(E_pric_RadarFrontCenter_TrajPointACCObj13_TrajPointACCObj13_TrajEnd_b_SetVt)==0)
    {
        if(chgEv_TrajPointACCObj13_TrajPointACCObj13_TrajEnd_b == 0)
        {
            phyValue = getvalue(this);
            // physical to raw conversion
            rawValue = ((phyValue -(0))/1);
            putValue(E_pric_RadarFrontCenter_TrajPointACCObj13_TrajPointACCObj13_TrajEnd_b_Rv, rawValue);
            chgEv_TrajPointACCObj13_TrajPointACCObj13_TrajEnd_b = 1;  
        }
        else
        {
            chgEv_TrajPointACCObj13_TrajPointACCObj13_TrajEnd_b = 0;
        }
    }
}

on envVar E_pric_RadarFrontCenter_TrajPointACCObj13_TrajPointACCObj13_TrajEnd_b_Vt
{
    qword rawValue = 0ll;
    if(getValue(E_pric_RadarFrontCenter_TrajPointACCObj13_TrajPointACCObj13_TrajEnd_b_SetVt))
    {
        //update the signal value
        Msg_TrajPointACCObj13.TrajPointACCObj13_TrajEnd_b=getValue(this);
    }
}

on envVar E_pric_RadarFrontCenter_TrajPointACCObj13_TrajPointACCObj13_TrajEnd_b_SetVt
{
    if(getValue(E_pric_RadarFrontCenter_TrajPointACCObj13_TrajPointACCObj13_TrajEnd_b_SetVt))
    {
        //update the signal value
        Msg_TrajPointACCObj13.TrajPointACCObj13_TrajEnd_b=getvalue(E_pric_RadarFrontCenter_TrajPointACCObj13_TrajPointACCObj13_TrajEnd_b_Vt);
    }
    else
    {
        Msg_TrajPointACCObj13.TrajPointACCObj13_TrajEnd_b=getValue(E_pric_RadarFrontCenter_TrajPointACCObj13_TrajPointACCObj13_TrajEnd_b_Rv);
    }
}
 
on envVar E_pric_RadarFrontCenter_TrajPointACCObj13_TrajPointACCObj13_Drive_b_Rv
{
    qword rawValue = 0ll;
    float rawValue_float = 0.0;
    float phyValue = 0.0;        

    //set the signal with updated raw value
    if(getValue(E_pric_RadarFrontCenter_TrajPointACCObj13_TrajPointACCObj13_Drive_b_SetVt)==0)
    {
        rawValue = getvalue(this);
        if(chgEv_TrajPointACCObj13_TrajPointACCObj13_Drive_b == 0)
        {
            //type conversion to float
            rawValue_float = rawValue;        
            // raw to physical conversion
            phyValue = ((rawValue_float *1)+(0));
            putValue(E_pric_RadarFrontCenter_TrajPointACCObj13_TrajPointACCObj13_Drive_b_Pv, phyValue);
            chgEv_TrajPointACCObj13_TrajPointACCObj13_Drive_b = 1;
        }
        else
        {
            chgEv_TrajPointACCObj13_TrajPointACCObj13_Drive_b = 0;
        }    
        //update the signal value
        Msg_TrajPointACCObj13.TrajPointACCObj13_Drive_b=rawValue;        
    }                                                                           
}

on envVar E_pric_RadarFrontCenter_TrajPointACCObj13_TrajPointACCObj13_Drive_b_Pv
{
    qword rawValue = 0ll;
    float phyValue = 0.0;
    
    //update the raw value with physical value 
    if(getValue(E_pric_RadarFrontCenter_TrajPointACCObj13_TrajPointACCObj13_Drive_b_SetVt)==0)
    {
        if(chgEv_TrajPointACCObj13_TrajPointACCObj13_Drive_b == 0)
        {
            phyValue = getvalue(this);
            // physical to raw conversion
            rawValue = ((phyValue -(0))/1);
            putValue(E_pric_RadarFrontCenter_TrajPointACCObj13_TrajPointACCObj13_Drive_b_Rv, rawValue);
            chgEv_TrajPointACCObj13_TrajPointACCObj13_Drive_b = 1;  
        }
        else
        {
            chgEv_TrajPointACCObj13_TrajPointACCObj13_Drive_b = 0;
        }
    }
}

on envVar E_pric_RadarFrontCenter_TrajPointACCObj13_TrajPointACCObj13_Drive_b_Vt
{
    qword rawValue = 0ll;
    if(getValue(E_pric_RadarFrontCenter_TrajPointACCObj13_TrajPointACCObj13_Drive_b_SetVt))
    {
        //update the signal value
        Msg_TrajPointACCObj13.TrajPointACCObj13_Drive_b=getValue(this);
    }
}

on envVar E_pric_RadarFrontCenter_TrajPointACCObj13_TrajPointACCObj13_Drive_b_SetVt
{
    if(getValue(E_pric_RadarFrontCenter_TrajPointACCObj13_TrajPointACCObj13_Drive_b_SetVt))
    {
        //update the signal value
        Msg_TrajPointACCObj13.TrajPointACCObj13_Drive_b=getvalue(E_pric_RadarFrontCenter_TrajPointACCObj13_TrajPointACCObj13_Drive_b_Vt);
    }
    else
    {
        Msg_TrajPointACCObj13.TrajPointACCObj13_Drive_b=getValue(E_pric_RadarFrontCenter_TrajPointACCObj13_TrajPointACCObj13_Drive_b_Rv);
    }
}
 
on envVar E_pric_RadarFrontCenter_TrajPointACCObj13_TrajPointACCObj13_Stand_b_Rv
{
    qword rawValue = 0ll;
    float rawValue_float = 0.0;
    float phyValue = 0.0;        

    //set the signal with updated raw value
    if(getValue(E_pric_RadarFrontCenter_TrajPointACCObj13_TrajPointACCObj13_Stand_b_SetVt)==0)
    {
        rawValue = getvalue(this);
        if(chgEv_TrajPointACCObj13_TrajPointACCObj13_Stand_b == 0)
        {
            //type conversion to float
            rawValue_float = rawValue;        
            // raw to physical conversion
            phyValue = ((rawValue_float *1)+(0));
            putValue(E_pric_RadarFrontCenter_TrajPointACCObj13_TrajPointACCObj13_Stand_b_Pv, phyValue);
            chgEv_TrajPointACCObj13_TrajPointACCObj13_Stand_b = 1;
        }
        else
        {
            chgEv_TrajPointACCObj13_TrajPointACCObj13_Stand_b = 0;
        }    
        //update the signal value
        Msg_TrajPointACCObj13.TrajPointACCObj13_Stand_b=rawValue;        
    }                                                                           
}

on envVar E_pric_RadarFrontCenter_TrajPointACCObj13_TrajPointACCObj13_Stand_b_Pv
{
    qword rawValue = 0ll;
    float phyValue = 0.0;
    
    //update the raw value with physical value 
    if(getValue(E_pric_RadarFrontCenter_TrajPointACCObj13_TrajPointACCObj13_Stand_b_SetVt)==0)
    {
        if(chgEv_TrajPointACCObj13_TrajPointACCObj13_Stand_b == 0)
        {
            phyValue = getvalue(this);
            // physical to raw conversion
            rawValue = ((phyValue -(0))/1);
            putValue(E_pric_RadarFrontCenter_TrajPointACCObj13_TrajPointACCObj13_Stand_b_Rv, rawValue);
            chgEv_TrajPointACCObj13_TrajPointACCObj13_Stand_b = 1;  
        }
        else
        {
            chgEv_TrajPointACCObj13_TrajPointACCObj13_Stand_b = 0;
        }
    }
}

on envVar E_pric_RadarFrontCenter_TrajPointACCObj13_TrajPointACCObj13_Stand_b_Vt
{
    qword rawValue = 0ll;
    if(getValue(E_pric_RadarFrontCenter_TrajPointACCObj13_TrajPointACCObj13_Stand_b_SetVt))
    {
        //update the signal value
        Msg_TrajPointACCObj13.TrajPointACCObj13_Stand_b=getValue(this);
    }
}

on envVar E_pric_RadarFrontCenter_TrajPointACCObj13_TrajPointACCObj13_Stand_b_SetVt
{
    if(getValue(E_pric_RadarFrontCenter_TrajPointACCObj13_TrajPointACCObj13_Stand_b_SetVt))
    {
        //update the signal value
        Msg_TrajPointACCObj13.TrajPointACCObj13_Stand_b=getvalue(E_pric_RadarFrontCenter_TrajPointACCObj13_TrajPointACCObj13_Stand_b_Vt);
    }
    else
    {
        Msg_TrajPointACCObj13.TrajPointACCObj13_Stand_b=getValue(E_pric_RadarFrontCenter_TrajPointACCObj13_TrajPointACCObj13_Stand_b_Rv);
    }
}
 
on envVar E_pric_RadarFrontCenter_TrajPointACCObj13_TrajPointACCObj13_dxv_sw_Rv
{
    qword rawValue = 0ll;
    float rawValue_float = 0.0;
    float phyValue = 0.0;        

    //set the signal with updated raw value
    {
        rawValue = getvalue(this);
        if(chgEv_TrajPointACCObj13_TrajPointACCObj13_dxv_sw == 0)
        {
            //type conversion to float
            rawValue_float = rawValue;        
            // raw to physical conversion
            phyValue = ((rawValue_float *0.0078125)+(0));
            putValue(E_pric_RadarFrontCenter_TrajPointACCObj13_TrajPointACCObj13_dxv_sw_Pv, phyValue);
            chgEv_TrajPointACCObj13_TrajPointACCObj13_dxv_sw = 1;
        }
        else
        {
            chgEv_TrajPointACCObj13_TrajPointACCObj13_dxv_sw = 0;
        }    
        //update the signal value
        Msg_TrajPointACCObj13.TrajPointACCObj13_dxv_sw=rawValue;        
    }                                                                           
}

on envVar E_pric_RadarFrontCenter_TrajPointACCObj13_TrajPointACCObj13_dxv_sw_Pv
{
    qword rawValue = 0ll;
    float phyValue = 0.0;
    
    //update the raw value with physical value 
    {
        if(chgEv_TrajPointACCObj13_TrajPointACCObj13_dxv_sw == 0)
        {
            phyValue = getvalue(this);
            // physical to raw conversion
            rawValue = ((phyValue -(0))/0.0078125);
            putValue(E_pric_RadarFrontCenter_TrajPointACCObj13_TrajPointACCObj13_dxv_sw_Rv, rawValue);
            chgEv_TrajPointACCObj13_TrajPointACCObj13_dxv_sw = 1;  
        }
        else
        {
            chgEv_TrajPointACCObj13_TrajPointACCObj13_dxv_sw = 0;
        }
    }
}


 
on envVar E_pric_RadarFrontCenter_TrajPointACCObj13_TrajPointACCObj13_dVarXv_uw_Rv
{
    qword rawValue = 0ll;
    float rawValue_float = 0.0;
    float phyValue = 0.0;        

    //set the signal with updated raw value
    {
        rawValue = getvalue(this);
        if(chgEv_TrajPointACCObj13_TrajPointACCObj13_dVarXv_uw == 0)
        {
            //type conversion to float
            rawValue_float = rawValue;        
            // raw to physical conversion
            phyValue = ((rawValue_float *0.00195313)+(0));
            putValue(E_pric_RadarFrontCenter_TrajPointACCObj13_TrajPointACCObj13_dVarXv_uw_Pv, phyValue);
            chgEv_TrajPointACCObj13_TrajPointACCObj13_dVarXv_uw = 1;
        }
        else
        {
            chgEv_TrajPointACCObj13_TrajPointACCObj13_dVarXv_uw = 0;
        }    
        //update the signal value
        Msg_TrajPointACCObj13.TrajPointACCObj13_dVarXv_uw=rawValue;        
    }                                                                           
}

on envVar E_pric_RadarFrontCenter_TrajPointACCObj13_TrajPointACCObj13_dVarXv_uw_Pv
{
    qword rawValue = 0ll;
    float phyValue = 0.0;
    
    //update the raw value with physical value 
    {
        if(chgEv_TrajPointACCObj13_TrajPointACCObj13_dVarXv_uw == 0)
        {
            phyValue = getvalue(this);
            // physical to raw conversion
            rawValue = ((phyValue -(0))/0.00195313);
            putValue(E_pric_RadarFrontCenter_TrajPointACCObj13_TrajPointACCObj13_dVarXv_uw_Rv, rawValue);
            chgEv_TrajPointACCObj13_TrajPointACCObj13_dVarXv_uw = 1;  
        }
        else
        {
            chgEv_TrajPointACCObj13_TrajPointACCObj13_dVarXv_uw = 0;
        }
    }
}


 
on envVar E_pric_RadarFrontCenter_TrajPointACCObj13_TrajPointACCObj13_wExistProb_ub_Rv
{
    qword rawValue = 0ll;
    float rawValue_float = 0.0;
    float phyValue = 0.0;        

    //set the signal with updated raw value
    {
        rawValue = getvalue(this);
        if(chgEv_TrajPointACCObj13_TrajPointACCObj13_wExistProb_ub == 0)
        {
            //type conversion to float
            rawValue_float = rawValue;        
            // raw to physical conversion
            phyValue = ((rawValue_float *0.00390625)+(0));
            putValue(E_pric_RadarFrontCenter_TrajPointACCObj13_TrajPointACCObj13_wExistProb_ub_Pv, phyValue);
            chgEv_TrajPointACCObj13_TrajPointACCObj13_wExistProb_ub = 1;
        }
        else
        {
            chgEv_TrajPointACCObj13_TrajPointACCObj13_wExistProb_ub = 0;
        }    
        //update the signal value
        Msg_TrajPointACCObj13.TrajPointACCObj13_wExistProb_ub=rawValue;        
    }                                                                           
}

on envVar E_pric_RadarFrontCenter_TrajPointACCObj13_TrajPointACCObj13_wExistProb_ub_Pv
{
    qword rawValue = 0ll;
    float phyValue = 0.0;
    
    //update the raw value with physical value 
    {
        if(chgEv_TrajPointACCObj13_TrajPointACCObj13_wExistProb_ub == 0)
        {
            phyValue = getvalue(this);
            // physical to raw conversion
            rawValue = ((phyValue -(0))/0.00390625);
            putValue(E_pric_RadarFrontCenter_TrajPointACCObj13_TrajPointACCObj13_wExistProb_ub_Rv, rawValue);
            chgEv_TrajPointACCObj13_TrajPointACCObj13_wExistProb_ub = 1;  
        }
        else
        {
            chgEv_TrajPointACCObj13_TrajPointACCObj13_wExistProb_ub = 0;
        }
    }
}


 
on envVar E_pric_RadarFrontCenter_TrajPointACCObj13_TrajPointACCObj13_Valid_b_Rv
{
    qword rawValue = 0ll;
    float rawValue_float = 0.0;
    float phyValue = 0.0;        

    //set the signal with updated raw value
    if(getValue(E_pric_RadarFrontCenter_TrajPointACCObj13_TrajPointACCObj13_Valid_b_SetVt)==0)
    {
        rawValue = getvalue(this);
        if(chgEv_TrajPointACCObj13_TrajPointACCObj13_Valid_b == 0)
        {
            //type conversion to float
            rawValue_float = rawValue;        
            // raw to physical conversion
            phyValue = ((rawValue_float *1)+(0));
            putValue(E_pric_RadarFrontCenter_TrajPointACCObj13_TrajPointACCObj13_Valid_b_Pv, phyValue);
            chgEv_TrajPointACCObj13_TrajPointACCObj13_Valid_b = 1;
        }
        else
        {
            chgEv_TrajPointACCObj13_TrajPointACCObj13_Valid_b = 0;
        }    
        //update the signal value
        Msg_TrajPointACCObj13.TrajPointACCObj13_Valid_b=rawValue;        
    }                                                                           
}

on envVar E_pric_RadarFrontCenter_TrajPointACCObj13_TrajPointACCObj13_Valid_b_Pv
{
    qword rawValue = 0ll;
    float phyValue = 0.0;
    
    //update the raw value with physical value 
    if(getValue(E_pric_RadarFrontCenter_TrajPointACCObj13_TrajPointACCObj13_Valid_b_SetVt)==0)
    {
        if(chgEv_TrajPointACCObj13_TrajPointACCObj13_Valid_b == 0)
        {
            phyValue = getvalue(this);
            // physical to raw conversion
            rawValue = ((phyValue -(0))/1);
            putValue(E_pric_RadarFrontCenter_TrajPointACCObj13_TrajPointACCObj13_Valid_b_Rv, rawValue);
            chgEv_TrajPointACCObj13_TrajPointACCObj13_Valid_b = 1;  
        }
        else
        {
            chgEv_TrajPointACCObj13_TrajPointACCObj13_Valid_b = 0;
        }
    }
}

on envVar E_pric_RadarFrontCenter_TrajPointACCObj13_TrajPointACCObj13_Valid_b_Vt
{
    qword rawValue = 0ll;
    if(getValue(E_pric_RadarFrontCenter_TrajPointACCObj13_TrajPointACCObj13_Valid_b_SetVt))
    {
        //update the signal value
        Msg_TrajPointACCObj13.TrajPointACCObj13_Valid_b=getValue(this);
    }
}

on envVar E_pric_RadarFrontCenter_TrajPointACCObj13_TrajPointACCObj13_Valid_b_SetVt
{
    if(getValue(E_pric_RadarFrontCenter_TrajPointACCObj13_TrajPointACCObj13_Valid_b_SetVt))
    {
        //update the signal value
        Msg_TrajPointACCObj13.TrajPointACCObj13_Valid_b=getvalue(E_pric_RadarFrontCenter_TrajPointACCObj13_TrajPointACCObj13_Valid_b_Vt);
    }
    else
    {
        Msg_TrajPointACCObj13.TrajPointACCObj13_Valid_b=getValue(E_pric_RadarFrontCenter_TrajPointACCObj13_TrajPointACCObj13_Valid_b_Rv);
    }
}
 
on envVar E_pric_RadarFrontCenter_TrajPointACCObj13_TrajPointACCObj13_dVarYv_uw_Rv
{
    qword rawValue = 0ll;
    float rawValue_float = 0.0;
    float phyValue = 0.0;        

    //set the signal with updated raw value
    {
        rawValue = getvalue(this);
        if(chgEv_TrajPointACCObj13_TrajPointACCObj13_dVarYv_uw == 0)
        {
            //type conversion to float
            rawValue_float = rawValue;        
            // raw to physical conversion
            phyValue = ((rawValue_float *0.00195313)+(0));
            putValue(E_pric_RadarFrontCenter_TrajPointACCObj13_TrajPointACCObj13_dVarYv_uw_Pv, phyValue);
            chgEv_TrajPointACCObj13_TrajPointACCObj13_dVarYv_uw = 1;
        }
        else
        {
            chgEv_TrajPointACCObj13_TrajPointACCObj13_dVarYv_uw = 0;
        }    
        //update the signal value
        Msg_TrajPointACCObj13.TrajPointACCObj13_dVarYv_uw=rawValue;        
    }                                                                           
}

on envVar E_pric_RadarFrontCenter_TrajPointACCObj13_TrajPointACCObj13_dVarYv_uw_Pv
{
    qword rawValue = 0ll;
    float phyValue = 0.0;
    
    //update the raw value with physical value 
    {
        if(chgEv_TrajPointACCObj13_TrajPointACCObj13_dVarYv_uw == 0)
        {
            phyValue = getvalue(this);
            // physical to raw conversion
            rawValue = ((phyValue -(0))/0.00195313);
            putValue(E_pric_RadarFrontCenter_TrajPointACCObj13_TrajPointACCObj13_dVarYv_uw_Rv, rawValue);
            chgEv_TrajPointACCObj13_TrajPointACCObj13_dVarYv_uw = 1;  
        }
        else
        {
            chgEv_TrajPointACCObj13_TrajPointACCObj13_dVarYv_uw = 0;
        }
    }
}


 
on envVar E_pric_RadarFrontCenter_TrajPointACCObj13_TrajPointACCObj13_InvDir_b_Rv
{
    qword rawValue = 0ll;
    float rawValue_float = 0.0;
    float phyValue = 0.0;        

    //set the signal with updated raw value
    if(getValue(E_pric_RadarFrontCenter_TrajPointACCObj13_TrajPointACCObj13_InvDir_b_SetVt)==0)
    {
        rawValue = getvalue(this);
        if(chgEv_TrajPointACCObj13_TrajPointACCObj13_InvDir_b == 0)
        {
            //type conversion to float
            rawValue_float = rawValue;        
            // raw to physical conversion
            phyValue = ((rawValue_float *1)+(0));
            putValue(E_pric_RadarFrontCenter_TrajPointACCObj13_TrajPointACCObj13_InvDir_b_Pv, phyValue);
            chgEv_TrajPointACCObj13_TrajPointACCObj13_InvDir_b = 1;
        }
        else
        {
            chgEv_TrajPointACCObj13_TrajPointACCObj13_InvDir_b = 0;
        }    
        //update the signal value
        Msg_TrajPointACCObj13.TrajPointACCObj13_InvDir_b=rawValue;        
    }                                                                           
}

on envVar E_pric_RadarFrontCenter_TrajPointACCObj13_TrajPointACCObj13_InvDir_b_Pv
{
    qword rawValue = 0ll;
    float phyValue = 0.0;
    
    //update the raw value with physical value 
    if(getValue(E_pric_RadarFrontCenter_TrajPointACCObj13_TrajPointACCObj13_InvDir_b_SetVt)==0)
    {
        if(chgEv_TrajPointACCObj13_TrajPointACCObj13_InvDir_b == 0)
        {
            phyValue = getvalue(this);
            // physical to raw conversion
            rawValue = ((phyValue -(0))/1);
            putValue(E_pric_RadarFrontCenter_TrajPointACCObj13_TrajPointACCObj13_InvDir_b_Rv, rawValue);
            chgEv_TrajPointACCObj13_TrajPointACCObj13_InvDir_b = 1;  
        }
        else
        {
            chgEv_TrajPointACCObj13_TrajPointACCObj13_InvDir_b = 0;
        }
    }
}

on envVar E_pric_RadarFrontCenter_TrajPointACCObj13_TrajPointACCObj13_InvDir_b_Vt
{
    qword rawValue = 0ll;
    if(getValue(E_pric_RadarFrontCenter_TrajPointACCObj13_TrajPointACCObj13_InvDir_b_SetVt))
    {
        //update the signal value
        Msg_TrajPointACCObj13.TrajPointACCObj13_InvDir_b=getValue(this);
    }
}

on envVar E_pric_RadarFrontCenter_TrajPointACCObj13_TrajPointACCObj13_InvDir_b_SetVt
{
    if(getValue(E_pric_RadarFrontCenter_TrajPointACCObj13_TrajPointACCObj13_InvDir_b_SetVt))
    {
        //update the signal value
        Msg_TrajPointACCObj13.TrajPointACCObj13_InvDir_b=getvalue(E_pric_RadarFrontCenter_TrajPointACCObj13_TrajPointACCObj13_InvDir_b_Vt);
    }
    else
    {
        Msg_TrajPointACCObj13.TrajPointACCObj13_InvDir_b=getValue(E_pric_RadarFrontCenter_TrajPointACCObj13_TrajPointACCObj13_InvDir_b_Rv);
    }
}
 
on envVar E_pric_RadarFrontCenter_TrajPointACCObj13_TrajPointACCObj13_Stopped_b_Rv
{
    qword rawValue = 0ll;
    float rawValue_float = 0.0;
    float phyValue = 0.0;        

    //set the signal with updated raw value
    if(getValue(E_pric_RadarFrontCenter_TrajPointACCObj13_TrajPointACCObj13_Stopped_b_SetVt)==0)
    {
        rawValue = getvalue(this);
        if(chgEv_TrajPointACCObj13_TrajPointACCObj13_Stopped_b == 0)
        {
            //type conversion to float
            rawValue_float = rawValue;        
            // raw to physical conversion
            phyValue = ((rawValue_float *1)+(0));
            putValue(E_pric_RadarFrontCenter_TrajPointACCObj13_TrajPointACCObj13_Stopped_b_Pv, phyValue);
            chgEv_TrajPointACCObj13_TrajPointACCObj13_Stopped_b = 1;
        }
        else
        {
            chgEv_TrajPointACCObj13_TrajPointACCObj13_Stopped_b = 0;
        }    
        //update the signal value
        Msg_TrajPointACCObj13.TrajPointACCObj13_Stopped_b=rawValue;        
    }                                                                           
}

on envVar E_pric_RadarFrontCenter_TrajPointACCObj13_TrajPointACCObj13_Stopped_b_Pv
{
    qword rawValue = 0ll;
    float phyValue = 0.0;
    
    //update the raw value with physical value 
    if(getValue(E_pric_RadarFrontCenter_TrajPointACCObj13_TrajPointACCObj13_Stopped_b_SetVt)==0)
    {
        if(chgEv_TrajPointACCObj13_TrajPointACCObj13_Stopped_b == 0)
        {
            phyValue = getvalue(this);
            // physical to raw conversion
            rawValue = ((phyValue -(0))/1);
            putValue(E_pric_RadarFrontCenter_TrajPointACCObj13_TrajPointACCObj13_Stopped_b_Rv, rawValue);
            chgEv_TrajPointACCObj13_TrajPointACCObj13_Stopped_b = 1;  
        }
        else
        {
            chgEv_TrajPointACCObj13_TrajPointACCObj13_Stopped_b = 0;
        }
    }
}

on envVar E_pric_RadarFrontCenter_TrajPointACCObj13_TrajPointACCObj13_Stopped_b_Vt
{
    qword rawValue = 0ll;
    if(getValue(E_pric_RadarFrontCenter_TrajPointACCObj13_TrajPointACCObj13_Stopped_b_SetVt))
    {
        //update the signal value
        Msg_TrajPointACCObj13.TrajPointACCObj13_Stopped_b=getValue(this);
    }
}

on envVar E_pric_RadarFrontCenter_TrajPointACCObj13_TrajPointACCObj13_Stopped_b_SetVt
{
    if(getValue(E_pric_RadarFrontCenter_TrajPointACCObj13_TrajPointACCObj13_Stopped_b_SetVt))
    {
        //update the signal value
        Msg_TrajPointACCObj13.TrajPointACCObj13_Stopped_b=getvalue(E_pric_RadarFrontCenter_TrajPointACCObj13_TrajPointACCObj13_Stopped_b_Vt);
    }
    else
    {
        Msg_TrajPointACCObj13.TrajPointACCObj13_Stopped_b=getValue(E_pric_RadarFrontCenter_TrajPointACCObj13_TrajPointACCObj13_Stopped_b_Rv);
    }
}
 
on envVar E_pric_RadarFrontCenter_TrajPointACCObj13_TrajPointACCObj13_timestamp_Rv
{
    qword rawValue = 0ll;
    float rawValue_float = 0.0;
    float phyValue = 0.0;        

    //set the signal with updated raw value
    {
        rawValue = getvalue(this);
        if(chgEv_TrajPointACCObj13_TrajPointACCObj13_timestamp == 0)
        {
            //type conversion to float
            rawValue_float = rawValue;        
            // raw to physical conversion
            phyValue = ((rawValue_float *0.000488281)+(0));
            putValue(E_pric_RadarFrontCenter_TrajPointACCObj13_TrajPointACCObj13_timestamp_Pv, phyValue);
            chgEv_TrajPointACCObj13_TrajPointACCObj13_timestamp = 1;
        }
        else
        {
            chgEv_TrajPointACCObj13_TrajPointACCObj13_timestamp = 0;
        }    
        //update the signal value
        Msg_TrajPointACCObj13.TrajPointACCObj13_timestamp=rawValue;        
    }                                                                           
}

on envVar E_pric_RadarFrontCenter_TrajPointACCObj13_TrajPointACCObj13_timestamp_Pv
{
    qword rawValue = 0ll;
    float phyValue = 0.0;
    
    //update the raw value with physical value 
    {
        if(chgEv_TrajPointACCObj13_TrajPointACCObj13_timestamp == 0)
        {
            phyValue = getvalue(this);
            // physical to raw conversion
            rawValue = ((phyValue -(0))/0.000488281);
            putValue(E_pric_RadarFrontCenter_TrajPointACCObj13_TrajPointACCObj13_timestamp_Rv, rawValue);
            chgEv_TrajPointACCObj13_TrajPointACCObj13_timestamp = 1;  
        }
        else
        {
            chgEv_TrajPointACCObj13_TrajPointACCObj13_timestamp = 0;
        }
    }
}


 
on envVar E_pric_RadarFrontCenter_TrajPointACCObj12_tx
{
    if(getValue(this))
    {       
        
        //update the BZ Signal
        if(TrajPointACCObj12_TrajPointACCObj12_MsgCtr_wrongvalctr == 0)
        {
            update_TrajPointACCObj12_TrajPointACCObj12_MsgCtr_counter();
            Msg_TrajPointACCObj12.TrajPointACCObj12_MsgCtr= TrajPointACCObj12_TrajPointACCObj12_MsgCtr_counter;
        }
        else if(TrajPointACCObj12_TrajPointACCObj12_MsgCtr_wrongvalctr > 0)
        {
             TrajPointACCObj12_TrajPointACCObj12_MsgCtr_wrongvalctr--;
              // if counter becomes zero, update panel controller to zero
             if(TrajPointACCObj12_TrajPointACCObj12_MsgCtr_wrongvalctr == 0)
             {
                 putValue(E_pric_RadarFrontCenter_TrajPointACCObj12_TrajPointACCObj12_MsgCtr_wrongvalctr,0);
             }
        }
        else
        {
            //do nothing
        }        
        //update the BZ Signal
        if(TrajPointACCObj12_TrajPointACCObj12_blockCtr_wrongvalctr == 0)
        {
            update_TrajPointACCObj12_TrajPointACCObj12_blockCtr_counter();
            Msg_TrajPointACCObj12.TrajPointACCObj12_blockCtr= TrajPointACCObj12_TrajPointACCObj12_blockCtr_counter;
        }
        else if(TrajPointACCObj12_TrajPointACCObj12_blockCtr_wrongvalctr > 0)
        {
             TrajPointACCObj12_TrajPointACCObj12_blockCtr_wrongvalctr--;
              // if counter becomes zero, update panel controller to zero
             if(TrajPointACCObj12_TrajPointACCObj12_blockCtr_wrongvalctr == 0)
             {
                 putValue(E_pric_RadarFrontCenter_TrajPointACCObj12_TrajPointACCObj12_blockCtr_wrongvalctr,0);
             }
        }
        else
        {
            //do nothing
        }        
        //calculate the CRC checksum
        update_TrajPointACCObj12_ChkSum_Checksum();

        output(Msg_TrajPointACCObj12);        
    }
}

on envVar E_pric_RadarFrontCenter_TrajPointACCObj12_Range
{
    qword rawstatus = 0ll;
    qword rawValue = 0ll;    
    
    rawstatus = getvalue(this);    
    // set all the signals with min raw /max raw /init raw
    switch (rawstatus) 
    {
     case(0) :
        rawValue= 0;
        putValue(E_pric_RadarFrontCenter_TrajPointACCObj12_TrajPointACCObj12_Valid_b_Rv, rawValue);
        rawValue= 0;
        putValue(E_pric_RadarFrontCenter_TrajPointACCObj12_TrajPointACCObj12_dVarYv_uw_Rv, rawValue);
        rawValue= 0;
        putValue(E_pric_RadarFrontCenter_TrajPointACCObj12_TrajPointACCObj12_wExistProb_ub_Rv, rawValue);
        rawValue= 0;
        putValue(E_pric_RadarFrontCenter_TrajPointACCObj12_TrajPointACCObj12_InvDir_b_Rv, rawValue);
        rawValue= 0;
        putValue(E_pric_RadarFrontCenter_TrajPointACCObj12_TrajPointACCObj12_dVarXv_uw_Rv, rawValue);
        rawValue= 0;
        putValue(E_pric_RadarFrontCenter_TrajPointACCObj12_TrajPointACCObj12_Stopped_b_Rv, rawValue);
        rawValue= -32768;
        putValue(E_pric_RadarFrontCenter_TrajPointACCObj12_TrajPointACCObj12_dyv_sw_Rv, rawValue);
        rawValue= -32768;
        putValue(E_pric_RadarFrontCenter_TrajPointACCObj12_TrajPointACCObj12_dxv_sw_Rv, rawValue);
        rawValue= 0;
        putValue(E_pric_RadarFrontCenter_TrajPointACCObj12_TrajPointACCObj12_Drive_b_Rv, rawValue);
        rawValue= 0;
        putValue(E_pric_RadarFrontCenter_TrajPointACCObj12_TrajPointACCObj12_timestamp_Rv, rawValue);
        rawValue= 0;
        putValue(E_pric_RadarFrontCenter_TrajPointACCObj12_TrajPointACCObj12_TrajEnd_b_Rv, rawValue);
        rawValue= 0;
        putValue(E_pric_RadarFrontCenter_TrajPointACCObj12_TrajPointACCObj12_Stand_b_Rv, rawValue);
        break;
     case(1) :
        rawValue= 1;
        putValue(E_pric_RadarFrontCenter_TrajPointACCObj12_TrajPointACCObj12_Valid_b_Rv, rawValue);
        rawValue= 65534;
        putValue(E_pric_RadarFrontCenter_TrajPointACCObj12_TrajPointACCObj12_dVarYv_uw_Rv, rawValue);
        rawValue= 255;
        putValue(E_pric_RadarFrontCenter_TrajPointACCObj12_TrajPointACCObj12_wExistProb_ub_Rv, rawValue);
        rawValue= 1;
        putValue(E_pric_RadarFrontCenter_TrajPointACCObj12_TrajPointACCObj12_InvDir_b_Rv, rawValue);
        rawValue= 65534;
        putValue(E_pric_RadarFrontCenter_TrajPointACCObj12_TrajPointACCObj12_dVarXv_uw_Rv, rawValue);
        rawValue= 1;
        putValue(E_pric_RadarFrontCenter_TrajPointACCObj12_TrajPointACCObj12_Stopped_b_Rv, rawValue);
        rawValue= 32767;
        putValue(E_pric_RadarFrontCenter_TrajPointACCObj12_TrajPointACCObj12_dyv_sw_Rv, rawValue);
        rawValue= 32767;
        putValue(E_pric_RadarFrontCenter_TrajPointACCObj12_TrajPointACCObj12_dxv_sw_Rv, rawValue);
        rawValue= 1;
        putValue(E_pric_RadarFrontCenter_TrajPointACCObj12_TrajPointACCObj12_Drive_b_Rv, rawValue);
        rawValue= 65536;
        putValue(E_pric_RadarFrontCenter_TrajPointACCObj12_TrajPointACCObj12_timestamp_Rv, rawValue);
        rawValue= 1;
        putValue(E_pric_RadarFrontCenter_TrajPointACCObj12_TrajPointACCObj12_TrajEnd_b_Rv, rawValue);
        rawValue= 1;
        putValue(E_pric_RadarFrontCenter_TrajPointACCObj12_TrajPointACCObj12_Stand_b_Rv, rawValue);
        break;
     default :
        rawValue= 0;
        putValue(E_pric_RadarFrontCenter_TrajPointACCObj12_TrajPointACCObj12_Valid_b_Rv, rawValue);
        rawValue= 0;
        putValue(E_pric_RadarFrontCenter_TrajPointACCObj12_TrajPointACCObj12_dVarYv_uw_Rv, rawValue);
        rawValue= 0;
        putValue(E_pric_RadarFrontCenter_TrajPointACCObj12_TrajPointACCObj12_wExistProb_ub_Rv, rawValue);
        rawValue= 0;
        putValue(E_pric_RadarFrontCenter_TrajPointACCObj12_TrajPointACCObj12_InvDir_b_Rv, rawValue);
        rawValue= 0;
        putValue(E_pric_RadarFrontCenter_TrajPointACCObj12_TrajPointACCObj12_dVarXv_uw_Rv, rawValue);
        rawValue= 0;
        putValue(E_pric_RadarFrontCenter_TrajPointACCObj12_TrajPointACCObj12_Stopped_b_Rv, rawValue);
        rawValue= -32768;
        putValue(E_pric_RadarFrontCenter_TrajPointACCObj12_TrajPointACCObj12_dyv_sw_Rv, rawValue);
        rawValue= -32768;
        putValue(E_pric_RadarFrontCenter_TrajPointACCObj12_TrajPointACCObj12_dxv_sw_Rv, rawValue);
        rawValue= 0;
        putValue(E_pric_RadarFrontCenter_TrajPointACCObj12_TrajPointACCObj12_Drive_b_Rv, rawValue);
        rawValue= 0;
        putValue(E_pric_RadarFrontCenter_TrajPointACCObj12_TrajPointACCObj12_timestamp_Rv, rawValue);
        rawValue= 0;
        putValue(E_pric_RadarFrontCenter_TrajPointACCObj12_TrajPointACCObj12_TrajEnd_b_Rv, rawValue);
        rawValue= 0;
        putValue(E_pric_RadarFrontCenter_TrajPointACCObj12_TrajPointACCObj12_Stand_b_Rv, rawValue);
      break;
   }
}

on envVar E_pric_RadarFrontCenter_TrajPointACCObj12_Dlc
{
    if(getValue(E_pric_RadarFrontCenter_TrajPointACCObj12_enDlc))
    {
        Msg_TrajPointACCObj12.dlc =getValue(this);
    }
    else
    {
       Dbc_dlc = 16;
	   Msg_TrajPointACCObj12.dlc = Calc_Canfd_dlc(Dbc_dlc);
	   	
  }
}

on envVar E_pric_RadarFrontCenter_TrajPointACCObj12_enDlc
{
    //For Messages with DLC = 8, set wrong DLC to smaller than defined DLC
    //For Messages with DLC < 8 set wrong DLC to smaller/longer than defined DLC
    if(getValue(this))
    {
        Msg_TrajPointACCObj12.dlc =getValue(E_pric_RadarFrontCenter_TrajPointACCObj12_Dlc);
    }
    else
    {
       Dbc_dlc = 16;
	   Msg_TrajPointACCObj12.dlc = Calc_Canfd_dlc(Dbc_dlc);
			
    }
}

on envVar E_pric_RadarFrontCenter_TrajPointACCObj12_TrajPointACCObj12_CRC_wrongvalctr
{
    //update disturb count
    //disturb value range:(-1 = always send wrong value),( X>0 ,x is the number of Messages with wrong CHK sent)
    TrajPointACCObj12_TrajPointACCObj12_CRC_wrongvalctr =getValue(this);    
}
on envVar E_pric_RadarFrontCenter_TrajPointACCObj12_TrajPointACCObj12_MsgCtr_wrongvalctr
{
    //update disturb count
    //disturb value range:(-1 = always send wrong value),( X>0 ,x is the number of Messages with wrong CHK sent)
    TrajPointACCObj12_TrajPointACCObj12_MsgCtr_wrongvalctr =getValue(this);    
}
on envVar E_pric_RadarFrontCenter_TrajPointACCObj12_TrajPointACCObj12_blockCtr_wrongvalctr
{
    //update disturb count
    //disturb value range:(-1 = always send wrong value),( X>0 ,x is the number of Messages with wrong CHK sent)
    TrajPointACCObj12_TrajPointACCObj12_blockCtr_wrongvalctr =getValue(this);    
}

on envVar E_pric_RadarFrontCenter_TrajPointACCObj12_TrajPointACCObj12_Valid_b_Rv
{
    qword rawValue = 0ll;
    float rawValue_float = 0.0;
    float phyValue = 0.0;        

    //set the signal with updated raw value
    if(getValue(E_pric_RadarFrontCenter_TrajPointACCObj12_TrajPointACCObj12_Valid_b_SetVt)==0)
    {
        rawValue = getvalue(this);
        if(chgEv_TrajPointACCObj12_TrajPointACCObj12_Valid_b == 0)
        {
            //type conversion to float
            rawValue_float = rawValue;        
            // raw to physical conversion
            phyValue = ((rawValue_float *1)+(0));
            putValue(E_pric_RadarFrontCenter_TrajPointACCObj12_TrajPointACCObj12_Valid_b_Pv, phyValue);
            chgEv_TrajPointACCObj12_TrajPointACCObj12_Valid_b = 1;
        }
        else
        {
            chgEv_TrajPointACCObj12_TrajPointACCObj12_Valid_b = 0;
        }    
        //update the signal value
        Msg_TrajPointACCObj12.TrajPointACCObj12_Valid_b=rawValue;        
    }                                                                           
}

on envVar E_pric_RadarFrontCenter_TrajPointACCObj12_TrajPointACCObj12_Valid_b_Pv
{
    qword rawValue = 0ll;
    float phyValue = 0.0;
    
    //update the raw value with physical value 
    if(getValue(E_pric_RadarFrontCenter_TrajPointACCObj12_TrajPointACCObj12_Valid_b_SetVt)==0)
    {
        if(chgEv_TrajPointACCObj12_TrajPointACCObj12_Valid_b == 0)
        {
            phyValue = getvalue(this);
            // physical to raw conversion
            rawValue = ((phyValue -(0))/1);
            putValue(E_pric_RadarFrontCenter_TrajPointACCObj12_TrajPointACCObj12_Valid_b_Rv, rawValue);
            chgEv_TrajPointACCObj12_TrajPointACCObj12_Valid_b = 1;  
        }
        else
        {
            chgEv_TrajPointACCObj12_TrajPointACCObj12_Valid_b = 0;
        }
    }
}

on envVar E_pric_RadarFrontCenter_TrajPointACCObj12_TrajPointACCObj12_Valid_b_Vt
{
    qword rawValue = 0ll;
    if(getValue(E_pric_RadarFrontCenter_TrajPointACCObj12_TrajPointACCObj12_Valid_b_SetVt))
    {
        //update the signal value
        Msg_TrajPointACCObj12.TrajPointACCObj12_Valid_b=getValue(this);
    }
}

on envVar E_pric_RadarFrontCenter_TrajPointACCObj12_TrajPointACCObj12_Valid_b_SetVt
{
    if(getValue(E_pric_RadarFrontCenter_TrajPointACCObj12_TrajPointACCObj12_Valid_b_SetVt))
    {
        //update the signal value
        Msg_TrajPointACCObj12.TrajPointACCObj12_Valid_b=getvalue(E_pric_RadarFrontCenter_TrajPointACCObj12_TrajPointACCObj12_Valid_b_Vt);
    }
    else
    {
        Msg_TrajPointACCObj12.TrajPointACCObj12_Valid_b=getValue(E_pric_RadarFrontCenter_TrajPointACCObj12_TrajPointACCObj12_Valid_b_Rv);
    }
}
 
on envVar E_pric_RadarFrontCenter_TrajPointACCObj12_TrajPointACCObj12_dVarYv_uw_Rv
{
    qword rawValue = 0ll;
    float rawValue_float = 0.0;
    float phyValue = 0.0;        

    //set the signal with updated raw value
    {
        rawValue = getvalue(this);
        if(chgEv_TrajPointACCObj12_TrajPointACCObj12_dVarYv_uw == 0)
        {
            //type conversion to float
            rawValue_float = rawValue;        
            // raw to physical conversion
            phyValue = ((rawValue_float *0.00195313)+(0));
            putValue(E_pric_RadarFrontCenter_TrajPointACCObj12_TrajPointACCObj12_dVarYv_uw_Pv, phyValue);
            chgEv_TrajPointACCObj12_TrajPointACCObj12_dVarYv_uw = 1;
        }
        else
        {
            chgEv_TrajPointACCObj12_TrajPointACCObj12_dVarYv_uw = 0;
        }    
        //update the signal value
        Msg_TrajPointACCObj12.TrajPointACCObj12_dVarYv_uw=rawValue;        
    }                                                                           
}

on envVar E_pric_RadarFrontCenter_TrajPointACCObj12_TrajPointACCObj12_dVarYv_uw_Pv
{
    qword rawValue = 0ll;
    float phyValue = 0.0;
    
    //update the raw value with physical value 
    {
        if(chgEv_TrajPointACCObj12_TrajPointACCObj12_dVarYv_uw == 0)
        {
            phyValue = getvalue(this);
            // physical to raw conversion
            rawValue = ((phyValue -(0))/0.00195313);
            putValue(E_pric_RadarFrontCenter_TrajPointACCObj12_TrajPointACCObj12_dVarYv_uw_Rv, rawValue);
            chgEv_TrajPointACCObj12_TrajPointACCObj12_dVarYv_uw = 1;  
        }
        else
        {
            chgEv_TrajPointACCObj12_TrajPointACCObj12_dVarYv_uw = 0;
        }
    }
}


 
on envVar E_pric_RadarFrontCenter_TrajPointACCObj12_TrajPointACCObj12_wExistProb_ub_Rv
{
    qword rawValue = 0ll;
    float rawValue_float = 0.0;
    float phyValue = 0.0;        

    //set the signal with updated raw value
    {
        rawValue = getvalue(this);
        if(chgEv_TrajPointACCObj12_TrajPointACCObj12_wExistProb_ub == 0)
        {
            //type conversion to float
            rawValue_float = rawValue;        
            // raw to physical conversion
            phyValue = ((rawValue_float *0.00390625)+(0));
            putValue(E_pric_RadarFrontCenter_TrajPointACCObj12_TrajPointACCObj12_wExistProb_ub_Pv, phyValue);
            chgEv_TrajPointACCObj12_TrajPointACCObj12_wExistProb_ub = 1;
        }
        else
        {
            chgEv_TrajPointACCObj12_TrajPointACCObj12_wExistProb_ub = 0;
        }    
        //update the signal value
        Msg_TrajPointACCObj12.TrajPointACCObj12_wExistProb_ub=rawValue;        
    }                                                                           
}

on envVar E_pric_RadarFrontCenter_TrajPointACCObj12_TrajPointACCObj12_wExistProb_ub_Pv
{
    qword rawValue = 0ll;
    float phyValue = 0.0;
    
    //update the raw value with physical value 
    {
        if(chgEv_TrajPointACCObj12_TrajPointACCObj12_wExistProb_ub == 0)
        {
            phyValue = getvalue(this);
            // physical to raw conversion
            rawValue = ((phyValue -(0))/0.00390625);
            putValue(E_pric_RadarFrontCenter_TrajPointACCObj12_TrajPointACCObj12_wExistProb_ub_Rv, rawValue);
            chgEv_TrajPointACCObj12_TrajPointACCObj12_wExistProb_ub = 1;  
        }
        else
        {
            chgEv_TrajPointACCObj12_TrajPointACCObj12_wExistProb_ub = 0;
        }
    }
}


 
on envVar E_pric_RadarFrontCenter_TrajPointACCObj12_TrajPointACCObj12_InvDir_b_Rv
{
    qword rawValue = 0ll;
    float rawValue_float = 0.0;
    float phyValue = 0.0;        

    //set the signal with updated raw value
    if(getValue(E_pric_RadarFrontCenter_TrajPointACCObj12_TrajPointACCObj12_InvDir_b_SetVt)==0)
    {
        rawValue = getvalue(this);
        if(chgEv_TrajPointACCObj12_TrajPointACCObj12_InvDir_b == 0)
        {
            //type conversion to float
            rawValue_float = rawValue;        
            // raw to physical conversion
            phyValue = ((rawValue_float *1)+(0));
            putValue(E_pric_RadarFrontCenter_TrajPointACCObj12_TrajPointACCObj12_InvDir_b_Pv, phyValue);
            chgEv_TrajPointACCObj12_TrajPointACCObj12_InvDir_b = 1;
        }
        else
        {
            chgEv_TrajPointACCObj12_TrajPointACCObj12_InvDir_b = 0;
        }    
        //update the signal value
        Msg_TrajPointACCObj12.TrajPointACCObj12_InvDir_b=rawValue;        
    }                                                                           
}

on envVar E_pric_RadarFrontCenter_TrajPointACCObj12_TrajPointACCObj12_InvDir_b_Pv
{
    qword rawValue = 0ll;
    float phyValue = 0.0;
    
    //update the raw value with physical value 
    if(getValue(E_pric_RadarFrontCenter_TrajPointACCObj12_TrajPointACCObj12_InvDir_b_SetVt)==0)
    {
        if(chgEv_TrajPointACCObj12_TrajPointACCObj12_InvDir_b == 0)
        {
            phyValue = getvalue(this);
            // physical to raw conversion
            rawValue = ((phyValue -(0))/1);
            putValue(E_pric_RadarFrontCenter_TrajPointACCObj12_TrajPointACCObj12_InvDir_b_Rv, rawValue);
            chgEv_TrajPointACCObj12_TrajPointACCObj12_InvDir_b = 1;  
        }
        else
        {
            chgEv_TrajPointACCObj12_TrajPointACCObj12_InvDir_b = 0;
        }
    }
}

on envVar E_pric_RadarFrontCenter_TrajPointACCObj12_TrajPointACCObj12_InvDir_b_Vt
{
    qword rawValue = 0ll;
    if(getValue(E_pric_RadarFrontCenter_TrajPointACCObj12_TrajPointACCObj12_InvDir_b_SetVt))
    {
        //update the signal value
        Msg_TrajPointACCObj12.TrajPointACCObj12_InvDir_b=getValue(this);
    }
}

on envVar E_pric_RadarFrontCenter_TrajPointACCObj12_TrajPointACCObj12_InvDir_b_SetVt
{
    if(getValue(E_pric_RadarFrontCenter_TrajPointACCObj12_TrajPointACCObj12_InvDir_b_SetVt))
    {
        //update the signal value
        Msg_TrajPointACCObj12.TrajPointACCObj12_InvDir_b=getvalue(E_pric_RadarFrontCenter_TrajPointACCObj12_TrajPointACCObj12_InvDir_b_Vt);
    }
    else
    {
        Msg_TrajPointACCObj12.TrajPointACCObj12_InvDir_b=getValue(E_pric_RadarFrontCenter_TrajPointACCObj12_TrajPointACCObj12_InvDir_b_Rv);
    }
}
 
on envVar E_pric_RadarFrontCenter_TrajPointACCObj12_TrajPointACCObj12_dVarXv_uw_Rv
{
    qword rawValue = 0ll;
    float rawValue_float = 0.0;
    float phyValue = 0.0;        

    //set the signal with updated raw value
    {
        rawValue = getvalue(this);
        if(chgEv_TrajPointACCObj12_TrajPointACCObj12_dVarXv_uw == 0)
        {
            //type conversion to float
            rawValue_float = rawValue;        
            // raw to physical conversion
            phyValue = ((rawValue_float *0.00195313)+(0));
            putValue(E_pric_RadarFrontCenter_TrajPointACCObj12_TrajPointACCObj12_dVarXv_uw_Pv, phyValue);
            chgEv_TrajPointACCObj12_TrajPointACCObj12_dVarXv_uw = 1;
        }
        else
        {
            chgEv_TrajPointACCObj12_TrajPointACCObj12_dVarXv_uw = 0;
        }    
        //update the signal value
        Msg_TrajPointACCObj12.TrajPointACCObj12_dVarXv_uw=rawValue;        
    }                                                                           
}

on envVar E_pric_RadarFrontCenter_TrajPointACCObj12_TrajPointACCObj12_dVarXv_uw_Pv
{
    qword rawValue = 0ll;
    float phyValue = 0.0;
    
    //update the raw value with physical value 
    {
        if(chgEv_TrajPointACCObj12_TrajPointACCObj12_dVarXv_uw == 0)
        {
            phyValue = getvalue(this);
            // physical to raw conversion
            rawValue = ((phyValue -(0))/0.00195313);
            putValue(E_pric_RadarFrontCenter_TrajPointACCObj12_TrajPointACCObj12_dVarXv_uw_Rv, rawValue);
            chgEv_TrajPointACCObj12_TrajPointACCObj12_dVarXv_uw = 1;  
        }
        else
        {
            chgEv_TrajPointACCObj12_TrajPointACCObj12_dVarXv_uw = 0;
        }
    }
}


 
on envVar E_pric_RadarFrontCenter_TrajPointACCObj12_TrajPointACCObj12_Stopped_b_Rv
{
    qword rawValue = 0ll;
    float rawValue_float = 0.0;
    float phyValue = 0.0;        

    //set the signal with updated raw value
    if(getValue(E_pric_RadarFrontCenter_TrajPointACCObj12_TrajPointACCObj12_Stopped_b_SetVt)==0)
    {
        rawValue = getvalue(this);
        if(chgEv_TrajPointACCObj12_TrajPointACCObj12_Stopped_b == 0)
        {
            //type conversion to float
            rawValue_float = rawValue;        
            // raw to physical conversion
            phyValue = ((rawValue_float *1)+(0));
            putValue(E_pric_RadarFrontCenter_TrajPointACCObj12_TrajPointACCObj12_Stopped_b_Pv, phyValue);
            chgEv_TrajPointACCObj12_TrajPointACCObj12_Stopped_b = 1;
        }
        else
        {
            chgEv_TrajPointACCObj12_TrajPointACCObj12_Stopped_b = 0;
        }    
        //update the signal value
        Msg_TrajPointACCObj12.TrajPointACCObj12_Stopped_b=rawValue;        
    }                                                                           
}

on envVar E_pric_RadarFrontCenter_TrajPointACCObj12_TrajPointACCObj12_Stopped_b_Pv
{
    qword rawValue = 0ll;
    float phyValue = 0.0;
    
    //update the raw value with physical value 
    if(getValue(E_pric_RadarFrontCenter_TrajPointACCObj12_TrajPointACCObj12_Stopped_b_SetVt)==0)
    {
        if(chgEv_TrajPointACCObj12_TrajPointACCObj12_Stopped_b == 0)
        {
            phyValue = getvalue(this);
            // physical to raw conversion
            rawValue = ((phyValue -(0))/1);
            putValue(E_pric_RadarFrontCenter_TrajPointACCObj12_TrajPointACCObj12_Stopped_b_Rv, rawValue);
            chgEv_TrajPointACCObj12_TrajPointACCObj12_Stopped_b = 1;  
        }
        else
        {
            chgEv_TrajPointACCObj12_TrajPointACCObj12_Stopped_b = 0;
        }
    }
}

on envVar E_pric_RadarFrontCenter_TrajPointACCObj12_TrajPointACCObj12_Stopped_b_Vt
{
    qword rawValue = 0ll;
    if(getValue(E_pric_RadarFrontCenter_TrajPointACCObj12_TrajPointACCObj12_Stopped_b_SetVt))
    {
        //update the signal value
        Msg_TrajPointACCObj12.TrajPointACCObj12_Stopped_b=getValue(this);
    }
}

on envVar E_pric_RadarFrontCenter_TrajPointACCObj12_TrajPointACCObj12_Stopped_b_SetVt
{
    if(getValue(E_pric_RadarFrontCenter_TrajPointACCObj12_TrajPointACCObj12_Stopped_b_SetVt))
    {
        //update the signal value
        Msg_TrajPointACCObj12.TrajPointACCObj12_Stopped_b=getvalue(E_pric_RadarFrontCenter_TrajPointACCObj12_TrajPointACCObj12_Stopped_b_Vt);
    }
    else
    {
        Msg_TrajPointACCObj12.TrajPointACCObj12_Stopped_b=getValue(E_pric_RadarFrontCenter_TrajPointACCObj12_TrajPointACCObj12_Stopped_b_Rv);
    }
}
 
on envVar E_pric_RadarFrontCenter_TrajPointACCObj12_TrajPointACCObj12_dyv_sw_Rv
{
    qword rawValue = 0ll;
    float rawValue_float = 0.0;
    float phyValue = 0.0;        

    //set the signal with updated raw value
    {
        rawValue = getvalue(this);
        if(chgEv_TrajPointACCObj12_TrajPointACCObj12_dyv_sw == 0)
        {
            //type conversion to float
            rawValue_float = rawValue;        
            // raw to physical conversion
            phyValue = ((rawValue_float *0.0078125)+(0));
            putValue(E_pric_RadarFrontCenter_TrajPointACCObj12_TrajPointACCObj12_dyv_sw_Pv, phyValue);
            chgEv_TrajPointACCObj12_TrajPointACCObj12_dyv_sw = 1;
        }
        else
        {
            chgEv_TrajPointACCObj12_TrajPointACCObj12_dyv_sw = 0;
        }    
        //update the signal value
        Msg_TrajPointACCObj12.TrajPointACCObj12_dyv_sw=rawValue;        
    }                                                                           
}

on envVar E_pric_RadarFrontCenter_TrajPointACCObj12_TrajPointACCObj12_dyv_sw_Pv
{
    qword rawValue = 0ll;
    float phyValue = 0.0;
    
    //update the raw value with physical value 
    {
        if(chgEv_TrajPointACCObj12_TrajPointACCObj12_dyv_sw == 0)
        {
            phyValue = getvalue(this);
            // physical to raw conversion
            rawValue = ((phyValue -(0))/0.0078125);
            putValue(E_pric_RadarFrontCenter_TrajPointACCObj12_TrajPointACCObj12_dyv_sw_Rv, rawValue);
            chgEv_TrajPointACCObj12_TrajPointACCObj12_dyv_sw = 1;  
        }
        else
        {
            chgEv_TrajPointACCObj12_TrajPointACCObj12_dyv_sw = 0;
        }
    }
}


 
on envVar E_pric_RadarFrontCenter_TrajPointACCObj12_TrajPointACCObj12_dxv_sw_Rv
{
    qword rawValue = 0ll;
    float rawValue_float = 0.0;
    float phyValue = 0.0;        

    //set the signal with updated raw value
    {
        rawValue = getvalue(this);
        if(chgEv_TrajPointACCObj12_TrajPointACCObj12_dxv_sw == 0)
        {
            //type conversion to float
            rawValue_float = rawValue;        
            // raw to physical conversion
            phyValue = ((rawValue_float *0.0078125)+(0));
            putValue(E_pric_RadarFrontCenter_TrajPointACCObj12_TrajPointACCObj12_dxv_sw_Pv, phyValue);
            chgEv_TrajPointACCObj12_TrajPointACCObj12_dxv_sw = 1;
        }
        else
        {
            chgEv_TrajPointACCObj12_TrajPointACCObj12_dxv_sw = 0;
        }    
        //update the signal value
        Msg_TrajPointACCObj12.TrajPointACCObj12_dxv_sw=rawValue;        
    }                                                                           
}

on envVar E_pric_RadarFrontCenter_TrajPointACCObj12_TrajPointACCObj12_dxv_sw_Pv
{
    qword rawValue = 0ll;
    float phyValue = 0.0;
    
    //update the raw value with physical value 
    {
        if(chgEv_TrajPointACCObj12_TrajPointACCObj12_dxv_sw == 0)
        {
            phyValue = getvalue(this);
            // physical to raw conversion
            rawValue = ((phyValue -(0))/0.0078125);
            putValue(E_pric_RadarFrontCenter_TrajPointACCObj12_TrajPointACCObj12_dxv_sw_Rv, rawValue);
            chgEv_TrajPointACCObj12_TrajPointACCObj12_dxv_sw = 1;  
        }
        else
        {
            chgEv_TrajPointACCObj12_TrajPointACCObj12_dxv_sw = 0;
        }
    }
}


 
on envVar E_pric_RadarFrontCenter_TrajPointACCObj12_TrajPointACCObj12_Drive_b_Rv
{
    qword rawValue = 0ll;
    float rawValue_float = 0.0;
    float phyValue = 0.0;        

    //set the signal with updated raw value
    if(getValue(E_pric_RadarFrontCenter_TrajPointACCObj12_TrajPointACCObj12_Drive_b_SetVt)==0)
    {
        rawValue = getvalue(this);
        if(chgEv_TrajPointACCObj12_TrajPointACCObj12_Drive_b == 0)
        {
            //type conversion to float
            rawValue_float = rawValue;        
            // raw to physical conversion
            phyValue = ((rawValue_float *1)+(0));
            putValue(E_pric_RadarFrontCenter_TrajPointACCObj12_TrajPointACCObj12_Drive_b_Pv, phyValue);
            chgEv_TrajPointACCObj12_TrajPointACCObj12_Drive_b = 1;
        }
        else
        {
            chgEv_TrajPointACCObj12_TrajPointACCObj12_Drive_b = 0;
        }    
        //update the signal value
        Msg_TrajPointACCObj12.TrajPointACCObj12_Drive_b=rawValue;        
    }                                                                           
}

on envVar E_pric_RadarFrontCenter_TrajPointACCObj12_TrajPointACCObj12_Drive_b_Pv
{
    qword rawValue = 0ll;
    float phyValue = 0.0;
    
    //update the raw value with physical value 
    if(getValue(E_pric_RadarFrontCenter_TrajPointACCObj12_TrajPointACCObj12_Drive_b_SetVt)==0)
    {
        if(chgEv_TrajPointACCObj12_TrajPointACCObj12_Drive_b == 0)
        {
            phyValue = getvalue(this);
            // physical to raw conversion
            rawValue = ((phyValue -(0))/1);
            putValue(E_pric_RadarFrontCenter_TrajPointACCObj12_TrajPointACCObj12_Drive_b_Rv, rawValue);
            chgEv_TrajPointACCObj12_TrajPointACCObj12_Drive_b = 1;  
        }
        else
        {
            chgEv_TrajPointACCObj12_TrajPointACCObj12_Drive_b = 0;
        }
    }
}

on envVar E_pric_RadarFrontCenter_TrajPointACCObj12_TrajPointACCObj12_Drive_b_Vt
{
    qword rawValue = 0ll;
    if(getValue(E_pric_RadarFrontCenter_TrajPointACCObj12_TrajPointACCObj12_Drive_b_SetVt))
    {
        //update the signal value
        Msg_TrajPointACCObj12.TrajPointACCObj12_Drive_b=getValue(this);
    }
}

on envVar E_pric_RadarFrontCenter_TrajPointACCObj12_TrajPointACCObj12_Drive_b_SetVt
{
    if(getValue(E_pric_RadarFrontCenter_TrajPointACCObj12_TrajPointACCObj12_Drive_b_SetVt))
    {
        //update the signal value
        Msg_TrajPointACCObj12.TrajPointACCObj12_Drive_b=getvalue(E_pric_RadarFrontCenter_TrajPointACCObj12_TrajPointACCObj12_Drive_b_Vt);
    }
    else
    {
        Msg_TrajPointACCObj12.TrajPointACCObj12_Drive_b=getValue(E_pric_RadarFrontCenter_TrajPointACCObj12_TrajPointACCObj12_Drive_b_Rv);
    }
}
 
on envVar E_pric_RadarFrontCenter_TrajPointACCObj12_TrajPointACCObj12_timestamp_Rv
{
    qword rawValue = 0ll;
    float rawValue_float = 0.0;
    float phyValue = 0.0;        

    //set the signal with updated raw value
    {
        rawValue = getvalue(this);
        if(chgEv_TrajPointACCObj12_TrajPointACCObj12_timestamp == 0)
        {
            //type conversion to float
            rawValue_float = rawValue;        
            // raw to physical conversion
            phyValue = ((rawValue_float *0.000488281)+(0));
            putValue(E_pric_RadarFrontCenter_TrajPointACCObj12_TrajPointACCObj12_timestamp_Pv, phyValue);
            chgEv_TrajPointACCObj12_TrajPointACCObj12_timestamp = 1;
        }
        else
        {
            chgEv_TrajPointACCObj12_TrajPointACCObj12_timestamp = 0;
        }    
        //update the signal value
        Msg_TrajPointACCObj12.TrajPointACCObj12_timestamp=rawValue;        
    }                                                                           
}

on envVar E_pric_RadarFrontCenter_TrajPointACCObj12_TrajPointACCObj12_timestamp_Pv
{
    qword rawValue = 0ll;
    float phyValue = 0.0;
    
    //update the raw value with physical value 
    {
        if(chgEv_TrajPointACCObj12_TrajPointACCObj12_timestamp == 0)
        {
            phyValue = getvalue(this);
            // physical to raw conversion
            rawValue = ((phyValue -(0))/0.000488281);
            putValue(E_pric_RadarFrontCenter_TrajPointACCObj12_TrajPointACCObj12_timestamp_Rv, rawValue);
            chgEv_TrajPointACCObj12_TrajPointACCObj12_timestamp = 1;  
        }
        else
        {
            chgEv_TrajPointACCObj12_TrajPointACCObj12_timestamp = 0;
        }
    }
}


 
on envVar E_pric_RadarFrontCenter_TrajPointACCObj12_TrajPointACCObj12_TrajEnd_b_Rv
{
    qword rawValue = 0ll;
    float rawValue_float = 0.0;
    float phyValue = 0.0;        

    //set the signal with updated raw value
    if(getValue(E_pric_RadarFrontCenter_TrajPointACCObj12_TrajPointACCObj12_TrajEnd_b_SetVt)==0)
    {
        rawValue = getvalue(this);
        if(chgEv_TrajPointACCObj12_TrajPointACCObj12_TrajEnd_b == 0)
        {
            //type conversion to float
            rawValue_float = rawValue;        
            // raw to physical conversion
            phyValue = ((rawValue_float *1)+(0));
            putValue(E_pric_RadarFrontCenter_TrajPointACCObj12_TrajPointACCObj12_TrajEnd_b_Pv, phyValue);
            chgEv_TrajPointACCObj12_TrajPointACCObj12_TrajEnd_b = 1;
        }
        else
        {
            chgEv_TrajPointACCObj12_TrajPointACCObj12_TrajEnd_b = 0;
        }    
        //update the signal value
        Msg_TrajPointACCObj12.TrajPointACCObj12_TrajEnd_b=rawValue;        
    }                                                                           
}

on envVar E_pric_RadarFrontCenter_TrajPointACCObj12_TrajPointACCObj12_TrajEnd_b_Pv
{
    qword rawValue = 0ll;
    float phyValue = 0.0;
    
    //update the raw value with physical value 
    if(getValue(E_pric_RadarFrontCenter_TrajPointACCObj12_TrajPointACCObj12_TrajEnd_b_SetVt)==0)
    {
        if(chgEv_TrajPointACCObj12_TrajPointACCObj12_TrajEnd_b == 0)
        {
            phyValue = getvalue(this);
            // physical to raw conversion
            rawValue = ((phyValue -(0))/1);
            putValue(E_pric_RadarFrontCenter_TrajPointACCObj12_TrajPointACCObj12_TrajEnd_b_Rv, rawValue);
            chgEv_TrajPointACCObj12_TrajPointACCObj12_TrajEnd_b = 1;  
        }
        else
        {
            chgEv_TrajPointACCObj12_TrajPointACCObj12_TrajEnd_b = 0;
        }
    }
}

on envVar E_pric_RadarFrontCenter_TrajPointACCObj12_TrajPointACCObj12_TrajEnd_b_Vt
{
    qword rawValue = 0ll;
    if(getValue(E_pric_RadarFrontCenter_TrajPointACCObj12_TrajPointACCObj12_TrajEnd_b_SetVt))
    {
        //update the signal value
        Msg_TrajPointACCObj12.TrajPointACCObj12_TrajEnd_b=getValue(this);
    }
}

on envVar E_pric_RadarFrontCenter_TrajPointACCObj12_TrajPointACCObj12_TrajEnd_b_SetVt
{
    if(getValue(E_pric_RadarFrontCenter_TrajPointACCObj12_TrajPointACCObj12_TrajEnd_b_SetVt))
    {
        //update the signal value
        Msg_TrajPointACCObj12.TrajPointACCObj12_TrajEnd_b=getvalue(E_pric_RadarFrontCenter_TrajPointACCObj12_TrajPointACCObj12_TrajEnd_b_Vt);
    }
    else
    {
        Msg_TrajPointACCObj12.TrajPointACCObj12_TrajEnd_b=getValue(E_pric_RadarFrontCenter_TrajPointACCObj12_TrajPointACCObj12_TrajEnd_b_Rv);
    }
}
 
on envVar E_pric_RadarFrontCenter_TrajPointACCObj12_TrajPointACCObj12_Stand_b_Rv
{
    qword rawValue = 0ll;
    float rawValue_float = 0.0;
    float phyValue = 0.0;        

    //set the signal with updated raw value
    if(getValue(E_pric_RadarFrontCenter_TrajPointACCObj12_TrajPointACCObj12_Stand_b_SetVt)==0)
    {
        rawValue = getvalue(this);
        if(chgEv_TrajPointACCObj12_TrajPointACCObj12_Stand_b == 0)
        {
            //type conversion to float
            rawValue_float = rawValue;        
            // raw to physical conversion
            phyValue = ((rawValue_float *1)+(0));
            putValue(E_pric_RadarFrontCenter_TrajPointACCObj12_TrajPointACCObj12_Stand_b_Pv, phyValue);
            chgEv_TrajPointACCObj12_TrajPointACCObj12_Stand_b = 1;
        }
        else
        {
            chgEv_TrajPointACCObj12_TrajPointACCObj12_Stand_b = 0;
        }    
        //update the signal value
        Msg_TrajPointACCObj12.TrajPointACCObj12_Stand_b=rawValue;        
    }                                                                           
}

on envVar E_pric_RadarFrontCenter_TrajPointACCObj12_TrajPointACCObj12_Stand_b_Pv
{
    qword rawValue = 0ll;
    float phyValue = 0.0;
    
    //update the raw value with physical value 
    if(getValue(E_pric_RadarFrontCenter_TrajPointACCObj12_TrajPointACCObj12_Stand_b_SetVt)==0)
    {
        if(chgEv_TrajPointACCObj12_TrajPointACCObj12_Stand_b == 0)
        {
            phyValue = getvalue(this);
            // physical to raw conversion
            rawValue = ((phyValue -(0))/1);
            putValue(E_pric_RadarFrontCenter_TrajPointACCObj12_TrajPointACCObj12_Stand_b_Rv, rawValue);
            chgEv_TrajPointACCObj12_TrajPointACCObj12_Stand_b = 1;  
        }
        else
        {
            chgEv_TrajPointACCObj12_TrajPointACCObj12_Stand_b = 0;
        }
    }
}

on envVar E_pric_RadarFrontCenter_TrajPointACCObj12_TrajPointACCObj12_Stand_b_Vt
{
    qword rawValue = 0ll;
    if(getValue(E_pric_RadarFrontCenter_TrajPointACCObj12_TrajPointACCObj12_Stand_b_SetVt))
    {
        //update the signal value
        Msg_TrajPointACCObj12.TrajPointACCObj12_Stand_b=getValue(this);
    }
}

on envVar E_pric_RadarFrontCenter_TrajPointACCObj12_TrajPointACCObj12_Stand_b_SetVt
{
    if(getValue(E_pric_RadarFrontCenter_TrajPointACCObj12_TrajPointACCObj12_Stand_b_SetVt))
    {
        //update the signal value
        Msg_TrajPointACCObj12.TrajPointACCObj12_Stand_b=getvalue(E_pric_RadarFrontCenter_TrajPointACCObj12_TrajPointACCObj12_Stand_b_Vt);
    }
    else
    {
        Msg_TrajPointACCObj12.TrajPointACCObj12_Stand_b=getValue(E_pric_RadarFrontCenter_TrajPointACCObj12_TrajPointACCObj12_Stand_b_Rv);
    }
}
 
on envVar E_pric_RadarFrontCenter_TrajPointACCObj11_tx
{
    if(getValue(this))
    {       
        
        //update the BZ Signal
        if(TrajPointACCObj11_TrajPointACCObj11_MsgCtr_wrongvalctr == 0)
        {
            update_TrajPointACCObj11_TrajPointACCObj11_MsgCtr_counter();
            Msg_TrajPointACCObj11.TrajPointACCObj11_MsgCtr= TrajPointACCObj11_TrajPointACCObj11_MsgCtr_counter;
        }
        else if(TrajPointACCObj11_TrajPointACCObj11_MsgCtr_wrongvalctr > 0)
        {
             TrajPointACCObj11_TrajPointACCObj11_MsgCtr_wrongvalctr--;
              // if counter becomes zero, update panel controller to zero
             if(TrajPointACCObj11_TrajPointACCObj11_MsgCtr_wrongvalctr == 0)
             {
                 putValue(E_pric_RadarFrontCenter_TrajPointACCObj11_TrajPointACCObj11_MsgCtr_wrongvalctr,0);
             }
        }
        else
        {
            //do nothing
        }        
        //update the BZ Signal
        if(TrajPointACCObj11_TrajPointACCObj11_blockCtr_wrongvalctr == 0)
        {
            update_TrajPointACCObj11_TrajPointACCObj11_blockCtr_counter();
            Msg_TrajPointACCObj11.TrajPointACCObj11_blockCtr= TrajPointACCObj11_TrajPointACCObj11_blockCtr_counter;
        }
        else if(TrajPointACCObj11_TrajPointACCObj11_blockCtr_wrongvalctr > 0)
        {
             TrajPointACCObj11_TrajPointACCObj11_blockCtr_wrongvalctr--;
              // if counter becomes zero, update panel controller to zero
             if(TrajPointACCObj11_TrajPointACCObj11_blockCtr_wrongvalctr == 0)
             {
                 putValue(E_pric_RadarFrontCenter_TrajPointACCObj11_TrajPointACCObj11_blockCtr_wrongvalctr,0);
             }
        }
        else
        {
            //do nothing
        }        
        //calculate the CRC checksum
        update_TrajPointACCObj11_ChkSum_Checksum();

        output(Msg_TrajPointACCObj11);        
    }
}

on envVar E_pric_RadarFrontCenter_TrajPointACCObj11_Range
{
    qword rawstatus = 0ll;
    qword rawValue = 0ll;    
    
    rawstatus = getvalue(this);    
    // set all the signals with min raw /max raw /init raw
    switch (rawstatus) 
    {
     case(0) :
        rawValue= -32768;
        putValue(E_pric_RadarFrontCenter_TrajPointACCObj11_TrajPointACCObj11_dyv_sw_Rv, rawValue);
        rawValue= 0;
        putValue(E_pric_RadarFrontCenter_TrajPointACCObj11_TrajPointACCObj11_dVarXv_uw_Rv, rawValue);
        rawValue= -32768;
        putValue(E_pric_RadarFrontCenter_TrajPointACCObj11_TrajPointACCObj11_dxv_sw_Rv, rawValue);
        rawValue= 0;
        putValue(E_pric_RadarFrontCenter_TrajPointACCObj11_TrajPointACCObj11_Drive_b_Rv, rawValue);
        rawValue= 0;
        putValue(E_pric_RadarFrontCenter_TrajPointACCObj11_TrajPointACCObj11_timestamp_Rv, rawValue);
        rawValue= 0;
        putValue(E_pric_RadarFrontCenter_TrajPointACCObj11_TrajPointACCObj11_Stopped_b_Rv, rawValue);
        rawValue= 0;
        putValue(E_pric_RadarFrontCenter_TrajPointACCObj11_TrajPointACCObj11_Valid_b_Rv, rawValue);
        rawValue= 0;
        putValue(E_pric_RadarFrontCenter_TrajPointACCObj11_TrajPointACCObj11_TrajEnd_b_Rv, rawValue);
        rawValue= 0;
        putValue(E_pric_RadarFrontCenter_TrajPointACCObj11_TrajPointACCObj11_Stand_b_Rv, rawValue);
        rawValue= 0;
        putValue(E_pric_RadarFrontCenter_TrajPointACCObj11_TrajPointACCObj11_dVarYv_uw_Rv, rawValue);
        rawValue= 0;
        putValue(E_pric_RadarFrontCenter_TrajPointACCObj11_TrajPointACCObj11_wExistProb_ub_Rv, rawValue);
        rawValue= 0;
        putValue(E_pric_RadarFrontCenter_TrajPointACCObj11_TrajPointACCObj11_InvDir_b_Rv, rawValue);
        break;
     case(1) :
        rawValue= 32767;
        putValue(E_pric_RadarFrontCenter_TrajPointACCObj11_TrajPointACCObj11_dyv_sw_Rv, rawValue);
        rawValue= 65534;
        putValue(E_pric_RadarFrontCenter_TrajPointACCObj11_TrajPointACCObj11_dVarXv_uw_Rv, rawValue);
        rawValue= 32767;
        putValue(E_pric_RadarFrontCenter_TrajPointACCObj11_TrajPointACCObj11_dxv_sw_Rv, rawValue);
        rawValue= 1;
        putValue(E_pric_RadarFrontCenter_TrajPointACCObj11_TrajPointACCObj11_Drive_b_Rv, rawValue);
        rawValue= 65536;
        putValue(E_pric_RadarFrontCenter_TrajPointACCObj11_TrajPointACCObj11_timestamp_Rv, rawValue);
        rawValue= 1;
        putValue(E_pric_RadarFrontCenter_TrajPointACCObj11_TrajPointACCObj11_Stopped_b_Rv, rawValue);
        rawValue= 1;
        putValue(E_pric_RadarFrontCenter_TrajPointACCObj11_TrajPointACCObj11_Valid_b_Rv, rawValue);
        rawValue= 1;
        putValue(E_pric_RadarFrontCenter_TrajPointACCObj11_TrajPointACCObj11_TrajEnd_b_Rv, rawValue);
        rawValue= 1;
        putValue(E_pric_RadarFrontCenter_TrajPointACCObj11_TrajPointACCObj11_Stand_b_Rv, rawValue);
        rawValue= 65534;
        putValue(E_pric_RadarFrontCenter_TrajPointACCObj11_TrajPointACCObj11_dVarYv_uw_Rv, rawValue);
        rawValue= 255;
        putValue(E_pric_RadarFrontCenter_TrajPointACCObj11_TrajPointACCObj11_wExistProb_ub_Rv, rawValue);
        rawValue= 1;
        putValue(E_pric_RadarFrontCenter_TrajPointACCObj11_TrajPointACCObj11_InvDir_b_Rv, rawValue);
        break;
     default :
        rawValue= -32768;
        putValue(E_pric_RadarFrontCenter_TrajPointACCObj11_TrajPointACCObj11_dyv_sw_Rv, rawValue);
        rawValue= 0;
        putValue(E_pric_RadarFrontCenter_TrajPointACCObj11_TrajPointACCObj11_dVarXv_uw_Rv, rawValue);
        rawValue= -32768;
        putValue(E_pric_RadarFrontCenter_TrajPointACCObj11_TrajPointACCObj11_dxv_sw_Rv, rawValue);
        rawValue= 0;
        putValue(E_pric_RadarFrontCenter_TrajPointACCObj11_TrajPointACCObj11_Drive_b_Rv, rawValue);
        rawValue= 0;
        putValue(E_pric_RadarFrontCenter_TrajPointACCObj11_TrajPointACCObj11_timestamp_Rv, rawValue);
        rawValue= 0;
        putValue(E_pric_RadarFrontCenter_TrajPointACCObj11_TrajPointACCObj11_Stopped_b_Rv, rawValue);
        rawValue= 0;
        putValue(E_pric_RadarFrontCenter_TrajPointACCObj11_TrajPointACCObj11_Valid_b_Rv, rawValue);
        rawValue= 0;
        putValue(E_pric_RadarFrontCenter_TrajPointACCObj11_TrajPointACCObj11_TrajEnd_b_Rv, rawValue);
        rawValue= 0;
        putValue(E_pric_RadarFrontCenter_TrajPointACCObj11_TrajPointACCObj11_Stand_b_Rv, rawValue);
        rawValue= 0;
        putValue(E_pric_RadarFrontCenter_TrajPointACCObj11_TrajPointACCObj11_dVarYv_uw_Rv, rawValue);
        rawValue= 0;
        putValue(E_pric_RadarFrontCenter_TrajPointACCObj11_TrajPointACCObj11_wExistProb_ub_Rv, rawValue);
        rawValue= 0;
        putValue(E_pric_RadarFrontCenter_TrajPointACCObj11_TrajPointACCObj11_InvDir_b_Rv, rawValue);
      break;
   }
}

on envVar E_pric_RadarFrontCenter_TrajPointACCObj11_Dlc
{
    if(getValue(E_pric_RadarFrontCenter_TrajPointACCObj11_enDlc))
    {
        Msg_TrajPointACCObj11.dlc =getValue(this);
    }
    else
    {
       Dbc_dlc = 16;
	   Msg_TrajPointACCObj11.dlc = Calc_Canfd_dlc(Dbc_dlc);
	   	
  }
}

on envVar E_pric_RadarFrontCenter_TrajPointACCObj11_enDlc
{
    //For Messages with DLC = 8, set wrong DLC to smaller than defined DLC
    //For Messages with DLC < 8 set wrong DLC to smaller/longer than defined DLC
    if(getValue(this))
    {
        Msg_TrajPointACCObj11.dlc =getValue(E_pric_RadarFrontCenter_TrajPointACCObj11_Dlc);
    }
    else
    {
       Dbc_dlc = 16;
	   Msg_TrajPointACCObj11.dlc = Calc_Canfd_dlc(Dbc_dlc);
			
    }
}

on envVar E_pric_RadarFrontCenter_TrajPointACCObj11_TrajPointACCObj11_CRC_wrongvalctr
{
    //update disturb count
    //disturb value range:(-1 = always send wrong value),( X>0 ,x is the number of Messages with wrong CHK sent)
    TrajPointACCObj11_TrajPointACCObj11_CRC_wrongvalctr =getValue(this);    
}
on envVar E_pric_RadarFrontCenter_TrajPointACCObj11_TrajPointACCObj11_MsgCtr_wrongvalctr
{
    //update disturb count
    //disturb value range:(-1 = always send wrong value),( X>0 ,x is the number of Messages with wrong CHK sent)
    TrajPointACCObj11_TrajPointACCObj11_MsgCtr_wrongvalctr =getValue(this);    
}
on envVar E_pric_RadarFrontCenter_TrajPointACCObj11_TrajPointACCObj11_blockCtr_wrongvalctr
{
    //update disturb count
    //disturb value range:(-1 = always send wrong value),( X>0 ,x is the number of Messages with wrong CHK sent)
    TrajPointACCObj11_TrajPointACCObj11_blockCtr_wrongvalctr =getValue(this);    
}

on envVar E_pric_RadarFrontCenter_TrajPointACCObj11_TrajPointACCObj11_dyv_sw_Rv
{
    qword rawValue = 0ll;
    float rawValue_float = 0.0;
    float phyValue = 0.0;        

    //set the signal with updated raw value
    {
        rawValue = getvalue(this);
        if(chgEv_TrajPointACCObj11_TrajPointACCObj11_dyv_sw == 0)
        {
            //type conversion to float
            rawValue_float = rawValue;        
            // raw to physical conversion
            phyValue = ((rawValue_float *0.0078125)+(0));
            putValue(E_pric_RadarFrontCenter_TrajPointACCObj11_TrajPointACCObj11_dyv_sw_Pv, phyValue);
            chgEv_TrajPointACCObj11_TrajPointACCObj11_dyv_sw = 1;
        }
        else
        {
            chgEv_TrajPointACCObj11_TrajPointACCObj11_dyv_sw = 0;
        }    
        //update the signal value
        Msg_TrajPointACCObj11.TrajPointACCObj11_dyv_sw=rawValue;        
    }                                                                           
}

on envVar E_pric_RadarFrontCenter_TrajPointACCObj11_TrajPointACCObj11_dyv_sw_Pv
{
    qword rawValue = 0ll;
    float phyValue = 0.0;
    
    //update the raw value with physical value 
    {
        if(chgEv_TrajPointACCObj11_TrajPointACCObj11_dyv_sw == 0)
        {
            phyValue = getvalue(this);
            // physical to raw conversion
            rawValue = ((phyValue -(0))/0.0078125);
            putValue(E_pric_RadarFrontCenter_TrajPointACCObj11_TrajPointACCObj11_dyv_sw_Rv, rawValue);
            chgEv_TrajPointACCObj11_TrajPointACCObj11_dyv_sw = 1;  
        }
        else
        {
            chgEv_TrajPointACCObj11_TrajPointACCObj11_dyv_sw = 0;
        }
    }
}


 
on envVar E_pric_RadarFrontCenter_TrajPointACCObj11_TrajPointACCObj11_dVarXv_uw_Rv
{
    qword rawValue = 0ll;
    float rawValue_float = 0.0;
    float phyValue = 0.0;        

    //set the signal with updated raw value
    {
        rawValue = getvalue(this);
        if(chgEv_TrajPointACCObj11_TrajPointACCObj11_dVarXv_uw == 0)
        {
            //type conversion to float
            rawValue_float = rawValue;        
            // raw to physical conversion
            phyValue = ((rawValue_float *0.00195313)+(0));
            putValue(E_pric_RadarFrontCenter_TrajPointACCObj11_TrajPointACCObj11_dVarXv_uw_Pv, phyValue);
            chgEv_TrajPointACCObj11_TrajPointACCObj11_dVarXv_uw = 1;
        }
        else
        {
            chgEv_TrajPointACCObj11_TrajPointACCObj11_dVarXv_uw = 0;
        }    
        //update the signal value
        Msg_TrajPointACCObj11.TrajPointACCObj11_dVarXv_uw=rawValue;        
    }                                                                           
}

on envVar E_pric_RadarFrontCenter_TrajPointACCObj11_TrajPointACCObj11_dVarXv_uw_Pv
{
    qword rawValue = 0ll;
    float phyValue = 0.0;
    
    //update the raw value with physical value 
    {
        if(chgEv_TrajPointACCObj11_TrajPointACCObj11_dVarXv_uw == 0)
        {
            phyValue = getvalue(this);
            // physical to raw conversion
            rawValue = ((phyValue -(0))/0.00195313);
            putValue(E_pric_RadarFrontCenter_TrajPointACCObj11_TrajPointACCObj11_dVarXv_uw_Rv, rawValue);
            chgEv_TrajPointACCObj11_TrajPointACCObj11_dVarXv_uw = 1;  
        }
        else
        {
            chgEv_TrajPointACCObj11_TrajPointACCObj11_dVarXv_uw = 0;
        }
    }
}


 
on envVar E_pric_RadarFrontCenter_TrajPointACCObj11_TrajPointACCObj11_dxv_sw_Rv
{
    qword rawValue = 0ll;
    float rawValue_float = 0.0;
    float phyValue = 0.0;        

    //set the signal with updated raw value
    {
        rawValue = getvalue(this);
        if(chgEv_TrajPointACCObj11_TrajPointACCObj11_dxv_sw == 0)
        {
            //type conversion to float
            rawValue_float = rawValue;        
            // raw to physical conversion
            phyValue = ((rawValue_float *0.0078125)+(0));
            putValue(E_pric_RadarFrontCenter_TrajPointACCObj11_TrajPointACCObj11_dxv_sw_Pv, phyValue);
            chgEv_TrajPointACCObj11_TrajPointACCObj11_dxv_sw = 1;
        }
        else
        {
            chgEv_TrajPointACCObj11_TrajPointACCObj11_dxv_sw = 0;
        }    
        //update the signal value
        Msg_TrajPointACCObj11.TrajPointACCObj11_dxv_sw=rawValue;        
    }                                                                           
}

on envVar E_pric_RadarFrontCenter_TrajPointACCObj11_TrajPointACCObj11_dxv_sw_Pv
{
    qword rawValue = 0ll;
    float phyValue = 0.0;
    
    //update the raw value with physical value 
    {
        if(chgEv_TrajPointACCObj11_TrajPointACCObj11_dxv_sw == 0)
        {
            phyValue = getvalue(this);
            // physical to raw conversion
            rawValue = ((phyValue -(0))/0.0078125);
            putValue(E_pric_RadarFrontCenter_TrajPointACCObj11_TrajPointACCObj11_dxv_sw_Rv, rawValue);
            chgEv_TrajPointACCObj11_TrajPointACCObj11_dxv_sw = 1;  
        }
        else
        {
            chgEv_TrajPointACCObj11_TrajPointACCObj11_dxv_sw = 0;
        }
    }
}


 
on envVar E_pric_RadarFrontCenter_TrajPointACCObj11_TrajPointACCObj11_Drive_b_Rv
{
    qword rawValue = 0ll;
    float rawValue_float = 0.0;
    float phyValue = 0.0;        

    //set the signal with updated raw value
    if(getValue(E_pric_RadarFrontCenter_TrajPointACCObj11_TrajPointACCObj11_Drive_b_SetVt)==0)
    {
        rawValue = getvalue(this);
        if(chgEv_TrajPointACCObj11_TrajPointACCObj11_Drive_b == 0)
        {
            //type conversion to float
            rawValue_float = rawValue;        
            // raw to physical conversion
            phyValue = ((rawValue_float *1)+(0));
            putValue(E_pric_RadarFrontCenter_TrajPointACCObj11_TrajPointACCObj11_Drive_b_Pv, phyValue);
            chgEv_TrajPointACCObj11_TrajPointACCObj11_Drive_b = 1;
        }
        else
        {
            chgEv_TrajPointACCObj11_TrajPointACCObj11_Drive_b = 0;
        }    
        //update the signal value
        Msg_TrajPointACCObj11.TrajPointACCObj11_Drive_b=rawValue;        
    }                                                                           
}

on envVar E_pric_RadarFrontCenter_TrajPointACCObj11_TrajPointACCObj11_Drive_b_Pv
{
    qword rawValue = 0ll;
    float phyValue = 0.0;
    
    //update the raw value with physical value 
    if(getValue(E_pric_RadarFrontCenter_TrajPointACCObj11_TrajPointACCObj11_Drive_b_SetVt)==0)
    {
        if(chgEv_TrajPointACCObj11_TrajPointACCObj11_Drive_b == 0)
        {
            phyValue = getvalue(this);
            // physical to raw conversion
            rawValue = ((phyValue -(0))/1);
            putValue(E_pric_RadarFrontCenter_TrajPointACCObj11_TrajPointACCObj11_Drive_b_Rv, rawValue);
            chgEv_TrajPointACCObj11_TrajPointACCObj11_Drive_b = 1;  
        }
        else
        {
            chgEv_TrajPointACCObj11_TrajPointACCObj11_Drive_b = 0;
        }
    }
}

on envVar E_pric_RadarFrontCenter_TrajPointACCObj11_TrajPointACCObj11_Drive_b_Vt
{
    qword rawValue = 0ll;
    if(getValue(E_pric_RadarFrontCenter_TrajPointACCObj11_TrajPointACCObj11_Drive_b_SetVt))
    {
        //update the signal value
        Msg_TrajPointACCObj11.TrajPointACCObj11_Drive_b=getValue(this);
    }
}

on envVar E_pric_RadarFrontCenter_TrajPointACCObj11_TrajPointACCObj11_Drive_b_SetVt
{
    if(getValue(E_pric_RadarFrontCenter_TrajPointACCObj11_TrajPointACCObj11_Drive_b_SetVt))
    {
        //update the signal value
        Msg_TrajPointACCObj11.TrajPointACCObj11_Drive_b=getvalue(E_pric_RadarFrontCenter_TrajPointACCObj11_TrajPointACCObj11_Drive_b_Vt);
    }
    else
    {
        Msg_TrajPointACCObj11.TrajPointACCObj11_Drive_b=getValue(E_pric_RadarFrontCenter_TrajPointACCObj11_TrajPointACCObj11_Drive_b_Rv);
    }
}
 
on envVar E_pric_RadarFrontCenter_TrajPointACCObj11_TrajPointACCObj11_timestamp_Rv
{
    qword rawValue = 0ll;
    float rawValue_float = 0.0;
    float phyValue = 0.0;        

    //set the signal with updated raw value
    {
        rawValue = getvalue(this);
        if(chgEv_TrajPointACCObj11_TrajPointACCObj11_timestamp == 0)
        {
            //type conversion to float
            rawValue_float = rawValue;        
            // raw to physical conversion
            phyValue = ((rawValue_float *0.000488281)+(0));
            putValue(E_pric_RadarFrontCenter_TrajPointACCObj11_TrajPointACCObj11_timestamp_Pv, phyValue);
            chgEv_TrajPointACCObj11_TrajPointACCObj11_timestamp = 1;
        }
        else
        {
            chgEv_TrajPointACCObj11_TrajPointACCObj11_timestamp = 0;
        }    
        //update the signal value
        Msg_TrajPointACCObj11.TrajPointACCObj11_timestamp=rawValue;        
    }                                                                           
}

on envVar E_pric_RadarFrontCenter_TrajPointACCObj11_TrajPointACCObj11_timestamp_Pv
{
    qword rawValue = 0ll;
    float phyValue = 0.0;
    
    //update the raw value with physical value 
    {
        if(chgEv_TrajPointACCObj11_TrajPointACCObj11_timestamp == 0)
        {
            phyValue = getvalue(this);
            // physical to raw conversion
            rawValue = ((phyValue -(0))/0.000488281);
            putValue(E_pric_RadarFrontCenter_TrajPointACCObj11_TrajPointACCObj11_timestamp_Rv, rawValue);
            chgEv_TrajPointACCObj11_TrajPointACCObj11_timestamp = 1;  
        }
        else
        {
            chgEv_TrajPointACCObj11_TrajPointACCObj11_timestamp = 0;
        }
    }
}


 
on envVar E_pric_RadarFrontCenter_TrajPointACCObj11_TrajPointACCObj11_Stopped_b_Rv
{
    qword rawValue = 0ll;
    float rawValue_float = 0.0;
    float phyValue = 0.0;        

    //set the signal with updated raw value
    if(getValue(E_pric_RadarFrontCenter_TrajPointACCObj11_TrajPointACCObj11_Stopped_b_SetVt)==0)
    {
        rawValue = getvalue(this);
        if(chgEv_TrajPointACCObj11_TrajPointACCObj11_Stopped_b == 0)
        {
            //type conversion to float
            rawValue_float = rawValue;        
            // raw to physical conversion
            phyValue = ((rawValue_float *1)+(0));
            putValue(E_pric_RadarFrontCenter_TrajPointACCObj11_TrajPointACCObj11_Stopped_b_Pv, phyValue);
            chgEv_TrajPointACCObj11_TrajPointACCObj11_Stopped_b = 1;
        }
        else
        {
            chgEv_TrajPointACCObj11_TrajPointACCObj11_Stopped_b = 0;
        }    
        //update the signal value
        Msg_TrajPointACCObj11.TrajPointACCObj11_Stopped_b=rawValue;        
    }                                                                           
}

on envVar E_pric_RadarFrontCenter_TrajPointACCObj11_TrajPointACCObj11_Stopped_b_Pv
{
    qword rawValue = 0ll;
    float phyValue = 0.0;
    
    //update the raw value with physical value 
    if(getValue(E_pric_RadarFrontCenter_TrajPointACCObj11_TrajPointACCObj11_Stopped_b_SetVt)==0)
    {
        if(chgEv_TrajPointACCObj11_TrajPointACCObj11_Stopped_b == 0)
        {
            phyValue = getvalue(this);
            // physical to raw conversion
            rawValue = ((phyValue -(0))/1);
            putValue(E_pric_RadarFrontCenter_TrajPointACCObj11_TrajPointACCObj11_Stopped_b_Rv, rawValue);
            chgEv_TrajPointACCObj11_TrajPointACCObj11_Stopped_b = 1;  
        }
        else
        {
            chgEv_TrajPointACCObj11_TrajPointACCObj11_Stopped_b = 0;
        }
    }
}

on envVar E_pric_RadarFrontCenter_TrajPointACCObj11_TrajPointACCObj11_Stopped_b_Vt
{
    qword rawValue = 0ll;
    if(getValue(E_pric_RadarFrontCenter_TrajPointACCObj11_TrajPointACCObj11_Stopped_b_SetVt))
    {
        //update the signal value
        Msg_TrajPointACCObj11.TrajPointACCObj11_Stopped_b=getValue(this);
    }
}

on envVar E_pric_RadarFrontCenter_TrajPointACCObj11_TrajPointACCObj11_Stopped_b_SetVt
{
    if(getValue(E_pric_RadarFrontCenter_TrajPointACCObj11_TrajPointACCObj11_Stopped_b_SetVt))
    {
        //update the signal value
        Msg_TrajPointACCObj11.TrajPointACCObj11_Stopped_b=getvalue(E_pric_RadarFrontCenter_TrajPointACCObj11_TrajPointACCObj11_Stopped_b_Vt);
    }
    else
    {
        Msg_TrajPointACCObj11.TrajPointACCObj11_Stopped_b=getValue(E_pric_RadarFrontCenter_TrajPointACCObj11_TrajPointACCObj11_Stopped_b_Rv);
    }
}
 
on envVar E_pric_RadarFrontCenter_TrajPointACCObj11_TrajPointACCObj11_Valid_b_Rv
{
    qword rawValue = 0ll;
    float rawValue_float = 0.0;
    float phyValue = 0.0;        

    //set the signal with updated raw value
    if(getValue(E_pric_RadarFrontCenter_TrajPointACCObj11_TrajPointACCObj11_Valid_b_SetVt)==0)
    {
        rawValue = getvalue(this);
        if(chgEv_TrajPointACCObj11_TrajPointACCObj11_Valid_b == 0)
        {
            //type conversion to float
            rawValue_float = rawValue;        
            // raw to physical conversion
            phyValue = ((rawValue_float *1)+(0));
            putValue(E_pric_RadarFrontCenter_TrajPointACCObj11_TrajPointACCObj11_Valid_b_Pv, phyValue);
            chgEv_TrajPointACCObj11_TrajPointACCObj11_Valid_b = 1;
        }
        else
        {
            chgEv_TrajPointACCObj11_TrajPointACCObj11_Valid_b = 0;
        }    
        //update the signal value
        Msg_TrajPointACCObj11.TrajPointACCObj11_Valid_b=rawValue;        
    }                                                                           
}

on envVar E_pric_RadarFrontCenter_TrajPointACCObj11_TrajPointACCObj11_Valid_b_Pv
{
    qword rawValue = 0ll;
    float phyValue = 0.0;
    
    //update the raw value with physical value 
    if(getValue(E_pric_RadarFrontCenter_TrajPointACCObj11_TrajPointACCObj11_Valid_b_SetVt)==0)
    {
        if(chgEv_TrajPointACCObj11_TrajPointACCObj11_Valid_b == 0)
        {
            phyValue = getvalue(this);
            // physical to raw conversion
            rawValue = ((phyValue -(0))/1);
            putValue(E_pric_RadarFrontCenter_TrajPointACCObj11_TrajPointACCObj11_Valid_b_Rv, rawValue);
            chgEv_TrajPointACCObj11_TrajPointACCObj11_Valid_b = 1;  
        }
        else
        {
            chgEv_TrajPointACCObj11_TrajPointACCObj11_Valid_b = 0;
        }
    }
}

on envVar E_pric_RadarFrontCenter_TrajPointACCObj11_TrajPointACCObj11_Valid_b_Vt
{
    qword rawValue = 0ll;
    if(getValue(E_pric_RadarFrontCenter_TrajPointACCObj11_TrajPointACCObj11_Valid_b_SetVt))
    {
        //update the signal value
        Msg_TrajPointACCObj11.TrajPointACCObj11_Valid_b=getValue(this);
    }
}

on envVar E_pric_RadarFrontCenter_TrajPointACCObj11_TrajPointACCObj11_Valid_b_SetVt
{
    if(getValue(E_pric_RadarFrontCenter_TrajPointACCObj11_TrajPointACCObj11_Valid_b_SetVt))
    {
        //update the signal value
        Msg_TrajPointACCObj11.TrajPointACCObj11_Valid_b=getvalue(E_pric_RadarFrontCenter_TrajPointACCObj11_TrajPointACCObj11_Valid_b_Vt);
    }
    else
    {
        Msg_TrajPointACCObj11.TrajPointACCObj11_Valid_b=getValue(E_pric_RadarFrontCenter_TrajPointACCObj11_TrajPointACCObj11_Valid_b_Rv);
    }
}
 
on envVar E_pric_RadarFrontCenter_TrajPointACCObj11_TrajPointACCObj11_TrajEnd_b_Rv
{
    qword rawValue = 0ll;
    float rawValue_float = 0.0;
    float phyValue = 0.0;        

    //set the signal with updated raw value
    if(getValue(E_pric_RadarFrontCenter_TrajPointACCObj11_TrajPointACCObj11_TrajEnd_b_SetVt)==0)
    {
        rawValue = getvalue(this);
        if(chgEv_TrajPointACCObj11_TrajPointACCObj11_TrajEnd_b == 0)
        {
            //type conversion to float
            rawValue_float = rawValue;        
            // raw to physical conversion
            phyValue = ((rawValue_float *1)+(0));
            putValue(E_pric_RadarFrontCenter_TrajPointACCObj11_TrajPointACCObj11_TrajEnd_b_Pv, phyValue);
            chgEv_TrajPointACCObj11_TrajPointACCObj11_TrajEnd_b = 1;
        }
        else
        {
            chgEv_TrajPointACCObj11_TrajPointACCObj11_TrajEnd_b = 0;
        }    
        //update the signal value
        Msg_TrajPointACCObj11.TrajPointACCObj11_TrajEnd_b=rawValue;        
    }                                                                           
}

on envVar E_pric_RadarFrontCenter_TrajPointACCObj11_TrajPointACCObj11_TrajEnd_b_Pv
{
    qword rawValue = 0ll;
    float phyValue = 0.0;
    
    //update the raw value with physical value 
    if(getValue(E_pric_RadarFrontCenter_TrajPointACCObj11_TrajPointACCObj11_TrajEnd_b_SetVt)==0)
    {
        if(chgEv_TrajPointACCObj11_TrajPointACCObj11_TrajEnd_b == 0)
        {
            phyValue = getvalue(this);
            // physical to raw conversion
            rawValue = ((phyValue -(0))/1);
            putValue(E_pric_RadarFrontCenter_TrajPointACCObj11_TrajPointACCObj11_TrajEnd_b_Rv, rawValue);
            chgEv_TrajPointACCObj11_TrajPointACCObj11_TrajEnd_b = 1;  
        }
        else
        {
            chgEv_TrajPointACCObj11_TrajPointACCObj11_TrajEnd_b = 0;
        }
    }
}

on envVar E_pric_RadarFrontCenter_TrajPointACCObj11_TrajPointACCObj11_TrajEnd_b_Vt
{
    qword rawValue = 0ll;
    if(getValue(E_pric_RadarFrontCenter_TrajPointACCObj11_TrajPointACCObj11_TrajEnd_b_SetVt))
    {
        //update the signal value
        Msg_TrajPointACCObj11.TrajPointACCObj11_TrajEnd_b=getValue(this);
    }
}

on envVar E_pric_RadarFrontCenter_TrajPointACCObj11_TrajPointACCObj11_TrajEnd_b_SetVt
{
    if(getValue(E_pric_RadarFrontCenter_TrajPointACCObj11_TrajPointACCObj11_TrajEnd_b_SetVt))
    {
        //update the signal value
        Msg_TrajPointACCObj11.TrajPointACCObj11_TrajEnd_b=getvalue(E_pric_RadarFrontCenter_TrajPointACCObj11_TrajPointACCObj11_TrajEnd_b_Vt);
    }
    else
    {
        Msg_TrajPointACCObj11.TrajPointACCObj11_TrajEnd_b=getValue(E_pric_RadarFrontCenter_TrajPointACCObj11_TrajPointACCObj11_TrajEnd_b_Rv);
    }
}
 
on envVar E_pric_RadarFrontCenter_TrajPointACCObj11_TrajPointACCObj11_Stand_b_Rv
{
    qword rawValue = 0ll;
    float rawValue_float = 0.0;
    float phyValue = 0.0;        

    //set the signal with updated raw value
    if(getValue(E_pric_RadarFrontCenter_TrajPointACCObj11_TrajPointACCObj11_Stand_b_SetVt)==0)
    {
        rawValue = getvalue(this);
        if(chgEv_TrajPointACCObj11_TrajPointACCObj11_Stand_b == 0)
        {
            //type conversion to float
            rawValue_float = rawValue;        
            // raw to physical conversion
            phyValue = ((rawValue_float *1)+(0));
            putValue(E_pric_RadarFrontCenter_TrajPointACCObj11_TrajPointACCObj11_Stand_b_Pv, phyValue);
            chgEv_TrajPointACCObj11_TrajPointACCObj11_Stand_b = 1;
        }
        else
        {
            chgEv_TrajPointACCObj11_TrajPointACCObj11_Stand_b = 0;
        }    
        //update the signal value
        Msg_TrajPointACCObj11.TrajPointACCObj11_Stand_b=rawValue;        
    }                                                                           
}

on envVar E_pric_RadarFrontCenter_TrajPointACCObj11_TrajPointACCObj11_Stand_b_Pv
{
    qword rawValue = 0ll;
    float phyValue = 0.0;
    
    //update the raw value with physical value 
    if(getValue(E_pric_RadarFrontCenter_TrajPointACCObj11_TrajPointACCObj11_Stand_b_SetVt)==0)
    {
        if(chgEv_TrajPointACCObj11_TrajPointACCObj11_Stand_b == 0)
        {
            phyValue = getvalue(this);
            // physical to raw conversion
            rawValue = ((phyValue -(0))/1);
            putValue(E_pric_RadarFrontCenter_TrajPointACCObj11_TrajPointACCObj11_Stand_b_Rv, rawValue);
            chgEv_TrajPointACCObj11_TrajPointACCObj11_Stand_b = 1;  
        }
        else
        {
            chgEv_TrajPointACCObj11_TrajPointACCObj11_Stand_b = 0;
        }
    }
}

on envVar E_pric_RadarFrontCenter_TrajPointACCObj11_TrajPointACCObj11_Stand_b_Vt
{
    qword rawValue = 0ll;
    if(getValue(E_pric_RadarFrontCenter_TrajPointACCObj11_TrajPointACCObj11_Stand_b_SetVt))
    {
        //update the signal value
        Msg_TrajPointACCObj11.TrajPointACCObj11_Stand_b=getValue(this);
    }
}

on envVar E_pric_RadarFrontCenter_TrajPointACCObj11_TrajPointACCObj11_Stand_b_SetVt
{
    if(getValue(E_pric_RadarFrontCenter_TrajPointACCObj11_TrajPointACCObj11_Stand_b_SetVt))
    {
        //update the signal value
        Msg_TrajPointACCObj11.TrajPointACCObj11_Stand_b=getvalue(E_pric_RadarFrontCenter_TrajPointACCObj11_TrajPointACCObj11_Stand_b_Vt);
    }
    else
    {
        Msg_TrajPointACCObj11.TrajPointACCObj11_Stand_b=getValue(E_pric_RadarFrontCenter_TrajPointACCObj11_TrajPointACCObj11_Stand_b_Rv);
    }
}
 
on envVar E_pric_RadarFrontCenter_TrajPointACCObj11_TrajPointACCObj11_dVarYv_uw_Rv
{
    qword rawValue = 0ll;
    float rawValue_float = 0.0;
    float phyValue = 0.0;        

    //set the signal with updated raw value
    {
        rawValue = getvalue(this);
        if(chgEv_TrajPointACCObj11_TrajPointACCObj11_dVarYv_uw == 0)
        {
            //type conversion to float
            rawValue_float = rawValue;        
            // raw to physical conversion
            phyValue = ((rawValue_float *0.00195313)+(0));
            putValue(E_pric_RadarFrontCenter_TrajPointACCObj11_TrajPointACCObj11_dVarYv_uw_Pv, phyValue);
            chgEv_TrajPointACCObj11_TrajPointACCObj11_dVarYv_uw = 1;
        }
        else
        {
            chgEv_TrajPointACCObj11_TrajPointACCObj11_dVarYv_uw = 0;
        }    
        //update the signal value
        Msg_TrajPointACCObj11.TrajPointACCObj11_dVarYv_uw=rawValue;        
    }                                                                           
}

on envVar E_pric_RadarFrontCenter_TrajPointACCObj11_TrajPointACCObj11_dVarYv_uw_Pv
{
    qword rawValue = 0ll;
    float phyValue = 0.0;
    
    //update the raw value with physical value 
    {
        if(chgEv_TrajPointACCObj11_TrajPointACCObj11_dVarYv_uw == 0)
        {
            phyValue = getvalue(this);
            // physical to raw conversion
            rawValue = ((phyValue -(0))/0.00195313);
            putValue(E_pric_RadarFrontCenter_TrajPointACCObj11_TrajPointACCObj11_dVarYv_uw_Rv, rawValue);
            chgEv_TrajPointACCObj11_TrajPointACCObj11_dVarYv_uw = 1;  
        }
        else
        {
            chgEv_TrajPointACCObj11_TrajPointACCObj11_dVarYv_uw = 0;
        }
    }
}


 
on envVar E_pric_RadarFrontCenter_TrajPointACCObj11_TrajPointACCObj11_wExistProb_ub_Rv
{
    qword rawValue = 0ll;
    float rawValue_float = 0.0;
    float phyValue = 0.0;        

    //set the signal with updated raw value
    {
        rawValue = getvalue(this);
        if(chgEv_TrajPointACCObj11_TrajPointACCObj11_wExistProb_ub == 0)
        {
            //type conversion to float
            rawValue_float = rawValue;        
            // raw to physical conversion
            phyValue = ((rawValue_float *0.00390625)+(0));
            putValue(E_pric_RadarFrontCenter_TrajPointACCObj11_TrajPointACCObj11_wExistProb_ub_Pv, phyValue);
            chgEv_TrajPointACCObj11_TrajPointACCObj11_wExistProb_ub = 1;
        }
        else
        {
            chgEv_TrajPointACCObj11_TrajPointACCObj11_wExistProb_ub = 0;
        }    
        //update the signal value
        Msg_TrajPointACCObj11.TrajPointACCObj11_wExistProb_ub=rawValue;        
    }                                                                           
}

on envVar E_pric_RadarFrontCenter_TrajPointACCObj11_TrajPointACCObj11_wExistProb_ub_Pv
{
    qword rawValue = 0ll;
    float phyValue = 0.0;
    
    //update the raw value with physical value 
    {
        if(chgEv_TrajPointACCObj11_TrajPointACCObj11_wExistProb_ub == 0)
        {
            phyValue = getvalue(this);
            // physical to raw conversion
            rawValue = ((phyValue -(0))/0.00390625);
            putValue(E_pric_RadarFrontCenter_TrajPointACCObj11_TrajPointACCObj11_wExistProb_ub_Rv, rawValue);
            chgEv_TrajPointACCObj11_TrajPointACCObj11_wExistProb_ub = 1;  
        }
        else
        {
            chgEv_TrajPointACCObj11_TrajPointACCObj11_wExistProb_ub = 0;
        }
    }
}


 
on envVar E_pric_RadarFrontCenter_TrajPointACCObj11_TrajPointACCObj11_InvDir_b_Rv
{
    qword rawValue = 0ll;
    float rawValue_float = 0.0;
    float phyValue = 0.0;        

    //set the signal with updated raw value
    if(getValue(E_pric_RadarFrontCenter_TrajPointACCObj11_TrajPointACCObj11_InvDir_b_SetVt)==0)
    {
        rawValue = getvalue(this);
        if(chgEv_TrajPointACCObj11_TrajPointACCObj11_InvDir_b == 0)
        {
            //type conversion to float
            rawValue_float = rawValue;        
            // raw to physical conversion
            phyValue = ((rawValue_float *1)+(0));
            putValue(E_pric_RadarFrontCenter_TrajPointACCObj11_TrajPointACCObj11_InvDir_b_Pv, phyValue);
            chgEv_TrajPointACCObj11_TrajPointACCObj11_InvDir_b = 1;
        }
        else
        {
            chgEv_TrajPointACCObj11_TrajPointACCObj11_InvDir_b = 0;
        }    
        //update the signal value
        Msg_TrajPointACCObj11.TrajPointACCObj11_InvDir_b=rawValue;        
    }                                                                           
}

on envVar E_pric_RadarFrontCenter_TrajPointACCObj11_TrajPointACCObj11_InvDir_b_Pv
{
    qword rawValue = 0ll;
    float phyValue = 0.0;
    
    //update the raw value with physical value 
    if(getValue(E_pric_RadarFrontCenter_TrajPointACCObj11_TrajPointACCObj11_InvDir_b_SetVt)==0)
    {
        if(chgEv_TrajPointACCObj11_TrajPointACCObj11_InvDir_b == 0)
        {
            phyValue = getvalue(this);
            // physical to raw conversion
            rawValue = ((phyValue -(0))/1);
            putValue(E_pric_RadarFrontCenter_TrajPointACCObj11_TrajPointACCObj11_InvDir_b_Rv, rawValue);
            chgEv_TrajPointACCObj11_TrajPointACCObj11_InvDir_b = 1;  
        }
        else
        {
            chgEv_TrajPointACCObj11_TrajPointACCObj11_InvDir_b = 0;
        }
    }
}

on envVar E_pric_RadarFrontCenter_TrajPointACCObj11_TrajPointACCObj11_InvDir_b_Vt
{
    qword rawValue = 0ll;
    if(getValue(E_pric_RadarFrontCenter_TrajPointACCObj11_TrajPointACCObj11_InvDir_b_SetVt))
    {
        //update the signal value
        Msg_TrajPointACCObj11.TrajPointACCObj11_InvDir_b=getValue(this);
    }
}

on envVar E_pric_RadarFrontCenter_TrajPointACCObj11_TrajPointACCObj11_InvDir_b_SetVt
{
    if(getValue(E_pric_RadarFrontCenter_TrajPointACCObj11_TrajPointACCObj11_InvDir_b_SetVt))
    {
        //update the signal value
        Msg_TrajPointACCObj11.TrajPointACCObj11_InvDir_b=getvalue(E_pric_RadarFrontCenter_TrajPointACCObj11_TrajPointACCObj11_InvDir_b_Vt);
    }
    else
    {
        Msg_TrajPointACCObj11.TrajPointACCObj11_InvDir_b=getValue(E_pric_RadarFrontCenter_TrajPointACCObj11_TrajPointACCObj11_InvDir_b_Rv);
    }
}
 
on envVar E_pric_RadarFrontCenter_TrajPointACCObj10_tx
{
    if(getValue(this))
    {       
        
        //update the BZ Signal
        if(TrajPointACCObj10_TrajPointACCObj10_blockCtr_wrongvalctr == 0)
        {
            update_TrajPointACCObj10_TrajPointACCObj10_blockCtr_counter();
            Msg_TrajPointACCObj10.TrajPointACCObj10_blockCtr= TrajPointACCObj10_TrajPointACCObj10_blockCtr_counter;
        }
        else if(TrajPointACCObj10_TrajPointACCObj10_blockCtr_wrongvalctr > 0)
        {
             TrajPointACCObj10_TrajPointACCObj10_blockCtr_wrongvalctr--;
              // if counter becomes zero, update panel controller to zero
             if(TrajPointACCObj10_TrajPointACCObj10_blockCtr_wrongvalctr == 0)
             {
                 putValue(E_pric_RadarFrontCenter_TrajPointACCObj10_TrajPointACCObj10_blockCtr_wrongvalctr,0);
             }
        }
        else
        {
            //do nothing
        }        
        //update the BZ Signal
        if(TrajPointACCObj10_TrajPointACCObj10_MsgCtr_wrongvalctr == 0)
        {
            update_TrajPointACCObj10_TrajPointACCObj10_MsgCtr_counter();
            Msg_TrajPointACCObj10.TrajPointACCObj10_MsgCtr= TrajPointACCObj10_TrajPointACCObj10_MsgCtr_counter;
        }
        else if(TrajPointACCObj10_TrajPointACCObj10_MsgCtr_wrongvalctr > 0)
        {
             TrajPointACCObj10_TrajPointACCObj10_MsgCtr_wrongvalctr--;
              // if counter becomes zero, update panel controller to zero
             if(TrajPointACCObj10_TrajPointACCObj10_MsgCtr_wrongvalctr == 0)
             {
                 putValue(E_pric_RadarFrontCenter_TrajPointACCObj10_TrajPointACCObj10_MsgCtr_wrongvalctr,0);
             }
        }
        else
        {
            //do nothing
        }        
        //calculate the CRC checksum
        update_TrajPointACCObj10_ChkSum_Checksum();

        output(Msg_TrajPointACCObj10);        
    }
}

on envVar E_pric_RadarFrontCenter_TrajPointACCObj10_Range
{
    qword rawstatus = 0ll;
    qword rawValue = 0ll;    
    
    rawstatus = getvalue(this);    
    // set all the signals with min raw /max raw /init raw
    switch (rawstatus) 
    {
     case(0) :
        rawValue= 0;
        putValue(E_pric_RadarFrontCenter_TrajPointACCObj10_TrajPointACCObj10_timestamp_Rv, rawValue);
        rawValue= 0;
        putValue(E_pric_RadarFrontCenter_TrajPointACCObj10_TrajPointACCObj10_wExistProb_ub_Rv, rawValue);
        rawValue= -32768;
        putValue(E_pric_RadarFrontCenter_TrajPointACCObj10_TrajPointACCObj10_dyv_sw_Rv, rawValue);
        rawValue= 0;
        putValue(E_pric_RadarFrontCenter_TrajPointACCObj10_TrajPointACCObj10_Drive_b_Rv, rawValue);
        rawValue= 0;
        putValue(E_pric_RadarFrontCenter_TrajPointACCObj10_TrajPointACCObj10_Stopped_b_Rv, rawValue);
        rawValue= 0;
        putValue(E_pric_RadarFrontCenter_TrajPointACCObj10_TrajPointACCObj10_Stand_b_Rv, rawValue);
        rawValue= 0;
        putValue(E_pric_RadarFrontCenter_TrajPointACCObj10_TrajPointACCObj10_TrajEnd_b_Rv, rawValue);
        rawValue= 0;
        putValue(E_pric_RadarFrontCenter_TrajPointACCObj10_TrajPointACCObj10_dVarXv_uw_Rv, rawValue);
        rawValue= 0;
        putValue(E_pric_RadarFrontCenter_TrajPointACCObj10_TrajPointACCObj10_dVarYv_uw_Rv, rawValue);
        rawValue= -32768;
        putValue(E_pric_RadarFrontCenter_TrajPointACCObj10_TrajPointACCObj10_dxv_sw_Rv, rawValue);
        rawValue= 0;
        putValue(E_pric_RadarFrontCenter_TrajPointACCObj10_TrajPointACCObj10_Valid_b_Rv, rawValue);
        rawValue= 0;
        putValue(E_pric_RadarFrontCenter_TrajPointACCObj10_TrajPointACCObj10_InvDir_b_Rv, rawValue);
        break;
     case(1) :
        rawValue= 65536;
        putValue(E_pric_RadarFrontCenter_TrajPointACCObj10_TrajPointACCObj10_timestamp_Rv, rawValue);
        rawValue= 255;
        putValue(E_pric_RadarFrontCenter_TrajPointACCObj10_TrajPointACCObj10_wExistProb_ub_Rv, rawValue);
        rawValue= 32767;
        putValue(E_pric_RadarFrontCenter_TrajPointACCObj10_TrajPointACCObj10_dyv_sw_Rv, rawValue);
        rawValue= 1;
        putValue(E_pric_RadarFrontCenter_TrajPointACCObj10_TrajPointACCObj10_Drive_b_Rv, rawValue);
        rawValue= 1;
        putValue(E_pric_RadarFrontCenter_TrajPointACCObj10_TrajPointACCObj10_Stopped_b_Rv, rawValue);
        rawValue= 1;
        putValue(E_pric_RadarFrontCenter_TrajPointACCObj10_TrajPointACCObj10_Stand_b_Rv, rawValue);
        rawValue= 1;
        putValue(E_pric_RadarFrontCenter_TrajPointACCObj10_TrajPointACCObj10_TrajEnd_b_Rv, rawValue);
        rawValue= 65534;
        putValue(E_pric_RadarFrontCenter_TrajPointACCObj10_TrajPointACCObj10_dVarXv_uw_Rv, rawValue);
        rawValue= 65534;
        putValue(E_pric_RadarFrontCenter_TrajPointACCObj10_TrajPointACCObj10_dVarYv_uw_Rv, rawValue);
        rawValue= 32767;
        putValue(E_pric_RadarFrontCenter_TrajPointACCObj10_TrajPointACCObj10_dxv_sw_Rv, rawValue);
        rawValue= 1;
        putValue(E_pric_RadarFrontCenter_TrajPointACCObj10_TrajPointACCObj10_Valid_b_Rv, rawValue);
        rawValue= 1;
        putValue(E_pric_RadarFrontCenter_TrajPointACCObj10_TrajPointACCObj10_InvDir_b_Rv, rawValue);
        break;
     default :
        rawValue= 0;
        putValue(E_pric_RadarFrontCenter_TrajPointACCObj10_TrajPointACCObj10_timestamp_Rv, rawValue);
        rawValue= 0;
        putValue(E_pric_RadarFrontCenter_TrajPointACCObj10_TrajPointACCObj10_wExistProb_ub_Rv, rawValue);
        rawValue= -32768;
        putValue(E_pric_RadarFrontCenter_TrajPointACCObj10_TrajPointACCObj10_dyv_sw_Rv, rawValue);
        rawValue= 0;
        putValue(E_pric_RadarFrontCenter_TrajPointACCObj10_TrajPointACCObj10_Drive_b_Rv, rawValue);
        rawValue= 0;
        putValue(E_pric_RadarFrontCenter_TrajPointACCObj10_TrajPointACCObj10_Stopped_b_Rv, rawValue);
        rawValue= 0;
        putValue(E_pric_RadarFrontCenter_TrajPointACCObj10_TrajPointACCObj10_Stand_b_Rv, rawValue);
        rawValue= 0;
        putValue(E_pric_RadarFrontCenter_TrajPointACCObj10_TrajPointACCObj10_TrajEnd_b_Rv, rawValue);
        rawValue= 0;
        putValue(E_pric_RadarFrontCenter_TrajPointACCObj10_TrajPointACCObj10_dVarXv_uw_Rv, rawValue);
        rawValue= 0;
        putValue(E_pric_RadarFrontCenter_TrajPointACCObj10_TrajPointACCObj10_dVarYv_uw_Rv, rawValue);
        rawValue= -32768;
        putValue(E_pric_RadarFrontCenter_TrajPointACCObj10_TrajPointACCObj10_dxv_sw_Rv, rawValue);
        rawValue= 0;
        putValue(E_pric_RadarFrontCenter_TrajPointACCObj10_TrajPointACCObj10_Valid_b_Rv, rawValue);
        rawValue= 0;
        putValue(E_pric_RadarFrontCenter_TrajPointACCObj10_TrajPointACCObj10_InvDir_b_Rv, rawValue);
      break;
   }
}

on envVar E_pric_RadarFrontCenter_TrajPointACCObj10_Dlc
{
    if(getValue(E_pric_RadarFrontCenter_TrajPointACCObj10_enDlc))
    {
        Msg_TrajPointACCObj10.dlc =getValue(this);
    }
    else
    {
       Dbc_dlc = 16;
	   Msg_TrajPointACCObj10.dlc = Calc_Canfd_dlc(Dbc_dlc);
	   	
  }
}

on envVar E_pric_RadarFrontCenter_TrajPointACCObj10_enDlc
{
    //For Messages with DLC = 8, set wrong DLC to smaller than defined DLC
    //For Messages with DLC < 8 set wrong DLC to smaller/longer than defined DLC
    if(getValue(this))
    {
        Msg_TrajPointACCObj10.dlc =getValue(E_pric_RadarFrontCenter_TrajPointACCObj10_Dlc);
    }
    else
    {
       Dbc_dlc = 16;
	   Msg_TrajPointACCObj10.dlc = Calc_Canfd_dlc(Dbc_dlc);
			
    }
}

on envVar E_pric_RadarFrontCenter_TrajPointACCObj10_TrajPointACCObj10_CRC_wrongvalctr
{
    //update disturb count
    //disturb value range:(-1 = always send wrong value),( X>0 ,x is the number of Messages with wrong CHK sent)
    TrajPointACCObj10_TrajPointACCObj10_CRC_wrongvalctr =getValue(this);    
}
on envVar E_pric_RadarFrontCenter_TrajPointACCObj10_TrajPointACCObj10_MsgCtr_wrongvalctr
{
    //update disturb count
    //disturb value range:(-1 = always send wrong value),( X>0 ,x is the number of Messages with wrong CHK sent)
    TrajPointACCObj10_TrajPointACCObj10_MsgCtr_wrongvalctr =getValue(this);    
}
on envVar E_pric_RadarFrontCenter_TrajPointACCObj10_TrajPointACCObj10_blockCtr_wrongvalctr
{
    //update disturb count
    //disturb value range:(-1 = always send wrong value),( X>0 ,x is the number of Messages with wrong CHK sent)
    TrajPointACCObj10_TrajPointACCObj10_blockCtr_wrongvalctr =getValue(this);    
}

on envVar E_pric_RadarFrontCenter_TrajPointACCObj10_TrajPointACCObj10_timestamp_Rv
{
    qword rawValue = 0ll;
    float rawValue_float = 0.0;
    float phyValue = 0.0;        

    //set the signal with updated raw value
    {
        rawValue = getvalue(this);
        if(chgEv_TrajPointACCObj10_TrajPointACCObj10_timestamp == 0)
        {
            //type conversion to float
            rawValue_float = rawValue;        
            // raw to physical conversion
            phyValue = ((rawValue_float *0.000488281)+(0));
            putValue(E_pric_RadarFrontCenter_TrajPointACCObj10_TrajPointACCObj10_timestamp_Pv, phyValue);
            chgEv_TrajPointACCObj10_TrajPointACCObj10_timestamp = 1;
        }
        else
        {
            chgEv_TrajPointACCObj10_TrajPointACCObj10_timestamp = 0;
        }    
        //update the signal value
        Msg_TrajPointACCObj10.TrajPointACCObj10_timestamp=rawValue;        
    }                                                                           
}

on envVar E_pric_RadarFrontCenter_TrajPointACCObj10_TrajPointACCObj10_timestamp_Pv
{
    qword rawValue = 0ll;
    float phyValue = 0.0;
    
    //update the raw value with physical value 
    {
        if(chgEv_TrajPointACCObj10_TrajPointACCObj10_timestamp == 0)
        {
            phyValue = getvalue(this);
            // physical to raw conversion
            rawValue = ((phyValue -(0))/0.000488281);
            putValue(E_pric_RadarFrontCenter_TrajPointACCObj10_TrajPointACCObj10_timestamp_Rv, rawValue);
            chgEv_TrajPointACCObj10_TrajPointACCObj10_timestamp = 1;  
        }
        else
        {
            chgEv_TrajPointACCObj10_TrajPointACCObj10_timestamp = 0;
        }
    }
}


 
on envVar E_pric_RadarFrontCenter_TrajPointACCObj10_TrajPointACCObj10_wExistProb_ub_Rv
{
    qword rawValue = 0ll;
    float rawValue_float = 0.0;
    float phyValue = 0.0;        

    //set the signal with updated raw value
    {
        rawValue = getvalue(this);
        if(chgEv_TrajPointACCObj10_TrajPointACCObj10_wExistProb_ub == 0)
        {
            //type conversion to float
            rawValue_float = rawValue;        
            // raw to physical conversion
            phyValue = ((rawValue_float *0.00390625)+(0));
            putValue(E_pric_RadarFrontCenter_TrajPointACCObj10_TrajPointACCObj10_wExistProb_ub_Pv, phyValue);
            chgEv_TrajPointACCObj10_TrajPointACCObj10_wExistProb_ub = 1;
        }
        else
        {
            chgEv_TrajPointACCObj10_TrajPointACCObj10_wExistProb_ub = 0;
        }    
        //update the signal value
        Msg_TrajPointACCObj10.TrajPointACCObj10_wExistProb_ub=rawValue;        
    }                                                                           
}

on envVar E_pric_RadarFrontCenter_TrajPointACCObj10_TrajPointACCObj10_wExistProb_ub_Pv
{
    qword rawValue = 0ll;
    float phyValue = 0.0;
    
    //update the raw value with physical value 
    {
        if(chgEv_TrajPointACCObj10_TrajPointACCObj10_wExistProb_ub == 0)
        {
            phyValue = getvalue(this);
            // physical to raw conversion
            rawValue = ((phyValue -(0))/0.00390625);
            putValue(E_pric_RadarFrontCenter_TrajPointACCObj10_TrajPointACCObj10_wExistProb_ub_Rv, rawValue);
            chgEv_TrajPointACCObj10_TrajPointACCObj10_wExistProb_ub = 1;  
        }
        else
        {
            chgEv_TrajPointACCObj10_TrajPointACCObj10_wExistProb_ub = 0;
        }
    }
}


 
on envVar E_pric_RadarFrontCenter_TrajPointACCObj10_TrajPointACCObj10_dyv_sw_Rv
{
    qword rawValue = 0ll;
    float rawValue_float = 0.0;
    float phyValue = 0.0;        

    //set the signal with updated raw value
    {
        rawValue = getvalue(this);
        if(chgEv_TrajPointACCObj10_TrajPointACCObj10_dyv_sw == 0)
        {
            //type conversion to float
            rawValue_float = rawValue;        
            // raw to physical conversion
            phyValue = ((rawValue_float *0.0078125)+(0));
            putValue(E_pric_RadarFrontCenter_TrajPointACCObj10_TrajPointACCObj10_dyv_sw_Pv, phyValue);
            chgEv_TrajPointACCObj10_TrajPointACCObj10_dyv_sw = 1;
        }
        else
        {
            chgEv_TrajPointACCObj10_TrajPointACCObj10_dyv_sw = 0;
        }    
        //update the signal value
        Msg_TrajPointACCObj10.TrajPointACCObj10_dyv_sw=rawValue;        
    }                                                                           
}

on envVar E_pric_RadarFrontCenter_TrajPointACCObj10_TrajPointACCObj10_dyv_sw_Pv
{
    qword rawValue = 0ll;
    float phyValue = 0.0;
    
    //update the raw value with physical value 
    {
        if(chgEv_TrajPointACCObj10_TrajPointACCObj10_dyv_sw == 0)
        {
            phyValue = getvalue(this);
            // physical to raw conversion
            rawValue = ((phyValue -(0))/0.0078125);
            putValue(E_pric_RadarFrontCenter_TrajPointACCObj10_TrajPointACCObj10_dyv_sw_Rv, rawValue);
            chgEv_TrajPointACCObj10_TrajPointACCObj10_dyv_sw = 1;  
        }
        else
        {
            chgEv_TrajPointACCObj10_TrajPointACCObj10_dyv_sw = 0;
        }
    }
}


 
on envVar E_pric_RadarFrontCenter_TrajPointACCObj10_TrajPointACCObj10_Drive_b_Rv
{
    qword rawValue = 0ll;
    float rawValue_float = 0.0;
    float phyValue = 0.0;        

    //set the signal with updated raw value
    if(getValue(E_pric_RadarFrontCenter_TrajPointACCObj10_TrajPointACCObj10_Drive_b_SetVt)==0)
    {
        rawValue = getvalue(this);
        if(chgEv_TrajPointACCObj10_TrajPointACCObj10_Drive_b == 0)
        {
            //type conversion to float
            rawValue_float = rawValue;        
            // raw to physical conversion
            phyValue = ((rawValue_float *1)+(0));
            putValue(E_pric_RadarFrontCenter_TrajPointACCObj10_TrajPointACCObj10_Drive_b_Pv, phyValue);
            chgEv_TrajPointACCObj10_TrajPointACCObj10_Drive_b = 1;
        }
        else
        {
            chgEv_TrajPointACCObj10_TrajPointACCObj10_Drive_b = 0;
        }    
        //update the signal value
        Msg_TrajPointACCObj10.TrajPointACCObj10_Drive_b=rawValue;        
    }                                                                           
}

on envVar E_pric_RadarFrontCenter_TrajPointACCObj10_TrajPointACCObj10_Drive_b_Pv
{
    qword rawValue = 0ll;
    float phyValue = 0.0;
    
    //update the raw value with physical value 
    if(getValue(E_pric_RadarFrontCenter_TrajPointACCObj10_TrajPointACCObj10_Drive_b_SetVt)==0)
    {
        if(chgEv_TrajPointACCObj10_TrajPointACCObj10_Drive_b == 0)
        {
            phyValue = getvalue(this);
            // physical to raw conversion
            rawValue = ((phyValue -(0))/1);
            putValue(E_pric_RadarFrontCenter_TrajPointACCObj10_TrajPointACCObj10_Drive_b_Rv, rawValue);
            chgEv_TrajPointACCObj10_TrajPointACCObj10_Drive_b = 1;  
        }
        else
        {
            chgEv_TrajPointACCObj10_TrajPointACCObj10_Drive_b = 0;
        }
    }
}

on envVar E_pric_RadarFrontCenter_TrajPointACCObj10_TrajPointACCObj10_Drive_b_Vt
{
    qword rawValue = 0ll;
    if(getValue(E_pric_RadarFrontCenter_TrajPointACCObj10_TrajPointACCObj10_Drive_b_SetVt))
    {
        //update the signal value
        Msg_TrajPointACCObj10.TrajPointACCObj10_Drive_b=getValue(this);
    }
}

on envVar E_pric_RadarFrontCenter_TrajPointACCObj10_TrajPointACCObj10_Drive_b_SetVt
{
    if(getValue(E_pric_RadarFrontCenter_TrajPointACCObj10_TrajPointACCObj10_Drive_b_SetVt))
    {
        //update the signal value
        Msg_TrajPointACCObj10.TrajPointACCObj10_Drive_b=getvalue(E_pric_RadarFrontCenter_TrajPointACCObj10_TrajPointACCObj10_Drive_b_Vt);
    }
    else
    {
        Msg_TrajPointACCObj10.TrajPointACCObj10_Drive_b=getValue(E_pric_RadarFrontCenter_TrajPointACCObj10_TrajPointACCObj10_Drive_b_Rv);
    }
}
 
on envVar E_pric_RadarFrontCenter_TrajPointACCObj10_TrajPointACCObj10_Stopped_b_Rv
{
    qword rawValue = 0ll;
    float rawValue_float = 0.0;
    float phyValue = 0.0;        

    //set the signal with updated raw value
    if(getValue(E_pric_RadarFrontCenter_TrajPointACCObj10_TrajPointACCObj10_Stopped_b_SetVt)==0)
    {
        rawValue = getvalue(this);
        if(chgEv_TrajPointACCObj10_TrajPointACCObj10_Stopped_b == 0)
        {
            //type conversion to float
            rawValue_float = rawValue;        
            // raw to physical conversion
            phyValue = ((rawValue_float *1)+(0));
            putValue(E_pric_RadarFrontCenter_TrajPointACCObj10_TrajPointACCObj10_Stopped_b_Pv, phyValue);
            chgEv_TrajPointACCObj10_TrajPointACCObj10_Stopped_b = 1;
        }
        else
        {
            chgEv_TrajPointACCObj10_TrajPointACCObj10_Stopped_b = 0;
        }    
        //update the signal value
        Msg_TrajPointACCObj10.TrajPointACCObj10_Stopped_b=rawValue;        
    }                                                                           
}

on envVar E_pric_RadarFrontCenter_TrajPointACCObj10_TrajPointACCObj10_Stopped_b_Pv
{
    qword rawValue = 0ll;
    float phyValue = 0.0;
    
    //update the raw value with physical value 
    if(getValue(E_pric_RadarFrontCenter_TrajPointACCObj10_TrajPointACCObj10_Stopped_b_SetVt)==0)
    {
        if(chgEv_TrajPointACCObj10_TrajPointACCObj10_Stopped_b == 0)
        {
            phyValue = getvalue(this);
            // physical to raw conversion
            rawValue = ((phyValue -(0))/1);
            putValue(E_pric_RadarFrontCenter_TrajPointACCObj10_TrajPointACCObj10_Stopped_b_Rv, rawValue);
            chgEv_TrajPointACCObj10_TrajPointACCObj10_Stopped_b = 1;  
        }
        else
        {
            chgEv_TrajPointACCObj10_TrajPointACCObj10_Stopped_b = 0;
        }
    }
}

on envVar E_pric_RadarFrontCenter_TrajPointACCObj10_TrajPointACCObj10_Stopped_b_Vt
{
    qword rawValue = 0ll;
    if(getValue(E_pric_RadarFrontCenter_TrajPointACCObj10_TrajPointACCObj10_Stopped_b_SetVt))
    {
        //update the signal value
        Msg_TrajPointACCObj10.TrajPointACCObj10_Stopped_b=getValue(this);
    }
}

on envVar E_pric_RadarFrontCenter_TrajPointACCObj10_TrajPointACCObj10_Stopped_b_SetVt
{
    if(getValue(E_pric_RadarFrontCenter_TrajPointACCObj10_TrajPointACCObj10_Stopped_b_SetVt))
    {
        //update the signal value
        Msg_TrajPointACCObj10.TrajPointACCObj10_Stopped_b=getvalue(E_pric_RadarFrontCenter_TrajPointACCObj10_TrajPointACCObj10_Stopped_b_Vt);
    }
    else
    {
        Msg_TrajPointACCObj10.TrajPointACCObj10_Stopped_b=getValue(E_pric_RadarFrontCenter_TrajPointACCObj10_TrajPointACCObj10_Stopped_b_Rv);
    }
}
 
on envVar E_pric_RadarFrontCenter_TrajPointACCObj10_TrajPointACCObj10_Stand_b_Rv
{
    qword rawValue = 0ll;
    float rawValue_float = 0.0;
    float phyValue = 0.0;        

    //set the signal with updated raw value
    if(getValue(E_pric_RadarFrontCenter_TrajPointACCObj10_TrajPointACCObj10_Stand_b_SetVt)==0)
    {
        rawValue = getvalue(this);
        if(chgEv_TrajPointACCObj10_TrajPointACCObj10_Stand_b == 0)
        {
            //type conversion to float
            rawValue_float = rawValue;        
            // raw to physical conversion
            phyValue = ((rawValue_float *1)+(0));
            putValue(E_pric_RadarFrontCenter_TrajPointACCObj10_TrajPointACCObj10_Stand_b_Pv, phyValue);
            chgEv_TrajPointACCObj10_TrajPointACCObj10_Stand_b = 1;
        }
        else
        {
            chgEv_TrajPointACCObj10_TrajPointACCObj10_Stand_b = 0;
        }    
        //update the signal value
        Msg_TrajPointACCObj10.TrajPointACCObj10_Stand_b=rawValue;        
    }                                                                           
}

on envVar E_pric_RadarFrontCenter_TrajPointACCObj10_TrajPointACCObj10_Stand_b_Pv
{
    qword rawValue = 0ll;
    float phyValue = 0.0;
    
    //update the raw value with physical value 
    if(getValue(E_pric_RadarFrontCenter_TrajPointACCObj10_TrajPointACCObj10_Stand_b_SetVt)==0)
    {
        if(chgEv_TrajPointACCObj10_TrajPointACCObj10_Stand_b == 0)
        {
            phyValue = getvalue(this);
            // physical to raw conversion
            rawValue = ((phyValue -(0))/1);
            putValue(E_pric_RadarFrontCenter_TrajPointACCObj10_TrajPointACCObj10_Stand_b_Rv, rawValue);
            chgEv_TrajPointACCObj10_TrajPointACCObj10_Stand_b = 1;  
        }
        else
        {
            chgEv_TrajPointACCObj10_TrajPointACCObj10_Stand_b = 0;
        }
    }
}

on envVar E_pric_RadarFrontCenter_TrajPointACCObj10_TrajPointACCObj10_Stand_b_Vt
{
    qword rawValue = 0ll;
    if(getValue(E_pric_RadarFrontCenter_TrajPointACCObj10_TrajPointACCObj10_Stand_b_SetVt))
    {
        //update the signal value
        Msg_TrajPointACCObj10.TrajPointACCObj10_Stand_b=getValue(this);
    }
}

on envVar E_pric_RadarFrontCenter_TrajPointACCObj10_TrajPointACCObj10_Stand_b_SetVt
{
    if(getValue(E_pric_RadarFrontCenter_TrajPointACCObj10_TrajPointACCObj10_Stand_b_SetVt))
    {
        //update the signal value
        Msg_TrajPointACCObj10.TrajPointACCObj10_Stand_b=getvalue(E_pric_RadarFrontCenter_TrajPointACCObj10_TrajPointACCObj10_Stand_b_Vt);
    }
    else
    {
        Msg_TrajPointACCObj10.TrajPointACCObj10_Stand_b=getValue(E_pric_RadarFrontCenter_TrajPointACCObj10_TrajPointACCObj10_Stand_b_Rv);
    }
}
 
on envVar E_pric_RadarFrontCenter_TrajPointACCObj10_TrajPointACCObj10_TrajEnd_b_Rv
{
    qword rawValue = 0ll;
    float rawValue_float = 0.0;
    float phyValue = 0.0;        

    //set the signal with updated raw value
    if(getValue(E_pric_RadarFrontCenter_TrajPointACCObj10_TrajPointACCObj10_TrajEnd_b_SetVt)==0)
    {
        rawValue = getvalue(this);
        if(chgEv_TrajPointACCObj10_TrajPointACCObj10_TrajEnd_b == 0)
        {
            //type conversion to float
            rawValue_float = rawValue;        
            // raw to physical conversion
            phyValue = ((rawValue_float *1)+(0));
            putValue(E_pric_RadarFrontCenter_TrajPointACCObj10_TrajPointACCObj10_TrajEnd_b_Pv, phyValue);
            chgEv_TrajPointACCObj10_TrajPointACCObj10_TrajEnd_b = 1;
        }
        else
        {
            chgEv_TrajPointACCObj10_TrajPointACCObj10_TrajEnd_b = 0;
        }    
        //update the signal value
        Msg_TrajPointACCObj10.TrajPointACCObj10_TrajEnd_b=rawValue;        
    }                                                                           
}

on envVar E_pric_RadarFrontCenter_TrajPointACCObj10_TrajPointACCObj10_TrajEnd_b_Pv
{
    qword rawValue = 0ll;
    float phyValue = 0.0;
    
    //update the raw value with physical value 
    if(getValue(E_pric_RadarFrontCenter_TrajPointACCObj10_TrajPointACCObj10_TrajEnd_b_SetVt)==0)
    {
        if(chgEv_TrajPointACCObj10_TrajPointACCObj10_TrajEnd_b == 0)
        {
            phyValue = getvalue(this);
            // physical to raw conversion
            rawValue = ((phyValue -(0))/1);
            putValue(E_pric_RadarFrontCenter_TrajPointACCObj10_TrajPointACCObj10_TrajEnd_b_Rv, rawValue);
            chgEv_TrajPointACCObj10_TrajPointACCObj10_TrajEnd_b = 1;  
        }
        else
        {
            chgEv_TrajPointACCObj10_TrajPointACCObj10_TrajEnd_b = 0;
        }
    }
}

on envVar E_pric_RadarFrontCenter_TrajPointACCObj10_TrajPointACCObj10_TrajEnd_b_Vt
{
    qword rawValue = 0ll;
    if(getValue(E_pric_RadarFrontCenter_TrajPointACCObj10_TrajPointACCObj10_TrajEnd_b_SetVt))
    {
        //update the signal value
        Msg_TrajPointACCObj10.TrajPointACCObj10_TrajEnd_b=getValue(this);
    }
}

on envVar E_pric_RadarFrontCenter_TrajPointACCObj10_TrajPointACCObj10_TrajEnd_b_SetVt
{
    if(getValue(E_pric_RadarFrontCenter_TrajPointACCObj10_TrajPointACCObj10_TrajEnd_b_SetVt))
    {
        //update the signal value
        Msg_TrajPointACCObj10.TrajPointACCObj10_TrajEnd_b=getvalue(E_pric_RadarFrontCenter_TrajPointACCObj10_TrajPointACCObj10_TrajEnd_b_Vt);
    }
    else
    {
        Msg_TrajPointACCObj10.TrajPointACCObj10_TrajEnd_b=getValue(E_pric_RadarFrontCenter_TrajPointACCObj10_TrajPointACCObj10_TrajEnd_b_Rv);
    }
}
 
on envVar E_pric_RadarFrontCenter_TrajPointACCObj10_TrajPointACCObj10_dVarXv_uw_Rv
{
    qword rawValue = 0ll;
    float rawValue_float = 0.0;
    float phyValue = 0.0;        

    //set the signal with updated raw value
    {
        rawValue = getvalue(this);
        if(chgEv_TrajPointACCObj10_TrajPointACCObj10_dVarXv_uw == 0)
        {
            //type conversion to float
            rawValue_float = rawValue;        
            // raw to physical conversion
            phyValue = ((rawValue_float *0.00195313)+(0));
            putValue(E_pric_RadarFrontCenter_TrajPointACCObj10_TrajPointACCObj10_dVarXv_uw_Pv, phyValue);
            chgEv_TrajPointACCObj10_TrajPointACCObj10_dVarXv_uw = 1;
        }
        else
        {
            chgEv_TrajPointACCObj10_TrajPointACCObj10_dVarXv_uw = 0;
        }    
        //update the signal value
        Msg_TrajPointACCObj10.TrajPointACCObj10_dVarXv_uw=rawValue;        
    }                                                                           
}

on envVar E_pric_RadarFrontCenter_TrajPointACCObj10_TrajPointACCObj10_dVarXv_uw_Pv
{
    qword rawValue = 0ll;
    float phyValue = 0.0;
    
    //update the raw value with physical value 
    {
        if(chgEv_TrajPointACCObj10_TrajPointACCObj10_dVarXv_uw == 0)
        {
            phyValue = getvalue(this);
            // physical to raw conversion
            rawValue = ((phyValue -(0))/0.00195313);
            putValue(E_pric_RadarFrontCenter_TrajPointACCObj10_TrajPointACCObj10_dVarXv_uw_Rv, rawValue);
            chgEv_TrajPointACCObj10_TrajPointACCObj10_dVarXv_uw = 1;  
        }
        else
        {
            chgEv_TrajPointACCObj10_TrajPointACCObj10_dVarXv_uw = 0;
        }
    }
}


 
on envVar E_pric_RadarFrontCenter_TrajPointACCObj10_TrajPointACCObj10_dVarYv_uw_Rv
{
    qword rawValue = 0ll;
    float rawValue_float = 0.0;
    float phyValue = 0.0;        

    //set the signal with updated raw value
    {
        rawValue = getvalue(this);
        if(chgEv_TrajPointACCObj10_TrajPointACCObj10_dVarYv_uw == 0)
        {
            //type conversion to float
            rawValue_float = rawValue;        
            // raw to physical conversion
            phyValue = ((rawValue_float *0.00195313)+(0));
            putValue(E_pric_RadarFrontCenter_TrajPointACCObj10_TrajPointACCObj10_dVarYv_uw_Pv, phyValue);
            chgEv_TrajPointACCObj10_TrajPointACCObj10_dVarYv_uw = 1;
        }
        else
        {
            chgEv_TrajPointACCObj10_TrajPointACCObj10_dVarYv_uw = 0;
        }    
        //update the signal value
        Msg_TrajPointACCObj10.TrajPointACCObj10_dVarYv_uw=rawValue;        
    }                                                                           
}

on envVar E_pric_RadarFrontCenter_TrajPointACCObj10_TrajPointACCObj10_dVarYv_uw_Pv
{
    qword rawValue = 0ll;
    float phyValue = 0.0;
    
    //update the raw value with physical value 
    {
        if(chgEv_TrajPointACCObj10_TrajPointACCObj10_dVarYv_uw == 0)
        {
            phyValue = getvalue(this);
            // physical to raw conversion
            rawValue = ((phyValue -(0))/0.00195313);
            putValue(E_pric_RadarFrontCenter_TrajPointACCObj10_TrajPointACCObj10_dVarYv_uw_Rv, rawValue);
            chgEv_TrajPointACCObj10_TrajPointACCObj10_dVarYv_uw = 1;  
        }
        else
        {
            chgEv_TrajPointACCObj10_TrajPointACCObj10_dVarYv_uw = 0;
        }
    }
}


 
on envVar E_pric_RadarFrontCenter_TrajPointACCObj10_TrajPointACCObj10_dxv_sw_Rv
{
    qword rawValue = 0ll;
    float rawValue_float = 0.0;
    float phyValue = 0.0;        

    //set the signal with updated raw value
    {
        rawValue = getvalue(this);
        if(chgEv_TrajPointACCObj10_TrajPointACCObj10_dxv_sw == 0)
        {
            //type conversion to float
            rawValue_float = rawValue;        
            // raw to physical conversion
            phyValue = ((rawValue_float *0.0078125)+(0));
            putValue(E_pric_RadarFrontCenter_TrajPointACCObj10_TrajPointACCObj10_dxv_sw_Pv, phyValue);
            chgEv_TrajPointACCObj10_TrajPointACCObj10_dxv_sw = 1;
        }
        else
        {
            chgEv_TrajPointACCObj10_TrajPointACCObj10_dxv_sw = 0;
        }    
        //update the signal value
        Msg_TrajPointACCObj10.TrajPointACCObj10_dxv_sw=rawValue;        
    }                                                                           
}

on envVar E_pric_RadarFrontCenter_TrajPointACCObj10_TrajPointACCObj10_dxv_sw_Pv
{
    qword rawValue = 0ll;
    float phyValue = 0.0;
    
    //update the raw value with physical value 
    {
        if(chgEv_TrajPointACCObj10_TrajPointACCObj10_dxv_sw == 0)
        {
            phyValue = getvalue(this);
            // physical to raw conversion
            rawValue = ((phyValue -(0))/0.0078125);
            putValue(E_pric_RadarFrontCenter_TrajPointACCObj10_TrajPointACCObj10_dxv_sw_Rv, rawValue);
            chgEv_TrajPointACCObj10_TrajPointACCObj10_dxv_sw = 1;  
        }
        else
        {
            chgEv_TrajPointACCObj10_TrajPointACCObj10_dxv_sw = 0;
        }
    }
}


 
on envVar E_pric_RadarFrontCenter_TrajPointACCObj10_TrajPointACCObj10_Valid_b_Rv
{
    qword rawValue = 0ll;
    float rawValue_float = 0.0;
    float phyValue = 0.0;        

    //set the signal with updated raw value
    if(getValue(E_pric_RadarFrontCenter_TrajPointACCObj10_TrajPointACCObj10_Valid_b_SetVt)==0)
    {
        rawValue = getvalue(this);
        if(chgEv_TrajPointACCObj10_TrajPointACCObj10_Valid_b == 0)
        {
            //type conversion to float
            rawValue_float = rawValue;        
            // raw to physical conversion
            phyValue = ((rawValue_float *1)+(0));
            putValue(E_pric_RadarFrontCenter_TrajPointACCObj10_TrajPointACCObj10_Valid_b_Pv, phyValue);
            chgEv_TrajPointACCObj10_TrajPointACCObj10_Valid_b = 1;
        }
        else
        {
            chgEv_TrajPointACCObj10_TrajPointACCObj10_Valid_b = 0;
        }    
        //update the signal value
        Msg_TrajPointACCObj10.TrajPointACCObj10_Valid_b=rawValue;        
    }                                                                           
}

on envVar E_pric_RadarFrontCenter_TrajPointACCObj10_TrajPointACCObj10_Valid_b_Pv
{
    qword rawValue = 0ll;
    float phyValue = 0.0;
    
    //update the raw value with physical value 
    if(getValue(E_pric_RadarFrontCenter_TrajPointACCObj10_TrajPointACCObj10_Valid_b_SetVt)==0)
    {
        if(chgEv_TrajPointACCObj10_TrajPointACCObj10_Valid_b == 0)
        {
            phyValue = getvalue(this);
            // physical to raw conversion
            rawValue = ((phyValue -(0))/1);
            putValue(E_pric_RadarFrontCenter_TrajPointACCObj10_TrajPointACCObj10_Valid_b_Rv, rawValue);
            chgEv_TrajPointACCObj10_TrajPointACCObj10_Valid_b = 1;  
        }
        else
        {
            chgEv_TrajPointACCObj10_TrajPointACCObj10_Valid_b = 0;
        }
    }
}

on envVar E_pric_RadarFrontCenter_TrajPointACCObj10_TrajPointACCObj10_Valid_b_Vt
{
    qword rawValue = 0ll;
    if(getValue(E_pric_RadarFrontCenter_TrajPointACCObj10_TrajPointACCObj10_Valid_b_SetVt))
    {
        //update the signal value
        Msg_TrajPointACCObj10.TrajPointACCObj10_Valid_b=getValue(this);
    }
}

on envVar E_pric_RadarFrontCenter_TrajPointACCObj10_TrajPointACCObj10_Valid_b_SetVt
{
    if(getValue(E_pric_RadarFrontCenter_TrajPointACCObj10_TrajPointACCObj10_Valid_b_SetVt))
    {
        //update the signal value
        Msg_TrajPointACCObj10.TrajPointACCObj10_Valid_b=getvalue(E_pric_RadarFrontCenter_TrajPointACCObj10_TrajPointACCObj10_Valid_b_Vt);
    }
    else
    {
        Msg_TrajPointACCObj10.TrajPointACCObj10_Valid_b=getValue(E_pric_RadarFrontCenter_TrajPointACCObj10_TrajPointACCObj10_Valid_b_Rv);
    }
}
 
on envVar E_pric_RadarFrontCenter_TrajPointACCObj10_TrajPointACCObj10_InvDir_b_Rv
{
    qword rawValue = 0ll;
    float rawValue_float = 0.0;
    float phyValue = 0.0;        

    //set the signal with updated raw value
    if(getValue(E_pric_RadarFrontCenter_TrajPointACCObj10_TrajPointACCObj10_InvDir_b_SetVt)==0)
    {
        rawValue = getvalue(this);
        if(chgEv_TrajPointACCObj10_TrajPointACCObj10_InvDir_b == 0)
        {
            //type conversion to float
            rawValue_float = rawValue;        
            // raw to physical conversion
            phyValue = ((rawValue_float *1)+(0));
            putValue(E_pric_RadarFrontCenter_TrajPointACCObj10_TrajPointACCObj10_InvDir_b_Pv, phyValue);
            chgEv_TrajPointACCObj10_TrajPointACCObj10_InvDir_b = 1;
        }
        else
        {
            chgEv_TrajPointACCObj10_TrajPointACCObj10_InvDir_b = 0;
        }    
        //update the signal value
        Msg_TrajPointACCObj10.TrajPointACCObj10_InvDir_b=rawValue;        
    }                                                                           
}

on envVar E_pric_RadarFrontCenter_TrajPointACCObj10_TrajPointACCObj10_InvDir_b_Pv
{
    qword rawValue = 0ll;
    float phyValue = 0.0;
    
    //update the raw value with physical value 
    if(getValue(E_pric_RadarFrontCenter_TrajPointACCObj10_TrajPointACCObj10_InvDir_b_SetVt)==0)
    {
        if(chgEv_TrajPointACCObj10_TrajPointACCObj10_InvDir_b == 0)
        {
            phyValue = getvalue(this);
            // physical to raw conversion
            rawValue = ((phyValue -(0))/1);
            putValue(E_pric_RadarFrontCenter_TrajPointACCObj10_TrajPointACCObj10_InvDir_b_Rv, rawValue);
            chgEv_TrajPointACCObj10_TrajPointACCObj10_InvDir_b = 1;  
        }
        else
        {
            chgEv_TrajPointACCObj10_TrajPointACCObj10_InvDir_b = 0;
        }
    }
}

on envVar E_pric_RadarFrontCenter_TrajPointACCObj10_TrajPointACCObj10_InvDir_b_Vt
{
    qword rawValue = 0ll;
    if(getValue(E_pric_RadarFrontCenter_TrajPointACCObj10_TrajPointACCObj10_InvDir_b_SetVt))
    {
        //update the signal value
        Msg_TrajPointACCObj10.TrajPointACCObj10_InvDir_b=getValue(this);
    }
}

on envVar E_pric_RadarFrontCenter_TrajPointACCObj10_TrajPointACCObj10_InvDir_b_SetVt
{
    if(getValue(E_pric_RadarFrontCenter_TrajPointACCObj10_TrajPointACCObj10_InvDir_b_SetVt))
    {
        //update the signal value
        Msg_TrajPointACCObj10.TrajPointACCObj10_InvDir_b=getvalue(E_pric_RadarFrontCenter_TrajPointACCObj10_TrajPointACCObj10_InvDir_b_Vt);
    }
    else
    {
        Msg_TrajPointACCObj10.TrajPointACCObj10_InvDir_b=getValue(E_pric_RadarFrontCenter_TrajPointACCObj10_TrajPointACCObj10_InvDir_b_Rv);
    }
}
 
on envVar E_pric_RadarFrontCenter_TrajPointACCObj17_tx
{
    if(getValue(this))
    {       
        
        //update the BZ Signal
        if(TrajPointACCObj17_TrajPointACCObj17_MsgCtr_wrongvalctr == 0)
        {
            update_TrajPointACCObj17_TrajPointACCObj17_MsgCtr_counter();
            Msg_TrajPointACCObj17.TrajPointACCObj17_MsgCtr= TrajPointACCObj17_TrajPointACCObj17_MsgCtr_counter;
        }
        else if(TrajPointACCObj17_TrajPointACCObj17_MsgCtr_wrongvalctr > 0)
        {
             TrajPointACCObj17_TrajPointACCObj17_MsgCtr_wrongvalctr--;
              // if counter becomes zero, update panel controller to zero
             if(TrajPointACCObj17_TrajPointACCObj17_MsgCtr_wrongvalctr == 0)
             {
                 putValue(E_pric_RadarFrontCenter_TrajPointACCObj17_TrajPointACCObj17_MsgCtr_wrongvalctr,0);
             }
        }
        else
        {
            //do nothing
        }        
        //update the BZ Signal
        if(TrajPointACCObj17_TrajPointACCObj17_blockCtr_wrongvalctr == 0)
        {
            update_TrajPointACCObj17_TrajPointACCObj17_blockCtr_counter();
            Msg_TrajPointACCObj17.TrajPointACCObj17_blockCtr= TrajPointACCObj17_TrajPointACCObj17_blockCtr_counter;
        }
        else if(TrajPointACCObj17_TrajPointACCObj17_blockCtr_wrongvalctr > 0)
        {
             TrajPointACCObj17_TrajPointACCObj17_blockCtr_wrongvalctr--;
              // if counter becomes zero, update panel controller to zero
             if(TrajPointACCObj17_TrajPointACCObj17_blockCtr_wrongvalctr == 0)
             {
                 putValue(E_pric_RadarFrontCenter_TrajPointACCObj17_TrajPointACCObj17_blockCtr_wrongvalctr,0);
             }
        }
        else
        {
            //do nothing
        }        
        //calculate the CRC checksum
        update_TrajPointACCObj17_ChkSum_Checksum();

        output(Msg_TrajPointACCObj17);        
    }
}

on envVar E_pric_RadarFrontCenter_TrajPointACCObj17_Range
{
    qword rawstatus = 0ll;
    qword rawValue = 0ll;    
    
    rawstatus = getvalue(this);    
    // set all the signals with min raw /max raw /init raw
    switch (rawstatus) 
    {
     case(0) :
        rawValue= 0;
        putValue(E_pric_RadarFrontCenter_TrajPointACCObj17_TrajPointACCObj17_Valid_b_Rv, rawValue);
        rawValue= 0;
        putValue(E_pric_RadarFrontCenter_TrajPointACCObj17_TrajPointACCObj17_Drive_b_Rv, rawValue);
        rawValue= 0;
        putValue(E_pric_RadarFrontCenter_TrajPointACCObj17_TrajPointACCObj17_dVarYv_uw_Rv, rawValue);
        rawValue= 0;
        putValue(E_pric_RadarFrontCenter_TrajPointACCObj17_TrajPointACCObj17_InvDir_b_Rv, rawValue);
        rawValue= 0;
        putValue(E_pric_RadarFrontCenter_TrajPointACCObj17_TrajPointACCObj17_wExistProb_ub_Rv, rawValue);
        rawValue= -32768;
        putValue(E_pric_RadarFrontCenter_TrajPointACCObj17_TrajPointACCObj17_dyv_sw_Rv, rawValue);
        rawValue= 0;
        putValue(E_pric_RadarFrontCenter_TrajPointACCObj17_TrajPointACCObj17_timestamp_Rv, rawValue);
        rawValue= 0;
        putValue(E_pric_RadarFrontCenter_TrajPointACCObj17_TrajPointACCObj17_Stopped_b_Rv, rawValue);
        rawValue= -32768;
        putValue(E_pric_RadarFrontCenter_TrajPointACCObj17_TrajPointACCObj17_dxv_sw_Rv, rawValue);
        rawValue= 0;
        putValue(E_pric_RadarFrontCenter_TrajPointACCObj17_TrajPointACCObj17_dVarXv_uw_Rv, rawValue);
        rawValue= 0;
        putValue(E_pric_RadarFrontCenter_TrajPointACCObj17_TrajPointACCObj17_TrajEnd_b_Rv, rawValue);
        rawValue= 0;
        putValue(E_pric_RadarFrontCenter_TrajPointACCObj17_TrajPointACCObj17_Stand_b_Rv, rawValue);
        break;
     case(1) :
        rawValue= 1;
        putValue(E_pric_RadarFrontCenter_TrajPointACCObj17_TrajPointACCObj17_Valid_b_Rv, rawValue);
        rawValue= 1;
        putValue(E_pric_RadarFrontCenter_TrajPointACCObj17_TrajPointACCObj17_Drive_b_Rv, rawValue);
        rawValue= 65534;
        putValue(E_pric_RadarFrontCenter_TrajPointACCObj17_TrajPointACCObj17_dVarYv_uw_Rv, rawValue);
        rawValue= 1;
        putValue(E_pric_RadarFrontCenter_TrajPointACCObj17_TrajPointACCObj17_InvDir_b_Rv, rawValue);
        rawValue= 255;
        putValue(E_pric_RadarFrontCenter_TrajPointACCObj17_TrajPointACCObj17_wExistProb_ub_Rv, rawValue);
        rawValue= 32767;
        putValue(E_pric_RadarFrontCenter_TrajPointACCObj17_TrajPointACCObj17_dyv_sw_Rv, rawValue);
        rawValue= 65536;
        putValue(E_pric_RadarFrontCenter_TrajPointACCObj17_TrajPointACCObj17_timestamp_Rv, rawValue);
        rawValue= 1;
        putValue(E_pric_RadarFrontCenter_TrajPointACCObj17_TrajPointACCObj17_Stopped_b_Rv, rawValue);
        rawValue= 32767;
        putValue(E_pric_RadarFrontCenter_TrajPointACCObj17_TrajPointACCObj17_dxv_sw_Rv, rawValue);
        rawValue= 65534;
        putValue(E_pric_RadarFrontCenter_TrajPointACCObj17_TrajPointACCObj17_dVarXv_uw_Rv, rawValue);
        rawValue= 1;
        putValue(E_pric_RadarFrontCenter_TrajPointACCObj17_TrajPointACCObj17_TrajEnd_b_Rv, rawValue);
        rawValue= 1;
        putValue(E_pric_RadarFrontCenter_TrajPointACCObj17_TrajPointACCObj17_Stand_b_Rv, rawValue);
        break;
     default :
        rawValue= 0;
        putValue(E_pric_RadarFrontCenter_TrajPointACCObj17_TrajPointACCObj17_Valid_b_Rv, rawValue);
        rawValue= 0;
        putValue(E_pric_RadarFrontCenter_TrajPointACCObj17_TrajPointACCObj17_Drive_b_Rv, rawValue);
        rawValue= 0;
        putValue(E_pric_RadarFrontCenter_TrajPointACCObj17_TrajPointACCObj17_dVarYv_uw_Rv, rawValue);
        rawValue= 0;
        putValue(E_pric_RadarFrontCenter_TrajPointACCObj17_TrajPointACCObj17_InvDir_b_Rv, rawValue);
        rawValue= 0;
        putValue(E_pric_RadarFrontCenter_TrajPointACCObj17_TrajPointACCObj17_wExistProb_ub_Rv, rawValue);
        rawValue= -32768;
        putValue(E_pric_RadarFrontCenter_TrajPointACCObj17_TrajPointACCObj17_dyv_sw_Rv, rawValue);
        rawValue= 0;
        putValue(E_pric_RadarFrontCenter_TrajPointACCObj17_TrajPointACCObj17_timestamp_Rv, rawValue);
        rawValue= 0;
        putValue(E_pric_RadarFrontCenter_TrajPointACCObj17_TrajPointACCObj17_Stopped_b_Rv, rawValue);
        rawValue= -32768;
        putValue(E_pric_RadarFrontCenter_TrajPointACCObj17_TrajPointACCObj17_dxv_sw_Rv, rawValue);
        rawValue= 0;
        putValue(E_pric_RadarFrontCenter_TrajPointACCObj17_TrajPointACCObj17_dVarXv_uw_Rv, rawValue);
        rawValue= 0;
        putValue(E_pric_RadarFrontCenter_TrajPointACCObj17_TrajPointACCObj17_TrajEnd_b_Rv, rawValue);
        rawValue= 0;
        putValue(E_pric_RadarFrontCenter_TrajPointACCObj17_TrajPointACCObj17_Stand_b_Rv, rawValue);
      break;
   }
}

on envVar E_pric_RadarFrontCenter_TrajPointACCObj17_Dlc
{
    if(getValue(E_pric_RadarFrontCenter_TrajPointACCObj17_enDlc))
    {
        Msg_TrajPointACCObj17.dlc =getValue(this);
    }
    else
    {
       Dbc_dlc = 16;
	   Msg_TrajPointACCObj17.dlc = Calc_Canfd_dlc(Dbc_dlc);
	   	
  }
}

on envVar E_pric_RadarFrontCenter_TrajPointACCObj17_enDlc
{
    //For Messages with DLC = 8, set wrong DLC to smaller than defined DLC
    //For Messages with DLC < 8 set wrong DLC to smaller/longer than defined DLC
    if(getValue(this))
    {
        Msg_TrajPointACCObj17.dlc =getValue(E_pric_RadarFrontCenter_TrajPointACCObj17_Dlc);
    }
    else
    {
       Dbc_dlc = 16;
	   Msg_TrajPointACCObj17.dlc = Calc_Canfd_dlc(Dbc_dlc);
			
    }
}

on envVar E_pric_RadarFrontCenter_TrajPointACCObj17_TrajPointACCObj17_CRC_wrongvalctr
{
    //update disturb count
    //disturb value range:(-1 = always send wrong value),( X>0 ,x is the number of Messages with wrong CHK sent)
    TrajPointACCObj17_TrajPointACCObj17_CRC_wrongvalctr =getValue(this);    
}
on envVar E_pric_RadarFrontCenter_TrajPointACCObj17_TrajPointACCObj17_MsgCtr_wrongvalctr
{
    //update disturb count
    //disturb value range:(-1 = always send wrong value),( X>0 ,x is the number of Messages with wrong CHK sent)
    TrajPointACCObj17_TrajPointACCObj17_MsgCtr_wrongvalctr =getValue(this);    
}
on envVar E_pric_RadarFrontCenter_TrajPointACCObj17_TrajPointACCObj17_blockCtr_wrongvalctr
{
    //update disturb count
    //disturb value range:(-1 = always send wrong value),( X>0 ,x is the number of Messages with wrong CHK sent)
    TrajPointACCObj17_TrajPointACCObj17_blockCtr_wrongvalctr =getValue(this);    
}

on envVar E_pric_RadarFrontCenter_TrajPointACCObj17_TrajPointACCObj17_Valid_b_Rv
{
    qword rawValue = 0ll;
    float rawValue_float = 0.0;
    float phyValue = 0.0;        

    //set the signal with updated raw value
    if(getValue(E_pric_RadarFrontCenter_TrajPointACCObj17_TrajPointACCObj17_Valid_b_SetVt)==0)
    {
        rawValue = getvalue(this);
        if(chgEv_TrajPointACCObj17_TrajPointACCObj17_Valid_b == 0)
        {
            //type conversion to float
            rawValue_float = rawValue;        
            // raw to physical conversion
            phyValue = ((rawValue_float *1)+(0));
            putValue(E_pric_RadarFrontCenter_TrajPointACCObj17_TrajPointACCObj17_Valid_b_Pv, phyValue);
            chgEv_TrajPointACCObj17_TrajPointACCObj17_Valid_b = 1;
        }
        else
        {
            chgEv_TrajPointACCObj17_TrajPointACCObj17_Valid_b = 0;
        }    
        //update the signal value
        Msg_TrajPointACCObj17.TrajPointACCObj17_Valid_b=rawValue;        
    }                                                                           
}

on envVar E_pric_RadarFrontCenter_TrajPointACCObj17_TrajPointACCObj17_Valid_b_Pv
{
    qword rawValue = 0ll;
    float phyValue = 0.0;
    
    //update the raw value with physical value 
    if(getValue(E_pric_RadarFrontCenter_TrajPointACCObj17_TrajPointACCObj17_Valid_b_SetVt)==0)
    {
        if(chgEv_TrajPointACCObj17_TrajPointACCObj17_Valid_b == 0)
        {
            phyValue = getvalue(this);
            // physical to raw conversion
            rawValue = ((phyValue -(0))/1);
            putValue(E_pric_RadarFrontCenter_TrajPointACCObj17_TrajPointACCObj17_Valid_b_Rv, rawValue);
            chgEv_TrajPointACCObj17_TrajPointACCObj17_Valid_b = 1;  
        }
        else
        {
            chgEv_TrajPointACCObj17_TrajPointACCObj17_Valid_b = 0;
        }
    }
}

on envVar E_pric_RadarFrontCenter_TrajPointACCObj17_TrajPointACCObj17_Valid_b_Vt
{
    qword rawValue = 0ll;
    if(getValue(E_pric_RadarFrontCenter_TrajPointACCObj17_TrajPointACCObj17_Valid_b_SetVt))
    {
        //update the signal value
        Msg_TrajPointACCObj17.TrajPointACCObj17_Valid_b=getValue(this);
    }
}

on envVar E_pric_RadarFrontCenter_TrajPointACCObj17_TrajPointACCObj17_Valid_b_SetVt
{
    if(getValue(E_pric_RadarFrontCenter_TrajPointACCObj17_TrajPointACCObj17_Valid_b_SetVt))
    {
        //update the signal value
        Msg_TrajPointACCObj17.TrajPointACCObj17_Valid_b=getvalue(E_pric_RadarFrontCenter_TrajPointACCObj17_TrajPointACCObj17_Valid_b_Vt);
    }
    else
    {
        Msg_TrajPointACCObj17.TrajPointACCObj17_Valid_b=getValue(E_pric_RadarFrontCenter_TrajPointACCObj17_TrajPointACCObj17_Valid_b_Rv);
    }
}
 
on envVar E_pric_RadarFrontCenter_TrajPointACCObj17_TrajPointACCObj17_Drive_b_Rv
{
    qword rawValue = 0ll;
    float rawValue_float = 0.0;
    float phyValue = 0.0;        

    //set the signal with updated raw value
    if(getValue(E_pric_RadarFrontCenter_TrajPointACCObj17_TrajPointACCObj17_Drive_b_SetVt)==0)
    {
        rawValue = getvalue(this);
        if(chgEv_TrajPointACCObj17_TrajPointACCObj17_Drive_b == 0)
        {
            //type conversion to float
            rawValue_float = rawValue;        
            // raw to physical conversion
            phyValue = ((rawValue_float *1)+(0));
            putValue(E_pric_RadarFrontCenter_TrajPointACCObj17_TrajPointACCObj17_Drive_b_Pv, phyValue);
            chgEv_TrajPointACCObj17_TrajPointACCObj17_Drive_b = 1;
        }
        else
        {
            chgEv_TrajPointACCObj17_TrajPointACCObj17_Drive_b = 0;
        }    
        //update the signal value
        Msg_TrajPointACCObj17.TrajPointACCObj17_Drive_b=rawValue;        
    }                                                                           
}

on envVar E_pric_RadarFrontCenter_TrajPointACCObj17_TrajPointACCObj17_Drive_b_Pv
{
    qword rawValue = 0ll;
    float phyValue = 0.0;
    
    //update the raw value with physical value 
    if(getValue(E_pric_RadarFrontCenter_TrajPointACCObj17_TrajPointACCObj17_Drive_b_SetVt)==0)
    {
        if(chgEv_TrajPointACCObj17_TrajPointACCObj17_Drive_b == 0)
        {
            phyValue = getvalue(this);
            // physical to raw conversion
            rawValue = ((phyValue -(0))/1);
            putValue(E_pric_RadarFrontCenter_TrajPointACCObj17_TrajPointACCObj17_Drive_b_Rv, rawValue);
            chgEv_TrajPointACCObj17_TrajPointACCObj17_Drive_b = 1;  
        }
        else
        {
            chgEv_TrajPointACCObj17_TrajPointACCObj17_Drive_b = 0;
        }
    }
}

on envVar E_pric_RadarFrontCenter_TrajPointACCObj17_TrajPointACCObj17_Drive_b_Vt
{
    qword rawValue = 0ll;
    if(getValue(E_pric_RadarFrontCenter_TrajPointACCObj17_TrajPointACCObj17_Drive_b_SetVt))
    {
        //update the signal value
        Msg_TrajPointACCObj17.TrajPointACCObj17_Drive_b=getValue(this);
    }
}

on envVar E_pric_RadarFrontCenter_TrajPointACCObj17_TrajPointACCObj17_Drive_b_SetVt
{
    if(getValue(E_pric_RadarFrontCenter_TrajPointACCObj17_TrajPointACCObj17_Drive_b_SetVt))
    {
        //update the signal value
        Msg_TrajPointACCObj17.TrajPointACCObj17_Drive_b=getvalue(E_pric_RadarFrontCenter_TrajPointACCObj17_TrajPointACCObj17_Drive_b_Vt);
    }
    else
    {
        Msg_TrajPointACCObj17.TrajPointACCObj17_Drive_b=getValue(E_pric_RadarFrontCenter_TrajPointACCObj17_TrajPointACCObj17_Drive_b_Rv);
    }
}
 
on envVar E_pric_RadarFrontCenter_TrajPointACCObj17_TrajPointACCObj17_dVarYv_uw_Rv
{
    qword rawValue = 0ll;
    float rawValue_float = 0.0;
    float phyValue = 0.0;        

    //set the signal with updated raw value
    {
        rawValue = getvalue(this);
        if(chgEv_TrajPointACCObj17_TrajPointACCObj17_dVarYv_uw == 0)
        {
            //type conversion to float
            rawValue_float = rawValue;        
            // raw to physical conversion
            phyValue = ((rawValue_float *0.00195313)+(0));
            putValue(E_pric_RadarFrontCenter_TrajPointACCObj17_TrajPointACCObj17_dVarYv_uw_Pv, phyValue);
            chgEv_TrajPointACCObj17_TrajPointACCObj17_dVarYv_uw = 1;
        }
        else
        {
            chgEv_TrajPointACCObj17_TrajPointACCObj17_dVarYv_uw = 0;
        }    
        //update the signal value
        Msg_TrajPointACCObj17.TrajPointACCObj17_dVarYv_uw=rawValue;        
    }                                                                           
}

on envVar E_pric_RadarFrontCenter_TrajPointACCObj17_TrajPointACCObj17_dVarYv_uw_Pv
{
    qword rawValue = 0ll;
    float phyValue = 0.0;
    
    //update the raw value with physical value 
    {
        if(chgEv_TrajPointACCObj17_TrajPointACCObj17_dVarYv_uw == 0)
        {
            phyValue = getvalue(this);
            // physical to raw conversion
            rawValue = ((phyValue -(0))/0.00195313);
            putValue(E_pric_RadarFrontCenter_TrajPointACCObj17_TrajPointACCObj17_dVarYv_uw_Rv, rawValue);
            chgEv_TrajPointACCObj17_TrajPointACCObj17_dVarYv_uw = 1;  
        }
        else
        {
            chgEv_TrajPointACCObj17_TrajPointACCObj17_dVarYv_uw = 0;
        }
    }
}


 
on envVar E_pric_RadarFrontCenter_TrajPointACCObj17_TrajPointACCObj17_InvDir_b_Rv
{
    qword rawValue = 0ll;
    float rawValue_float = 0.0;
    float phyValue = 0.0;        

    //set the signal with updated raw value
    if(getValue(E_pric_RadarFrontCenter_TrajPointACCObj17_TrajPointACCObj17_InvDir_b_SetVt)==0)
    {
        rawValue = getvalue(this);
        if(chgEv_TrajPointACCObj17_TrajPointACCObj17_InvDir_b == 0)
        {
            //type conversion to float
            rawValue_float = rawValue;        
            // raw to physical conversion
            phyValue = ((rawValue_float *1)+(0));
            putValue(E_pric_RadarFrontCenter_TrajPointACCObj17_TrajPointACCObj17_InvDir_b_Pv, phyValue);
            chgEv_TrajPointACCObj17_TrajPointACCObj17_InvDir_b = 1;
        }
        else
        {
            chgEv_TrajPointACCObj17_TrajPointACCObj17_InvDir_b = 0;
        }    
        //update the signal value
        Msg_TrajPointACCObj17.TrajPointACCObj17_InvDir_b=rawValue;        
    }                                                                           
}

on envVar E_pric_RadarFrontCenter_TrajPointACCObj17_TrajPointACCObj17_InvDir_b_Pv
{
    qword rawValue = 0ll;
    float phyValue = 0.0;
    
    //update the raw value with physical value 
    if(getValue(E_pric_RadarFrontCenter_TrajPointACCObj17_TrajPointACCObj17_InvDir_b_SetVt)==0)
    {
        if(chgEv_TrajPointACCObj17_TrajPointACCObj17_InvDir_b == 0)
        {
            phyValue = getvalue(this);
            // physical to raw conversion
            rawValue = ((phyValue -(0))/1);
            putValue(E_pric_RadarFrontCenter_TrajPointACCObj17_TrajPointACCObj17_InvDir_b_Rv, rawValue);
            chgEv_TrajPointACCObj17_TrajPointACCObj17_InvDir_b = 1;  
        }
        else
        {
            chgEv_TrajPointACCObj17_TrajPointACCObj17_InvDir_b = 0;
        }
    }
}

on envVar E_pric_RadarFrontCenter_TrajPointACCObj17_TrajPointACCObj17_InvDir_b_Vt
{
    qword rawValue = 0ll;
    if(getValue(E_pric_RadarFrontCenter_TrajPointACCObj17_TrajPointACCObj17_InvDir_b_SetVt))
    {
        //update the signal value
        Msg_TrajPointACCObj17.TrajPointACCObj17_InvDir_b=getValue(this);
    }
}

on envVar E_pric_RadarFrontCenter_TrajPointACCObj17_TrajPointACCObj17_InvDir_b_SetVt
{
    if(getValue(E_pric_RadarFrontCenter_TrajPointACCObj17_TrajPointACCObj17_InvDir_b_SetVt))
    {
        //update the signal value
        Msg_TrajPointACCObj17.TrajPointACCObj17_InvDir_b=getvalue(E_pric_RadarFrontCenter_TrajPointACCObj17_TrajPointACCObj17_InvDir_b_Vt);
    }
    else
    {
        Msg_TrajPointACCObj17.TrajPointACCObj17_InvDir_b=getValue(E_pric_RadarFrontCenter_TrajPointACCObj17_TrajPointACCObj17_InvDir_b_Rv);
    }
}
 
on envVar E_pric_RadarFrontCenter_TrajPointACCObj17_TrajPointACCObj17_wExistProb_ub_Rv
{
    qword rawValue = 0ll;
    float rawValue_float = 0.0;
    float phyValue = 0.0;        

    //set the signal with updated raw value
    {
        rawValue = getvalue(this);
        if(chgEv_TrajPointACCObj17_TrajPointACCObj17_wExistProb_ub == 0)
        {
            //type conversion to float
            rawValue_float = rawValue;        
            // raw to physical conversion
            phyValue = ((rawValue_float *0.00390625)+(0));
            putValue(E_pric_RadarFrontCenter_TrajPointACCObj17_TrajPointACCObj17_wExistProb_ub_Pv, phyValue);
            chgEv_TrajPointACCObj17_TrajPointACCObj17_wExistProb_ub = 1;
        }
        else
        {
            chgEv_TrajPointACCObj17_TrajPointACCObj17_wExistProb_ub = 0;
        }    
        //update the signal value
        Msg_TrajPointACCObj17.TrajPointACCObj17_wExistProb_ub=rawValue;        
    }                                                                           
}

on envVar E_pric_RadarFrontCenter_TrajPointACCObj17_TrajPointACCObj17_wExistProb_ub_Pv
{
    qword rawValue = 0ll;
    float phyValue = 0.0;
    
    //update the raw value with physical value 
    {
        if(chgEv_TrajPointACCObj17_TrajPointACCObj17_wExistProb_ub == 0)
        {
            phyValue = getvalue(this);
            // physical to raw conversion
            rawValue = ((phyValue -(0))/0.00390625);
            putValue(E_pric_RadarFrontCenter_TrajPointACCObj17_TrajPointACCObj17_wExistProb_ub_Rv, rawValue);
            chgEv_TrajPointACCObj17_TrajPointACCObj17_wExistProb_ub = 1;  
        }
        else
        {
            chgEv_TrajPointACCObj17_TrajPointACCObj17_wExistProb_ub = 0;
        }
    }
}


 
on envVar E_pric_RadarFrontCenter_TrajPointACCObj17_TrajPointACCObj17_dyv_sw_Rv
{
    qword rawValue = 0ll;
    float rawValue_float = 0.0;
    float phyValue = 0.0;        

    //set the signal with updated raw value
    {
        rawValue = getvalue(this);
        if(chgEv_TrajPointACCObj17_TrajPointACCObj17_dyv_sw == 0)
        {
            //type conversion to float
            rawValue_float = rawValue;        
            // raw to physical conversion
            phyValue = ((rawValue_float *0.0078125)+(0));
            putValue(E_pric_RadarFrontCenter_TrajPointACCObj17_TrajPointACCObj17_dyv_sw_Pv, phyValue);
            chgEv_TrajPointACCObj17_TrajPointACCObj17_dyv_sw = 1;
        }
        else
        {
            chgEv_TrajPointACCObj17_TrajPointACCObj17_dyv_sw = 0;
        }    
        //update the signal value
        Msg_TrajPointACCObj17.TrajPointACCObj17_dyv_sw=rawValue;        
    }                                                                           
}

on envVar E_pric_RadarFrontCenter_TrajPointACCObj17_TrajPointACCObj17_dyv_sw_Pv
{
    qword rawValue = 0ll;
    float phyValue = 0.0;
    
    //update the raw value with physical value 
    {
        if(chgEv_TrajPointACCObj17_TrajPointACCObj17_dyv_sw == 0)
        {
            phyValue = getvalue(this);
            // physical to raw conversion
            rawValue = ((phyValue -(0))/0.0078125);
            putValue(E_pric_RadarFrontCenter_TrajPointACCObj17_TrajPointACCObj17_dyv_sw_Rv, rawValue);
            chgEv_TrajPointACCObj17_TrajPointACCObj17_dyv_sw = 1;  
        }
        else
        {
            chgEv_TrajPointACCObj17_TrajPointACCObj17_dyv_sw = 0;
        }
    }
}


 
on envVar E_pric_RadarFrontCenter_TrajPointACCObj17_TrajPointACCObj17_timestamp_Rv
{
    qword rawValue = 0ll;
    float rawValue_float = 0.0;
    float phyValue = 0.0;        

    //set the signal with updated raw value
    {
        rawValue = getvalue(this);
        if(chgEv_TrajPointACCObj17_TrajPointACCObj17_timestamp == 0)
        {
            //type conversion to float
            rawValue_float = rawValue;        
            // raw to physical conversion
            phyValue = ((rawValue_float *0.000488281)+(0));
            putValue(E_pric_RadarFrontCenter_TrajPointACCObj17_TrajPointACCObj17_timestamp_Pv, phyValue);
            chgEv_TrajPointACCObj17_TrajPointACCObj17_timestamp = 1;
        }
        else
        {
            chgEv_TrajPointACCObj17_TrajPointACCObj17_timestamp = 0;
        }    
        //update the signal value
        Msg_TrajPointACCObj17.TrajPointACCObj17_timestamp=rawValue;        
    }                                                                           
}

on envVar E_pric_RadarFrontCenter_TrajPointACCObj17_TrajPointACCObj17_timestamp_Pv
{
    qword rawValue = 0ll;
    float phyValue = 0.0;
    
    //update the raw value with physical value 
    {
        if(chgEv_TrajPointACCObj17_TrajPointACCObj17_timestamp == 0)
        {
            phyValue = getvalue(this);
            // physical to raw conversion
            rawValue = ((phyValue -(0))/0.000488281);
            putValue(E_pric_RadarFrontCenter_TrajPointACCObj17_TrajPointACCObj17_timestamp_Rv, rawValue);
            chgEv_TrajPointACCObj17_TrajPointACCObj17_timestamp = 1;  
        }
        else
        {
            chgEv_TrajPointACCObj17_TrajPointACCObj17_timestamp = 0;
        }
    }
}


 
on envVar E_pric_RadarFrontCenter_TrajPointACCObj17_TrajPointACCObj17_Stopped_b_Rv
{
    qword rawValue = 0ll;
    float rawValue_float = 0.0;
    float phyValue = 0.0;        

    //set the signal with updated raw value
    if(getValue(E_pric_RadarFrontCenter_TrajPointACCObj17_TrajPointACCObj17_Stopped_b_SetVt)==0)
    {
        rawValue = getvalue(this);
        if(chgEv_TrajPointACCObj17_TrajPointACCObj17_Stopped_b == 0)
        {
            //type conversion to float
            rawValue_float = rawValue;        
            // raw to physical conversion
            phyValue = ((rawValue_float *1)+(0));
            putValue(E_pric_RadarFrontCenter_TrajPointACCObj17_TrajPointACCObj17_Stopped_b_Pv, phyValue);
            chgEv_TrajPointACCObj17_TrajPointACCObj17_Stopped_b = 1;
        }
        else
        {
            chgEv_TrajPointACCObj17_TrajPointACCObj17_Stopped_b = 0;
        }    
        //update the signal value
        Msg_TrajPointACCObj17.TrajPointACCObj17_Stopped_b=rawValue;        
    }                                                                           
}

on envVar E_pric_RadarFrontCenter_TrajPointACCObj17_TrajPointACCObj17_Stopped_b_Pv
{
    qword rawValue = 0ll;
    float phyValue = 0.0;
    
    //update the raw value with physical value 
    if(getValue(E_pric_RadarFrontCenter_TrajPointACCObj17_TrajPointACCObj17_Stopped_b_SetVt)==0)
    {
        if(chgEv_TrajPointACCObj17_TrajPointACCObj17_Stopped_b == 0)
        {
            phyValue = getvalue(this);
            // physical to raw conversion
            rawValue = ((phyValue -(0))/1);
            putValue(E_pric_RadarFrontCenter_TrajPointACCObj17_TrajPointACCObj17_Stopped_b_Rv, rawValue);
            chgEv_TrajPointACCObj17_TrajPointACCObj17_Stopped_b = 1;  
        }
        else
        {
            chgEv_TrajPointACCObj17_TrajPointACCObj17_Stopped_b = 0;
        }
    }
}

on envVar E_pric_RadarFrontCenter_TrajPointACCObj17_TrajPointACCObj17_Stopped_b_Vt
{
    qword rawValue = 0ll;
    if(getValue(E_pric_RadarFrontCenter_TrajPointACCObj17_TrajPointACCObj17_Stopped_b_SetVt))
    {
        //update the signal value
        Msg_TrajPointACCObj17.TrajPointACCObj17_Stopped_b=getValue(this);
    }
}

on envVar E_pric_RadarFrontCenter_TrajPointACCObj17_TrajPointACCObj17_Stopped_b_SetVt
{
    if(getValue(E_pric_RadarFrontCenter_TrajPointACCObj17_TrajPointACCObj17_Stopped_b_SetVt))
    {
        //update the signal value
        Msg_TrajPointACCObj17.TrajPointACCObj17_Stopped_b=getvalue(E_pric_RadarFrontCenter_TrajPointACCObj17_TrajPointACCObj17_Stopped_b_Vt);
    }
    else
    {
        Msg_TrajPointACCObj17.TrajPointACCObj17_Stopped_b=getValue(E_pric_RadarFrontCenter_TrajPointACCObj17_TrajPointACCObj17_Stopped_b_Rv);
    }
}
 
on envVar E_pric_RadarFrontCenter_TrajPointACCObj17_TrajPointACCObj17_dxv_sw_Rv
{
    qword rawValue = 0ll;
    float rawValue_float = 0.0;
    float phyValue = 0.0;        

    //set the signal with updated raw value
    {
        rawValue = getvalue(this);
        if(chgEv_TrajPointACCObj17_TrajPointACCObj17_dxv_sw == 0)
        {
            //type conversion to float
            rawValue_float = rawValue;        
            // raw to physical conversion
            phyValue = ((rawValue_float *0.0078125)+(0));
            putValue(E_pric_RadarFrontCenter_TrajPointACCObj17_TrajPointACCObj17_dxv_sw_Pv, phyValue);
            chgEv_TrajPointACCObj17_TrajPointACCObj17_dxv_sw = 1;
        }
        else
        {
            chgEv_TrajPointACCObj17_TrajPointACCObj17_dxv_sw = 0;
        }    
        //update the signal value
        Msg_TrajPointACCObj17.TrajPointACCObj17_dxv_sw=rawValue;        
    }                                                                           
}

on envVar E_pric_RadarFrontCenter_TrajPointACCObj17_TrajPointACCObj17_dxv_sw_Pv
{
    qword rawValue = 0ll;
    float phyValue = 0.0;
    
    //update the raw value with physical value 
    {
        if(chgEv_TrajPointACCObj17_TrajPointACCObj17_dxv_sw == 0)
        {
            phyValue = getvalue(this);
            // physical to raw conversion
            rawValue = ((phyValue -(0))/0.0078125);
            putValue(E_pric_RadarFrontCenter_TrajPointACCObj17_TrajPointACCObj17_dxv_sw_Rv, rawValue);
            chgEv_TrajPointACCObj17_TrajPointACCObj17_dxv_sw = 1;  
        }
        else
        {
            chgEv_TrajPointACCObj17_TrajPointACCObj17_dxv_sw = 0;
        }
    }
}


 
on envVar E_pric_RadarFrontCenter_TrajPointACCObj17_TrajPointACCObj17_dVarXv_uw_Rv
{
    qword rawValue = 0ll;
    float rawValue_float = 0.0;
    float phyValue = 0.0;        

    //set the signal with updated raw value
    {
        rawValue = getvalue(this);
        if(chgEv_TrajPointACCObj17_TrajPointACCObj17_dVarXv_uw == 0)
        {
            //type conversion to float
            rawValue_float = rawValue;        
            // raw to physical conversion
            phyValue = ((rawValue_float *0.00195313)+(0));
            putValue(E_pric_RadarFrontCenter_TrajPointACCObj17_TrajPointACCObj17_dVarXv_uw_Pv, phyValue);
            chgEv_TrajPointACCObj17_TrajPointACCObj17_dVarXv_uw = 1;
        }
        else
        {
            chgEv_TrajPointACCObj17_TrajPointACCObj17_dVarXv_uw = 0;
        }    
        //update the signal value
        Msg_TrajPointACCObj17.TrajPointACCObj17_dVarXv_uw=rawValue;        
    }                                                                           
}

on envVar E_pric_RadarFrontCenter_TrajPointACCObj17_TrajPointACCObj17_dVarXv_uw_Pv
{
    qword rawValue = 0ll;
    float phyValue = 0.0;
    
    //update the raw value with physical value 
    {
        if(chgEv_TrajPointACCObj17_TrajPointACCObj17_dVarXv_uw == 0)
        {
            phyValue = getvalue(this);
            // physical to raw conversion
            rawValue = ((phyValue -(0))/0.00195313);
            putValue(E_pric_RadarFrontCenter_TrajPointACCObj17_TrajPointACCObj17_dVarXv_uw_Rv, rawValue);
            chgEv_TrajPointACCObj17_TrajPointACCObj17_dVarXv_uw = 1;  
        }
        else
        {
            chgEv_TrajPointACCObj17_TrajPointACCObj17_dVarXv_uw = 0;
        }
    }
}


 
on envVar E_pric_RadarFrontCenter_TrajPointACCObj17_TrajPointACCObj17_TrajEnd_b_Rv
{
    qword rawValue = 0ll;
    float rawValue_float = 0.0;
    float phyValue = 0.0;        

    //set the signal with updated raw value
    if(getValue(E_pric_RadarFrontCenter_TrajPointACCObj17_TrajPointACCObj17_TrajEnd_b_SetVt)==0)
    {
        rawValue = getvalue(this);
        if(chgEv_TrajPointACCObj17_TrajPointACCObj17_TrajEnd_b == 0)
        {
            //type conversion to float
            rawValue_float = rawValue;        
            // raw to physical conversion
            phyValue = ((rawValue_float *1)+(0));
            putValue(E_pric_RadarFrontCenter_TrajPointACCObj17_TrajPointACCObj17_TrajEnd_b_Pv, phyValue);
            chgEv_TrajPointACCObj17_TrajPointACCObj17_TrajEnd_b = 1;
        }
        else
        {
            chgEv_TrajPointACCObj17_TrajPointACCObj17_TrajEnd_b = 0;
        }    
        //update the signal value
        Msg_TrajPointACCObj17.TrajPointACCObj17_TrajEnd_b=rawValue;        
    }                                                                           
}

on envVar E_pric_RadarFrontCenter_TrajPointACCObj17_TrajPointACCObj17_TrajEnd_b_Pv
{
    qword rawValue = 0ll;
    float phyValue = 0.0;
    
    //update the raw value with physical value 
    if(getValue(E_pric_RadarFrontCenter_TrajPointACCObj17_TrajPointACCObj17_TrajEnd_b_SetVt)==0)
    {
        if(chgEv_TrajPointACCObj17_TrajPointACCObj17_TrajEnd_b == 0)
        {
            phyValue = getvalue(this);
            // physical to raw conversion
            rawValue = ((phyValue -(0))/1);
            putValue(E_pric_RadarFrontCenter_TrajPointACCObj17_TrajPointACCObj17_TrajEnd_b_Rv, rawValue);
            chgEv_TrajPointACCObj17_TrajPointACCObj17_TrajEnd_b = 1;  
        }
        else
        {
            chgEv_TrajPointACCObj17_TrajPointACCObj17_TrajEnd_b = 0;
        }
    }
}

on envVar E_pric_RadarFrontCenter_TrajPointACCObj17_TrajPointACCObj17_TrajEnd_b_Vt
{
    qword rawValue = 0ll;
    if(getValue(E_pric_RadarFrontCenter_TrajPointACCObj17_TrajPointACCObj17_TrajEnd_b_SetVt))
    {
        //update the signal value
        Msg_TrajPointACCObj17.TrajPointACCObj17_TrajEnd_b=getValue(this);
    }
}

on envVar E_pric_RadarFrontCenter_TrajPointACCObj17_TrajPointACCObj17_TrajEnd_b_SetVt
{
    if(getValue(E_pric_RadarFrontCenter_TrajPointACCObj17_TrajPointACCObj17_TrajEnd_b_SetVt))
    {
        //update the signal value
        Msg_TrajPointACCObj17.TrajPointACCObj17_TrajEnd_b=getvalue(E_pric_RadarFrontCenter_TrajPointACCObj17_TrajPointACCObj17_TrajEnd_b_Vt);
    }
    else
    {
        Msg_TrajPointACCObj17.TrajPointACCObj17_TrajEnd_b=getValue(E_pric_RadarFrontCenter_TrajPointACCObj17_TrajPointACCObj17_TrajEnd_b_Rv);
    }
}
 
on envVar E_pric_RadarFrontCenter_TrajPointACCObj17_TrajPointACCObj17_Stand_b_Rv
{
    qword rawValue = 0ll;
    float rawValue_float = 0.0;
    float phyValue = 0.0;        

    //set the signal with updated raw value
    if(getValue(E_pric_RadarFrontCenter_TrajPointACCObj17_TrajPointACCObj17_Stand_b_SetVt)==0)
    {
        rawValue = getvalue(this);
        if(chgEv_TrajPointACCObj17_TrajPointACCObj17_Stand_b == 0)
        {
            //type conversion to float
            rawValue_float = rawValue;        
            // raw to physical conversion
            phyValue = ((rawValue_float *1)+(0));
            putValue(E_pric_RadarFrontCenter_TrajPointACCObj17_TrajPointACCObj17_Stand_b_Pv, phyValue);
            chgEv_TrajPointACCObj17_TrajPointACCObj17_Stand_b = 1;
        }
        else
        {
            chgEv_TrajPointACCObj17_TrajPointACCObj17_Stand_b = 0;
        }    
        //update the signal value
        Msg_TrajPointACCObj17.TrajPointACCObj17_Stand_b=rawValue;        
    }                                                                           
}

on envVar E_pric_RadarFrontCenter_TrajPointACCObj17_TrajPointACCObj17_Stand_b_Pv
{
    qword rawValue = 0ll;
    float phyValue = 0.0;
    
    //update the raw value with physical value 
    if(getValue(E_pric_RadarFrontCenter_TrajPointACCObj17_TrajPointACCObj17_Stand_b_SetVt)==0)
    {
        if(chgEv_TrajPointACCObj17_TrajPointACCObj17_Stand_b == 0)
        {
            phyValue = getvalue(this);
            // physical to raw conversion
            rawValue = ((phyValue -(0))/1);
            putValue(E_pric_RadarFrontCenter_TrajPointACCObj17_TrajPointACCObj17_Stand_b_Rv, rawValue);
            chgEv_TrajPointACCObj17_TrajPointACCObj17_Stand_b = 1;  
        }
        else
        {
            chgEv_TrajPointACCObj17_TrajPointACCObj17_Stand_b = 0;
        }
    }
}

on envVar E_pric_RadarFrontCenter_TrajPointACCObj17_TrajPointACCObj17_Stand_b_Vt
{
    qword rawValue = 0ll;
    if(getValue(E_pric_RadarFrontCenter_TrajPointACCObj17_TrajPointACCObj17_Stand_b_SetVt))
    {
        //update the signal value
        Msg_TrajPointACCObj17.TrajPointACCObj17_Stand_b=getValue(this);
    }
}

on envVar E_pric_RadarFrontCenter_TrajPointACCObj17_TrajPointACCObj17_Stand_b_SetVt
{
    if(getValue(E_pric_RadarFrontCenter_TrajPointACCObj17_TrajPointACCObj17_Stand_b_SetVt))
    {
        //update the signal value
        Msg_TrajPointACCObj17.TrajPointACCObj17_Stand_b=getvalue(E_pric_RadarFrontCenter_TrajPointACCObj17_TrajPointACCObj17_Stand_b_Vt);
    }
    else
    {
        Msg_TrajPointACCObj17.TrajPointACCObj17_Stand_b=getValue(E_pric_RadarFrontCenter_TrajPointACCObj17_TrajPointACCObj17_Stand_b_Rv);
    }
}
 
on envVar E_pric_RadarFrontCenter_TrajACC_tx
{
    if(getValue(this))
    {       
        
        //update the BZ Signal
        if(TrajACC_TrajACC_blockCtr_wrongvalctr == 0)
        {
            update_TrajACC_TrajACC_blockCtr_counter();
            Msg_TrajACC.TrajACC_blockCtr= TrajACC_TrajACC_blockCtr_counter;
        }
        else if(TrajACC_TrajACC_blockCtr_wrongvalctr > 0)
        {
             TrajACC_TrajACC_blockCtr_wrongvalctr--;
              // if counter becomes zero, update panel controller to zero
             if(TrajACC_TrajACC_blockCtr_wrongvalctr == 0)
             {
                 putValue(E_pric_RadarFrontCenter_TrajACC_TrajACC_blockCtr_wrongvalctr,0);
             }
        }
        else
        {
            //do nothing
        }        
        //update the BZ Signal
        if(TrajACC_TrajACC_MsgCtr_wrongvalctr == 0)
        {
            update_TrajACC_TrajACC_MsgCtr_counter();
            Msg_TrajACC.TrajACC_MsgCtr= TrajACC_TrajACC_MsgCtr_counter;
        }
        else if(TrajACC_TrajACC_MsgCtr_wrongvalctr > 0)
        {
             TrajACC_TrajACC_MsgCtr_wrongvalctr--;
              // if counter becomes zero, update panel controller to zero
             if(TrajACC_TrajACC_MsgCtr_wrongvalctr == 0)
             {
                 putValue(E_pric_RadarFrontCenter_TrajACC_TrajACC_MsgCtr_wrongvalctr,0);
             }
        }
        else
        {
            //do nothing
        }        
        //calculate the CRC checksum
        update_TrajACC_ChkSum_Checksum();

        output(Msg_TrajACC);        
    }
}

on envVar E_pric_RadarFrontCenter_TrajACC_Range
{
    qword rawstatus = 0ll;
    qword rawValue = 0ll;    
    
    rawstatus = getvalue(this);    
    // set all the signals with min raw /max raw /init raw
    switch (rawstatus) 
    {
     case(0) :
        rawValue= 0;
        putValue(E_pric_RadarFrontCenter_TrajACC_TrajACC_objType_ub_Rv, rawValue);
        rawValue= 0;
        putValue(E_pric_RadarFrontCenter_TrajACC_TrajACC_TrajHistCurrentIndex_ub_Rv, rawValue);
        break;
     case(1) :
        rawValue= 255;
        putValue(E_pric_RadarFrontCenter_TrajACC_TrajACC_objType_ub_Rv, rawValue);
        rawValue= 255;
        putValue(E_pric_RadarFrontCenter_TrajACC_TrajACC_TrajHistCurrentIndex_ub_Rv, rawValue);
        break;
     default :
        rawValue= 0;
        putValue(E_pric_RadarFrontCenter_TrajACC_TrajACC_objType_ub_Rv, rawValue);
        rawValue= 0;
        putValue(E_pric_RadarFrontCenter_TrajACC_TrajACC_TrajHistCurrentIndex_ub_Rv, rawValue);
      break;
   }
}

on envVar E_pric_RadarFrontCenter_TrajACC_Dlc
{
    if(getValue(E_pric_RadarFrontCenter_TrajACC_enDlc))
    {
        Msg_TrajACC.dlc =getValue(this);
    }
    else
    {
       Dbc_dlc = 4;
	   Msg_TrajACC.dlc = Calc_Canfd_dlc(Dbc_dlc);
	   	
  }
}

on envVar E_pric_RadarFrontCenter_TrajACC_enDlc
{
    //For Messages with DLC = 8, set wrong DLC to smaller than defined DLC
    //For Messages with DLC < 8 set wrong DLC to smaller/longer than defined DLC
    if(getValue(this))
    {
        Msg_TrajACC.dlc =getValue(E_pric_RadarFrontCenter_TrajACC_Dlc);
    }
    else
    {
       Dbc_dlc = 4;
	   Msg_TrajACC.dlc = Calc_Canfd_dlc(Dbc_dlc);
			
    }
}

on envVar E_pric_RadarFrontCenter_TrajACC_TrajACC_CRC_wrongvalctr
{
    //update disturb count
    //disturb value range:(-1 = always send wrong value),( X>0 ,x is the number of Messages with wrong CHK sent)
    TrajACC_TrajACC_CRC_wrongvalctr =getValue(this);    
}
on envVar E_pric_RadarFrontCenter_TrajACC_TrajACC_MsgCtr_wrongvalctr
{
    //update disturb count
    //disturb value range:(-1 = always send wrong value),( X>0 ,x is the number of Messages with wrong CHK sent)
    TrajACC_TrajACC_MsgCtr_wrongvalctr =getValue(this);    
}
on envVar E_pric_RadarFrontCenter_TrajACC_TrajACC_blockCtr_wrongvalctr
{
    //update disturb count
    //disturb value range:(-1 = always send wrong value),( X>0 ,x is the number of Messages with wrong CHK sent)
    TrajACC_TrajACC_blockCtr_wrongvalctr =getValue(this);    
}

on envVar E_pric_RadarFrontCenter_TrajACC_TrajACC_objType_ub_Rv
{
    qword rawValue = 0ll;
    float rawValue_float = 0.0;
    float phyValue = 0.0;        

    //set the signal with updated raw value
    {
        rawValue = getvalue(this);
        if(chgEv_TrajACC_TrajACC_objType_ub == 0)
        {
            //type conversion to float
            rawValue_float = rawValue;        
            // raw to physical conversion
            phyValue = ((rawValue_float *1)+(0));
            putValue(E_pric_RadarFrontCenter_TrajACC_TrajACC_objType_ub_Pv, phyValue);
            chgEv_TrajACC_TrajACC_objType_ub = 1;
        }
        else
        {
            chgEv_TrajACC_TrajACC_objType_ub = 0;
        }    
        //update the signal value
        Msg_TrajACC.TrajACC_objType_ub=rawValue;        
    }                                                                           
}

on envVar E_pric_RadarFrontCenter_TrajACC_TrajACC_objType_ub_Pv
{
    qword rawValue = 0ll;
    float phyValue = 0.0;
    
    //update the raw value with physical value 
    {
        if(chgEv_TrajACC_TrajACC_objType_ub == 0)
        {
            phyValue = getvalue(this);
            // physical to raw conversion
            rawValue = ((phyValue -(0))/1);
            putValue(E_pric_RadarFrontCenter_TrajACC_TrajACC_objType_ub_Rv, rawValue);
            chgEv_TrajACC_TrajACC_objType_ub = 1;  
        }
        else
        {
            chgEv_TrajACC_TrajACC_objType_ub = 0;
        }
    }
}


 
on envVar E_pric_RadarFrontCenter_TrajACC_TrajACC_TrajHistCurrentIndex_ub_Rv
{
    qword rawValue = 0ll;
    float rawValue_float = 0.0;
    float phyValue = 0.0;        

    //set the signal with updated raw value
    {
        rawValue = getvalue(this);
        if(chgEv_TrajACC_TrajACC_TrajHistCurrentIndex_ub == 0)
        {
            //type conversion to float
            rawValue_float = rawValue;        
            // raw to physical conversion
            phyValue = ((rawValue_float *1)+(0));
            putValue(E_pric_RadarFrontCenter_TrajACC_TrajACC_TrajHistCurrentIndex_ub_Pv, phyValue);
            chgEv_TrajACC_TrajACC_TrajHistCurrentIndex_ub = 1;
        }
        else
        {
            chgEv_TrajACC_TrajACC_TrajHistCurrentIndex_ub = 0;
        }    
        //update the signal value
        Msg_TrajACC.TrajACC_TrajHistCurrentIndex_ub=rawValue;        
    }                                                                           
}

on envVar E_pric_RadarFrontCenter_TrajACC_TrajACC_TrajHistCurrentIndex_ub_Pv
{
    qword rawValue = 0ll;
    float phyValue = 0.0;
    
    //update the raw value with physical value 
    {
        if(chgEv_TrajACC_TrajACC_TrajHistCurrentIndex_ub == 0)
        {
            phyValue = getvalue(this);
            // physical to raw conversion
            rawValue = ((phyValue -(0))/1);
            putValue(E_pric_RadarFrontCenter_TrajACC_TrajACC_TrajHistCurrentIndex_ub_Rv, rawValue);
            chgEv_TrajACC_TrajACC_TrajHistCurrentIndex_ub = 1;  
        }
        else
        {
            chgEv_TrajACC_TrajACC_TrajHistCurrentIndex_ub = 0;
        }
    }
}


 
on envVar E_pric_RadarFrontCenter_TrajPointACCObj15_tx
{
    if(getValue(this))
    {       
        
        //update the BZ Signal
        if(TrajPointACCObj15_TrajPointACCObj15_blockCtr_wrongvalctr == 0)
        {
            update_TrajPointACCObj15_TrajPointACCObj15_blockCtr_counter();
            Msg_TrajPointACCObj15.TrajPointACCObj15_blockCtr= TrajPointACCObj15_TrajPointACCObj15_blockCtr_counter;
        }
        else if(TrajPointACCObj15_TrajPointACCObj15_blockCtr_wrongvalctr > 0)
        {
             TrajPointACCObj15_TrajPointACCObj15_blockCtr_wrongvalctr--;
              // if counter becomes zero, update panel controller to zero
             if(TrajPointACCObj15_TrajPointACCObj15_blockCtr_wrongvalctr == 0)
             {
                 putValue(E_pric_RadarFrontCenter_TrajPointACCObj15_TrajPointACCObj15_blockCtr_wrongvalctr,0);
             }
        }
        else
        {
            //do nothing
        }        
        //update the BZ Signal
        if(TrajPointACCObj15_TrajPointACCObj15_MsgCtr_wrongvalctr == 0)
        {
            update_TrajPointACCObj15_TrajPointACCObj15_MsgCtr_counter();
            Msg_TrajPointACCObj15.TrajPointACCObj15_MsgCtr= TrajPointACCObj15_TrajPointACCObj15_MsgCtr_counter;
        }
        else if(TrajPointACCObj15_TrajPointACCObj15_MsgCtr_wrongvalctr > 0)
        {
             TrajPointACCObj15_TrajPointACCObj15_MsgCtr_wrongvalctr--;
              // if counter becomes zero, update panel controller to zero
             if(TrajPointACCObj15_TrajPointACCObj15_MsgCtr_wrongvalctr == 0)
             {
                 putValue(E_pric_RadarFrontCenter_TrajPointACCObj15_TrajPointACCObj15_MsgCtr_wrongvalctr,0);
             }
        }
        else
        {
            //do nothing
        }        
        //calculate the CRC checksum
        update_TrajPointACCObj15_ChkSum_Checksum();

        output(Msg_TrajPointACCObj15);        
    }
}

on envVar E_pric_RadarFrontCenter_TrajPointACCObj15_Range
{
    qword rawstatus = 0ll;
    qword rawValue = 0ll;    
    
    rawstatus = getvalue(this);    
    // set all the signals with min raw /max raw /init raw
    switch (rawstatus) 
    {
     case(0) :
        rawValue= 0;
        putValue(E_pric_RadarFrontCenter_TrajPointACCObj15_TrajPointACCObj15_wExistProb_ub_Rv, rawValue);
        rawValue= 0;
        putValue(E_pric_RadarFrontCenter_TrajPointACCObj15_TrajPointACCObj15_Stand_b_Rv, rawValue);
        rawValue= 0;
        putValue(E_pric_RadarFrontCenter_TrajPointACCObj15_TrajPointACCObj15_Stopped_b_Rv, rawValue);
        rawValue= 0;
        putValue(E_pric_RadarFrontCenter_TrajPointACCObj15_TrajPointACCObj15_InvDir_b_Rv, rawValue);
        rawValue= -32768;
        putValue(E_pric_RadarFrontCenter_TrajPointACCObj15_TrajPointACCObj15_dxv_sw_Rv, rawValue);
        rawValue= 0;
        putValue(E_pric_RadarFrontCenter_TrajPointACCObj15_TrajPointACCObj15_dVarXv_uw_Rv, rawValue);
        rawValue= 0;
        putValue(E_pric_RadarFrontCenter_TrajPointACCObj15_TrajPointACCObj15_timestamp_Rv, rawValue);
        rawValue= -32768;
        putValue(E_pric_RadarFrontCenter_TrajPointACCObj15_TrajPointACCObj15_dyv_sw_Rv, rawValue);
        rawValue= 0;
        putValue(E_pric_RadarFrontCenter_TrajPointACCObj15_TrajPointACCObj15_TrajEnd_b_Rv, rawValue);
        rawValue= 0;
        putValue(E_pric_RadarFrontCenter_TrajPointACCObj15_TrajPointACCObj15_Drive_b_Rv, rawValue);
        rawValue= 0;
        putValue(E_pric_RadarFrontCenter_TrajPointACCObj15_TrajPointACCObj15_dVarYv_uw_Rv, rawValue);
        rawValue= 0;
        putValue(E_pric_RadarFrontCenter_TrajPointACCObj15_TrajPointACCObj15_Valid_b_Rv, rawValue);
        break;
     case(1) :
        rawValue= 255;
        putValue(E_pric_RadarFrontCenter_TrajPointACCObj15_TrajPointACCObj15_wExistProb_ub_Rv, rawValue);
        rawValue= 1;
        putValue(E_pric_RadarFrontCenter_TrajPointACCObj15_TrajPointACCObj15_Stand_b_Rv, rawValue);
        rawValue= 1;
        putValue(E_pric_RadarFrontCenter_TrajPointACCObj15_TrajPointACCObj15_Stopped_b_Rv, rawValue);
        rawValue= 1;
        putValue(E_pric_RadarFrontCenter_TrajPointACCObj15_TrajPointACCObj15_InvDir_b_Rv, rawValue);
        rawValue= 32767;
        putValue(E_pric_RadarFrontCenter_TrajPointACCObj15_TrajPointACCObj15_dxv_sw_Rv, rawValue);
        rawValue= 65534;
        putValue(E_pric_RadarFrontCenter_TrajPointACCObj15_TrajPointACCObj15_dVarXv_uw_Rv, rawValue);
        rawValue= 65536;
        putValue(E_pric_RadarFrontCenter_TrajPointACCObj15_TrajPointACCObj15_timestamp_Rv, rawValue);
        rawValue= 32767;
        putValue(E_pric_RadarFrontCenter_TrajPointACCObj15_TrajPointACCObj15_dyv_sw_Rv, rawValue);
        rawValue= 1;
        putValue(E_pric_RadarFrontCenter_TrajPointACCObj15_TrajPointACCObj15_TrajEnd_b_Rv, rawValue);
        rawValue= 1;
        putValue(E_pric_RadarFrontCenter_TrajPointACCObj15_TrajPointACCObj15_Drive_b_Rv, rawValue);
        rawValue= 65534;
        putValue(E_pric_RadarFrontCenter_TrajPointACCObj15_TrajPointACCObj15_dVarYv_uw_Rv, rawValue);
        rawValue= 1;
        putValue(E_pric_RadarFrontCenter_TrajPointACCObj15_TrajPointACCObj15_Valid_b_Rv, rawValue);
        break;
     default :
        rawValue= 0;
        putValue(E_pric_RadarFrontCenter_TrajPointACCObj15_TrajPointACCObj15_wExistProb_ub_Rv, rawValue);
        rawValue= 0;
        putValue(E_pric_RadarFrontCenter_TrajPointACCObj15_TrajPointACCObj15_Stand_b_Rv, rawValue);
        rawValue= 0;
        putValue(E_pric_RadarFrontCenter_TrajPointACCObj15_TrajPointACCObj15_Stopped_b_Rv, rawValue);
        rawValue= 0;
        putValue(E_pric_RadarFrontCenter_TrajPointACCObj15_TrajPointACCObj15_InvDir_b_Rv, rawValue);
        rawValue= -32768;
        putValue(E_pric_RadarFrontCenter_TrajPointACCObj15_TrajPointACCObj15_dxv_sw_Rv, rawValue);
        rawValue= 0;
        putValue(E_pric_RadarFrontCenter_TrajPointACCObj15_TrajPointACCObj15_dVarXv_uw_Rv, rawValue);
        rawValue= 0;
        putValue(E_pric_RadarFrontCenter_TrajPointACCObj15_TrajPointACCObj15_timestamp_Rv, rawValue);
        rawValue= -32768;
        putValue(E_pric_RadarFrontCenter_TrajPointACCObj15_TrajPointACCObj15_dyv_sw_Rv, rawValue);
        rawValue= 0;
        putValue(E_pric_RadarFrontCenter_TrajPointACCObj15_TrajPointACCObj15_TrajEnd_b_Rv, rawValue);
        rawValue= 0;
        putValue(E_pric_RadarFrontCenter_TrajPointACCObj15_TrajPointACCObj15_Drive_b_Rv, rawValue);
        rawValue= 0;
        putValue(E_pric_RadarFrontCenter_TrajPointACCObj15_TrajPointACCObj15_dVarYv_uw_Rv, rawValue);
        rawValue= 0;
        putValue(E_pric_RadarFrontCenter_TrajPointACCObj15_TrajPointACCObj15_Valid_b_Rv, rawValue);
      break;
   }
}

on envVar E_pric_RadarFrontCenter_TrajPointACCObj15_Dlc
{
    if(getValue(E_pric_RadarFrontCenter_TrajPointACCObj15_enDlc))
    {
        Msg_TrajPointACCObj15.dlc =getValue(this);
    }
    else
    {
       Dbc_dlc = 16;
	   Msg_TrajPointACCObj15.dlc = Calc_Canfd_dlc(Dbc_dlc);
	   	
  }
}

on envVar E_pric_RadarFrontCenter_TrajPointACCObj15_enDlc
{
    //For Messages with DLC = 8, set wrong DLC to smaller than defined DLC
    //For Messages with DLC < 8 set wrong DLC to smaller/longer than defined DLC
    if(getValue(this))
    {
        Msg_TrajPointACCObj15.dlc =getValue(E_pric_RadarFrontCenter_TrajPointACCObj15_Dlc);
    }
    else
    {
       Dbc_dlc = 16;
	   Msg_TrajPointACCObj15.dlc = Calc_Canfd_dlc(Dbc_dlc);
			
    }
}

on envVar E_pric_RadarFrontCenter_TrajPointACCObj15_TrajPointACCObj15_CRC_wrongvalctr
{
    //update disturb count
    //disturb value range:(-1 = always send wrong value),( X>0 ,x is the number of Messages with wrong CHK sent)
    TrajPointACCObj15_TrajPointACCObj15_CRC_wrongvalctr =getValue(this);    
}
on envVar E_pric_RadarFrontCenter_TrajPointACCObj15_TrajPointACCObj15_MsgCtr_wrongvalctr
{
    //update disturb count
    //disturb value range:(-1 = always send wrong value),( X>0 ,x is the number of Messages with wrong CHK sent)
    TrajPointACCObj15_TrajPointACCObj15_MsgCtr_wrongvalctr =getValue(this);    
}
on envVar E_pric_RadarFrontCenter_TrajPointACCObj15_TrajPointACCObj15_blockCtr_wrongvalctr
{
    //update disturb count
    //disturb value range:(-1 = always send wrong value),( X>0 ,x is the number of Messages with wrong CHK sent)
    TrajPointACCObj15_TrajPointACCObj15_blockCtr_wrongvalctr =getValue(this);    
}

on envVar E_pric_RadarFrontCenter_TrajPointACCObj15_TrajPointACCObj15_wExistProb_ub_Rv
{
    qword rawValue = 0ll;
    float rawValue_float = 0.0;
    float phyValue = 0.0;        

    //set the signal with updated raw value
    {
        rawValue = getvalue(this);
        if(chgEv_TrajPointACCObj15_TrajPointACCObj15_wExistProb_ub == 0)
        {
            //type conversion to float
            rawValue_float = rawValue;        
            // raw to physical conversion
            phyValue = ((rawValue_float *0.00390625)+(0));
            putValue(E_pric_RadarFrontCenter_TrajPointACCObj15_TrajPointACCObj15_wExistProb_ub_Pv, phyValue);
            chgEv_TrajPointACCObj15_TrajPointACCObj15_wExistProb_ub = 1;
        }
        else
        {
            chgEv_TrajPointACCObj15_TrajPointACCObj15_wExistProb_ub = 0;
        }    
        //update the signal value
        Msg_TrajPointACCObj15.TrajPointACCObj15_wExistProb_ub=rawValue;        
    }                                                                           
}

on envVar E_pric_RadarFrontCenter_TrajPointACCObj15_TrajPointACCObj15_wExistProb_ub_Pv
{
    qword rawValue = 0ll;
    float phyValue = 0.0;
    
    //update the raw value with physical value 
    {
        if(chgEv_TrajPointACCObj15_TrajPointACCObj15_wExistProb_ub == 0)
        {
            phyValue = getvalue(this);
            // physical to raw conversion
            rawValue = ((phyValue -(0))/0.00390625);
            putValue(E_pric_RadarFrontCenter_TrajPointACCObj15_TrajPointACCObj15_wExistProb_ub_Rv, rawValue);
            chgEv_TrajPointACCObj15_TrajPointACCObj15_wExistProb_ub = 1;  
        }
        else
        {
            chgEv_TrajPointACCObj15_TrajPointACCObj15_wExistProb_ub = 0;
        }
    }
}


 
on envVar E_pric_RadarFrontCenter_TrajPointACCObj15_TrajPointACCObj15_Stand_b_Rv
{
    qword rawValue = 0ll;
    float rawValue_float = 0.0;
    float phyValue = 0.0;        

    //set the signal with updated raw value
    if(getValue(E_pric_RadarFrontCenter_TrajPointACCObj15_TrajPointACCObj15_Stand_b_SetVt)==0)
    {
        rawValue = getvalue(this);
        if(chgEv_TrajPointACCObj15_TrajPointACCObj15_Stand_b == 0)
        {
            //type conversion to float
            rawValue_float = rawValue;        
            // raw to physical conversion
            phyValue = ((rawValue_float *1)+(0));
            putValue(E_pric_RadarFrontCenter_TrajPointACCObj15_TrajPointACCObj15_Stand_b_Pv, phyValue);
            chgEv_TrajPointACCObj15_TrajPointACCObj15_Stand_b = 1;
        }
        else
        {
            chgEv_TrajPointACCObj15_TrajPointACCObj15_Stand_b = 0;
        }    
        //update the signal value
        Msg_TrajPointACCObj15.TrajPointACCObj15_Stand_b=rawValue;        
    }                                                                           
}

on envVar E_pric_RadarFrontCenter_TrajPointACCObj15_TrajPointACCObj15_Stand_b_Pv
{
    qword rawValue = 0ll;
    float phyValue = 0.0;
    
    //update the raw value with physical value 
    if(getValue(E_pric_RadarFrontCenter_TrajPointACCObj15_TrajPointACCObj15_Stand_b_SetVt)==0)
    {
        if(chgEv_TrajPointACCObj15_TrajPointACCObj15_Stand_b == 0)
        {
            phyValue = getvalue(this);
            // physical to raw conversion
            rawValue = ((phyValue -(0))/1);
            putValue(E_pric_RadarFrontCenter_TrajPointACCObj15_TrajPointACCObj15_Stand_b_Rv, rawValue);
            chgEv_TrajPointACCObj15_TrajPointACCObj15_Stand_b = 1;  
        }
        else
        {
            chgEv_TrajPointACCObj15_TrajPointACCObj15_Stand_b = 0;
        }
    }
}

on envVar E_pric_RadarFrontCenter_TrajPointACCObj15_TrajPointACCObj15_Stand_b_Vt
{
    qword rawValue = 0ll;
    if(getValue(E_pric_RadarFrontCenter_TrajPointACCObj15_TrajPointACCObj15_Stand_b_SetVt))
    {
        //update the signal value
        Msg_TrajPointACCObj15.TrajPointACCObj15_Stand_b=getValue(this);
    }
}

on envVar E_pric_RadarFrontCenter_TrajPointACCObj15_TrajPointACCObj15_Stand_b_SetVt
{
    if(getValue(E_pric_RadarFrontCenter_TrajPointACCObj15_TrajPointACCObj15_Stand_b_SetVt))
    {
        //update the signal value
        Msg_TrajPointACCObj15.TrajPointACCObj15_Stand_b=getvalue(E_pric_RadarFrontCenter_TrajPointACCObj15_TrajPointACCObj15_Stand_b_Vt);
    }
    else
    {
        Msg_TrajPointACCObj15.TrajPointACCObj15_Stand_b=getValue(E_pric_RadarFrontCenter_TrajPointACCObj15_TrajPointACCObj15_Stand_b_Rv);
    }
}
 
on envVar E_pric_RadarFrontCenter_TrajPointACCObj15_TrajPointACCObj15_Stopped_b_Rv
{
    qword rawValue = 0ll;
    float rawValue_float = 0.0;
    float phyValue = 0.0;        

    //set the signal with updated raw value
    if(getValue(E_pric_RadarFrontCenter_TrajPointACCObj15_TrajPointACCObj15_Stopped_b_SetVt)==0)
    {
        rawValue = getvalue(this);
        if(chgEv_TrajPointACCObj15_TrajPointACCObj15_Stopped_b == 0)
        {
            //type conversion to float
            rawValue_float = rawValue;        
            // raw to physical conversion
            phyValue = ((rawValue_float *1)+(0));
            putValue(E_pric_RadarFrontCenter_TrajPointACCObj15_TrajPointACCObj15_Stopped_b_Pv, phyValue);
            chgEv_TrajPointACCObj15_TrajPointACCObj15_Stopped_b = 1;
        }
        else
        {
            chgEv_TrajPointACCObj15_TrajPointACCObj15_Stopped_b = 0;
        }    
        //update the signal value
        Msg_TrajPointACCObj15.TrajPointACCObj15_Stopped_b=rawValue;        
    }                                                                           
}

on envVar E_pric_RadarFrontCenter_TrajPointACCObj15_TrajPointACCObj15_Stopped_b_Pv
{
    qword rawValue = 0ll;
    float phyValue = 0.0;
    
    //update the raw value with physical value 
    if(getValue(E_pric_RadarFrontCenter_TrajPointACCObj15_TrajPointACCObj15_Stopped_b_SetVt)==0)
    {
        if(chgEv_TrajPointACCObj15_TrajPointACCObj15_Stopped_b == 0)
        {
            phyValue = getvalue(this);
            // physical to raw conversion
            rawValue = ((phyValue -(0))/1);
            putValue(E_pric_RadarFrontCenter_TrajPointACCObj15_TrajPointACCObj15_Stopped_b_Rv, rawValue);
            chgEv_TrajPointACCObj15_TrajPointACCObj15_Stopped_b = 1;  
        }
        else
        {
            chgEv_TrajPointACCObj15_TrajPointACCObj15_Stopped_b = 0;
        }
    }
}

on envVar E_pric_RadarFrontCenter_TrajPointACCObj15_TrajPointACCObj15_Stopped_b_Vt
{
    qword rawValue = 0ll;
    if(getValue(E_pric_RadarFrontCenter_TrajPointACCObj15_TrajPointACCObj15_Stopped_b_SetVt))
    {
        //update the signal value
        Msg_TrajPointACCObj15.TrajPointACCObj15_Stopped_b=getValue(this);
    }
}

on envVar E_pric_RadarFrontCenter_TrajPointACCObj15_TrajPointACCObj15_Stopped_b_SetVt
{
    if(getValue(E_pric_RadarFrontCenter_TrajPointACCObj15_TrajPointACCObj15_Stopped_b_SetVt))
    {
        //update the signal value
        Msg_TrajPointACCObj15.TrajPointACCObj15_Stopped_b=getvalue(E_pric_RadarFrontCenter_TrajPointACCObj15_TrajPointACCObj15_Stopped_b_Vt);
    }
    else
    {
        Msg_TrajPointACCObj15.TrajPointACCObj15_Stopped_b=getValue(E_pric_RadarFrontCenter_TrajPointACCObj15_TrajPointACCObj15_Stopped_b_Rv);
    }
}
 
on envVar E_pric_RadarFrontCenter_TrajPointACCObj15_TrajPointACCObj15_InvDir_b_Rv
{
    qword rawValue = 0ll;
    float rawValue_float = 0.0;
    float phyValue = 0.0;        

    //set the signal with updated raw value
    if(getValue(E_pric_RadarFrontCenter_TrajPointACCObj15_TrajPointACCObj15_InvDir_b_SetVt)==0)
    {
        rawValue = getvalue(this);
        if(chgEv_TrajPointACCObj15_TrajPointACCObj15_InvDir_b == 0)
        {
            //type conversion to float
            rawValue_float = rawValue;        
            // raw to physical conversion
            phyValue = ((rawValue_float *1)+(0));
            putValue(E_pric_RadarFrontCenter_TrajPointACCObj15_TrajPointACCObj15_InvDir_b_Pv, phyValue);
            chgEv_TrajPointACCObj15_TrajPointACCObj15_InvDir_b = 1;
        }
        else
        {
            chgEv_TrajPointACCObj15_TrajPointACCObj15_InvDir_b = 0;
        }    
        //update the signal value
        Msg_TrajPointACCObj15.TrajPointACCObj15_InvDir_b=rawValue;        
    }                                                                           
}

on envVar E_pric_RadarFrontCenter_TrajPointACCObj15_TrajPointACCObj15_InvDir_b_Pv
{
    qword rawValue = 0ll;
    float phyValue = 0.0;
    
    //update the raw value with physical value 
    if(getValue(E_pric_RadarFrontCenter_TrajPointACCObj15_TrajPointACCObj15_InvDir_b_SetVt)==0)
    {
        if(chgEv_TrajPointACCObj15_TrajPointACCObj15_InvDir_b == 0)
        {
            phyValue = getvalue(this);
            // physical to raw conversion
            rawValue = ((phyValue -(0))/1);
            putValue(E_pric_RadarFrontCenter_TrajPointACCObj15_TrajPointACCObj15_InvDir_b_Rv, rawValue);
            chgEv_TrajPointACCObj15_TrajPointACCObj15_InvDir_b = 1;  
        }
        else
        {
            chgEv_TrajPointACCObj15_TrajPointACCObj15_InvDir_b = 0;
        }
    }
}

on envVar E_pric_RadarFrontCenter_TrajPointACCObj15_TrajPointACCObj15_InvDir_b_Vt
{
    qword rawValue = 0ll;
    if(getValue(E_pric_RadarFrontCenter_TrajPointACCObj15_TrajPointACCObj15_InvDir_b_SetVt))
    {
        //update the signal value
        Msg_TrajPointACCObj15.TrajPointACCObj15_InvDir_b=getValue(this);
    }
}

on envVar E_pric_RadarFrontCenter_TrajPointACCObj15_TrajPointACCObj15_InvDir_b_SetVt
{
    if(getValue(E_pric_RadarFrontCenter_TrajPointACCObj15_TrajPointACCObj15_InvDir_b_SetVt))
    {
        //update the signal value
        Msg_TrajPointACCObj15.TrajPointACCObj15_InvDir_b=getvalue(E_pric_RadarFrontCenter_TrajPointACCObj15_TrajPointACCObj15_InvDir_b_Vt);
    }
    else
    {
        Msg_TrajPointACCObj15.TrajPointACCObj15_InvDir_b=getValue(E_pric_RadarFrontCenter_TrajPointACCObj15_TrajPointACCObj15_InvDir_b_Rv);
    }
}
 
on envVar E_pric_RadarFrontCenter_TrajPointACCObj15_TrajPointACCObj15_dxv_sw_Rv
{
    qword rawValue = 0ll;
    float rawValue_float = 0.0;
    float phyValue = 0.0;        

    //set the signal with updated raw value
    {
        rawValue = getvalue(this);
        if(chgEv_TrajPointACCObj15_TrajPointACCObj15_dxv_sw == 0)
        {
            //type conversion to float
            rawValue_float = rawValue;        
            // raw to physical conversion
            phyValue = ((rawValue_float *0.0078125)+(0));
            putValue(E_pric_RadarFrontCenter_TrajPointACCObj15_TrajPointACCObj15_dxv_sw_Pv, phyValue);
            chgEv_TrajPointACCObj15_TrajPointACCObj15_dxv_sw = 1;
        }
        else
        {
            chgEv_TrajPointACCObj15_TrajPointACCObj15_dxv_sw = 0;
        }    
        //update the signal value
        Msg_TrajPointACCObj15.TrajPointACCObj15_dxv_sw=rawValue;        
    }                                                                           
}

on envVar E_pric_RadarFrontCenter_TrajPointACCObj15_TrajPointACCObj15_dxv_sw_Pv
{
    qword rawValue = 0ll;
    float phyValue = 0.0;
    
    //update the raw value with physical value 
    {
        if(chgEv_TrajPointACCObj15_TrajPointACCObj15_dxv_sw == 0)
        {
            phyValue = getvalue(this);
            // physical to raw conversion
            rawValue = ((phyValue -(0))/0.0078125);
            putValue(E_pric_RadarFrontCenter_TrajPointACCObj15_TrajPointACCObj15_dxv_sw_Rv, rawValue);
            chgEv_TrajPointACCObj15_TrajPointACCObj15_dxv_sw = 1;  
        }
        else
        {
            chgEv_TrajPointACCObj15_TrajPointACCObj15_dxv_sw = 0;
        }
    }
}


 
on envVar E_pric_RadarFrontCenter_TrajPointACCObj15_TrajPointACCObj15_dVarXv_uw_Rv
{
    qword rawValue = 0ll;
    float rawValue_float = 0.0;
    float phyValue = 0.0;        

    //set the signal with updated raw value
    {
        rawValue = getvalue(this);
        if(chgEv_TrajPointACCObj15_TrajPointACCObj15_dVarXv_uw == 0)
        {
            //type conversion to float
            rawValue_float = rawValue;        
            // raw to physical conversion
            phyValue = ((rawValue_float *0.00195313)+(0));
            putValue(E_pric_RadarFrontCenter_TrajPointACCObj15_TrajPointACCObj15_dVarXv_uw_Pv, phyValue);
            chgEv_TrajPointACCObj15_TrajPointACCObj15_dVarXv_uw = 1;
        }
        else
        {
            chgEv_TrajPointACCObj15_TrajPointACCObj15_dVarXv_uw = 0;
        }    
        //update the signal value
        Msg_TrajPointACCObj15.TrajPointACCObj15_dVarXv_uw=rawValue;        
    }                                                                           
}

on envVar E_pric_RadarFrontCenter_TrajPointACCObj15_TrajPointACCObj15_dVarXv_uw_Pv
{
    qword rawValue = 0ll;
    float phyValue = 0.0;
    
    //update the raw value with physical value 
    {
        if(chgEv_TrajPointACCObj15_TrajPointACCObj15_dVarXv_uw == 0)
        {
            phyValue = getvalue(this);
            // physical to raw conversion
            rawValue = ((phyValue -(0))/0.00195313);
            putValue(E_pric_RadarFrontCenter_TrajPointACCObj15_TrajPointACCObj15_dVarXv_uw_Rv, rawValue);
            chgEv_TrajPointACCObj15_TrajPointACCObj15_dVarXv_uw = 1;  
        }
        else
        {
            chgEv_TrajPointACCObj15_TrajPointACCObj15_dVarXv_uw = 0;
        }
    }
}


 
on envVar E_pric_RadarFrontCenter_TrajPointACCObj15_TrajPointACCObj15_timestamp_Rv
{
    qword rawValue = 0ll;
    float rawValue_float = 0.0;
    float phyValue = 0.0;        

    //set the signal with updated raw value
    {
        rawValue = getvalue(this);
        if(chgEv_TrajPointACCObj15_TrajPointACCObj15_timestamp == 0)
        {
            //type conversion to float
            rawValue_float = rawValue;        
            // raw to physical conversion
            phyValue = ((rawValue_float *0.000488281)+(0));
            putValue(E_pric_RadarFrontCenter_TrajPointACCObj15_TrajPointACCObj15_timestamp_Pv, phyValue);
            chgEv_TrajPointACCObj15_TrajPointACCObj15_timestamp = 1;
        }
        else
        {
            chgEv_TrajPointACCObj15_TrajPointACCObj15_timestamp = 0;
        }    
        //update the signal value
        Msg_TrajPointACCObj15.TrajPointACCObj15_timestamp=rawValue;        
    }                                                                           
}

on envVar E_pric_RadarFrontCenter_TrajPointACCObj15_TrajPointACCObj15_timestamp_Pv
{
    qword rawValue = 0ll;
    float phyValue = 0.0;
    
    //update the raw value with physical value 
    {
        if(chgEv_TrajPointACCObj15_TrajPointACCObj15_timestamp == 0)
        {
            phyValue = getvalue(this);
            // physical to raw conversion
            rawValue = ((phyValue -(0))/0.000488281);
            putValue(E_pric_RadarFrontCenter_TrajPointACCObj15_TrajPointACCObj15_timestamp_Rv, rawValue);
            chgEv_TrajPointACCObj15_TrajPointACCObj15_timestamp = 1;  
        }
        else
        {
            chgEv_TrajPointACCObj15_TrajPointACCObj15_timestamp = 0;
        }
    }
}


 
on envVar E_pric_RadarFrontCenter_TrajPointACCObj15_TrajPointACCObj15_dyv_sw_Rv
{
    qword rawValue = 0ll;
    float rawValue_float = 0.0;
    float phyValue = 0.0;        

    //set the signal with updated raw value
    {
        rawValue = getvalue(this);
        if(chgEv_TrajPointACCObj15_TrajPointACCObj15_dyv_sw == 0)
        {
            //type conversion to float
            rawValue_float = rawValue;        
            // raw to physical conversion
            phyValue = ((rawValue_float *0.0078125)+(0));
            putValue(E_pric_RadarFrontCenter_TrajPointACCObj15_TrajPointACCObj15_dyv_sw_Pv, phyValue);
            chgEv_TrajPointACCObj15_TrajPointACCObj15_dyv_sw = 1;
        }
        else
        {
            chgEv_TrajPointACCObj15_TrajPointACCObj15_dyv_sw = 0;
        }    
        //update the signal value
        Msg_TrajPointACCObj15.TrajPointACCObj15_dyv_sw=rawValue;        
    }                                                                           
}

on envVar E_pric_RadarFrontCenter_TrajPointACCObj15_TrajPointACCObj15_dyv_sw_Pv
{
    qword rawValue = 0ll;
    float phyValue = 0.0;
    
    //update the raw value with physical value 
    {
        if(chgEv_TrajPointACCObj15_TrajPointACCObj15_dyv_sw == 0)
        {
            phyValue = getvalue(this);
            // physical to raw conversion
            rawValue = ((phyValue -(0))/0.0078125);
            putValue(E_pric_RadarFrontCenter_TrajPointACCObj15_TrajPointACCObj15_dyv_sw_Rv, rawValue);
            chgEv_TrajPointACCObj15_TrajPointACCObj15_dyv_sw = 1;  
        }
        else
        {
            chgEv_TrajPointACCObj15_TrajPointACCObj15_dyv_sw = 0;
        }
    }
}


 
on envVar E_pric_RadarFrontCenter_TrajPointACCObj15_TrajPointACCObj15_TrajEnd_b_Rv
{
    qword rawValue = 0ll;
    float rawValue_float = 0.0;
    float phyValue = 0.0;        

    //set the signal with updated raw value
    if(getValue(E_pric_RadarFrontCenter_TrajPointACCObj15_TrajPointACCObj15_TrajEnd_b_SetVt)==0)
    {
        rawValue = getvalue(this);
        if(chgEv_TrajPointACCObj15_TrajPointACCObj15_TrajEnd_b == 0)
        {
            //type conversion to float
            rawValue_float = rawValue;        
            // raw to physical conversion
            phyValue = ((rawValue_float *1)+(0));
            putValue(E_pric_RadarFrontCenter_TrajPointACCObj15_TrajPointACCObj15_TrajEnd_b_Pv, phyValue);
            chgEv_TrajPointACCObj15_TrajPointACCObj15_TrajEnd_b = 1;
        }
        else
        {
            chgEv_TrajPointACCObj15_TrajPointACCObj15_TrajEnd_b = 0;
        }    
        //update the signal value
        Msg_TrajPointACCObj15.TrajPointACCObj15_TrajEnd_b=rawValue;        
    }                                                                           
}

on envVar E_pric_RadarFrontCenter_TrajPointACCObj15_TrajPointACCObj15_TrajEnd_b_Pv
{
    qword rawValue = 0ll;
    float phyValue = 0.0;
    
    //update the raw value with physical value 
    if(getValue(E_pric_RadarFrontCenter_TrajPointACCObj15_TrajPointACCObj15_TrajEnd_b_SetVt)==0)
    {
        if(chgEv_TrajPointACCObj15_TrajPointACCObj15_TrajEnd_b == 0)
        {
            phyValue = getvalue(this);
            // physical to raw conversion
            rawValue = ((phyValue -(0))/1);
            putValue(E_pric_RadarFrontCenter_TrajPointACCObj15_TrajPointACCObj15_TrajEnd_b_Rv, rawValue);
            chgEv_TrajPointACCObj15_TrajPointACCObj15_TrajEnd_b = 1;  
        }
        else
        {
            chgEv_TrajPointACCObj15_TrajPointACCObj15_TrajEnd_b = 0;
        }
    }
}

on envVar E_pric_RadarFrontCenter_TrajPointACCObj15_TrajPointACCObj15_TrajEnd_b_Vt
{
    qword rawValue = 0ll;
    if(getValue(E_pric_RadarFrontCenter_TrajPointACCObj15_TrajPointACCObj15_TrajEnd_b_SetVt))
    {
        //update the signal value
        Msg_TrajPointACCObj15.TrajPointACCObj15_TrajEnd_b=getValue(this);
    }
}

on envVar E_pric_RadarFrontCenter_TrajPointACCObj15_TrajPointACCObj15_TrajEnd_b_SetVt
{
    if(getValue(E_pric_RadarFrontCenter_TrajPointACCObj15_TrajPointACCObj15_TrajEnd_b_SetVt))
    {
        //update the signal value
        Msg_TrajPointACCObj15.TrajPointACCObj15_TrajEnd_b=getvalue(E_pric_RadarFrontCenter_TrajPointACCObj15_TrajPointACCObj15_TrajEnd_b_Vt);
    }
    else
    {
        Msg_TrajPointACCObj15.TrajPointACCObj15_TrajEnd_b=getValue(E_pric_RadarFrontCenter_TrajPointACCObj15_TrajPointACCObj15_TrajEnd_b_Rv);
    }
}
 
on envVar E_pric_RadarFrontCenter_TrajPointACCObj15_TrajPointACCObj15_Drive_b_Rv
{
    qword rawValue = 0ll;
    float rawValue_float = 0.0;
    float phyValue = 0.0;        

    //set the signal with updated raw value
    if(getValue(E_pric_RadarFrontCenter_TrajPointACCObj15_TrajPointACCObj15_Drive_b_SetVt)==0)
    {
        rawValue = getvalue(this);
        if(chgEv_TrajPointACCObj15_TrajPointACCObj15_Drive_b == 0)
        {
            //type conversion to float
            rawValue_float = rawValue;        
            // raw to physical conversion
            phyValue = ((rawValue_float *1)+(0));
            putValue(E_pric_RadarFrontCenter_TrajPointACCObj15_TrajPointACCObj15_Drive_b_Pv, phyValue);
            chgEv_TrajPointACCObj15_TrajPointACCObj15_Drive_b = 1;
        }
        else
        {
            chgEv_TrajPointACCObj15_TrajPointACCObj15_Drive_b = 0;
        }    
        //update the signal value
        Msg_TrajPointACCObj15.TrajPointACCObj15_Drive_b=rawValue;        
    }                                                                           
}

on envVar E_pric_RadarFrontCenter_TrajPointACCObj15_TrajPointACCObj15_Drive_b_Pv
{
    qword rawValue = 0ll;
    float phyValue = 0.0;
    
    //update the raw value with physical value 
    if(getValue(E_pric_RadarFrontCenter_TrajPointACCObj15_TrajPointACCObj15_Drive_b_SetVt)==0)
    {
        if(chgEv_TrajPointACCObj15_TrajPointACCObj15_Drive_b == 0)
        {
            phyValue = getvalue(this);
            // physical to raw conversion
            rawValue = ((phyValue -(0))/1);
            putValue(E_pric_RadarFrontCenter_TrajPointACCObj15_TrajPointACCObj15_Drive_b_Rv, rawValue);
            chgEv_TrajPointACCObj15_TrajPointACCObj15_Drive_b = 1;  
        }
        else
        {
            chgEv_TrajPointACCObj15_TrajPointACCObj15_Drive_b = 0;
        }
    }
}

on envVar E_pric_RadarFrontCenter_TrajPointACCObj15_TrajPointACCObj15_Drive_b_Vt
{
    qword rawValue = 0ll;
    if(getValue(E_pric_RadarFrontCenter_TrajPointACCObj15_TrajPointACCObj15_Drive_b_SetVt))
    {
        //update the signal value
        Msg_TrajPointACCObj15.TrajPointACCObj15_Drive_b=getValue(this);
    }
}

on envVar E_pric_RadarFrontCenter_TrajPointACCObj15_TrajPointACCObj15_Drive_b_SetVt
{
    if(getValue(E_pric_RadarFrontCenter_TrajPointACCObj15_TrajPointACCObj15_Drive_b_SetVt))
    {
        //update the signal value
        Msg_TrajPointACCObj15.TrajPointACCObj15_Drive_b=getvalue(E_pric_RadarFrontCenter_TrajPointACCObj15_TrajPointACCObj15_Drive_b_Vt);
    }
    else
    {
        Msg_TrajPointACCObj15.TrajPointACCObj15_Drive_b=getValue(E_pric_RadarFrontCenter_TrajPointACCObj15_TrajPointACCObj15_Drive_b_Rv);
    }
}
 
on envVar E_pric_RadarFrontCenter_TrajPointACCObj15_TrajPointACCObj15_dVarYv_uw_Rv
{
    qword rawValue = 0ll;
    float rawValue_float = 0.0;
    float phyValue = 0.0;        

    //set the signal with updated raw value
    {
        rawValue = getvalue(this);
        if(chgEv_TrajPointACCObj15_TrajPointACCObj15_dVarYv_uw == 0)
        {
            //type conversion to float
            rawValue_float = rawValue;        
            // raw to physical conversion
            phyValue = ((rawValue_float *0.00195313)+(0));
            putValue(E_pric_RadarFrontCenter_TrajPointACCObj15_TrajPointACCObj15_dVarYv_uw_Pv, phyValue);
            chgEv_TrajPointACCObj15_TrajPointACCObj15_dVarYv_uw = 1;
        }
        else
        {
            chgEv_TrajPointACCObj15_TrajPointACCObj15_dVarYv_uw = 0;
        }    
        //update the signal value
        Msg_TrajPointACCObj15.TrajPointACCObj15_dVarYv_uw=rawValue;        
    }                                                                           
}

on envVar E_pric_RadarFrontCenter_TrajPointACCObj15_TrajPointACCObj15_dVarYv_uw_Pv
{
    qword rawValue = 0ll;
    float phyValue = 0.0;
    
    //update the raw value with physical value 
    {
        if(chgEv_TrajPointACCObj15_TrajPointACCObj15_dVarYv_uw == 0)
        {
            phyValue = getvalue(this);
            // physical to raw conversion
            rawValue = ((phyValue -(0))/0.00195313);
            putValue(E_pric_RadarFrontCenter_TrajPointACCObj15_TrajPointACCObj15_dVarYv_uw_Rv, rawValue);
            chgEv_TrajPointACCObj15_TrajPointACCObj15_dVarYv_uw = 1;  
        }
        else
        {
            chgEv_TrajPointACCObj15_TrajPointACCObj15_dVarYv_uw = 0;
        }
    }
}


 
on envVar E_pric_RadarFrontCenter_TrajPointACCObj15_TrajPointACCObj15_Valid_b_Rv
{
    qword rawValue = 0ll;
    float rawValue_float = 0.0;
    float phyValue = 0.0;        

    //set the signal with updated raw value
    if(getValue(E_pric_RadarFrontCenter_TrajPointACCObj15_TrajPointACCObj15_Valid_b_SetVt)==0)
    {
        rawValue = getvalue(this);
        if(chgEv_TrajPointACCObj15_TrajPointACCObj15_Valid_b == 0)
        {
            //type conversion to float
            rawValue_float = rawValue;        
            // raw to physical conversion
            phyValue = ((rawValue_float *1)+(0));
            putValue(E_pric_RadarFrontCenter_TrajPointACCObj15_TrajPointACCObj15_Valid_b_Pv, phyValue);
            chgEv_TrajPointACCObj15_TrajPointACCObj15_Valid_b = 1;
        }
        else
        {
            chgEv_TrajPointACCObj15_TrajPointACCObj15_Valid_b = 0;
        }    
        //update the signal value
        Msg_TrajPointACCObj15.TrajPointACCObj15_Valid_b=rawValue;        
    }                                                                           
}

on envVar E_pric_RadarFrontCenter_TrajPointACCObj15_TrajPointACCObj15_Valid_b_Pv
{
    qword rawValue = 0ll;
    float phyValue = 0.0;
    
    //update the raw value with physical value 
    if(getValue(E_pric_RadarFrontCenter_TrajPointACCObj15_TrajPointACCObj15_Valid_b_SetVt)==0)
    {
        if(chgEv_TrajPointACCObj15_TrajPointACCObj15_Valid_b == 0)
        {
            phyValue = getvalue(this);
            // physical to raw conversion
            rawValue = ((phyValue -(0))/1);
            putValue(E_pric_RadarFrontCenter_TrajPointACCObj15_TrajPointACCObj15_Valid_b_Rv, rawValue);
            chgEv_TrajPointACCObj15_TrajPointACCObj15_Valid_b = 1;  
        }
        else
        {
            chgEv_TrajPointACCObj15_TrajPointACCObj15_Valid_b = 0;
        }
    }
}

on envVar E_pric_RadarFrontCenter_TrajPointACCObj15_TrajPointACCObj15_Valid_b_Vt
{
    qword rawValue = 0ll;
    if(getValue(E_pric_RadarFrontCenter_TrajPointACCObj15_TrajPointACCObj15_Valid_b_SetVt))
    {
        //update the signal value
        Msg_TrajPointACCObj15.TrajPointACCObj15_Valid_b=getValue(this);
    }
}

on envVar E_pric_RadarFrontCenter_TrajPointACCObj15_TrajPointACCObj15_Valid_b_SetVt
{
    if(getValue(E_pric_RadarFrontCenter_TrajPointACCObj15_TrajPointACCObj15_Valid_b_SetVt))
    {
        //update the signal value
        Msg_TrajPointACCObj15.TrajPointACCObj15_Valid_b=getvalue(E_pric_RadarFrontCenter_TrajPointACCObj15_TrajPointACCObj15_Valid_b_Vt);
    }
    else
    {
        Msg_TrajPointACCObj15.TrajPointACCObj15_Valid_b=getValue(E_pric_RadarFrontCenter_TrajPointACCObj15_TrajPointACCObj15_Valid_b_Rv);
    }
}
 
on envVar E_pric_RadarFrontCenter_TrajPointACCObj14_tx
{
    if(getValue(this))
    {       
        
        //update the BZ Signal
        if(TrajPointACCObj14_TrajPointACCObj14_blockCtr_wrongvalctr == 0)
        {
            update_TrajPointACCObj14_TrajPointACCObj14_blockCtr_counter();
            Msg_TrajPointACCObj14.TrajPointACCObj14_blockCtr= TrajPointACCObj14_TrajPointACCObj14_blockCtr_counter;
        }
        else if(TrajPointACCObj14_TrajPointACCObj14_blockCtr_wrongvalctr > 0)
        {
             TrajPointACCObj14_TrajPointACCObj14_blockCtr_wrongvalctr--;
              // if counter becomes zero, update panel controller to zero
             if(TrajPointACCObj14_TrajPointACCObj14_blockCtr_wrongvalctr == 0)
             {
                 putValue(E_pric_RadarFrontCenter_TrajPointACCObj14_TrajPointACCObj14_blockCtr_wrongvalctr,0);
             }
        }
        else
        {
            //do nothing
        }        
        //update the BZ Signal
        if(TrajPointACCObj14_TrajPointACCObj14_MsgCtr_wrongvalctr == 0)
        {
            update_TrajPointACCObj14_TrajPointACCObj14_MsgCtr_counter();
            Msg_TrajPointACCObj14.TrajPointACCObj14_MsgCtr= TrajPointACCObj14_TrajPointACCObj14_MsgCtr_counter;
        }
        else if(TrajPointACCObj14_TrajPointACCObj14_MsgCtr_wrongvalctr > 0)
        {
             TrajPointACCObj14_TrajPointACCObj14_MsgCtr_wrongvalctr--;
              // if counter becomes zero, update panel controller to zero
             if(TrajPointACCObj14_TrajPointACCObj14_MsgCtr_wrongvalctr == 0)
             {
                 putValue(E_pric_RadarFrontCenter_TrajPointACCObj14_TrajPointACCObj14_MsgCtr_wrongvalctr,0);
             }
        }
        else
        {
            //do nothing
        }        
        //calculate the CRC checksum
        update_TrajPointACCObj14_ChkSum_Checksum();

        output(Msg_TrajPointACCObj14);        
    }
}

on envVar E_pric_RadarFrontCenter_TrajPointACCObj14_Range
{
    qword rawstatus = 0ll;
    qword rawValue = 0ll;    
    
    rawstatus = getvalue(this);    
    // set all the signals with min raw /max raw /init raw
    switch (rawstatus) 
    {
     case(0) :
        rawValue= 0;
        putValue(E_pric_RadarFrontCenter_TrajPointACCObj14_TrajPointACCObj14_timestamp_Rv, rawValue);
        rawValue= 0;
        putValue(E_pric_RadarFrontCenter_TrajPointACCObj14_TrajPointACCObj14_dVarXv_uw_Rv, rawValue);
        rawValue= 0;
        putValue(E_pric_RadarFrontCenter_TrajPointACCObj14_TrajPointACCObj14_Valid_b_Rv, rawValue);
        rawValue= 0;
        putValue(E_pric_RadarFrontCenter_TrajPointACCObj14_TrajPointACCObj14_dVarYv_uw_Rv, rawValue);
        rawValue= 0;
        putValue(E_pric_RadarFrontCenter_TrajPointACCObj14_TrajPointACCObj14_TrajEnd_b_Rv, rawValue);
        rawValue= -32768;
        putValue(E_pric_RadarFrontCenter_TrajPointACCObj14_TrajPointACCObj14_dxv_sw_Rv, rawValue);
        rawValue= 0;
        putValue(E_pric_RadarFrontCenter_TrajPointACCObj14_TrajPointACCObj14_Stopped_b_Rv, rawValue);
        rawValue= 0;
        putValue(E_pric_RadarFrontCenter_TrajPointACCObj14_TrajPointACCObj14_wExistProb_ub_Rv, rawValue);
        rawValue= 0;
        putValue(E_pric_RadarFrontCenter_TrajPointACCObj14_TrajPointACCObj14_Stand_b_Rv, rawValue);
        rawValue= -32768;
        putValue(E_pric_RadarFrontCenter_TrajPointACCObj14_TrajPointACCObj14_dyv_sw_Rv, rawValue);
        rawValue= 0;
        putValue(E_pric_RadarFrontCenter_TrajPointACCObj14_TrajPointACCObj14_InvDir_b_Rv, rawValue);
        rawValue= 0;
        putValue(E_pric_RadarFrontCenter_TrajPointACCObj14_TrajPointACCObj14_Drive_b_Rv, rawValue);
        break;
     case(1) :
        rawValue= 65536;
        putValue(E_pric_RadarFrontCenter_TrajPointACCObj14_TrajPointACCObj14_timestamp_Rv, rawValue);
        rawValue= 65534;
        putValue(E_pric_RadarFrontCenter_TrajPointACCObj14_TrajPointACCObj14_dVarXv_uw_Rv, rawValue);
        rawValue= 1;
        putValue(E_pric_RadarFrontCenter_TrajPointACCObj14_TrajPointACCObj14_Valid_b_Rv, rawValue);
        rawValue= 65534;
        putValue(E_pric_RadarFrontCenter_TrajPointACCObj14_TrajPointACCObj14_dVarYv_uw_Rv, rawValue);
        rawValue= 1;
        putValue(E_pric_RadarFrontCenter_TrajPointACCObj14_TrajPointACCObj14_TrajEnd_b_Rv, rawValue);
        rawValue= 32767;
        putValue(E_pric_RadarFrontCenter_TrajPointACCObj14_TrajPointACCObj14_dxv_sw_Rv, rawValue);
        rawValue= 1;
        putValue(E_pric_RadarFrontCenter_TrajPointACCObj14_TrajPointACCObj14_Stopped_b_Rv, rawValue);
        rawValue= 255;
        putValue(E_pric_RadarFrontCenter_TrajPointACCObj14_TrajPointACCObj14_wExistProb_ub_Rv, rawValue);
        rawValue= 1;
        putValue(E_pric_RadarFrontCenter_TrajPointACCObj14_TrajPointACCObj14_Stand_b_Rv, rawValue);
        rawValue= 32767;
        putValue(E_pric_RadarFrontCenter_TrajPointACCObj14_TrajPointACCObj14_dyv_sw_Rv, rawValue);
        rawValue= 1;
        putValue(E_pric_RadarFrontCenter_TrajPointACCObj14_TrajPointACCObj14_InvDir_b_Rv, rawValue);
        rawValue= 1;
        putValue(E_pric_RadarFrontCenter_TrajPointACCObj14_TrajPointACCObj14_Drive_b_Rv, rawValue);
        break;
     default :
        rawValue= 0;
        putValue(E_pric_RadarFrontCenter_TrajPointACCObj14_TrajPointACCObj14_timestamp_Rv, rawValue);
        rawValue= 0;
        putValue(E_pric_RadarFrontCenter_TrajPointACCObj14_TrajPointACCObj14_dVarXv_uw_Rv, rawValue);
        rawValue= 0;
        putValue(E_pric_RadarFrontCenter_TrajPointACCObj14_TrajPointACCObj14_Valid_b_Rv, rawValue);
        rawValue= 0;
        putValue(E_pric_RadarFrontCenter_TrajPointACCObj14_TrajPointACCObj14_dVarYv_uw_Rv, rawValue);
        rawValue= 0;
        putValue(E_pric_RadarFrontCenter_TrajPointACCObj14_TrajPointACCObj14_TrajEnd_b_Rv, rawValue);
        rawValue= -32768;
        putValue(E_pric_RadarFrontCenter_TrajPointACCObj14_TrajPointACCObj14_dxv_sw_Rv, rawValue);
        rawValue= 0;
        putValue(E_pric_RadarFrontCenter_TrajPointACCObj14_TrajPointACCObj14_Stopped_b_Rv, rawValue);
        rawValue= 0;
        putValue(E_pric_RadarFrontCenter_TrajPointACCObj14_TrajPointACCObj14_wExistProb_ub_Rv, rawValue);
        rawValue= 0;
        putValue(E_pric_RadarFrontCenter_TrajPointACCObj14_TrajPointACCObj14_Stand_b_Rv, rawValue);
        rawValue= -32768;
        putValue(E_pric_RadarFrontCenter_TrajPointACCObj14_TrajPointACCObj14_dyv_sw_Rv, rawValue);
        rawValue= 0;
        putValue(E_pric_RadarFrontCenter_TrajPointACCObj14_TrajPointACCObj14_InvDir_b_Rv, rawValue);
        rawValue= 0;
        putValue(E_pric_RadarFrontCenter_TrajPointACCObj14_TrajPointACCObj14_Drive_b_Rv, rawValue);
      break;
   }
}

on envVar E_pric_RadarFrontCenter_TrajPointACCObj14_Dlc
{
    if(getValue(E_pric_RadarFrontCenter_TrajPointACCObj14_enDlc))
    {
        Msg_TrajPointACCObj14.dlc =getValue(this);
    }
    else
    {
       Dbc_dlc = 16;
	   Msg_TrajPointACCObj14.dlc = Calc_Canfd_dlc(Dbc_dlc);
	   	
  }
}

on envVar E_pric_RadarFrontCenter_TrajPointACCObj14_enDlc
{
    //For Messages with DLC = 8, set wrong DLC to smaller than defined DLC
    //For Messages with DLC < 8 set wrong DLC to smaller/longer than defined DLC
    if(getValue(this))
    {
        Msg_TrajPointACCObj14.dlc =getValue(E_pric_RadarFrontCenter_TrajPointACCObj14_Dlc);
    }
    else
    {
       Dbc_dlc = 16;
	   Msg_TrajPointACCObj14.dlc = Calc_Canfd_dlc(Dbc_dlc);
			
    }
}

on envVar E_pric_RadarFrontCenter_TrajPointACCObj14_TrajPointACCObj14_CRC_wrongvalctr
{
    //update disturb count
    //disturb value range:(-1 = always send wrong value),( X>0 ,x is the number of Messages with wrong CHK sent)
    TrajPointACCObj14_TrajPointACCObj14_CRC_wrongvalctr =getValue(this);    
}
on envVar E_pric_RadarFrontCenter_TrajPointACCObj14_TrajPointACCObj14_MsgCtr_wrongvalctr
{
    //update disturb count
    //disturb value range:(-1 = always send wrong value),( X>0 ,x is the number of Messages with wrong CHK sent)
    TrajPointACCObj14_TrajPointACCObj14_MsgCtr_wrongvalctr =getValue(this);    
}
on envVar E_pric_RadarFrontCenter_TrajPointACCObj14_TrajPointACCObj14_blockCtr_wrongvalctr
{
    //update disturb count
    //disturb value range:(-1 = always send wrong value),( X>0 ,x is the number of Messages with wrong CHK sent)
    TrajPointACCObj14_TrajPointACCObj14_blockCtr_wrongvalctr =getValue(this);    
}

on envVar E_pric_RadarFrontCenter_TrajPointACCObj14_TrajPointACCObj14_timestamp_Rv
{
    qword rawValue = 0ll;
    float rawValue_float = 0.0;
    float phyValue = 0.0;        

    //set the signal with updated raw value
    {
        rawValue = getvalue(this);
        if(chgEv_TrajPointACCObj14_TrajPointACCObj14_timestamp == 0)
        {
            //type conversion to float
            rawValue_float = rawValue;        
            // raw to physical conversion
            phyValue = ((rawValue_float *0.000488281)+(0));
            putValue(E_pric_RadarFrontCenter_TrajPointACCObj14_TrajPointACCObj14_timestamp_Pv, phyValue);
            chgEv_TrajPointACCObj14_TrajPointACCObj14_timestamp = 1;
        }
        else
        {
            chgEv_TrajPointACCObj14_TrajPointACCObj14_timestamp = 0;
        }    
        //update the signal value
        Msg_TrajPointACCObj14.TrajPointACCObj14_timestamp=rawValue;        
    }                                                                           
}

on envVar E_pric_RadarFrontCenter_TrajPointACCObj14_TrajPointACCObj14_timestamp_Pv
{
    qword rawValue = 0ll;
    float phyValue = 0.0;
    
    //update the raw value with physical value 
    {
        if(chgEv_TrajPointACCObj14_TrajPointACCObj14_timestamp == 0)
        {
            phyValue = getvalue(this);
            // physical to raw conversion
            rawValue = ((phyValue -(0))/0.000488281);
            putValue(E_pric_RadarFrontCenter_TrajPointACCObj14_TrajPointACCObj14_timestamp_Rv, rawValue);
            chgEv_TrajPointACCObj14_TrajPointACCObj14_timestamp = 1;  
        }
        else
        {
            chgEv_TrajPointACCObj14_TrajPointACCObj14_timestamp = 0;
        }
    }
}


 
on envVar E_pric_RadarFrontCenter_TrajPointACCObj14_TrajPointACCObj14_dVarXv_uw_Rv
{
    qword rawValue = 0ll;
    float rawValue_float = 0.0;
    float phyValue = 0.0;        

    //set the signal with updated raw value
    {
        rawValue = getvalue(this);
        if(chgEv_TrajPointACCObj14_TrajPointACCObj14_dVarXv_uw == 0)
        {
            //type conversion to float
            rawValue_float = rawValue;        
            // raw to physical conversion
            phyValue = ((rawValue_float *0.00195313)+(0));
            putValue(E_pric_RadarFrontCenter_TrajPointACCObj14_TrajPointACCObj14_dVarXv_uw_Pv, phyValue);
            chgEv_TrajPointACCObj14_TrajPointACCObj14_dVarXv_uw = 1;
        }
        else
        {
            chgEv_TrajPointACCObj14_TrajPointACCObj14_dVarXv_uw = 0;
        }    
        //update the signal value
        Msg_TrajPointACCObj14.TrajPointACCObj14_dVarXv_uw=rawValue;        
    }                                                                           
}

on envVar E_pric_RadarFrontCenter_TrajPointACCObj14_TrajPointACCObj14_dVarXv_uw_Pv
{
    qword rawValue = 0ll;
    float phyValue = 0.0;
    
    //update the raw value with physical value 
    {
        if(chgEv_TrajPointACCObj14_TrajPointACCObj14_dVarXv_uw == 0)
        {
            phyValue = getvalue(this);
            // physical to raw conversion
            rawValue = ((phyValue -(0))/0.00195313);
            putValue(E_pric_RadarFrontCenter_TrajPointACCObj14_TrajPointACCObj14_dVarXv_uw_Rv, rawValue);
            chgEv_TrajPointACCObj14_TrajPointACCObj14_dVarXv_uw = 1;  
        }
        else
        {
            chgEv_TrajPointACCObj14_TrajPointACCObj14_dVarXv_uw = 0;
        }
    }
}


 
on envVar E_pric_RadarFrontCenter_TrajPointACCObj14_TrajPointACCObj14_Valid_b_Rv
{
    qword rawValue = 0ll;
    float rawValue_float = 0.0;
    float phyValue = 0.0;        

    //set the signal with updated raw value
    if(getValue(E_pric_RadarFrontCenter_TrajPointACCObj14_TrajPointACCObj14_Valid_b_SetVt)==0)
    {
        rawValue = getvalue(this);
        if(chgEv_TrajPointACCObj14_TrajPointACCObj14_Valid_b == 0)
        {
            //type conversion to float
            rawValue_float = rawValue;        
            // raw to physical conversion
            phyValue = ((rawValue_float *1)+(0));
            putValue(E_pric_RadarFrontCenter_TrajPointACCObj14_TrajPointACCObj14_Valid_b_Pv, phyValue);
            chgEv_TrajPointACCObj14_TrajPointACCObj14_Valid_b = 1;
        }
        else
        {
            chgEv_TrajPointACCObj14_TrajPointACCObj14_Valid_b = 0;
        }    
        //update the signal value
        Msg_TrajPointACCObj14.TrajPointACCObj14_Valid_b=rawValue;        
    }                                                                           
}

on envVar E_pric_RadarFrontCenter_TrajPointACCObj14_TrajPointACCObj14_Valid_b_Pv
{
    qword rawValue = 0ll;
    float phyValue = 0.0;
    
    //update the raw value with physical value 
    if(getValue(E_pric_RadarFrontCenter_TrajPointACCObj14_TrajPointACCObj14_Valid_b_SetVt)==0)
    {
        if(chgEv_TrajPointACCObj14_TrajPointACCObj14_Valid_b == 0)
        {
            phyValue = getvalue(this);
            // physical to raw conversion
            rawValue = ((phyValue -(0))/1);
            putValue(E_pric_RadarFrontCenter_TrajPointACCObj14_TrajPointACCObj14_Valid_b_Rv, rawValue);
            chgEv_TrajPointACCObj14_TrajPointACCObj14_Valid_b = 1;  
        }
        else
        {
            chgEv_TrajPointACCObj14_TrajPointACCObj14_Valid_b = 0;
        }
    }
}

on envVar E_pric_RadarFrontCenter_TrajPointACCObj14_TrajPointACCObj14_Valid_b_Vt
{
    qword rawValue = 0ll;
    if(getValue(E_pric_RadarFrontCenter_TrajPointACCObj14_TrajPointACCObj14_Valid_b_SetVt))
    {
        //update the signal value
        Msg_TrajPointACCObj14.TrajPointACCObj14_Valid_b=getValue(this);
    }
}

on envVar E_pric_RadarFrontCenter_TrajPointACCObj14_TrajPointACCObj14_Valid_b_SetVt
{
    if(getValue(E_pric_RadarFrontCenter_TrajPointACCObj14_TrajPointACCObj14_Valid_b_SetVt))
    {
        //update the signal value
        Msg_TrajPointACCObj14.TrajPointACCObj14_Valid_b=getvalue(E_pric_RadarFrontCenter_TrajPointACCObj14_TrajPointACCObj14_Valid_b_Vt);
    }
    else
    {
        Msg_TrajPointACCObj14.TrajPointACCObj14_Valid_b=getValue(E_pric_RadarFrontCenter_TrajPointACCObj14_TrajPointACCObj14_Valid_b_Rv);
    }
}
 
on envVar E_pric_RadarFrontCenter_TrajPointACCObj14_TrajPointACCObj14_dVarYv_uw_Rv
{
    qword rawValue = 0ll;
    float rawValue_float = 0.0;
    float phyValue = 0.0;        

    //set the signal with updated raw value
    {
        rawValue = getvalue(this);
        if(chgEv_TrajPointACCObj14_TrajPointACCObj14_dVarYv_uw == 0)
        {
            //type conversion to float
            rawValue_float = rawValue;        
            // raw to physical conversion
            phyValue = ((rawValue_float *0.00195313)+(0));
            putValue(E_pric_RadarFrontCenter_TrajPointACCObj14_TrajPointACCObj14_dVarYv_uw_Pv, phyValue);
            chgEv_TrajPointACCObj14_TrajPointACCObj14_dVarYv_uw = 1;
        }
        else
        {
            chgEv_TrajPointACCObj14_TrajPointACCObj14_dVarYv_uw = 0;
        }    
        //update the signal value
        Msg_TrajPointACCObj14.TrajPointACCObj14_dVarYv_uw=rawValue;        
    }                                                                           
}

on envVar E_pric_RadarFrontCenter_TrajPointACCObj14_TrajPointACCObj14_dVarYv_uw_Pv
{
    qword rawValue = 0ll;
    float phyValue = 0.0;
    
    //update the raw value with physical value 
    {
        if(chgEv_TrajPointACCObj14_TrajPointACCObj14_dVarYv_uw == 0)
        {
            phyValue = getvalue(this);
            // physical to raw conversion
            rawValue = ((phyValue -(0))/0.00195313);
            putValue(E_pric_RadarFrontCenter_TrajPointACCObj14_TrajPointACCObj14_dVarYv_uw_Rv, rawValue);
            chgEv_TrajPointACCObj14_TrajPointACCObj14_dVarYv_uw = 1;  
        }
        else
        {
            chgEv_TrajPointACCObj14_TrajPointACCObj14_dVarYv_uw = 0;
        }
    }
}


 
on envVar E_pric_RadarFrontCenter_TrajPointACCObj14_TrajPointACCObj14_TrajEnd_b_Rv
{
    qword rawValue = 0ll;
    float rawValue_float = 0.0;
    float phyValue = 0.0;        

    //set the signal with updated raw value
    if(getValue(E_pric_RadarFrontCenter_TrajPointACCObj14_TrajPointACCObj14_TrajEnd_b_SetVt)==0)
    {
        rawValue = getvalue(this);
        if(chgEv_TrajPointACCObj14_TrajPointACCObj14_TrajEnd_b == 0)
        {
            //type conversion to float
            rawValue_float = rawValue;        
            // raw to physical conversion
            phyValue = ((rawValue_float *1)+(0));
            putValue(E_pric_RadarFrontCenter_TrajPointACCObj14_TrajPointACCObj14_TrajEnd_b_Pv, phyValue);
            chgEv_TrajPointACCObj14_TrajPointACCObj14_TrajEnd_b = 1;
        }
        else
        {
            chgEv_TrajPointACCObj14_TrajPointACCObj14_TrajEnd_b = 0;
        }    
        //update the signal value
        Msg_TrajPointACCObj14.TrajPointACCObj14_TrajEnd_b=rawValue;        
    }                                                                           
}

on envVar E_pric_RadarFrontCenter_TrajPointACCObj14_TrajPointACCObj14_TrajEnd_b_Pv
{
    qword rawValue = 0ll;
    float phyValue = 0.0;
    
    //update the raw value with physical value 
    if(getValue(E_pric_RadarFrontCenter_TrajPointACCObj14_TrajPointACCObj14_TrajEnd_b_SetVt)==0)
    {
        if(chgEv_TrajPointACCObj14_TrajPointACCObj14_TrajEnd_b == 0)
        {
            phyValue = getvalue(this);
            // physical to raw conversion
            rawValue = ((phyValue -(0))/1);
            putValue(E_pric_RadarFrontCenter_TrajPointACCObj14_TrajPointACCObj14_TrajEnd_b_Rv, rawValue);
            chgEv_TrajPointACCObj14_TrajPointACCObj14_TrajEnd_b = 1;  
        }
        else
        {
            chgEv_TrajPointACCObj14_TrajPointACCObj14_TrajEnd_b = 0;
        }
    }
}

on envVar E_pric_RadarFrontCenter_TrajPointACCObj14_TrajPointACCObj14_TrajEnd_b_Vt
{
    qword rawValue = 0ll;
    if(getValue(E_pric_RadarFrontCenter_TrajPointACCObj14_TrajPointACCObj14_TrajEnd_b_SetVt))
    {
        //update the signal value
        Msg_TrajPointACCObj14.TrajPointACCObj14_TrajEnd_b=getValue(this);
    }
}

on envVar E_pric_RadarFrontCenter_TrajPointACCObj14_TrajPointACCObj14_TrajEnd_b_SetVt
{
    if(getValue(E_pric_RadarFrontCenter_TrajPointACCObj14_TrajPointACCObj14_TrajEnd_b_SetVt))
    {
        //update the signal value
        Msg_TrajPointACCObj14.TrajPointACCObj14_TrajEnd_b=getvalue(E_pric_RadarFrontCenter_TrajPointACCObj14_TrajPointACCObj14_TrajEnd_b_Vt);
    }
    else
    {
        Msg_TrajPointACCObj14.TrajPointACCObj14_TrajEnd_b=getValue(E_pric_RadarFrontCenter_TrajPointACCObj14_TrajPointACCObj14_TrajEnd_b_Rv);
    }
}
 
on envVar E_pric_RadarFrontCenter_TrajPointACCObj14_TrajPointACCObj14_dxv_sw_Rv
{
    qword rawValue = 0ll;
    float rawValue_float = 0.0;
    float phyValue = 0.0;        

    //set the signal with updated raw value
    {
        rawValue = getvalue(this);
        if(chgEv_TrajPointACCObj14_TrajPointACCObj14_dxv_sw == 0)
        {
            //type conversion to float
            rawValue_float = rawValue;        
            // raw to physical conversion
            phyValue = ((rawValue_float *0.0078125)+(0));
            putValue(E_pric_RadarFrontCenter_TrajPointACCObj14_TrajPointACCObj14_dxv_sw_Pv, phyValue);
            chgEv_TrajPointACCObj14_TrajPointACCObj14_dxv_sw = 1;
        }
        else
        {
            chgEv_TrajPointACCObj14_TrajPointACCObj14_dxv_sw = 0;
        }    
        //update the signal value
        Msg_TrajPointACCObj14.TrajPointACCObj14_dxv_sw=rawValue;        
    }                                                                           
}

on envVar E_pric_RadarFrontCenter_TrajPointACCObj14_TrajPointACCObj14_dxv_sw_Pv
{
    qword rawValue = 0ll;
    float phyValue = 0.0;
    
    //update the raw value with physical value 
    {
        if(chgEv_TrajPointACCObj14_TrajPointACCObj14_dxv_sw == 0)
        {
            phyValue = getvalue(this);
            // physical to raw conversion
            rawValue = ((phyValue -(0))/0.0078125);
            putValue(E_pric_RadarFrontCenter_TrajPointACCObj14_TrajPointACCObj14_dxv_sw_Rv, rawValue);
            chgEv_TrajPointACCObj14_TrajPointACCObj14_dxv_sw = 1;  
        }
        else
        {
            chgEv_TrajPointACCObj14_TrajPointACCObj14_dxv_sw = 0;
        }
    }
}


 
on envVar E_pric_RadarFrontCenter_TrajPointACCObj14_TrajPointACCObj14_Stopped_b_Rv
{
    qword rawValue = 0ll;
    float rawValue_float = 0.0;
    float phyValue = 0.0;        

    //set the signal with updated raw value
    if(getValue(E_pric_RadarFrontCenter_TrajPointACCObj14_TrajPointACCObj14_Stopped_b_SetVt)==0)
    {
        rawValue = getvalue(this);
        if(chgEv_TrajPointACCObj14_TrajPointACCObj14_Stopped_b == 0)
        {
            //type conversion to float
            rawValue_float = rawValue;        
            // raw to physical conversion
            phyValue = ((rawValue_float *1)+(0));
            putValue(E_pric_RadarFrontCenter_TrajPointACCObj14_TrajPointACCObj14_Stopped_b_Pv, phyValue);
            chgEv_TrajPointACCObj14_TrajPointACCObj14_Stopped_b = 1;
        }
        else
        {
            chgEv_TrajPointACCObj14_TrajPointACCObj14_Stopped_b = 0;
        }    
        //update the signal value
        Msg_TrajPointACCObj14.TrajPointACCObj14_Stopped_b=rawValue;        
    }                                                                           
}

on envVar E_pric_RadarFrontCenter_TrajPointACCObj14_TrajPointACCObj14_Stopped_b_Pv
{
    qword rawValue = 0ll;
    float phyValue = 0.0;
    
    //update the raw value with physical value 
    if(getValue(E_pric_RadarFrontCenter_TrajPointACCObj14_TrajPointACCObj14_Stopped_b_SetVt)==0)
    {
        if(chgEv_TrajPointACCObj14_TrajPointACCObj14_Stopped_b == 0)
        {
            phyValue = getvalue(this);
            // physical to raw conversion
            rawValue = ((phyValue -(0))/1);
            putValue(E_pric_RadarFrontCenter_TrajPointACCObj14_TrajPointACCObj14_Stopped_b_Rv, rawValue);
            chgEv_TrajPointACCObj14_TrajPointACCObj14_Stopped_b = 1;  
        }
        else
        {
            chgEv_TrajPointACCObj14_TrajPointACCObj14_Stopped_b = 0;
        }
    }
}

on envVar E_pric_RadarFrontCenter_TrajPointACCObj14_TrajPointACCObj14_Stopped_b_Vt
{
    qword rawValue = 0ll;
    if(getValue(E_pric_RadarFrontCenter_TrajPointACCObj14_TrajPointACCObj14_Stopped_b_SetVt))
    {
        //update the signal value
        Msg_TrajPointACCObj14.TrajPointACCObj14_Stopped_b=getValue(this);
    }
}

on envVar E_pric_RadarFrontCenter_TrajPointACCObj14_TrajPointACCObj14_Stopped_b_SetVt
{
    if(getValue(E_pric_RadarFrontCenter_TrajPointACCObj14_TrajPointACCObj14_Stopped_b_SetVt))
    {
        //update the signal value
        Msg_TrajPointACCObj14.TrajPointACCObj14_Stopped_b=getvalue(E_pric_RadarFrontCenter_TrajPointACCObj14_TrajPointACCObj14_Stopped_b_Vt);
    }
    else
    {
        Msg_TrajPointACCObj14.TrajPointACCObj14_Stopped_b=getValue(E_pric_RadarFrontCenter_TrajPointACCObj14_TrajPointACCObj14_Stopped_b_Rv);
    }
}
 
on envVar E_pric_RadarFrontCenter_TrajPointACCObj14_TrajPointACCObj14_wExistProb_ub_Rv
{
    qword rawValue = 0ll;
    float rawValue_float = 0.0;
    float phyValue = 0.0;        

    //set the signal with updated raw value
    {
        rawValue = getvalue(this);
        if(chgEv_TrajPointACCObj14_TrajPointACCObj14_wExistProb_ub == 0)
        {
            //type conversion to float
            rawValue_float = rawValue;        
            // raw to physical conversion
            phyValue = ((rawValue_float *0.00390625)+(0));
            putValue(E_pric_RadarFrontCenter_TrajPointACCObj14_TrajPointACCObj14_wExistProb_ub_Pv, phyValue);
            chgEv_TrajPointACCObj14_TrajPointACCObj14_wExistProb_ub = 1;
        }
        else
        {
            chgEv_TrajPointACCObj14_TrajPointACCObj14_wExistProb_ub = 0;
        }    
        //update the signal value
        Msg_TrajPointACCObj14.TrajPointACCObj14_wExistProb_ub=rawValue;        
    }                                                                           
}

on envVar E_pric_RadarFrontCenter_TrajPointACCObj14_TrajPointACCObj14_wExistProb_ub_Pv
{
    qword rawValue = 0ll;
    float phyValue = 0.0;
    
    //update the raw value with physical value 
    {
        if(chgEv_TrajPointACCObj14_TrajPointACCObj14_wExistProb_ub == 0)
        {
            phyValue = getvalue(this);
            // physical to raw conversion
            rawValue = ((phyValue -(0))/0.00390625);
            putValue(E_pric_RadarFrontCenter_TrajPointACCObj14_TrajPointACCObj14_wExistProb_ub_Rv, rawValue);
            chgEv_TrajPointACCObj14_TrajPointACCObj14_wExistProb_ub = 1;  
        }
        else
        {
            chgEv_TrajPointACCObj14_TrajPointACCObj14_wExistProb_ub = 0;
        }
    }
}


 
on envVar E_pric_RadarFrontCenter_TrajPointACCObj14_TrajPointACCObj14_Stand_b_Rv
{
    qword rawValue = 0ll;
    float rawValue_float = 0.0;
    float phyValue = 0.0;        

    //set the signal with updated raw value
    if(getValue(E_pric_RadarFrontCenter_TrajPointACCObj14_TrajPointACCObj14_Stand_b_SetVt)==0)
    {
        rawValue = getvalue(this);
        if(chgEv_TrajPointACCObj14_TrajPointACCObj14_Stand_b == 0)
        {
            //type conversion to float
            rawValue_float = rawValue;        
            // raw to physical conversion
            phyValue = ((rawValue_float *1)+(0));
            putValue(E_pric_RadarFrontCenter_TrajPointACCObj14_TrajPointACCObj14_Stand_b_Pv, phyValue);
            chgEv_TrajPointACCObj14_TrajPointACCObj14_Stand_b = 1;
        }
        else
        {
            chgEv_TrajPointACCObj14_TrajPointACCObj14_Stand_b = 0;
        }    
        //update the signal value
        Msg_TrajPointACCObj14.TrajPointACCObj14_Stand_b=rawValue;        
    }                                                                           
}

on envVar E_pric_RadarFrontCenter_TrajPointACCObj14_TrajPointACCObj14_Stand_b_Pv
{
    qword rawValue = 0ll;
    float phyValue = 0.0;
    
    //update the raw value with physical value 
    if(getValue(E_pric_RadarFrontCenter_TrajPointACCObj14_TrajPointACCObj14_Stand_b_SetVt)==0)
    {
        if(chgEv_TrajPointACCObj14_TrajPointACCObj14_Stand_b == 0)
        {
            phyValue = getvalue(this);
            // physical to raw conversion
            rawValue = ((phyValue -(0))/1);
            putValue(E_pric_RadarFrontCenter_TrajPointACCObj14_TrajPointACCObj14_Stand_b_Rv, rawValue);
            chgEv_TrajPointACCObj14_TrajPointACCObj14_Stand_b = 1;  
        }
        else
        {
            chgEv_TrajPointACCObj14_TrajPointACCObj14_Stand_b = 0;
        }
    }
}

on envVar E_pric_RadarFrontCenter_TrajPointACCObj14_TrajPointACCObj14_Stand_b_Vt
{
    qword rawValue = 0ll;
    if(getValue(E_pric_RadarFrontCenter_TrajPointACCObj14_TrajPointACCObj14_Stand_b_SetVt))
    {
        //update the signal value
        Msg_TrajPointACCObj14.TrajPointACCObj14_Stand_b=getValue(this);
    }
}

on envVar E_pric_RadarFrontCenter_TrajPointACCObj14_TrajPointACCObj14_Stand_b_SetVt
{
    if(getValue(E_pric_RadarFrontCenter_TrajPointACCObj14_TrajPointACCObj14_Stand_b_SetVt))
    {
        //update the signal value
        Msg_TrajPointACCObj14.TrajPointACCObj14_Stand_b=getvalue(E_pric_RadarFrontCenter_TrajPointACCObj14_TrajPointACCObj14_Stand_b_Vt);
    }
    else
    {
        Msg_TrajPointACCObj14.TrajPointACCObj14_Stand_b=getValue(E_pric_RadarFrontCenter_TrajPointACCObj14_TrajPointACCObj14_Stand_b_Rv);
    }
}
 
on envVar E_pric_RadarFrontCenter_TrajPointACCObj14_TrajPointACCObj14_dyv_sw_Rv
{
    qword rawValue = 0ll;
    float rawValue_float = 0.0;
    float phyValue = 0.0;        

    //set the signal with updated raw value
    {
        rawValue = getvalue(this);
        if(chgEv_TrajPointACCObj14_TrajPointACCObj14_dyv_sw == 0)
        {
            //type conversion to float
            rawValue_float = rawValue;        
            // raw to physical conversion
            phyValue = ((rawValue_float *0.0078125)+(0));
            putValue(E_pric_RadarFrontCenter_TrajPointACCObj14_TrajPointACCObj14_dyv_sw_Pv, phyValue);
            chgEv_TrajPointACCObj14_TrajPointACCObj14_dyv_sw = 1;
        }
        else
        {
            chgEv_TrajPointACCObj14_TrajPointACCObj14_dyv_sw = 0;
        }    
        //update the signal value
        Msg_TrajPointACCObj14.TrajPointACCObj14_dyv_sw=rawValue;        
    }                                                                           
}

on envVar E_pric_RadarFrontCenter_TrajPointACCObj14_TrajPointACCObj14_dyv_sw_Pv
{
    qword rawValue = 0ll;
    float phyValue = 0.0;
    
    //update the raw value with physical value 
    {
        if(chgEv_TrajPointACCObj14_TrajPointACCObj14_dyv_sw == 0)
        {
            phyValue = getvalue(this);
            // physical to raw conversion
            rawValue = ((phyValue -(0))/0.0078125);
            putValue(E_pric_RadarFrontCenter_TrajPointACCObj14_TrajPointACCObj14_dyv_sw_Rv, rawValue);
            chgEv_TrajPointACCObj14_TrajPointACCObj14_dyv_sw = 1;  
        }
        else
        {
            chgEv_TrajPointACCObj14_TrajPointACCObj14_dyv_sw = 0;
        }
    }
}


 
on envVar E_pric_RadarFrontCenter_TrajPointACCObj14_TrajPointACCObj14_InvDir_b_Rv
{
    qword rawValue = 0ll;
    float rawValue_float = 0.0;
    float phyValue = 0.0;        

    //set the signal with updated raw value
    if(getValue(E_pric_RadarFrontCenter_TrajPointACCObj14_TrajPointACCObj14_InvDir_b_SetVt)==0)
    {
        rawValue = getvalue(this);
        if(chgEv_TrajPointACCObj14_TrajPointACCObj14_InvDir_b == 0)
        {
            //type conversion to float
            rawValue_float = rawValue;        
            // raw to physical conversion
            phyValue = ((rawValue_float *1)+(0));
            putValue(E_pric_RadarFrontCenter_TrajPointACCObj14_TrajPointACCObj14_InvDir_b_Pv, phyValue);
            chgEv_TrajPointACCObj14_TrajPointACCObj14_InvDir_b = 1;
        }
        else
        {
            chgEv_TrajPointACCObj14_TrajPointACCObj14_InvDir_b = 0;
        }    
        //update the signal value
        Msg_TrajPointACCObj14.TrajPointACCObj14_InvDir_b=rawValue;        
    }                                                                           
}

on envVar E_pric_RadarFrontCenter_TrajPointACCObj14_TrajPointACCObj14_InvDir_b_Pv
{
    qword rawValue = 0ll;
    float phyValue = 0.0;
    
    //update the raw value with physical value 
    if(getValue(E_pric_RadarFrontCenter_TrajPointACCObj14_TrajPointACCObj14_InvDir_b_SetVt)==0)
    {
        if(chgEv_TrajPointACCObj14_TrajPointACCObj14_InvDir_b == 0)
        {
            phyValue = getvalue(this);
            // physical to raw conversion
            rawValue = ((phyValue -(0))/1);
            putValue(E_pric_RadarFrontCenter_TrajPointACCObj14_TrajPointACCObj14_InvDir_b_Rv, rawValue);
            chgEv_TrajPointACCObj14_TrajPointACCObj14_InvDir_b = 1;  
        }
        else
        {
            chgEv_TrajPointACCObj14_TrajPointACCObj14_InvDir_b = 0;
        }
    }
}

on envVar E_pric_RadarFrontCenter_TrajPointACCObj14_TrajPointACCObj14_InvDir_b_Vt
{
    qword rawValue = 0ll;
    if(getValue(E_pric_RadarFrontCenter_TrajPointACCObj14_TrajPointACCObj14_InvDir_b_SetVt))
    {
        //update the signal value
        Msg_TrajPointACCObj14.TrajPointACCObj14_InvDir_b=getValue(this);
    }
}

on envVar E_pric_RadarFrontCenter_TrajPointACCObj14_TrajPointACCObj14_InvDir_b_SetVt
{
    if(getValue(E_pric_RadarFrontCenter_TrajPointACCObj14_TrajPointACCObj14_InvDir_b_SetVt))
    {
        //update the signal value
        Msg_TrajPointACCObj14.TrajPointACCObj14_InvDir_b=getvalue(E_pric_RadarFrontCenter_TrajPointACCObj14_TrajPointACCObj14_InvDir_b_Vt);
    }
    else
    {
        Msg_TrajPointACCObj14.TrajPointACCObj14_InvDir_b=getValue(E_pric_RadarFrontCenter_TrajPointACCObj14_TrajPointACCObj14_InvDir_b_Rv);
    }
}
 
on envVar E_pric_RadarFrontCenter_TrajPointACCObj14_TrajPointACCObj14_Drive_b_Rv
{
    qword rawValue = 0ll;
    float rawValue_float = 0.0;
    float phyValue = 0.0;        

    //set the signal with updated raw value
    if(getValue(E_pric_RadarFrontCenter_TrajPointACCObj14_TrajPointACCObj14_Drive_b_SetVt)==0)
    {
        rawValue = getvalue(this);
        if(chgEv_TrajPointACCObj14_TrajPointACCObj14_Drive_b == 0)
        {
            //type conversion to float
            rawValue_float = rawValue;        
            // raw to physical conversion
            phyValue = ((rawValue_float *1)+(0));
            putValue(E_pric_RadarFrontCenter_TrajPointACCObj14_TrajPointACCObj14_Drive_b_Pv, phyValue);
            chgEv_TrajPointACCObj14_TrajPointACCObj14_Drive_b = 1;
        }
        else
        {
            chgEv_TrajPointACCObj14_TrajPointACCObj14_Drive_b = 0;
        }    
        //update the signal value
        Msg_TrajPointACCObj14.TrajPointACCObj14_Drive_b=rawValue;        
    }                                                                           
}

on envVar E_pric_RadarFrontCenter_TrajPointACCObj14_TrajPointACCObj14_Drive_b_Pv
{
    qword rawValue = 0ll;
    float phyValue = 0.0;
    
    //update the raw value with physical value 
    if(getValue(E_pric_RadarFrontCenter_TrajPointACCObj14_TrajPointACCObj14_Drive_b_SetVt)==0)
    {
        if(chgEv_TrajPointACCObj14_TrajPointACCObj14_Drive_b == 0)
        {
            phyValue = getvalue(this);
            // physical to raw conversion
            rawValue = ((phyValue -(0))/1);
            putValue(E_pric_RadarFrontCenter_TrajPointACCObj14_TrajPointACCObj14_Drive_b_Rv, rawValue);
            chgEv_TrajPointACCObj14_TrajPointACCObj14_Drive_b = 1;  
        }
        else
        {
            chgEv_TrajPointACCObj14_TrajPointACCObj14_Drive_b = 0;
        }
    }
}

on envVar E_pric_RadarFrontCenter_TrajPointACCObj14_TrajPointACCObj14_Drive_b_Vt
{
    qword rawValue = 0ll;
    if(getValue(E_pric_RadarFrontCenter_TrajPointACCObj14_TrajPointACCObj14_Drive_b_SetVt))
    {
        //update the signal value
        Msg_TrajPointACCObj14.TrajPointACCObj14_Drive_b=getValue(this);
    }
}

on envVar E_pric_RadarFrontCenter_TrajPointACCObj14_TrajPointACCObj14_Drive_b_SetVt
{
    if(getValue(E_pric_RadarFrontCenter_TrajPointACCObj14_TrajPointACCObj14_Drive_b_SetVt))
    {
        //update the signal value
        Msg_TrajPointACCObj14.TrajPointACCObj14_Drive_b=getvalue(E_pric_RadarFrontCenter_TrajPointACCObj14_TrajPointACCObj14_Drive_b_Vt);
    }
    else
    {
        Msg_TrajPointACCObj14.TrajPointACCObj14_Drive_b=getValue(E_pric_RadarFrontCenter_TrajPointACCObj14_TrajPointACCObj14_Drive_b_Rv);
    }
}
 
on envVar E_pric_RadarFrontCenter_RDR_Status_tx
{
    if(getValue(this))
    {       
        
        //update the BZ Signal
        if(RDR_Status_RDR_Status_MsgCtr_wrongvalctr == 0)
        {
            update_RDR_Status_RDR_Status_MsgCtr_counter();
            Msg_RDR_Status.RDR_Status_MsgCtr= RDR_Status_RDR_Status_MsgCtr_counter;
        }
        else if(RDR_Status_RDR_Status_MsgCtr_wrongvalctr > 0)
        {
             RDR_Status_RDR_Status_MsgCtr_wrongvalctr--;
              // if counter becomes zero, update panel controller to zero
             if(RDR_Status_RDR_Status_MsgCtr_wrongvalctr == 0)
             {
                 putValue(E_pric_RadarFrontCenter_RDR_Status_RDR_Status_MsgCtr_wrongvalctr,0);
             }
        }
        else
        {
            //do nothing
        }        
        //update the BZ Signal
        if(RDR_Status_RDR_Status_blockCtr_wrongvalctr == 0)
        {
            update_RDR_Status_RDR_Status_blockCtr_counter();
            Msg_RDR_Status.RDR_Status_blockCtr= RDR_Status_RDR_Status_blockCtr_counter;
        }
        else if(RDR_Status_RDR_Status_blockCtr_wrongvalctr > 0)
        {
             RDR_Status_RDR_Status_blockCtr_wrongvalctr--;
              // if counter becomes zero, update panel controller to zero
             if(RDR_Status_RDR_Status_blockCtr_wrongvalctr == 0)
             {
                 putValue(E_pric_RadarFrontCenter_RDR_Status_RDR_Status_blockCtr_wrongvalctr,0);
             }
        }
        else
        {
            //do nothing
        }        
        //calculate the CRC checksum
        update_RDR_Status_ChkSum_Checksum();

        output(Msg_RDR_Status);        
    }
}

on envVar E_pric_RadarFrontCenter_RDR_Status_Range
{
    qword rawstatus = 0ll;
    qword rawValue = 0ll;    
    
    rawstatus = getvalue(this);    
    // set all the signals with min raw /max raw /init raw
    switch (rawstatus) 
    {
     case(0) :
        rawValue= 0;
        putValue(E_pric_RadarFrontCenter_RDR_Status_RDR_Stat_blindness_det_Rv, rawValue);
        rawValue= 0;
        putValue(E_pric_RadarFrontCenter_RDR_Status_RDR_Stat_Error_Rv, rawValue);
        rawValue= 0;
        putValue(E_pric_RadarFrontCenter_RDR_Status_RDR_Stat_PED_Brake_Rv, rawValue);
        rawValue= 0;
        putValue(E_pric_RadarFrontCenter_RDR_Status_RDR_Stat_ObjDataAge_Rv, rawValue);
        rawValue= 0;
        putValue(E_pric_RadarFrontCenter_RDR_Status_RDR_Stat_ACCSwitchButton_Rv, rawValue);
        rawValue= 0;
        putValue(E_pric_RadarFrontCenter_RDR_Status_RDR_Stat_Avail_Rv, rawValue);
        break;
     case(1) :
        rawValue= 1;
        putValue(E_pric_RadarFrontCenter_RDR_Status_RDR_Stat_blindness_det_Rv, rawValue);
        rawValue= 1;
        putValue(E_pric_RadarFrontCenter_RDR_Status_RDR_Stat_Error_Rv, rawValue);
        rawValue= 3;
        putValue(E_pric_RadarFrontCenter_RDR_Status_RDR_Stat_PED_Brake_Rv, rawValue);
        rawValue= 1022;
        putValue(E_pric_RadarFrontCenter_RDR_Status_RDR_Stat_ObjDataAge_Rv, rawValue);
        rawValue= 3;
        putValue(E_pric_RadarFrontCenter_RDR_Status_RDR_Stat_ACCSwitchButton_Rv, rawValue);
        rawValue= 15;
        putValue(E_pric_RadarFrontCenter_RDR_Status_RDR_Stat_Avail_Rv, rawValue);
        break;
     default :
        rawValue= 0;
        putValue(E_pric_RadarFrontCenter_RDR_Status_RDR_Stat_blindness_det_Rv, rawValue);
        rawValue= 0;
        putValue(E_pric_RadarFrontCenter_RDR_Status_RDR_Stat_Error_Rv, rawValue);
        rawValue= 0;
        putValue(E_pric_RadarFrontCenter_RDR_Status_RDR_Stat_PED_Brake_Rv, rawValue);
        rawValue= 0;
        putValue(E_pric_RadarFrontCenter_RDR_Status_RDR_Stat_ObjDataAge_Rv, rawValue);
        rawValue= 0;
        putValue(E_pric_RadarFrontCenter_RDR_Status_RDR_Stat_ACCSwitchButton_Rv, rawValue);
        rawValue= 0;
        putValue(E_pric_RadarFrontCenter_RDR_Status_RDR_Stat_Avail_Rv, rawValue);
      break;
   }
}

on envVar E_pric_RadarFrontCenter_RDR_Status_Dlc
{
    if(getValue(E_pric_RadarFrontCenter_RDR_Status_enDlc))
    {
        Msg_RDR_Status.dlc =getValue(this);
    }
    else
    {
       Dbc_dlc = 8;
	   Msg_RDR_Status.dlc = Calc_Canfd_dlc(Dbc_dlc);
	   	
  }
}

on envVar E_pric_RadarFrontCenter_RDR_Status_enDlc
{
    //For Messages with DLC = 8, set wrong DLC to smaller than defined DLC
    //For Messages with DLC < 8 set wrong DLC to smaller/longer than defined DLC
    if(getValue(this))
    {
        Msg_RDR_Status.dlc =getValue(E_pric_RadarFrontCenter_RDR_Status_Dlc);
    }
    else
    {
       Dbc_dlc = 8;
	   Msg_RDR_Status.dlc = Calc_Canfd_dlc(Dbc_dlc);
			
    }
}

on envVar E_pric_RadarFrontCenter_RDR_Status_RDR_Status_CRC_wrongvalctr
{
    //update disturb count
    //disturb value range:(-1 = always send wrong value),( X>0 ,x is the number of Messages with wrong CHK sent)
    RDR_Status_RDR_Status_CRC_wrongvalctr =getValue(this);    
}
on envVar E_pric_RadarFrontCenter_RDR_Status_RDR_Status_MsgCtr_wrongvalctr
{
    //update disturb count
    //disturb value range:(-1 = always send wrong value),( X>0 ,x is the number of Messages with wrong CHK sent)
    RDR_Status_RDR_Status_MsgCtr_wrongvalctr =getValue(this);    
}
on envVar E_pric_RadarFrontCenter_RDR_Status_RDR_Status_blockCtr_wrongvalctr
{
    //update disturb count
    //disturb value range:(-1 = always send wrong value),( X>0 ,x is the number of Messages with wrong CHK sent)
    RDR_Status_RDR_Status_blockCtr_wrongvalctr =getValue(this);    
}

on envVar E_pric_RadarFrontCenter_RDR_Status_RDR_Stat_blindness_det_Rv
{
    qword rawValue = 0ll;
    float rawValue_float = 0.0;
    float phyValue = 0.0;        

    //set the signal with updated raw value
    {
        rawValue = getvalue(this);
        if(chgEv_RDR_Status_RDR_Stat_blindness_det == 0)
        {
            //type conversion to float
            rawValue_float = rawValue;        
            // raw to physical conversion
            phyValue = ((rawValue_float *1)+(0));
            putValue(E_pric_RadarFrontCenter_RDR_Status_RDR_Stat_blindness_det_Pv, phyValue);
            chgEv_RDR_Status_RDR_Stat_blindness_det = 1;
        }
        else
        {
            chgEv_RDR_Status_RDR_Stat_blindness_det = 0;
        }    
        //update the signal value
        Msg_RDR_Status.RDR_Stat_blindness_det=rawValue;        
    }                                                                           
}

on envVar E_pric_RadarFrontCenter_RDR_Status_RDR_Stat_blindness_det_Pv
{
    qword rawValue = 0ll;
    float phyValue = 0.0;
    
    //update the raw value with physical value 
    {
        if(chgEv_RDR_Status_RDR_Stat_blindness_det == 0)
        {
            phyValue = getvalue(this);
            // physical to raw conversion
            rawValue = ((phyValue -(0))/1);
            putValue(E_pric_RadarFrontCenter_RDR_Status_RDR_Stat_blindness_det_Rv, rawValue);
            chgEv_RDR_Status_RDR_Stat_blindness_det = 1;  
        }
        else
        {
            chgEv_RDR_Status_RDR_Stat_blindness_det = 0;
        }
    }
}


 
on envVar E_pric_RadarFrontCenter_RDR_Status_RDR_Stat_Error_Rv
{
    qword rawValue = 0ll;
    float rawValue_float = 0.0;
    float phyValue = 0.0;        

    //set the signal with updated raw value
    {
        rawValue = getvalue(this);
        if(chgEv_RDR_Status_RDR_Stat_Error == 0)
        {
            //type conversion to float
            rawValue_float = rawValue;        
            // raw to physical conversion
            phyValue = ((rawValue_float *1)+(0));
            putValue(E_pric_RadarFrontCenter_RDR_Status_RDR_Stat_Error_Pv, phyValue);
            chgEv_RDR_Status_RDR_Stat_Error = 1;
        }
        else
        {
            chgEv_RDR_Status_RDR_Stat_Error = 0;
        }    
        //update the signal value
        Msg_RDR_Status.RDR_Stat_Error=rawValue;        
    }                                                                           
}

on envVar E_pric_RadarFrontCenter_RDR_Status_RDR_Stat_Error_Pv
{
    qword rawValue = 0ll;
    float phyValue = 0.0;
    
    //update the raw value with physical value 
    {
        if(chgEv_RDR_Status_RDR_Stat_Error == 0)
        {
            phyValue = getvalue(this);
            // physical to raw conversion
            rawValue = ((phyValue -(0))/1);
            putValue(E_pric_RadarFrontCenter_RDR_Status_RDR_Stat_Error_Rv, rawValue);
            chgEv_RDR_Status_RDR_Stat_Error = 1;  
        }
        else
        {
            chgEv_RDR_Status_RDR_Stat_Error = 0;
        }
    }
}


 
on envVar E_pric_RadarFrontCenter_RDR_Status_RDR_Stat_PED_Brake_Rv
{
    qword rawValue = 0ll;
    float rawValue_float = 0.0;
    float phyValue = 0.0;        

    //set the signal with updated raw value
    {
        rawValue = getvalue(this);
        if(chgEv_RDR_Status_RDR_Stat_PED_Brake == 0)
        {
            //type conversion to float
            rawValue_float = rawValue;        
            // raw to physical conversion
            phyValue = ((rawValue_float *1)+(0));
            putValue(E_pric_RadarFrontCenter_RDR_Status_RDR_Stat_PED_Brake_Pv, phyValue);
            chgEv_RDR_Status_RDR_Stat_PED_Brake = 1;
        }
        else
        {
            chgEv_RDR_Status_RDR_Stat_PED_Brake = 0;
        }    
        //update the signal value
        Msg_RDR_Status.RDR_Stat_PED_Brake=rawValue;        
    }                                                                           
}

on envVar E_pric_RadarFrontCenter_RDR_Status_RDR_Stat_PED_Brake_Pv
{
    qword rawValue = 0ll;
    float phyValue = 0.0;
    
    //update the raw value with physical value 
    {
        if(chgEv_RDR_Status_RDR_Stat_PED_Brake == 0)
        {
            phyValue = getvalue(this);
            // physical to raw conversion
            rawValue = ((phyValue -(0))/1);
            putValue(E_pric_RadarFrontCenter_RDR_Status_RDR_Stat_PED_Brake_Rv, rawValue);
            chgEv_RDR_Status_RDR_Stat_PED_Brake = 1;  
        }
        else
        {
            chgEv_RDR_Status_RDR_Stat_PED_Brake = 0;
        }
    }
}


 
on envVar E_pric_RadarFrontCenter_RDR_Status_RDR_Stat_ObjDataAge_Rv
{
    qword rawValue = 0ll;
    float rawValue_float = 0.0;
    float phyValue = 0.0;        

    //set the signal with updated raw value
    {
        rawValue = getvalue(this);
        if(chgEv_RDR_Status_RDR_Stat_ObjDataAge == 0)
        {
            //type conversion to float
            rawValue_float = rawValue;        
            // raw to physical conversion
            phyValue = ((rawValue_float *0.000976563)+(0));
            putValue(E_pric_RadarFrontCenter_RDR_Status_RDR_Stat_ObjDataAge_Pv, phyValue);
            chgEv_RDR_Status_RDR_Stat_ObjDataAge = 1;
        }
        else
        {
            chgEv_RDR_Status_RDR_Stat_ObjDataAge = 0;
        }    
        //update the signal value
        Msg_RDR_Status.RDR_Stat_ObjDataAge=rawValue;        
    }                                                                           
}

on envVar E_pric_RadarFrontCenter_RDR_Status_RDR_Stat_ObjDataAge_Pv
{
    qword rawValue = 0ll;
    float phyValue = 0.0;
    
    //update the raw value with physical value 
    {
        if(chgEv_RDR_Status_RDR_Stat_ObjDataAge == 0)
        {
            phyValue = getvalue(this);
            // physical to raw conversion
            rawValue = ((phyValue -(0))/0.000976563);
            putValue(E_pric_RadarFrontCenter_RDR_Status_RDR_Stat_ObjDataAge_Rv, rawValue);
            chgEv_RDR_Status_RDR_Stat_ObjDataAge = 1;  
        }
        else
        {
            chgEv_RDR_Status_RDR_Stat_ObjDataAge = 0;
        }
    }
}


 
on envVar E_pric_RadarFrontCenter_RDR_Status_RDR_Stat_ACCSwitchButton_Rv
{
    qword rawValue = 0ll;
    float rawValue_float = 0.0;
    float phyValue = 0.0;        

    //set the signal with updated raw value
    if(getValue(E_pric_RadarFrontCenter_RDR_Status_RDR_Stat_ACCSwitchButton_SetVt)==0)
    {
        rawValue = getvalue(this);
        if(chgEv_RDR_Status_RDR_Stat_ACCSwitchButton == 0)
        {
            //type conversion to float
            rawValue_float = rawValue;        
            // raw to physical conversion
            phyValue = ((rawValue_float *1)+(0));
            putValue(E_pric_RadarFrontCenter_RDR_Status_RDR_Stat_ACCSwitchButton_Pv, phyValue);
            chgEv_RDR_Status_RDR_Stat_ACCSwitchButton = 1;
        }
        else
        {
            chgEv_RDR_Status_RDR_Stat_ACCSwitchButton = 0;
        }    
        //update the signal value
        Msg_RDR_Status.RDR_Stat_ACCSwitchButton=rawValue;        
    }                                                                           
}

on envVar E_pric_RadarFrontCenter_RDR_Status_RDR_Stat_ACCSwitchButton_Pv
{
    qword rawValue = 0ll;
    float phyValue = 0.0;
    
    //update the raw value with physical value 
    if(getValue(E_pric_RadarFrontCenter_RDR_Status_RDR_Stat_ACCSwitchButton_SetVt)==0)
    {
        if(chgEv_RDR_Status_RDR_Stat_ACCSwitchButton == 0)
        {
            phyValue = getvalue(this);
            // physical to raw conversion
            rawValue = ((phyValue -(0))/1);
            putValue(E_pric_RadarFrontCenter_RDR_Status_RDR_Stat_ACCSwitchButton_Rv, rawValue);
            chgEv_RDR_Status_RDR_Stat_ACCSwitchButton = 1;  
        }
        else
        {
            chgEv_RDR_Status_RDR_Stat_ACCSwitchButton = 0;
        }
    }
}

on envVar E_pric_RadarFrontCenter_RDR_Status_RDR_Stat_ACCSwitchButton_Vt
{
    qword rawValue = 0ll;
    if(getValue(E_pric_RadarFrontCenter_RDR_Status_RDR_Stat_ACCSwitchButton_SetVt))
    {
        //update the signal value
        Msg_RDR_Status.RDR_Stat_ACCSwitchButton=getValue(this);
    }
}

on envVar E_pric_RadarFrontCenter_RDR_Status_RDR_Stat_ACCSwitchButton_SetVt
{
    if(getValue(E_pric_RadarFrontCenter_RDR_Status_RDR_Stat_ACCSwitchButton_SetVt))
    {
        //update the signal value
        Msg_RDR_Status.RDR_Stat_ACCSwitchButton=getvalue(E_pric_RadarFrontCenter_RDR_Status_RDR_Stat_ACCSwitchButton_Vt);
    }
    else
    {
        Msg_RDR_Status.RDR_Stat_ACCSwitchButton=getValue(E_pric_RadarFrontCenter_RDR_Status_RDR_Stat_ACCSwitchButton_Rv);
    }
}
 
on envVar E_pric_RadarFrontCenter_RDR_Status_RDR_Stat_Avail_Rv
{
    qword rawValue = 0ll;
    float rawValue_float = 0.0;
    float phyValue = 0.0;        

    //set the signal with updated raw value
    if(getValue(E_pric_RadarFrontCenter_RDR_Status_RDR_Stat_Avail_SetVt)==0)
    {
        rawValue = getvalue(this);
        if(chgEv_RDR_Status_RDR_Stat_Avail == 0)
        {
            //type conversion to float
            rawValue_float = rawValue;        
            // raw to physical conversion
            phyValue = ((rawValue_float *1)+(0));
            putValue(E_pric_RadarFrontCenter_RDR_Status_RDR_Stat_Avail_Pv, phyValue);
            chgEv_RDR_Status_RDR_Stat_Avail = 1;
        }
        else
        {
            chgEv_RDR_Status_RDR_Stat_Avail = 0;
        }    
        //update the signal value
        Msg_RDR_Status.RDR_Stat_Avail=rawValue;        
    }                                                                           
}

on envVar E_pric_RadarFrontCenter_RDR_Status_RDR_Stat_Avail_Pv
{
    qword rawValue = 0ll;
    float phyValue = 0.0;
    
    //update the raw value with physical value 
    if(getValue(E_pric_RadarFrontCenter_RDR_Status_RDR_Stat_Avail_SetVt)==0)
    {
        if(chgEv_RDR_Status_RDR_Stat_Avail == 0)
        {
            phyValue = getvalue(this);
            // physical to raw conversion
            rawValue = ((phyValue -(0))/1);
            putValue(E_pric_RadarFrontCenter_RDR_Status_RDR_Stat_Avail_Rv, rawValue);
            chgEv_RDR_Status_RDR_Stat_Avail = 1;  
        }
        else
        {
            chgEv_RDR_Status_RDR_Stat_Avail = 0;
        }
    }
}

/*@@envVar:E_pric_RadarFrontCenter_RDR_Status_RDR_Stat_Avail_Vt:*/
on envVar E_pric_RadarFrontCenter_RDR_Status_RDR_Stat_Avail_Vt
{
    qword rawValue = 0ll;
    if(getValue(E_pric_RadarFrontCenter_RDR_Status_RDR_Stat_Avail_SetVt))
    {
        //update the signal value
        Msg_RDR_Status.RDR_Stat_Avail=getValue(this);
    }
}
/*@@end*/

/*@@envVar:E_pric_RadarFrontCenter_RDR_Status_RDR_Stat_Avail_SetVt:*/
on envVar E_pric_RadarFrontCenter_RDR_Status_RDR_Stat_Avail_SetVt
{
    if(getValue(E_pric_RadarFrontCenter_RDR_Status_RDR_Stat_Avail_SetVt))
    {
        //update the signal value
        Msg_RDR_Status.RDR_Stat_Avail=getvalue(E_pric_RadarFrontCenter_RDR_Status_RDR_Stat_Avail_Vt);
    }
    else
    {
        Msg_RDR_Status.RDR_Stat_Avail=getValue(E_pric_RadarFrontCenter_RDR_Status_RDR_Stat_Avail_Rv);
    }
}
/*@@end*/
 
on envVar E_pric_RadarFrontCenter_TrajPointACCObj9_tx
{
    if(getValue(this))
    {       
        
        //update the BZ Signal
        if(TrajPointACCObj9_TrajPointACCObj9_MsgCtr_wrongvalctr == 0)
        {
            update_TrajPointACCObj9_TrajPointACCObj9_MsgCtr_counter();
            Msg_TrajPointACCObj9.TrajPointACCObj9_MsgCtr= TrajPointACCObj9_TrajPointACCObj9_MsgCtr_counter;
        }
        else if(TrajPointACCObj9_TrajPointACCObj9_MsgCtr_wrongvalctr > 0)
        {
             TrajPointACCObj9_TrajPointACCObj9_MsgCtr_wrongvalctr--;
              // if counter becomes zero, update panel controller to zero
             if(TrajPointACCObj9_TrajPointACCObj9_MsgCtr_wrongvalctr == 0)
             {
                 putValue(E_pric_RadarFrontCenter_TrajPointACCObj9_TrajPointACCObj9_MsgCtr_wrongvalctr,0);
             }
        }
        else
        {
            //do nothing
        }        
        //update the BZ Signal
        if(TrajPointACCObj9_TrajPointACCObj9_blockCtr_wrongvalctr == 0)
        {
            update_TrajPointACCObj9_TrajPointACCObj9_blockCtr_counter();
            Msg_TrajPointACCObj9.TrajPointACCObj9_blockCtr= TrajPointACCObj9_TrajPointACCObj9_blockCtr_counter;
        }
        else if(TrajPointACCObj9_TrajPointACCObj9_blockCtr_wrongvalctr > 0)
        {
             TrajPointACCObj9_TrajPointACCObj9_blockCtr_wrongvalctr--;
              // if counter becomes zero, update panel controller to zero
             if(TrajPointACCObj9_TrajPointACCObj9_blockCtr_wrongvalctr == 0)
             {
                 putValue(E_pric_RadarFrontCenter_TrajPointACCObj9_TrajPointACCObj9_blockCtr_wrongvalctr,0);
             }
        }
        else
        {
            //do nothing
        }        
        //calculate the CRC checksum
        update_TrajPointACCObj9_ChkSum_Checksum();

        output(Msg_TrajPointACCObj9);        
    }
}

on envVar E_pric_RadarFrontCenter_TrajPointACCObj9_Range
{
    qword rawstatus = 0ll;
    qword rawValue = 0ll;    
    
    rawstatus = getvalue(this);    
    // set all the signals with min raw /max raw /init raw
    switch (rawstatus) 
    {
     case(0) :
        rawValue= 0;
        putValue(E_pric_RadarFrontCenter_TrajPointACCObj9_TrajPointACCObj9_Stand_b_Rv, rawValue);
        rawValue= 0;
        putValue(E_pric_RadarFrontCenter_TrajPointACCObj9_TrajPointACCObj9_Drive_b_Rv, rawValue);
        rawValue= 0;
        putValue(E_pric_RadarFrontCenter_TrajPointACCObj9_TrajPointACCObj9_wExistProb_ub_Rv, rawValue);
        rawValue= 0;
        putValue(E_pric_RadarFrontCenter_TrajPointACCObj9_TrajPointACCObj9_TrajEnd_b_Rv, rawValue);
        rawValue= 0;
        putValue(E_pric_RadarFrontCenter_TrajPointACCObj9_TrajPointACCObj9_dVarYv_uw_Rv, rawValue);
        rawValue= 0;
        putValue(E_pric_RadarFrontCenter_TrajPointACCObj9_TrajPointACCObj9_dVarXv_uw_Rv, rawValue);
        rawValue= 0;
        putValue(E_pric_RadarFrontCenter_TrajPointACCObj9_TrajPointACCObj9_InvDir_b_Rv, rawValue);
        rawValue= -32768;
        putValue(E_pric_RadarFrontCenter_TrajPointACCObj9_TrajPointACCObj9_dxv_sw_Rv, rawValue);
        rawValue= 0;
        putValue(E_pric_RadarFrontCenter_TrajPointACCObj9_TrajPointACCObj9_Stopped_b_Rv, rawValue);
        rawValue= -32768;
        putValue(E_pric_RadarFrontCenter_TrajPointACCObj9_TrajPointACCObj9_dyv_sw_Rv, rawValue);
        rawValue= 0;
        putValue(E_pric_RadarFrontCenter_TrajPointACCObj9_TrajPointACCObj9_timestamp_Rv, rawValue);
        rawValue= 0;
        putValue(E_pric_RadarFrontCenter_TrajPointACCObj9_TrajPointACCObj9_Valid_b_Rv, rawValue);
        break;
     case(1) :
        rawValue= 1;
        putValue(E_pric_RadarFrontCenter_TrajPointACCObj9_TrajPointACCObj9_Stand_b_Rv, rawValue);
        rawValue= 1;
        putValue(E_pric_RadarFrontCenter_TrajPointACCObj9_TrajPointACCObj9_Drive_b_Rv, rawValue);
        rawValue= 255;
        putValue(E_pric_RadarFrontCenter_TrajPointACCObj9_TrajPointACCObj9_wExistProb_ub_Rv, rawValue);
        rawValue= 1;
        putValue(E_pric_RadarFrontCenter_TrajPointACCObj9_TrajPointACCObj9_TrajEnd_b_Rv, rawValue);
        rawValue= 65534;
        putValue(E_pric_RadarFrontCenter_TrajPointACCObj9_TrajPointACCObj9_dVarYv_uw_Rv, rawValue);
        rawValue= 65534;
        putValue(E_pric_RadarFrontCenter_TrajPointACCObj9_TrajPointACCObj9_dVarXv_uw_Rv, rawValue);
        rawValue= 1;
        putValue(E_pric_RadarFrontCenter_TrajPointACCObj9_TrajPointACCObj9_InvDir_b_Rv, rawValue);
        rawValue= 32767;
        putValue(E_pric_RadarFrontCenter_TrajPointACCObj9_TrajPointACCObj9_dxv_sw_Rv, rawValue);
        rawValue= 1;
        putValue(E_pric_RadarFrontCenter_TrajPointACCObj9_TrajPointACCObj9_Stopped_b_Rv, rawValue);
        rawValue= 32767;
        putValue(E_pric_RadarFrontCenter_TrajPointACCObj9_TrajPointACCObj9_dyv_sw_Rv, rawValue);
        rawValue= 65536;
        putValue(E_pric_RadarFrontCenter_TrajPointACCObj9_TrajPointACCObj9_timestamp_Rv, rawValue);
        rawValue= 1;
        putValue(E_pric_RadarFrontCenter_TrajPointACCObj9_TrajPointACCObj9_Valid_b_Rv, rawValue);
        break;
     default :
        rawValue= 0;
        putValue(E_pric_RadarFrontCenter_TrajPointACCObj9_TrajPointACCObj9_Stand_b_Rv, rawValue);
        rawValue= 0;
        putValue(E_pric_RadarFrontCenter_TrajPointACCObj9_TrajPointACCObj9_Drive_b_Rv, rawValue);
        rawValue= 0;
        putValue(E_pric_RadarFrontCenter_TrajPointACCObj9_TrajPointACCObj9_wExistProb_ub_Rv, rawValue);
        rawValue= 0;
        putValue(E_pric_RadarFrontCenter_TrajPointACCObj9_TrajPointACCObj9_TrajEnd_b_Rv, rawValue);
        rawValue= 0;
        putValue(E_pric_RadarFrontCenter_TrajPointACCObj9_TrajPointACCObj9_dVarYv_uw_Rv, rawValue);
        rawValue= 0;
        putValue(E_pric_RadarFrontCenter_TrajPointACCObj9_TrajPointACCObj9_dVarXv_uw_Rv, rawValue);
        rawValue= 0;
        putValue(E_pric_RadarFrontCenter_TrajPointACCObj9_TrajPointACCObj9_InvDir_b_Rv, rawValue);
        rawValue= -32768;
        putValue(E_pric_RadarFrontCenter_TrajPointACCObj9_TrajPointACCObj9_dxv_sw_Rv, rawValue);
        rawValue= 0;
        putValue(E_pric_RadarFrontCenter_TrajPointACCObj9_TrajPointACCObj9_Stopped_b_Rv, rawValue);
        rawValue= -32768;
        putValue(E_pric_RadarFrontCenter_TrajPointACCObj9_TrajPointACCObj9_dyv_sw_Rv, rawValue);
        rawValue= 0;
        putValue(E_pric_RadarFrontCenter_TrajPointACCObj9_TrajPointACCObj9_timestamp_Rv, rawValue);
        rawValue= 0;
        putValue(E_pric_RadarFrontCenter_TrajPointACCObj9_TrajPointACCObj9_Valid_b_Rv, rawValue);
      break;
   }
}

on envVar E_pric_RadarFrontCenter_TrajPointACCObj9_Dlc
{
    if(getValue(E_pric_RadarFrontCenter_TrajPointACCObj9_enDlc))
    {
        Msg_TrajPointACCObj9.dlc =getValue(this);
    }
    else
    {
       Dbc_dlc = 16;
	   Msg_TrajPointACCObj9.dlc = Calc_Canfd_dlc(Dbc_dlc);
	   	
  }
}

on envVar E_pric_RadarFrontCenter_TrajPointACCObj9_enDlc
{
    //For Messages with DLC = 8, set wrong DLC to smaller than defined DLC
    //For Messages with DLC < 8 set wrong DLC to smaller/longer than defined DLC
    if(getValue(this))
    {
        Msg_TrajPointACCObj9.dlc =getValue(E_pric_RadarFrontCenter_TrajPointACCObj9_Dlc);
    }
    else
    {
       Dbc_dlc = 16;
	   Msg_TrajPointACCObj9.dlc = Calc_Canfd_dlc(Dbc_dlc);
			
    }
}

on envVar E_pric_RadarFrontCenter_TrajPointACCObj9_TrajPointACCObj9_CRC_wrongvalctr
{
    //update disturb count
    //disturb value range:(-1 = always send wrong value),( X>0 ,x is the number of Messages with wrong CHK sent)
    TrajPointACCObj9_TrajPointACCObj9_CRC_wrongvalctr =getValue(this);    
}
on envVar E_pric_RadarFrontCenter_TrajPointACCObj9_TrajPointACCObj9_MsgCtr_wrongvalctr
{
    //update disturb count
    //disturb value range:(-1 = always send wrong value),( X>0 ,x is the number of Messages with wrong CHK sent)
    TrajPointACCObj9_TrajPointACCObj9_MsgCtr_wrongvalctr =getValue(this);    
}
on envVar E_pric_RadarFrontCenter_TrajPointACCObj9_TrajPointACCObj9_blockCtr_wrongvalctr
{
    //update disturb count
    //disturb value range:(-1 = always send wrong value),( X>0 ,x is the number of Messages with wrong CHK sent)
    TrajPointACCObj9_TrajPointACCObj9_blockCtr_wrongvalctr =getValue(this);    
}

on envVar E_pric_RadarFrontCenter_TrajPointACCObj9_TrajPointACCObj9_Stand_b_Rv
{
    qword rawValue = 0ll;
    float rawValue_float = 0.0;
    float phyValue = 0.0;        

    //set the signal with updated raw value
    if(getValue(E_pric_RadarFrontCenter_TrajPointACCObj9_TrajPointACCObj9_Stand_b_SetVt)==0)
    {
        rawValue = getvalue(this);
        if(chgEv_TrajPointACCObj9_TrajPointACCObj9_Stand_b == 0)
        {
            //type conversion to float
            rawValue_float = rawValue;        
            // raw to physical conversion
            phyValue = ((rawValue_float *1)+(0));
            putValue(E_pric_RadarFrontCenter_TrajPointACCObj9_TrajPointACCObj9_Stand_b_Pv, phyValue);
            chgEv_TrajPointACCObj9_TrajPointACCObj9_Stand_b = 1;
        }
        else
        {
            chgEv_TrajPointACCObj9_TrajPointACCObj9_Stand_b = 0;
        }    
        //update the signal value
        Msg_TrajPointACCObj9.TrajPointACCObj9_Stand_b=rawValue;        
    }                                                                           
}

on envVar E_pric_RadarFrontCenter_TrajPointACCObj9_TrajPointACCObj9_Stand_b_Pv
{
    qword rawValue = 0ll;
    float phyValue = 0.0;
    
    //update the raw value with physical value 
    if(getValue(E_pric_RadarFrontCenter_TrajPointACCObj9_TrajPointACCObj9_Stand_b_SetVt)==0)
    {
        if(chgEv_TrajPointACCObj9_TrajPointACCObj9_Stand_b == 0)
        {
            phyValue = getvalue(this);
            // physical to raw conversion
            rawValue = ((phyValue -(0))/1);
            putValue(E_pric_RadarFrontCenter_TrajPointACCObj9_TrajPointACCObj9_Stand_b_Rv, rawValue);
            chgEv_TrajPointACCObj9_TrajPointACCObj9_Stand_b = 1;  
        }
        else
        {
            chgEv_TrajPointACCObj9_TrajPointACCObj9_Stand_b = 0;
        }
    }
}

on envVar E_pric_RadarFrontCenter_TrajPointACCObj9_TrajPointACCObj9_Stand_b_Vt
{
    qword rawValue = 0ll;
    if(getValue(E_pric_RadarFrontCenter_TrajPointACCObj9_TrajPointACCObj9_Stand_b_SetVt))
    {
        //update the signal value
        Msg_TrajPointACCObj9.TrajPointACCObj9_Stand_b=getValue(this);
    }
}

on envVar E_pric_RadarFrontCenter_TrajPointACCObj9_TrajPointACCObj9_Stand_b_SetVt
{
    if(getValue(E_pric_RadarFrontCenter_TrajPointACCObj9_TrajPointACCObj9_Stand_b_SetVt))
    {
        //update the signal value
        Msg_TrajPointACCObj9.TrajPointACCObj9_Stand_b=getvalue(E_pric_RadarFrontCenter_TrajPointACCObj9_TrajPointACCObj9_Stand_b_Vt);
    }
    else
    {
        Msg_TrajPointACCObj9.TrajPointACCObj9_Stand_b=getValue(E_pric_RadarFrontCenter_TrajPointACCObj9_TrajPointACCObj9_Stand_b_Rv);
    }
}
 
on envVar E_pric_RadarFrontCenter_TrajPointACCObj9_TrajPointACCObj9_Drive_b_Rv
{
    qword rawValue = 0ll;
    float rawValue_float = 0.0;
    float phyValue = 0.0;        

    //set the signal with updated raw value
    if(getValue(E_pric_RadarFrontCenter_TrajPointACCObj9_TrajPointACCObj9_Drive_b_SetVt)==0)
    {
        rawValue = getvalue(this);
        if(chgEv_TrajPointACCObj9_TrajPointACCObj9_Drive_b == 0)
        {
            //type conversion to float
            rawValue_float = rawValue;        
            // raw to physical conversion
            phyValue = ((rawValue_float *1)+(0));
            putValue(E_pric_RadarFrontCenter_TrajPointACCObj9_TrajPointACCObj9_Drive_b_Pv, phyValue);
            chgEv_TrajPointACCObj9_TrajPointACCObj9_Drive_b = 1;
        }
        else
        {
            chgEv_TrajPointACCObj9_TrajPointACCObj9_Drive_b = 0;
        }    
        //update the signal value
        Msg_TrajPointACCObj9.TrajPointACCObj9_Drive_b=rawValue;        
    }                                                                           
}

on envVar E_pric_RadarFrontCenter_TrajPointACCObj9_TrajPointACCObj9_Drive_b_Pv
{
    qword rawValue = 0ll;
    float phyValue = 0.0;
    
    //update the raw value with physical value 
    if(getValue(E_pric_RadarFrontCenter_TrajPointACCObj9_TrajPointACCObj9_Drive_b_SetVt)==0)
    {
        if(chgEv_TrajPointACCObj9_TrajPointACCObj9_Drive_b == 0)
        {
            phyValue = getvalue(this);
            // physical to raw conversion
            rawValue = ((phyValue -(0))/1);
            putValue(E_pric_RadarFrontCenter_TrajPointACCObj9_TrajPointACCObj9_Drive_b_Rv, rawValue);
            chgEv_TrajPointACCObj9_TrajPointACCObj9_Drive_b = 1;  
        }
        else
        {
            chgEv_TrajPointACCObj9_TrajPointACCObj9_Drive_b = 0;
        }
    }
}

on envVar E_pric_RadarFrontCenter_TrajPointACCObj9_TrajPointACCObj9_Drive_b_Vt
{
    qword rawValue = 0ll;
    if(getValue(E_pric_RadarFrontCenter_TrajPointACCObj9_TrajPointACCObj9_Drive_b_SetVt))
    {
        //update the signal value
        Msg_TrajPointACCObj9.TrajPointACCObj9_Drive_b=getValue(this);
    }
}

on envVar E_pric_RadarFrontCenter_TrajPointACCObj9_TrajPointACCObj9_Drive_b_SetVt
{
    if(getValue(E_pric_RadarFrontCenter_TrajPointACCObj9_TrajPointACCObj9_Drive_b_SetVt))
    {
        //update the signal value
        Msg_TrajPointACCObj9.TrajPointACCObj9_Drive_b=getvalue(E_pric_RadarFrontCenter_TrajPointACCObj9_TrajPointACCObj9_Drive_b_Vt);
    }
    else
    {
        Msg_TrajPointACCObj9.TrajPointACCObj9_Drive_b=getValue(E_pric_RadarFrontCenter_TrajPointACCObj9_TrajPointACCObj9_Drive_b_Rv);
    }
}
 
on envVar E_pric_RadarFrontCenter_TrajPointACCObj9_TrajPointACCObj9_wExistProb_ub_Rv
{
    qword rawValue = 0ll;
    float rawValue_float = 0.0;
    float phyValue = 0.0;        

    //set the signal with updated raw value
    {
        rawValue = getvalue(this);
        if(chgEv_TrajPointACCObj9_TrajPointACCObj9_wExistProb_ub == 0)
        {
            //type conversion to float
            rawValue_float = rawValue;        
            // raw to physical conversion
            phyValue = ((rawValue_float *0.00390625)+(0));
            putValue(E_pric_RadarFrontCenter_TrajPointACCObj9_TrajPointACCObj9_wExistProb_ub_Pv, phyValue);
            chgEv_TrajPointACCObj9_TrajPointACCObj9_wExistProb_ub = 1;
        }
        else
        {
            chgEv_TrajPointACCObj9_TrajPointACCObj9_wExistProb_ub = 0;
        }    
        //update the signal value
        Msg_TrajPointACCObj9.TrajPointACCObj9_wExistProb_ub=rawValue;        
    }                                                                           
}

on envVar E_pric_RadarFrontCenter_TrajPointACCObj9_TrajPointACCObj9_wExistProb_ub_Pv
{
    qword rawValue = 0ll;
    float phyValue = 0.0;
    
    //update the raw value with physical value 
    {
        if(chgEv_TrajPointACCObj9_TrajPointACCObj9_wExistProb_ub == 0)
        {
            phyValue = getvalue(this);
            // physical to raw conversion
            rawValue = ((phyValue -(0))/0.00390625);
            putValue(E_pric_RadarFrontCenter_TrajPointACCObj9_TrajPointACCObj9_wExistProb_ub_Rv, rawValue);
            chgEv_TrajPointACCObj9_TrajPointACCObj9_wExistProb_ub = 1;  
        }
        else
        {
            chgEv_TrajPointACCObj9_TrajPointACCObj9_wExistProb_ub = 0;
        }
    }
}


 
on envVar E_pric_RadarFrontCenter_TrajPointACCObj9_TrajPointACCObj9_TrajEnd_b_Rv
{
    qword rawValue = 0ll;
    float rawValue_float = 0.0;
    float phyValue = 0.0;        

    //set the signal with updated raw value
    if(getValue(E_pric_RadarFrontCenter_TrajPointACCObj9_TrajPointACCObj9_TrajEnd_b_SetVt)==0)
    {
        rawValue = getvalue(this);
        if(chgEv_TrajPointACCObj9_TrajPointACCObj9_TrajEnd_b == 0)
        {
            //type conversion to float
            rawValue_float = rawValue;        
            // raw to physical conversion
            phyValue = ((rawValue_float *1)+(0));
            putValue(E_pric_RadarFrontCenter_TrajPointACCObj9_TrajPointACCObj9_TrajEnd_b_Pv, phyValue);
            chgEv_TrajPointACCObj9_TrajPointACCObj9_TrajEnd_b = 1;
        }
        else
        {
            chgEv_TrajPointACCObj9_TrajPointACCObj9_TrajEnd_b = 0;
        }    
        //update the signal value
        Msg_TrajPointACCObj9.TrajPointACCObj9_TrajEnd_b=rawValue;        
    }                                                                           
}

on envVar E_pric_RadarFrontCenter_TrajPointACCObj9_TrajPointACCObj9_TrajEnd_b_Pv
{
    qword rawValue = 0ll;
    float phyValue = 0.0;
    
    //update the raw value with physical value 
    if(getValue(E_pric_RadarFrontCenter_TrajPointACCObj9_TrajPointACCObj9_TrajEnd_b_SetVt)==0)
    {
        if(chgEv_TrajPointACCObj9_TrajPointACCObj9_TrajEnd_b == 0)
        {
            phyValue = getvalue(this);
            // physical to raw conversion
            rawValue = ((phyValue -(0))/1);
            putValue(E_pric_RadarFrontCenter_TrajPointACCObj9_TrajPointACCObj9_TrajEnd_b_Rv, rawValue);
            chgEv_TrajPointACCObj9_TrajPointACCObj9_TrajEnd_b = 1;  
        }
        else
        {
            chgEv_TrajPointACCObj9_TrajPointACCObj9_TrajEnd_b = 0;
        }
    }
}

on envVar E_pric_RadarFrontCenter_TrajPointACCObj9_TrajPointACCObj9_TrajEnd_b_Vt
{
    qword rawValue = 0ll;
    if(getValue(E_pric_RadarFrontCenter_TrajPointACCObj9_TrajPointACCObj9_TrajEnd_b_SetVt))
    {
        //update the signal value
        Msg_TrajPointACCObj9.TrajPointACCObj9_TrajEnd_b=getValue(this);
    }
}

on envVar E_pric_RadarFrontCenter_TrajPointACCObj9_TrajPointACCObj9_TrajEnd_b_SetVt
{
    if(getValue(E_pric_RadarFrontCenter_TrajPointACCObj9_TrajPointACCObj9_TrajEnd_b_SetVt))
    {
        //update the signal value
        Msg_TrajPointACCObj9.TrajPointACCObj9_TrajEnd_b=getvalue(E_pric_RadarFrontCenter_TrajPointACCObj9_TrajPointACCObj9_TrajEnd_b_Vt);
    }
    else
    {
        Msg_TrajPointACCObj9.TrajPointACCObj9_TrajEnd_b=getValue(E_pric_RadarFrontCenter_TrajPointACCObj9_TrajPointACCObj9_TrajEnd_b_Rv);
    }
}
 
on envVar E_pric_RadarFrontCenter_TrajPointACCObj9_TrajPointACCObj9_dVarYv_uw_Rv
{
    qword rawValue = 0ll;
    float rawValue_float = 0.0;
    float phyValue = 0.0;        

    //set the signal with updated raw value
    {
        rawValue = getvalue(this);
        if(chgEv_TrajPointACCObj9_TrajPointACCObj9_dVarYv_uw == 0)
        {
            //type conversion to float
            rawValue_float = rawValue;        
            // raw to physical conversion
            phyValue = ((rawValue_float *0.00195313)+(0));
            putValue(E_pric_RadarFrontCenter_TrajPointACCObj9_TrajPointACCObj9_dVarYv_uw_Pv, phyValue);
            chgEv_TrajPointACCObj9_TrajPointACCObj9_dVarYv_uw = 1;
        }
        else
        {
            chgEv_TrajPointACCObj9_TrajPointACCObj9_dVarYv_uw = 0;
        }    
        //update the signal value
        Msg_TrajPointACCObj9.TrajPointACCObj9_dVarYv_uw=rawValue;        
    }                                                                           
}

on envVar E_pric_RadarFrontCenter_TrajPointACCObj9_TrajPointACCObj9_dVarYv_uw_Pv
{
    qword rawValue = 0ll;
    float phyValue = 0.0;
    
    //update the raw value with physical value 
    {
        if(chgEv_TrajPointACCObj9_TrajPointACCObj9_dVarYv_uw == 0)
        {
            phyValue = getvalue(this);
            // physical to raw conversion
            rawValue = ((phyValue -(0))/0.00195313);
            putValue(E_pric_RadarFrontCenter_TrajPointACCObj9_TrajPointACCObj9_dVarYv_uw_Rv, rawValue);
            chgEv_TrajPointACCObj9_TrajPointACCObj9_dVarYv_uw = 1;  
        }
        else
        {
            chgEv_TrajPointACCObj9_TrajPointACCObj9_dVarYv_uw = 0;
        }
    }
}


 
on envVar E_pric_RadarFrontCenter_TrajPointACCObj9_TrajPointACCObj9_dVarXv_uw_Rv
{
    qword rawValue = 0ll;
    float rawValue_float = 0.0;
    float phyValue = 0.0;        

    //set the signal with updated raw value
    {
        rawValue = getvalue(this);
        if(chgEv_TrajPointACCObj9_TrajPointACCObj9_dVarXv_uw == 0)
        {
            //type conversion to float
            rawValue_float = rawValue;        
            // raw to physical conversion
            phyValue = ((rawValue_float *0.00195313)+(0));
            putValue(E_pric_RadarFrontCenter_TrajPointACCObj9_TrajPointACCObj9_dVarXv_uw_Pv, phyValue);
            chgEv_TrajPointACCObj9_TrajPointACCObj9_dVarXv_uw = 1;
        }
        else
        {
            chgEv_TrajPointACCObj9_TrajPointACCObj9_dVarXv_uw = 0;
        }    
        //update the signal value
        Msg_TrajPointACCObj9.TrajPointACCObj9_dVarXv_uw=rawValue;        
    }                                                                           
}

on envVar E_pric_RadarFrontCenter_TrajPointACCObj9_TrajPointACCObj9_dVarXv_uw_Pv
{
    qword rawValue = 0ll;
    float phyValue = 0.0;
    
    //update the raw value with physical value 
    {
        if(chgEv_TrajPointACCObj9_TrajPointACCObj9_dVarXv_uw == 0)
        {
            phyValue = getvalue(this);
            // physical to raw conversion
            rawValue = ((phyValue -(0))/0.00195313);
            putValue(E_pric_RadarFrontCenter_TrajPointACCObj9_TrajPointACCObj9_dVarXv_uw_Rv, rawValue);
            chgEv_TrajPointACCObj9_TrajPointACCObj9_dVarXv_uw = 1;  
        }
        else
        {
            chgEv_TrajPointACCObj9_TrajPointACCObj9_dVarXv_uw = 0;
        }
    }
}


 
on envVar E_pric_RadarFrontCenter_TrajPointACCObj9_TrajPointACCObj9_InvDir_b_Rv
{
    qword rawValue = 0ll;
    float rawValue_float = 0.0;
    float phyValue = 0.0;        

    //set the signal with updated raw value
    if(getValue(E_pric_RadarFrontCenter_TrajPointACCObj9_TrajPointACCObj9_InvDir_b_SetVt)==0)
    {
        rawValue = getvalue(this);
        if(chgEv_TrajPointACCObj9_TrajPointACCObj9_InvDir_b == 0)
        {
            //type conversion to float
            rawValue_float = rawValue;        
            // raw to physical conversion
            phyValue = ((rawValue_float *1)+(0));
            putValue(E_pric_RadarFrontCenter_TrajPointACCObj9_TrajPointACCObj9_InvDir_b_Pv, phyValue);
            chgEv_TrajPointACCObj9_TrajPointACCObj9_InvDir_b = 1;
        }
        else
        {
            chgEv_TrajPointACCObj9_TrajPointACCObj9_InvDir_b = 0;
        }    
        //update the signal value
        Msg_TrajPointACCObj9.TrajPointACCObj9_InvDir_b=rawValue;        
    }                                                                           
}

on envVar E_pric_RadarFrontCenter_TrajPointACCObj9_TrajPointACCObj9_InvDir_b_Pv
{
    qword rawValue = 0ll;
    float phyValue = 0.0;
    
    //update the raw value with physical value 
    if(getValue(E_pric_RadarFrontCenter_TrajPointACCObj9_TrajPointACCObj9_InvDir_b_SetVt)==0)
    {
        if(chgEv_TrajPointACCObj9_TrajPointACCObj9_InvDir_b == 0)
        {
            phyValue = getvalue(this);
            // physical to raw conversion
            rawValue = ((phyValue -(0))/1);
            putValue(E_pric_RadarFrontCenter_TrajPointACCObj9_TrajPointACCObj9_InvDir_b_Rv, rawValue);
            chgEv_TrajPointACCObj9_TrajPointACCObj9_InvDir_b = 1;  
        }
        else
        {
            chgEv_TrajPointACCObj9_TrajPointACCObj9_InvDir_b = 0;
        }
    }
}

on envVar E_pric_RadarFrontCenter_TrajPointACCObj9_TrajPointACCObj9_InvDir_b_Vt
{
    qword rawValue = 0ll;
    if(getValue(E_pric_RadarFrontCenter_TrajPointACCObj9_TrajPointACCObj9_InvDir_b_SetVt))
    {
        //update the signal value
        Msg_TrajPointACCObj9.TrajPointACCObj9_InvDir_b=getValue(this);
    }
}

on envVar E_pric_RadarFrontCenter_TrajPointACCObj9_TrajPointACCObj9_InvDir_b_SetVt
{
    if(getValue(E_pric_RadarFrontCenter_TrajPointACCObj9_TrajPointACCObj9_InvDir_b_SetVt))
    {
        //update the signal value
        Msg_TrajPointACCObj9.TrajPointACCObj9_InvDir_b=getvalue(E_pric_RadarFrontCenter_TrajPointACCObj9_TrajPointACCObj9_InvDir_b_Vt);
    }
    else
    {
        Msg_TrajPointACCObj9.TrajPointACCObj9_InvDir_b=getValue(E_pric_RadarFrontCenter_TrajPointACCObj9_TrajPointACCObj9_InvDir_b_Rv);
    }
}
 
on envVar E_pric_RadarFrontCenter_TrajPointACCObj9_TrajPointACCObj9_dxv_sw_Rv
{
    qword rawValue = 0ll;
    float rawValue_float = 0.0;
    float phyValue = 0.0;        

    //set the signal with updated raw value
    {
        rawValue = getvalue(this);
        if(chgEv_TrajPointACCObj9_TrajPointACCObj9_dxv_sw == 0)
        {
            //type conversion to float
            rawValue_float = rawValue;        
            // raw to physical conversion
            phyValue = ((rawValue_float *0.0078125)+(0));
            putValue(E_pric_RadarFrontCenter_TrajPointACCObj9_TrajPointACCObj9_dxv_sw_Pv, phyValue);
            chgEv_TrajPointACCObj9_TrajPointACCObj9_dxv_sw = 1;
        }
        else
        {
            chgEv_TrajPointACCObj9_TrajPointACCObj9_dxv_sw = 0;
        }    
        //update the signal value
        Msg_TrajPointACCObj9.TrajPointACCObj9_dxv_sw=rawValue;        
    }                                                                           
}

on envVar E_pric_RadarFrontCenter_TrajPointACCObj9_TrajPointACCObj9_dxv_sw_Pv
{
    qword rawValue = 0ll;
    float phyValue = 0.0;
    
    //update the raw value with physical value 
    {
        if(chgEv_TrajPointACCObj9_TrajPointACCObj9_dxv_sw == 0)
        {
            phyValue = getvalue(this);
            // physical to raw conversion
            rawValue = ((phyValue -(0))/0.0078125);
            putValue(E_pric_RadarFrontCenter_TrajPointACCObj9_TrajPointACCObj9_dxv_sw_Rv, rawValue);
            chgEv_TrajPointACCObj9_TrajPointACCObj9_dxv_sw = 1;  
        }
        else
        {
            chgEv_TrajPointACCObj9_TrajPointACCObj9_dxv_sw = 0;
        }
    }
}


 
on envVar E_pric_RadarFrontCenter_TrajPointACCObj9_TrajPointACCObj9_Stopped_b_Rv
{
    qword rawValue = 0ll;
    float rawValue_float = 0.0;
    float phyValue = 0.0;        

    //set the signal with updated raw value
    if(getValue(E_pric_RadarFrontCenter_TrajPointACCObj9_TrajPointACCObj9_Stopped_b_SetVt)==0)
    {
        rawValue = getvalue(this);
        if(chgEv_TrajPointACCObj9_TrajPointACCObj9_Stopped_b == 0)
        {
            //type conversion to float
            rawValue_float = rawValue;        
            // raw to physical conversion
            phyValue = ((rawValue_float *1)+(0));
            putValue(E_pric_RadarFrontCenter_TrajPointACCObj9_TrajPointACCObj9_Stopped_b_Pv, phyValue);
            chgEv_TrajPointACCObj9_TrajPointACCObj9_Stopped_b = 1;
        }
        else
        {
            chgEv_TrajPointACCObj9_TrajPointACCObj9_Stopped_b = 0;
        }    
        //update the signal value
        Msg_TrajPointACCObj9.TrajPointACCObj9_Stopped_b=rawValue;        
    }                                                                           
}

on envVar E_pric_RadarFrontCenter_TrajPointACCObj9_TrajPointACCObj9_Stopped_b_Pv
{
    qword rawValue = 0ll;
    float phyValue = 0.0;
    
    //update the raw value with physical value 
    if(getValue(E_pric_RadarFrontCenter_TrajPointACCObj9_TrajPointACCObj9_Stopped_b_SetVt)==0)
    {
        if(chgEv_TrajPointACCObj9_TrajPointACCObj9_Stopped_b == 0)
        {
            phyValue = getvalue(this);
            // physical to raw conversion
            rawValue = ((phyValue -(0))/1);
            putValue(E_pric_RadarFrontCenter_TrajPointACCObj9_TrajPointACCObj9_Stopped_b_Rv, rawValue);
            chgEv_TrajPointACCObj9_TrajPointACCObj9_Stopped_b = 1;  
        }
        else
        {
            chgEv_TrajPointACCObj9_TrajPointACCObj9_Stopped_b = 0;
        }
    }
}

on envVar E_pric_RadarFrontCenter_TrajPointACCObj9_TrajPointACCObj9_Stopped_b_Vt
{
    qword rawValue = 0ll;
    if(getValue(E_pric_RadarFrontCenter_TrajPointACCObj9_TrajPointACCObj9_Stopped_b_SetVt))
    {
        //update the signal value
        Msg_TrajPointACCObj9.TrajPointACCObj9_Stopped_b=getValue(this);
    }
}

on envVar E_pric_RadarFrontCenter_TrajPointACCObj9_TrajPointACCObj9_Stopped_b_SetVt
{
    if(getValue(E_pric_RadarFrontCenter_TrajPointACCObj9_TrajPointACCObj9_Stopped_b_SetVt))
    {
        //update the signal value
        Msg_TrajPointACCObj9.TrajPointACCObj9_Stopped_b=getvalue(E_pric_RadarFrontCenter_TrajPointACCObj9_TrajPointACCObj9_Stopped_b_Vt);
    }
    else
    {
        Msg_TrajPointACCObj9.TrajPointACCObj9_Stopped_b=getValue(E_pric_RadarFrontCenter_TrajPointACCObj9_TrajPointACCObj9_Stopped_b_Rv);
    }
}
 
on envVar E_pric_RadarFrontCenter_TrajPointACCObj9_TrajPointACCObj9_dyv_sw_Rv
{
    qword rawValue = 0ll;
    float rawValue_float = 0.0;
    float phyValue = 0.0;        

    //set the signal with updated raw value
    {
        rawValue = getvalue(this);
        if(chgEv_TrajPointACCObj9_TrajPointACCObj9_dyv_sw == 0)
        {
            //type conversion to float
            rawValue_float = rawValue;        
            // raw to physical conversion
            phyValue = ((rawValue_float *0.0078125)+(0));
            putValue(E_pric_RadarFrontCenter_TrajPointACCObj9_TrajPointACCObj9_dyv_sw_Pv, phyValue);
            chgEv_TrajPointACCObj9_TrajPointACCObj9_dyv_sw = 1;
        }
        else
        {
            chgEv_TrajPointACCObj9_TrajPointACCObj9_dyv_sw = 0;
        }    
        //update the signal value
        Msg_TrajPointACCObj9.TrajPointACCObj9_dyv_sw=rawValue;        
    }                                                                           
}

on envVar E_pric_RadarFrontCenter_TrajPointACCObj9_TrajPointACCObj9_dyv_sw_Pv
{
    qword rawValue = 0ll;
    float phyValue = 0.0;
    
    //update the raw value with physical value 
    {
        if(chgEv_TrajPointACCObj9_TrajPointACCObj9_dyv_sw == 0)
        {
            phyValue = getvalue(this);
            // physical to raw conversion
            rawValue = ((phyValue -(0))/0.0078125);
            putValue(E_pric_RadarFrontCenter_TrajPointACCObj9_TrajPointACCObj9_dyv_sw_Rv, rawValue);
            chgEv_TrajPointACCObj9_TrajPointACCObj9_dyv_sw = 1;  
        }
        else
        {
            chgEv_TrajPointACCObj9_TrajPointACCObj9_dyv_sw = 0;
        }
    }
}


 
on envVar E_pric_RadarFrontCenter_TrajPointACCObj9_TrajPointACCObj9_timestamp_Rv
{
    qword rawValue = 0ll;
    float rawValue_float = 0.0;
    float phyValue = 0.0;        

    //set the signal with updated raw value
    {
        rawValue = getvalue(this);
        if(chgEv_TrajPointACCObj9_TrajPointACCObj9_timestamp == 0)
        {
            //type conversion to float
            rawValue_float = rawValue;        
            // raw to physical conversion
            phyValue = ((rawValue_float *0.000488281)+(0));
            putValue(E_pric_RadarFrontCenter_TrajPointACCObj9_TrajPointACCObj9_timestamp_Pv, phyValue);
            chgEv_TrajPointACCObj9_TrajPointACCObj9_timestamp = 1;
        }
        else
        {
            chgEv_TrajPointACCObj9_TrajPointACCObj9_timestamp = 0;
        }    
        //update the signal value
        Msg_TrajPointACCObj9.TrajPointACCObj9_timestamp=rawValue;        
    }                                                                           
}

on envVar E_pric_RadarFrontCenter_TrajPointACCObj9_TrajPointACCObj9_timestamp_Pv
{
    qword rawValue = 0ll;
    float phyValue = 0.0;
    
    //update the raw value with physical value 
    {
        if(chgEv_TrajPointACCObj9_TrajPointACCObj9_timestamp == 0)
        {
            phyValue = getvalue(this);
            // physical to raw conversion
            rawValue = ((phyValue -(0))/0.000488281);
            putValue(E_pric_RadarFrontCenter_TrajPointACCObj9_TrajPointACCObj9_timestamp_Rv, rawValue);
            chgEv_TrajPointACCObj9_TrajPointACCObj9_timestamp = 1;  
        }
        else
        {
            chgEv_TrajPointACCObj9_TrajPointACCObj9_timestamp = 0;
        }
    }
}


 
on envVar E_pric_RadarFrontCenter_TrajPointACCObj9_TrajPointACCObj9_Valid_b_Rv
{
    qword rawValue = 0ll;
    float rawValue_float = 0.0;
    float phyValue = 0.0;        

    //set the signal with updated raw value
    if(getValue(E_pric_RadarFrontCenter_TrajPointACCObj9_TrajPointACCObj9_Valid_b_SetVt)==0)
    {
        rawValue = getvalue(this);
        if(chgEv_TrajPointACCObj9_TrajPointACCObj9_Valid_b == 0)
        {
            //type conversion to float
            rawValue_float = rawValue;        
            // raw to physical conversion
            phyValue = ((rawValue_float *1)+(0));
            putValue(E_pric_RadarFrontCenter_TrajPointACCObj9_TrajPointACCObj9_Valid_b_Pv, phyValue);
            chgEv_TrajPointACCObj9_TrajPointACCObj9_Valid_b = 1;
        }
        else
        {
            chgEv_TrajPointACCObj9_TrajPointACCObj9_Valid_b = 0;
        }    
        //update the signal value
        Msg_TrajPointACCObj9.TrajPointACCObj9_Valid_b=rawValue;        
    }                                                                           
}

on envVar E_pric_RadarFrontCenter_TrajPointACCObj9_TrajPointACCObj9_Valid_b_Pv
{
    qword rawValue = 0ll;
    float phyValue = 0.0;
    
    //update the raw value with physical value 
    if(getValue(E_pric_RadarFrontCenter_TrajPointACCObj9_TrajPointACCObj9_Valid_b_SetVt)==0)
    {
        if(chgEv_TrajPointACCObj9_TrajPointACCObj9_Valid_b == 0)
        {
            phyValue = getvalue(this);
            // physical to raw conversion
            rawValue = ((phyValue -(0))/1);
            putValue(E_pric_RadarFrontCenter_TrajPointACCObj9_TrajPointACCObj9_Valid_b_Rv, rawValue);
            chgEv_TrajPointACCObj9_TrajPointACCObj9_Valid_b = 1;  
        }
        else
        {
            chgEv_TrajPointACCObj9_TrajPointACCObj9_Valid_b = 0;
        }
    }
}

on envVar E_pric_RadarFrontCenter_TrajPointACCObj9_TrajPointACCObj9_Valid_b_Vt
{
    qword rawValue = 0ll;
    if(getValue(E_pric_RadarFrontCenter_TrajPointACCObj9_TrajPointACCObj9_Valid_b_SetVt))
    {
        //update the signal value
        Msg_TrajPointACCObj9.TrajPointACCObj9_Valid_b=getValue(this);
    }
}

on envVar E_pric_RadarFrontCenter_TrajPointACCObj9_TrajPointACCObj9_Valid_b_SetVt
{
    if(getValue(E_pric_RadarFrontCenter_TrajPointACCObj9_TrajPointACCObj9_Valid_b_SetVt))
    {
        //update the signal value
        Msg_TrajPointACCObj9.TrajPointACCObj9_Valid_b=getvalue(E_pric_RadarFrontCenter_TrajPointACCObj9_TrajPointACCObj9_Valid_b_Vt);
    }
    else
    {
        Msg_TrajPointACCObj9.TrajPointACCObj9_Valid_b=getValue(E_pric_RadarFrontCenter_TrajPointACCObj9_TrajPointACCObj9_Valid_b_Rv);
    }
}
 
on envVar E_pric_RadarFrontCenter_TrajPointACCObj8_tx
{
    if(getValue(this))
    {       
        
        //update the BZ Signal
        if(TrajPointACCObj8_TrajPointACCObj8_MsgCtr_wrongvalctr == 0)
        {
            update_TrajPointACCObj8_TrajPointACCObj8_MsgCtr_counter();
            Msg_TrajPointACCObj8.TrajPointACCObj8_MsgCtr= TrajPointACCObj8_TrajPointACCObj8_MsgCtr_counter;
        }
        else if(TrajPointACCObj8_TrajPointACCObj8_MsgCtr_wrongvalctr > 0)
        {
             TrajPointACCObj8_TrajPointACCObj8_MsgCtr_wrongvalctr--;
              // if counter becomes zero, update panel controller to zero
             if(TrajPointACCObj8_TrajPointACCObj8_MsgCtr_wrongvalctr == 0)
             {
                 putValue(E_pric_RadarFrontCenter_TrajPointACCObj8_TrajPointACCObj8_MsgCtr_wrongvalctr,0);
             }
        }
        else
        {
            //do nothing
        }        
        //update the BZ Signal
        if(TrajPointACCObj8_TrajPointACCObj8_blockCtr_wrongvalctr == 0)
        {
            update_TrajPointACCObj8_TrajPointACCObj8_blockCtr_counter();
            Msg_TrajPointACCObj8.TrajPointACCObj8_blockCtr= TrajPointACCObj8_TrajPointACCObj8_blockCtr_counter;
        }
        else if(TrajPointACCObj8_TrajPointACCObj8_blockCtr_wrongvalctr > 0)
        {
             TrajPointACCObj8_TrajPointACCObj8_blockCtr_wrongvalctr--;
              // if counter becomes zero, update panel controller to zero
             if(TrajPointACCObj8_TrajPointACCObj8_blockCtr_wrongvalctr == 0)
             {
                 putValue(E_pric_RadarFrontCenter_TrajPointACCObj8_TrajPointACCObj8_blockCtr_wrongvalctr,0);
             }
        }
        else
        {
            //do nothing
        }        
        //calculate the CRC checksum
        update_TrajPointACCObj8_ChkSum_Checksum();

        output(Msg_TrajPointACCObj8);        
    }
}

on envVar E_pric_RadarFrontCenter_TrajPointACCObj8_Range
{
    qword rawstatus = 0ll;
    qword rawValue = 0ll;    
    
    rawstatus = getvalue(this);    
    // set all the signals with min raw /max raw /init raw
    switch (rawstatus) 
    {
     case(0) :
        rawValue= -32768;
        putValue(E_pric_RadarFrontCenter_TrajPointACCObj8_TrajPointACCObj8_dyv_sw_Rv, rawValue);
        rawValue= 0;
        putValue(E_pric_RadarFrontCenter_TrajPointACCObj8_TrajPointACCObj8_dVarYv_uw_Rv, rawValue);
        rawValue= 0;
        putValue(E_pric_RadarFrontCenter_TrajPointACCObj8_TrajPointACCObj8_timestamp_Rv, rawValue);
        rawValue= 0;
        putValue(E_pric_RadarFrontCenter_TrajPointACCObj8_TrajPointACCObj8_wExistProb_ub_Rv, rawValue);
        rawValue= 0;
        putValue(E_pric_RadarFrontCenter_TrajPointACCObj8_TrajPointACCObj8_InvDir_b_Rv, rawValue);
        rawValue= 0;
        putValue(E_pric_RadarFrontCenter_TrajPointACCObj8_TrajPointACCObj8_Stopped_b_Rv, rawValue);
        rawValue= 0;
        putValue(E_pric_RadarFrontCenter_TrajPointACCObj8_TrajPointACCObj8_Stand_b_Rv, rawValue);
        rawValue= -32768;
        putValue(E_pric_RadarFrontCenter_TrajPointACCObj8_TrajPointACCObj8_dxv_sw_Rv, rawValue);
        rawValue= 0;
        putValue(E_pric_RadarFrontCenter_TrajPointACCObj8_TrajPointACCObj8_TrajEnd_b_Rv, rawValue);
        rawValue= 0;
        putValue(E_pric_RadarFrontCenter_TrajPointACCObj8_TrajPointACCObj8_dVarXv_uw_Rv, rawValue);
        rawValue= 0;
        putValue(E_pric_RadarFrontCenter_TrajPointACCObj8_TrajPointACCObj8_Valid_b_Rv, rawValue);
        rawValue= 0;
        putValue(E_pric_RadarFrontCenter_TrajPointACCObj8_TrajPointACCObj8_Drive_b_Rv, rawValue);
        break;
     case(1) :
        rawValue= 32767;
        putValue(E_pric_RadarFrontCenter_TrajPointACCObj8_TrajPointACCObj8_dyv_sw_Rv, rawValue);
        rawValue= 65534;
        putValue(E_pric_RadarFrontCenter_TrajPointACCObj8_TrajPointACCObj8_dVarYv_uw_Rv, rawValue);
        rawValue= 65536;
        putValue(E_pric_RadarFrontCenter_TrajPointACCObj8_TrajPointACCObj8_timestamp_Rv, rawValue);
        rawValue= 255;
        putValue(E_pric_RadarFrontCenter_TrajPointACCObj8_TrajPointACCObj8_wExistProb_ub_Rv, rawValue);
        rawValue= 1;
        putValue(E_pric_RadarFrontCenter_TrajPointACCObj8_TrajPointACCObj8_InvDir_b_Rv, rawValue);
        rawValue= 1;
        putValue(E_pric_RadarFrontCenter_TrajPointACCObj8_TrajPointACCObj8_Stopped_b_Rv, rawValue);
        rawValue= 1;
        putValue(E_pric_RadarFrontCenter_TrajPointACCObj8_TrajPointACCObj8_Stand_b_Rv, rawValue);
        rawValue= 32767;
        putValue(E_pric_RadarFrontCenter_TrajPointACCObj8_TrajPointACCObj8_dxv_sw_Rv, rawValue);
        rawValue= 1;
        putValue(E_pric_RadarFrontCenter_TrajPointACCObj8_TrajPointACCObj8_TrajEnd_b_Rv, rawValue);
        rawValue= 65534;
        putValue(E_pric_RadarFrontCenter_TrajPointACCObj8_TrajPointACCObj8_dVarXv_uw_Rv, rawValue);
        rawValue= 1;
        putValue(E_pric_RadarFrontCenter_TrajPointACCObj8_TrajPointACCObj8_Valid_b_Rv, rawValue);
        rawValue= 1;
        putValue(E_pric_RadarFrontCenter_TrajPointACCObj8_TrajPointACCObj8_Drive_b_Rv, rawValue);
        break;
     default :
        rawValue= -32768;
        putValue(E_pric_RadarFrontCenter_TrajPointACCObj8_TrajPointACCObj8_dyv_sw_Rv, rawValue);
        rawValue= 0;
        putValue(E_pric_RadarFrontCenter_TrajPointACCObj8_TrajPointACCObj8_dVarYv_uw_Rv, rawValue);
        rawValue= 0;
        putValue(E_pric_RadarFrontCenter_TrajPointACCObj8_TrajPointACCObj8_timestamp_Rv, rawValue);
        rawValue= 0;
        putValue(E_pric_RadarFrontCenter_TrajPointACCObj8_TrajPointACCObj8_wExistProb_ub_Rv, rawValue);
        rawValue= 0;
        putValue(E_pric_RadarFrontCenter_TrajPointACCObj8_TrajPointACCObj8_InvDir_b_Rv, rawValue);
        rawValue= 0;
        putValue(E_pric_RadarFrontCenter_TrajPointACCObj8_TrajPointACCObj8_Stopped_b_Rv, rawValue);
        rawValue= 0;
        putValue(E_pric_RadarFrontCenter_TrajPointACCObj8_TrajPointACCObj8_Stand_b_Rv, rawValue);
        rawValue= -32768;
        putValue(E_pric_RadarFrontCenter_TrajPointACCObj8_TrajPointACCObj8_dxv_sw_Rv, rawValue);
        rawValue= 0;
        putValue(E_pric_RadarFrontCenter_TrajPointACCObj8_TrajPointACCObj8_TrajEnd_b_Rv, rawValue);
        rawValue= 0;
        putValue(E_pric_RadarFrontCenter_TrajPointACCObj8_TrajPointACCObj8_dVarXv_uw_Rv, rawValue);
        rawValue= 0;
        putValue(E_pric_RadarFrontCenter_TrajPointACCObj8_TrajPointACCObj8_Valid_b_Rv, rawValue);
        rawValue= 0;
        putValue(E_pric_RadarFrontCenter_TrajPointACCObj8_TrajPointACCObj8_Drive_b_Rv, rawValue);
      break;
   }
}

on envVar E_pric_RadarFrontCenter_TrajPointACCObj8_Dlc
{
    if(getValue(E_pric_RadarFrontCenter_TrajPointACCObj8_enDlc))
    {
        Msg_TrajPointACCObj8.dlc =getValue(this);
    }
    else
    {
       Dbc_dlc = 16;
	   Msg_TrajPointACCObj8.dlc = Calc_Canfd_dlc(Dbc_dlc);
	   	
  }
}

on envVar E_pric_RadarFrontCenter_TrajPointACCObj8_enDlc
{
    //For Messages with DLC = 8, set wrong DLC to smaller than defined DLC
    //For Messages with DLC < 8 set wrong DLC to smaller/longer than defined DLC
    if(getValue(this))
    {
        Msg_TrajPointACCObj8.dlc =getValue(E_pric_RadarFrontCenter_TrajPointACCObj8_Dlc);
    }
    else
    {
       Dbc_dlc = 16;
	   Msg_TrajPointACCObj8.dlc = Calc_Canfd_dlc(Dbc_dlc);
			
    }
}

on envVar E_pric_RadarFrontCenter_TrajPointACCObj8_TrajPointACCObj8_CRC_wrongvalctr
{
    //update disturb count
    //disturb value range:(-1 = always send wrong value),( X>0 ,x is the number of Messages with wrong CHK sent)
    TrajPointACCObj8_TrajPointACCObj8_CRC_wrongvalctr =getValue(this);    
}
on envVar E_pric_RadarFrontCenter_TrajPointACCObj8_TrajPointACCObj8_MsgCtr_wrongvalctr
{
    //update disturb count
    //disturb value range:(-1 = always send wrong value),( X>0 ,x is the number of Messages with wrong CHK sent)
    TrajPointACCObj8_TrajPointACCObj8_MsgCtr_wrongvalctr =getValue(this);    
}
on envVar E_pric_RadarFrontCenter_TrajPointACCObj8_TrajPointACCObj8_blockCtr_wrongvalctr
{
    //update disturb count
    //disturb value range:(-1 = always send wrong value),( X>0 ,x is the number of Messages with wrong CHK sent)
    TrajPointACCObj8_TrajPointACCObj8_blockCtr_wrongvalctr =getValue(this);    
}

on envVar E_pric_RadarFrontCenter_TrajPointACCObj8_TrajPointACCObj8_dyv_sw_Rv
{
    qword rawValue = 0ll;
    float rawValue_float = 0.0;
    float phyValue = 0.0;        

    //set the signal with updated raw value
    {
        rawValue = getvalue(this);
        if(chgEv_TrajPointACCObj8_TrajPointACCObj8_dyv_sw == 0)
        {
            //type conversion to float
            rawValue_float = rawValue;        
            // raw to physical conversion
            phyValue = ((rawValue_float *0.0078125)+(0));
            putValue(E_pric_RadarFrontCenter_TrajPointACCObj8_TrajPointACCObj8_dyv_sw_Pv, phyValue);
            chgEv_TrajPointACCObj8_TrajPointACCObj8_dyv_sw = 1;
        }
        else
        {
            chgEv_TrajPointACCObj8_TrajPointACCObj8_dyv_sw = 0;
        }    
        //update the signal value
        Msg_TrajPointACCObj8.TrajPointACCObj8_dyv_sw=rawValue;        
    }                                                                           
}

on envVar E_pric_RadarFrontCenter_TrajPointACCObj8_TrajPointACCObj8_dyv_sw_Pv
{
    qword rawValue = 0ll;
    float phyValue = 0.0;
    
    //update the raw value with physical value 
    {
        if(chgEv_TrajPointACCObj8_TrajPointACCObj8_dyv_sw == 0)
        {
            phyValue = getvalue(this);
            // physical to raw conversion
            rawValue = ((phyValue -(0))/0.0078125);
            putValue(E_pric_RadarFrontCenter_TrajPointACCObj8_TrajPointACCObj8_dyv_sw_Rv, rawValue);
            chgEv_TrajPointACCObj8_TrajPointACCObj8_dyv_sw = 1;  
        }
        else
        {
            chgEv_TrajPointACCObj8_TrajPointACCObj8_dyv_sw = 0;
        }
    }
}


 
on envVar E_pric_RadarFrontCenter_TrajPointACCObj8_TrajPointACCObj8_dVarYv_uw_Rv
{
    qword rawValue = 0ll;
    float rawValue_float = 0.0;
    float phyValue = 0.0;        

    //set the signal with updated raw value
    {
        rawValue = getvalue(this);
        if(chgEv_TrajPointACCObj8_TrajPointACCObj8_dVarYv_uw == 0)
        {
            //type conversion to float
            rawValue_float = rawValue;        
            // raw to physical conversion
            phyValue = ((rawValue_float *0.00195313)+(0));
            putValue(E_pric_RadarFrontCenter_TrajPointACCObj8_TrajPointACCObj8_dVarYv_uw_Pv, phyValue);
            chgEv_TrajPointACCObj8_TrajPointACCObj8_dVarYv_uw = 1;
        }
        else
        {
            chgEv_TrajPointACCObj8_TrajPointACCObj8_dVarYv_uw = 0;
        }    
        //update the signal value
        Msg_TrajPointACCObj8.TrajPointACCObj8_dVarYv_uw=rawValue;        
    }                                                                           
}

on envVar E_pric_RadarFrontCenter_TrajPointACCObj8_TrajPointACCObj8_dVarYv_uw_Pv
{
    qword rawValue = 0ll;
    float phyValue = 0.0;
    
    //update the raw value with physical value 
    {
        if(chgEv_TrajPointACCObj8_TrajPointACCObj8_dVarYv_uw == 0)
        {
            phyValue = getvalue(this);
            // physical to raw conversion
            rawValue = ((phyValue -(0))/0.00195313);
            putValue(E_pric_RadarFrontCenter_TrajPointACCObj8_TrajPointACCObj8_dVarYv_uw_Rv, rawValue);
            chgEv_TrajPointACCObj8_TrajPointACCObj8_dVarYv_uw = 1;  
        }
        else
        {
            chgEv_TrajPointACCObj8_TrajPointACCObj8_dVarYv_uw = 0;
        }
    }
}


 
on envVar E_pric_RadarFrontCenter_TrajPointACCObj8_TrajPointACCObj8_timestamp_Rv
{
    qword rawValue = 0ll;
    float rawValue_float = 0.0;
    float phyValue = 0.0;        

    //set the signal with updated raw value
    {
        rawValue = getvalue(this);
        if(chgEv_TrajPointACCObj8_TrajPointACCObj8_timestamp == 0)
        {
            //type conversion to float
            rawValue_float = rawValue;        
            // raw to physical conversion
            phyValue = ((rawValue_float *0.000488281)+(0));
            putValue(E_pric_RadarFrontCenter_TrajPointACCObj8_TrajPointACCObj8_timestamp_Pv, phyValue);
            chgEv_TrajPointACCObj8_TrajPointACCObj8_timestamp = 1;
        }
        else
        {
            chgEv_TrajPointACCObj8_TrajPointACCObj8_timestamp = 0;
        }    
        //update the signal value
        Msg_TrajPointACCObj8.TrajPointACCObj8_timestamp=rawValue;        
    }                                                                           
}

on envVar E_pric_RadarFrontCenter_TrajPointACCObj8_TrajPointACCObj8_timestamp_Pv
{
    qword rawValue = 0ll;
    float phyValue = 0.0;
    
    //update the raw value with physical value 
    {
        if(chgEv_TrajPointACCObj8_TrajPointACCObj8_timestamp == 0)
        {
            phyValue = getvalue(this);
            // physical to raw conversion
            rawValue = ((phyValue -(0))/0.000488281);
            putValue(E_pric_RadarFrontCenter_TrajPointACCObj8_TrajPointACCObj8_timestamp_Rv, rawValue);
            chgEv_TrajPointACCObj8_TrajPointACCObj8_timestamp = 1;  
        }
        else
        {
            chgEv_TrajPointACCObj8_TrajPointACCObj8_timestamp = 0;
        }
    }
}


 
on envVar E_pric_RadarFrontCenter_TrajPointACCObj8_TrajPointACCObj8_wExistProb_ub_Rv
{
    qword rawValue = 0ll;
    float rawValue_float = 0.0;
    float phyValue = 0.0;        

    //set the signal with updated raw value
    {
        rawValue = getvalue(this);
        if(chgEv_TrajPointACCObj8_TrajPointACCObj8_wExistProb_ub == 0)
        {
            //type conversion to float
            rawValue_float = rawValue;        
            // raw to physical conversion
            phyValue = ((rawValue_float *0.00390625)+(0));
            putValue(E_pric_RadarFrontCenter_TrajPointACCObj8_TrajPointACCObj8_wExistProb_ub_Pv, phyValue);
            chgEv_TrajPointACCObj8_TrajPointACCObj8_wExistProb_ub = 1;
        }
        else
        {
            chgEv_TrajPointACCObj8_TrajPointACCObj8_wExistProb_ub = 0;
        }    
        //update the signal value
        Msg_TrajPointACCObj8.TrajPointACCObj8_wExistProb_ub=rawValue;        
    }                                                                           
}

on envVar E_pric_RadarFrontCenter_TrajPointACCObj8_TrajPointACCObj8_wExistProb_ub_Pv
{
    qword rawValue = 0ll;
    float phyValue = 0.0;
    
    //update the raw value with physical value 
    {
        if(chgEv_TrajPointACCObj8_TrajPointACCObj8_wExistProb_ub == 0)
        {
            phyValue = getvalue(this);
            // physical to raw conversion
            rawValue = ((phyValue -(0))/0.00390625);
            putValue(E_pric_RadarFrontCenter_TrajPointACCObj8_TrajPointACCObj8_wExistProb_ub_Rv, rawValue);
            chgEv_TrajPointACCObj8_TrajPointACCObj8_wExistProb_ub = 1;  
        }
        else
        {
            chgEv_TrajPointACCObj8_TrajPointACCObj8_wExistProb_ub = 0;
        }
    }
}


 
on envVar E_pric_RadarFrontCenter_TrajPointACCObj8_TrajPointACCObj8_InvDir_b_Rv
{
    qword rawValue = 0ll;
    float rawValue_float = 0.0;
    float phyValue = 0.0;        

    //set the signal with updated raw value
    if(getValue(E_pric_RadarFrontCenter_TrajPointACCObj8_TrajPointACCObj8_InvDir_b_SetVt)==0)
    {
        rawValue = getvalue(this);
        if(chgEv_TrajPointACCObj8_TrajPointACCObj8_InvDir_b == 0)
        {
            //type conversion to float
            rawValue_float = rawValue;        
            // raw to physical conversion
            phyValue = ((rawValue_float *1)+(0));
            putValue(E_pric_RadarFrontCenter_TrajPointACCObj8_TrajPointACCObj8_InvDir_b_Pv, phyValue);
            chgEv_TrajPointACCObj8_TrajPointACCObj8_InvDir_b = 1;
        }
        else
        {
            chgEv_TrajPointACCObj8_TrajPointACCObj8_InvDir_b = 0;
        }    
        //update the signal value
        Msg_TrajPointACCObj8.TrajPointACCObj8_InvDir_b=rawValue;        
    }                                                                           
}

on envVar E_pric_RadarFrontCenter_TrajPointACCObj8_TrajPointACCObj8_InvDir_b_Pv
{
    qword rawValue = 0ll;
    float phyValue = 0.0;
    
    //update the raw value with physical value 
    if(getValue(E_pric_RadarFrontCenter_TrajPointACCObj8_TrajPointACCObj8_InvDir_b_SetVt)==0)
    {
        if(chgEv_TrajPointACCObj8_TrajPointACCObj8_InvDir_b == 0)
        {
            phyValue = getvalue(this);
            // physical to raw conversion
            rawValue = ((phyValue -(0))/1);
            putValue(E_pric_RadarFrontCenter_TrajPointACCObj8_TrajPointACCObj8_InvDir_b_Rv, rawValue);
            chgEv_TrajPointACCObj8_TrajPointACCObj8_InvDir_b = 1;  
        }
        else
        {
            chgEv_TrajPointACCObj8_TrajPointACCObj8_InvDir_b = 0;
        }
    }
}

on envVar E_pric_RadarFrontCenter_TrajPointACCObj8_TrajPointACCObj8_InvDir_b_Vt
{
    qword rawValue = 0ll;
    if(getValue(E_pric_RadarFrontCenter_TrajPointACCObj8_TrajPointACCObj8_InvDir_b_SetVt))
    {
        //update the signal value
        Msg_TrajPointACCObj8.TrajPointACCObj8_InvDir_b=getValue(this);
    }
}

on envVar E_pric_RadarFrontCenter_TrajPointACCObj8_TrajPointACCObj8_InvDir_b_SetVt
{
    if(getValue(E_pric_RadarFrontCenter_TrajPointACCObj8_TrajPointACCObj8_InvDir_b_SetVt))
    {
        //update the signal value
        Msg_TrajPointACCObj8.TrajPointACCObj8_InvDir_b=getvalue(E_pric_RadarFrontCenter_TrajPointACCObj8_TrajPointACCObj8_InvDir_b_Vt);
    }
    else
    {
        Msg_TrajPointACCObj8.TrajPointACCObj8_InvDir_b=getValue(E_pric_RadarFrontCenter_TrajPointACCObj8_TrajPointACCObj8_InvDir_b_Rv);
    }
}
 
on envVar E_pric_RadarFrontCenter_TrajPointACCObj8_TrajPointACCObj8_Stopped_b_Rv
{
    qword rawValue = 0ll;
    float rawValue_float = 0.0;
    float phyValue = 0.0;        

    //set the signal with updated raw value
    if(getValue(E_pric_RadarFrontCenter_TrajPointACCObj8_TrajPointACCObj8_Stopped_b_SetVt)==0)
    {
        rawValue = getvalue(this);
        if(chgEv_TrajPointACCObj8_TrajPointACCObj8_Stopped_b == 0)
        {
            //type conversion to float
            rawValue_float = rawValue;        
            // raw to physical conversion
            phyValue = ((rawValue_float *1)+(0));
            putValue(E_pric_RadarFrontCenter_TrajPointACCObj8_TrajPointACCObj8_Stopped_b_Pv, phyValue);
            chgEv_TrajPointACCObj8_TrajPointACCObj8_Stopped_b = 1;
        }
        else
        {
            chgEv_TrajPointACCObj8_TrajPointACCObj8_Stopped_b = 0;
        }    
        //update the signal value
        Msg_TrajPointACCObj8.TrajPointACCObj8_Stopped_b=rawValue;        
    }                                                                           
}

on envVar E_pric_RadarFrontCenter_TrajPointACCObj8_TrajPointACCObj8_Stopped_b_Pv
{
    qword rawValue = 0ll;
    float phyValue = 0.0;
    
    //update the raw value with physical value 
    if(getValue(E_pric_RadarFrontCenter_TrajPointACCObj8_TrajPointACCObj8_Stopped_b_SetVt)==0)
    {
        if(chgEv_TrajPointACCObj8_TrajPointACCObj8_Stopped_b == 0)
        {
            phyValue = getvalue(this);
            // physical to raw conversion
            rawValue = ((phyValue -(0))/1);
            putValue(E_pric_RadarFrontCenter_TrajPointACCObj8_TrajPointACCObj8_Stopped_b_Rv, rawValue);
            chgEv_TrajPointACCObj8_TrajPointACCObj8_Stopped_b = 1;  
        }
        else
        {
            chgEv_TrajPointACCObj8_TrajPointACCObj8_Stopped_b = 0;
        }
    }
}

on envVar E_pric_RadarFrontCenter_TrajPointACCObj8_TrajPointACCObj8_Stopped_b_Vt
{
    qword rawValue = 0ll;
    if(getValue(E_pric_RadarFrontCenter_TrajPointACCObj8_TrajPointACCObj8_Stopped_b_SetVt))
    {
        //update the signal value
        Msg_TrajPointACCObj8.TrajPointACCObj8_Stopped_b=getValue(this);
    }
}

on envVar E_pric_RadarFrontCenter_TrajPointACCObj8_TrajPointACCObj8_Stopped_b_SetVt
{
    if(getValue(E_pric_RadarFrontCenter_TrajPointACCObj8_TrajPointACCObj8_Stopped_b_SetVt))
    {
        //update the signal value
        Msg_TrajPointACCObj8.TrajPointACCObj8_Stopped_b=getvalue(E_pric_RadarFrontCenter_TrajPointACCObj8_TrajPointACCObj8_Stopped_b_Vt);
    }
    else
    {
        Msg_TrajPointACCObj8.TrajPointACCObj8_Stopped_b=getValue(E_pric_RadarFrontCenter_TrajPointACCObj8_TrajPointACCObj8_Stopped_b_Rv);
    }
}
 
on envVar E_pric_RadarFrontCenter_TrajPointACCObj8_TrajPointACCObj8_Stand_b_Rv
{
    qword rawValue = 0ll;
    float rawValue_float = 0.0;
    float phyValue = 0.0;        

    //set the signal with updated raw value
    if(getValue(E_pric_RadarFrontCenter_TrajPointACCObj8_TrajPointACCObj8_Stand_b_SetVt)==0)
    {
        rawValue = getvalue(this);
        if(chgEv_TrajPointACCObj8_TrajPointACCObj8_Stand_b == 0)
        {
            //type conversion to float
            rawValue_float = rawValue;        
            // raw to physical conversion
            phyValue = ((rawValue_float *1)+(0));
            putValue(E_pric_RadarFrontCenter_TrajPointACCObj8_TrajPointACCObj8_Stand_b_Pv, phyValue);
            chgEv_TrajPointACCObj8_TrajPointACCObj8_Stand_b = 1;
        }
        else
        {
            chgEv_TrajPointACCObj8_TrajPointACCObj8_Stand_b = 0;
        }    
        //update the signal value
        Msg_TrajPointACCObj8.TrajPointACCObj8_Stand_b=rawValue;        
    }                                                                           
}

on envVar E_pric_RadarFrontCenter_TrajPointACCObj8_TrajPointACCObj8_Stand_b_Pv
{
    qword rawValue = 0ll;
    float phyValue = 0.0;
    
    //update the raw value with physical value 
    if(getValue(E_pric_RadarFrontCenter_TrajPointACCObj8_TrajPointACCObj8_Stand_b_SetVt)==0)
    {
        if(chgEv_TrajPointACCObj8_TrajPointACCObj8_Stand_b == 0)
        {
            phyValue = getvalue(this);
            // physical to raw conversion
            rawValue = ((phyValue -(0))/1);
            putValue(E_pric_RadarFrontCenter_TrajPointACCObj8_TrajPointACCObj8_Stand_b_Rv, rawValue);
            chgEv_TrajPointACCObj8_TrajPointACCObj8_Stand_b = 1;  
        }
        else
        {
            chgEv_TrajPointACCObj8_TrajPointACCObj8_Stand_b = 0;
        }
    }
}

on envVar E_pric_RadarFrontCenter_TrajPointACCObj8_TrajPointACCObj8_Stand_b_Vt
{
    qword rawValue = 0ll;
    if(getValue(E_pric_RadarFrontCenter_TrajPointACCObj8_TrajPointACCObj8_Stand_b_SetVt))
    {
        //update the signal value
        Msg_TrajPointACCObj8.TrajPointACCObj8_Stand_b=getValue(this);
    }
}

on envVar E_pric_RadarFrontCenter_TrajPointACCObj8_TrajPointACCObj8_Stand_b_SetVt
{
    if(getValue(E_pric_RadarFrontCenter_TrajPointACCObj8_TrajPointACCObj8_Stand_b_SetVt))
    {
        //update the signal value
        Msg_TrajPointACCObj8.TrajPointACCObj8_Stand_b=getvalue(E_pric_RadarFrontCenter_TrajPointACCObj8_TrajPointACCObj8_Stand_b_Vt);
    }
    else
    {
        Msg_TrajPointACCObj8.TrajPointACCObj8_Stand_b=getValue(E_pric_RadarFrontCenter_TrajPointACCObj8_TrajPointACCObj8_Stand_b_Rv);
    }
}
 
on envVar E_pric_RadarFrontCenter_TrajPointACCObj8_TrajPointACCObj8_dxv_sw_Rv
{
    qword rawValue = 0ll;
    float rawValue_float = 0.0;
    float phyValue = 0.0;        

    //set the signal with updated raw value
    {
        rawValue = getvalue(this);
        if(chgEv_TrajPointACCObj8_TrajPointACCObj8_dxv_sw == 0)
        {
            //type conversion to float
            rawValue_float = rawValue;        
            // raw to physical conversion
            phyValue = ((rawValue_float *0.0078125)+(0));
            putValue(E_pric_RadarFrontCenter_TrajPointACCObj8_TrajPointACCObj8_dxv_sw_Pv, phyValue);
            chgEv_TrajPointACCObj8_TrajPointACCObj8_dxv_sw = 1;
        }
        else
        {
            chgEv_TrajPointACCObj8_TrajPointACCObj8_dxv_sw = 0;
        }    
        //update the signal value
        Msg_TrajPointACCObj8.TrajPointACCObj8_dxv_sw=rawValue;        
    }                                                                           
}

on envVar E_pric_RadarFrontCenter_TrajPointACCObj8_TrajPointACCObj8_dxv_sw_Pv
{
    qword rawValue = 0ll;
    float phyValue = 0.0;
    
    //update the raw value with physical value 
    {
        if(chgEv_TrajPointACCObj8_TrajPointACCObj8_dxv_sw == 0)
        {
            phyValue = getvalue(this);
            // physical to raw conversion
            rawValue = ((phyValue -(0))/0.0078125);
            putValue(E_pric_RadarFrontCenter_TrajPointACCObj8_TrajPointACCObj8_dxv_sw_Rv, rawValue);
            chgEv_TrajPointACCObj8_TrajPointACCObj8_dxv_sw = 1;  
        }
        else
        {
            chgEv_TrajPointACCObj8_TrajPointACCObj8_dxv_sw = 0;
        }
    }
}


 
on envVar E_pric_RadarFrontCenter_TrajPointACCObj8_TrajPointACCObj8_TrajEnd_b_Rv
{
    qword rawValue = 0ll;
    float rawValue_float = 0.0;
    float phyValue = 0.0;        

    //set the signal with updated raw value
    if(getValue(E_pric_RadarFrontCenter_TrajPointACCObj8_TrajPointACCObj8_TrajEnd_b_SetVt)==0)
    {
        rawValue = getvalue(this);
        if(chgEv_TrajPointACCObj8_TrajPointACCObj8_TrajEnd_b == 0)
        {
            //type conversion to float
            rawValue_float = rawValue;        
            // raw to physical conversion
            phyValue = ((rawValue_float *1)+(0));
            putValue(E_pric_RadarFrontCenter_TrajPointACCObj8_TrajPointACCObj8_TrajEnd_b_Pv, phyValue);
            chgEv_TrajPointACCObj8_TrajPointACCObj8_TrajEnd_b = 1;
        }
        else
        {
            chgEv_TrajPointACCObj8_TrajPointACCObj8_TrajEnd_b = 0;
        }    
        //update the signal value
        Msg_TrajPointACCObj8.TrajPointACCObj8_TrajEnd_b=rawValue;        
    }                                                                           
}

on envVar E_pric_RadarFrontCenter_TrajPointACCObj8_TrajPointACCObj8_TrajEnd_b_Pv
{
    qword rawValue = 0ll;
    float phyValue = 0.0;
    
    //update the raw value with physical value 
    if(getValue(E_pric_RadarFrontCenter_TrajPointACCObj8_TrajPointACCObj8_TrajEnd_b_SetVt)==0)
    {
        if(chgEv_TrajPointACCObj8_TrajPointACCObj8_TrajEnd_b == 0)
        {
            phyValue = getvalue(this);
            // physical to raw conversion
            rawValue = ((phyValue -(0))/1);
            putValue(E_pric_RadarFrontCenter_TrajPointACCObj8_TrajPointACCObj8_TrajEnd_b_Rv, rawValue);
            chgEv_TrajPointACCObj8_TrajPointACCObj8_TrajEnd_b = 1;  
        }
        else
        {
            chgEv_TrajPointACCObj8_TrajPointACCObj8_TrajEnd_b = 0;
        }
    }
}

on envVar E_pric_RadarFrontCenter_TrajPointACCObj8_TrajPointACCObj8_TrajEnd_b_Vt
{
    qword rawValue = 0ll;
    if(getValue(E_pric_RadarFrontCenter_TrajPointACCObj8_TrajPointACCObj8_TrajEnd_b_SetVt))
    {
        //update the signal value
        Msg_TrajPointACCObj8.TrajPointACCObj8_TrajEnd_b=getValue(this);
    }
}

on envVar E_pric_RadarFrontCenter_TrajPointACCObj8_TrajPointACCObj8_TrajEnd_b_SetVt
{
    if(getValue(E_pric_RadarFrontCenter_TrajPointACCObj8_TrajPointACCObj8_TrajEnd_b_SetVt))
    {
        //update the signal value
        Msg_TrajPointACCObj8.TrajPointACCObj8_TrajEnd_b=getvalue(E_pric_RadarFrontCenter_TrajPointACCObj8_TrajPointACCObj8_TrajEnd_b_Vt);
    }
    else
    {
        Msg_TrajPointACCObj8.TrajPointACCObj8_TrajEnd_b=getValue(E_pric_RadarFrontCenter_TrajPointACCObj8_TrajPointACCObj8_TrajEnd_b_Rv);
    }
}
 
on envVar E_pric_RadarFrontCenter_TrajPointACCObj8_TrajPointACCObj8_dVarXv_uw_Rv
{
    qword rawValue = 0ll;
    float rawValue_float = 0.0;
    float phyValue = 0.0;        

    //set the signal with updated raw value
    {
        rawValue = getvalue(this);
        if(chgEv_TrajPointACCObj8_TrajPointACCObj8_dVarXv_uw == 0)
        {
            //type conversion to float
            rawValue_float = rawValue;        
            // raw to physical conversion
            phyValue = ((rawValue_float *0.00195313)+(0));
            putValue(E_pric_RadarFrontCenter_TrajPointACCObj8_TrajPointACCObj8_dVarXv_uw_Pv, phyValue);
            chgEv_TrajPointACCObj8_TrajPointACCObj8_dVarXv_uw = 1;
        }
        else
        {
            chgEv_TrajPointACCObj8_TrajPointACCObj8_dVarXv_uw = 0;
        }    
        //update the signal value
        Msg_TrajPointACCObj8.TrajPointACCObj8_dVarXv_uw=rawValue;        
    }                                                                           
}

on envVar E_pric_RadarFrontCenter_TrajPointACCObj8_TrajPointACCObj8_dVarXv_uw_Pv
{
    qword rawValue = 0ll;
    float phyValue = 0.0;
    
    //update the raw value with physical value 
    {
        if(chgEv_TrajPointACCObj8_TrajPointACCObj8_dVarXv_uw == 0)
        {
            phyValue = getvalue(this);
            // physical to raw conversion
            rawValue = ((phyValue -(0))/0.00195313);
            putValue(E_pric_RadarFrontCenter_TrajPointACCObj8_TrajPointACCObj8_dVarXv_uw_Rv, rawValue);
            chgEv_TrajPointACCObj8_TrajPointACCObj8_dVarXv_uw = 1;  
        }
        else
        {
            chgEv_TrajPointACCObj8_TrajPointACCObj8_dVarXv_uw = 0;
        }
    }
}


 
on envVar E_pric_RadarFrontCenter_TrajPointACCObj8_TrajPointACCObj8_Valid_b_Rv
{
    qword rawValue = 0ll;
    float rawValue_float = 0.0;
    float phyValue = 0.0;        

    //set the signal with updated raw value
    if(getValue(E_pric_RadarFrontCenter_TrajPointACCObj8_TrajPointACCObj8_Valid_b_SetVt)==0)
    {
        rawValue = getvalue(this);
        if(chgEv_TrajPointACCObj8_TrajPointACCObj8_Valid_b == 0)
        {
            //type conversion to float
            rawValue_float = rawValue;        
            // raw to physical conversion
            phyValue = ((rawValue_float *1)+(0));
            putValue(E_pric_RadarFrontCenter_TrajPointACCObj8_TrajPointACCObj8_Valid_b_Pv, phyValue);
            chgEv_TrajPointACCObj8_TrajPointACCObj8_Valid_b = 1;
        }
        else
        {
            chgEv_TrajPointACCObj8_TrajPointACCObj8_Valid_b = 0;
        }    
        //update the signal value
        Msg_TrajPointACCObj8.TrajPointACCObj8_Valid_b=rawValue;        
    }                                                                           
}

on envVar E_pric_RadarFrontCenter_TrajPointACCObj8_TrajPointACCObj8_Valid_b_Pv
{
    qword rawValue = 0ll;
    float phyValue = 0.0;
    
    //update the raw value with physical value 
    if(getValue(E_pric_RadarFrontCenter_TrajPointACCObj8_TrajPointACCObj8_Valid_b_SetVt)==0)
    {
        if(chgEv_TrajPointACCObj8_TrajPointACCObj8_Valid_b == 0)
        {
            phyValue = getvalue(this);
            // physical to raw conversion
            rawValue = ((phyValue -(0))/1);
            putValue(E_pric_RadarFrontCenter_TrajPointACCObj8_TrajPointACCObj8_Valid_b_Rv, rawValue);
            chgEv_TrajPointACCObj8_TrajPointACCObj8_Valid_b = 1;  
        }
        else
        {
            chgEv_TrajPointACCObj8_TrajPointACCObj8_Valid_b = 0;
        }
    }
}

on envVar E_pric_RadarFrontCenter_TrajPointACCObj8_TrajPointACCObj8_Valid_b_Vt
{
    qword rawValue = 0ll;
    if(getValue(E_pric_RadarFrontCenter_TrajPointACCObj8_TrajPointACCObj8_Valid_b_SetVt))
    {
        //update the signal value
        Msg_TrajPointACCObj8.TrajPointACCObj8_Valid_b=getValue(this);
    }
}

on envVar E_pric_RadarFrontCenter_TrajPointACCObj8_TrajPointACCObj8_Valid_b_SetVt
{
    if(getValue(E_pric_RadarFrontCenter_TrajPointACCObj8_TrajPointACCObj8_Valid_b_SetVt))
    {
        //update the signal value
        Msg_TrajPointACCObj8.TrajPointACCObj8_Valid_b=getvalue(E_pric_RadarFrontCenter_TrajPointACCObj8_TrajPointACCObj8_Valid_b_Vt);
    }
    else
    {
        Msg_TrajPointACCObj8.TrajPointACCObj8_Valid_b=getValue(E_pric_RadarFrontCenter_TrajPointACCObj8_TrajPointACCObj8_Valid_b_Rv);
    }
}
 
on envVar E_pric_RadarFrontCenter_TrajPointACCObj8_TrajPointACCObj8_Drive_b_Rv
{
    qword rawValue = 0ll;
    float rawValue_float = 0.0;
    float phyValue = 0.0;        

    //set the signal with updated raw value
    if(getValue(E_pric_RadarFrontCenter_TrajPointACCObj8_TrajPointACCObj8_Drive_b_SetVt)==0)
    {
        rawValue = getvalue(this);
        if(chgEv_TrajPointACCObj8_TrajPointACCObj8_Drive_b == 0)
        {
            //type conversion to float
            rawValue_float = rawValue;        
            // raw to physical conversion
            phyValue = ((rawValue_float *1)+(0));
            putValue(E_pric_RadarFrontCenter_TrajPointACCObj8_TrajPointACCObj8_Drive_b_Pv, phyValue);
            chgEv_TrajPointACCObj8_TrajPointACCObj8_Drive_b = 1;
        }
        else
        {
            chgEv_TrajPointACCObj8_TrajPointACCObj8_Drive_b = 0;
        }    
        //update the signal value
        Msg_TrajPointACCObj8.TrajPointACCObj8_Drive_b=rawValue;        
    }                                                                           
}

on envVar E_pric_RadarFrontCenter_TrajPointACCObj8_TrajPointACCObj8_Drive_b_Pv
{
    qword rawValue = 0ll;
    float phyValue = 0.0;
    
    //update the raw value with physical value 
    if(getValue(E_pric_RadarFrontCenter_TrajPointACCObj8_TrajPointACCObj8_Drive_b_SetVt)==0)
    {
        if(chgEv_TrajPointACCObj8_TrajPointACCObj8_Drive_b == 0)
        {
            phyValue = getvalue(this);
            // physical to raw conversion
            rawValue = ((phyValue -(0))/1);
            putValue(E_pric_RadarFrontCenter_TrajPointACCObj8_TrajPointACCObj8_Drive_b_Rv, rawValue);
            chgEv_TrajPointACCObj8_TrajPointACCObj8_Drive_b = 1;  
        }
        else
        {
            chgEv_TrajPointACCObj8_TrajPointACCObj8_Drive_b = 0;
        }
    }
}

on envVar E_pric_RadarFrontCenter_TrajPointACCObj8_TrajPointACCObj8_Drive_b_Vt
{
    qword rawValue = 0ll;
    if(getValue(E_pric_RadarFrontCenter_TrajPointACCObj8_TrajPointACCObj8_Drive_b_SetVt))
    {
        //update the signal value
        Msg_TrajPointACCObj8.TrajPointACCObj8_Drive_b=getValue(this);
    }
}

on envVar E_pric_RadarFrontCenter_TrajPointACCObj8_TrajPointACCObj8_Drive_b_SetVt
{
    if(getValue(E_pric_RadarFrontCenter_TrajPointACCObj8_TrajPointACCObj8_Drive_b_SetVt))
    {
        //update the signal value
        Msg_TrajPointACCObj8.TrajPointACCObj8_Drive_b=getvalue(E_pric_RadarFrontCenter_TrajPointACCObj8_TrajPointACCObj8_Drive_b_Vt);
    }
    else
    {
        Msg_TrajPointACCObj8.TrajPointACCObj8_Drive_b=getValue(E_pric_RadarFrontCenter_TrajPointACCObj8_TrajPointACCObj8_Drive_b_Rv);
    }
}
 
on envVar E_pric_RadarFrontCenter_TrajPointACCObj7_tx
{
    if(getValue(this))
    {       
        
        //update the BZ Signal
        if(TrajPointACCObj7_TrajPointACCObj7_MsgCtr_wrongvalctr == 0)
        {
            update_TrajPointACCObj7_TrajPointACCObj7_MsgCtr_counter();
            Msg_TrajPointACCObj7.TrajPointACCObj7_MsgCtr= TrajPointACCObj7_TrajPointACCObj7_MsgCtr_counter;
        }
        else if(TrajPointACCObj7_TrajPointACCObj7_MsgCtr_wrongvalctr > 0)
        {
             TrajPointACCObj7_TrajPointACCObj7_MsgCtr_wrongvalctr--;
              // if counter becomes zero, update panel controller to zero
             if(TrajPointACCObj7_TrajPointACCObj7_MsgCtr_wrongvalctr == 0)
             {
                 putValue(E_pric_RadarFrontCenter_TrajPointACCObj7_TrajPointACCObj7_MsgCtr_wrongvalctr,0);
             }
        }
        else
        {
            //do nothing
        }        
        //update the BZ Signal
        if(TrajPointACCObj7_TrajPointACCObj7_blockCtr_wrongvalctr == 0)
        {
            update_TrajPointACCObj7_TrajPointACCObj7_blockCtr_counter();
            Msg_TrajPointACCObj7.TrajPointACCObj7_blockCtr= TrajPointACCObj7_TrajPointACCObj7_blockCtr_counter;
        }
        else if(TrajPointACCObj7_TrajPointACCObj7_blockCtr_wrongvalctr > 0)
        {
             TrajPointACCObj7_TrajPointACCObj7_blockCtr_wrongvalctr--;
              // if counter becomes zero, update panel controller to zero
             if(TrajPointACCObj7_TrajPointACCObj7_blockCtr_wrongvalctr == 0)
             {
                 putValue(E_pric_RadarFrontCenter_TrajPointACCObj7_TrajPointACCObj7_blockCtr_wrongvalctr,0);
             }
        }
        else
        {
            //do nothing
        }        
        //calculate the CRC checksum
        update_TrajPointACCObj7_ChkSum_Checksum();

        output(Msg_TrajPointACCObj7);        
    }
}

on envVar E_pric_RadarFrontCenter_TrajPointACCObj7_Range
{
    qword rawstatus = 0ll;
    qword rawValue = 0ll;    
    
    rawstatus = getvalue(this);    
    // set all the signals with min raw /max raw /init raw
    switch (rawstatus) 
    {
     case(0) :
        rawValue= 0;
        putValue(E_pric_RadarFrontCenter_TrajPointACCObj7_TrajPointACCObj7_wExistProb_ub_Rv, rawValue);
        rawValue= 0;
        putValue(E_pric_RadarFrontCenter_TrajPointACCObj7_TrajPointACCObj7_dVarXv_uw_Rv, rawValue);
        rawValue= 0;
        putValue(E_pric_RadarFrontCenter_TrajPointACCObj7_TrajPointACCObj7_Drive_b_Rv, rawValue);
        rawValue= 0;
        putValue(E_pric_RadarFrontCenter_TrajPointACCObj7_TrajPointACCObj7_TrajEnd_b_Rv, rawValue);
        rawValue= 0;
        putValue(E_pric_RadarFrontCenter_TrajPointACCObj7_TrajPointACCObj7_timestamp_Rv, rawValue);
        rawValue= 0;
        putValue(E_pric_RadarFrontCenter_TrajPointACCObj7_TrajPointACCObj7_dVarYv_uw_Rv, rawValue);
        rawValue= 0;
        putValue(E_pric_RadarFrontCenter_TrajPointACCObj7_TrajPointACCObj7_Stand_b_Rv, rawValue);
        rawValue= 0;
        putValue(E_pric_RadarFrontCenter_TrajPointACCObj7_TrajPointACCObj7_Valid_b_Rv, rawValue);
        rawValue= -32768;
        putValue(E_pric_RadarFrontCenter_TrajPointACCObj7_TrajPointACCObj7_dyv_sw_Rv, rawValue);
        rawValue= 0;
        putValue(E_pric_RadarFrontCenter_TrajPointACCObj7_TrajPointACCObj7_Stopped_b_Rv, rawValue);
        rawValue= -32768;
        putValue(E_pric_RadarFrontCenter_TrajPointACCObj7_TrajPointACCObj7_dxv_sw_Rv, rawValue);
        rawValue= 0;
        putValue(E_pric_RadarFrontCenter_TrajPointACCObj7_TrajPointACCObj7_InvDir_b_Rv, rawValue);
        break;
     case(1) :
        rawValue= 255;
        putValue(E_pric_RadarFrontCenter_TrajPointACCObj7_TrajPointACCObj7_wExistProb_ub_Rv, rawValue);
        rawValue= 65534;
        putValue(E_pric_RadarFrontCenter_TrajPointACCObj7_TrajPointACCObj7_dVarXv_uw_Rv, rawValue);
        rawValue= 1;
        putValue(E_pric_RadarFrontCenter_TrajPointACCObj7_TrajPointACCObj7_Drive_b_Rv, rawValue);
        rawValue= 1;
        putValue(E_pric_RadarFrontCenter_TrajPointACCObj7_TrajPointACCObj7_TrajEnd_b_Rv, rawValue);
        rawValue= 65536;
        putValue(E_pric_RadarFrontCenter_TrajPointACCObj7_TrajPointACCObj7_timestamp_Rv, rawValue);
        rawValue= 65534;
        putValue(E_pric_RadarFrontCenter_TrajPointACCObj7_TrajPointACCObj7_dVarYv_uw_Rv, rawValue);
        rawValue= 1;
        putValue(E_pric_RadarFrontCenter_TrajPointACCObj7_TrajPointACCObj7_Stand_b_Rv, rawValue);
        rawValue= 1;
        putValue(E_pric_RadarFrontCenter_TrajPointACCObj7_TrajPointACCObj7_Valid_b_Rv, rawValue);
        rawValue= 32767;
        putValue(E_pric_RadarFrontCenter_TrajPointACCObj7_TrajPointACCObj7_dyv_sw_Rv, rawValue);
        rawValue= 1;
        putValue(E_pric_RadarFrontCenter_TrajPointACCObj7_TrajPointACCObj7_Stopped_b_Rv, rawValue);
        rawValue= 32767;
        putValue(E_pric_RadarFrontCenter_TrajPointACCObj7_TrajPointACCObj7_dxv_sw_Rv, rawValue);
        rawValue= 1;
        putValue(E_pric_RadarFrontCenter_TrajPointACCObj7_TrajPointACCObj7_InvDir_b_Rv, rawValue);
        break;
     default :
        rawValue= 0;
        putValue(E_pric_RadarFrontCenter_TrajPointACCObj7_TrajPointACCObj7_wExistProb_ub_Rv, rawValue);
        rawValue= 0;
        putValue(E_pric_RadarFrontCenter_TrajPointACCObj7_TrajPointACCObj7_dVarXv_uw_Rv, rawValue);
        rawValue= 0;
        putValue(E_pric_RadarFrontCenter_TrajPointACCObj7_TrajPointACCObj7_Drive_b_Rv, rawValue);
        rawValue= 0;
        putValue(E_pric_RadarFrontCenter_TrajPointACCObj7_TrajPointACCObj7_TrajEnd_b_Rv, rawValue);
        rawValue= 0;
        putValue(E_pric_RadarFrontCenter_TrajPointACCObj7_TrajPointACCObj7_timestamp_Rv, rawValue);
        rawValue= 0;
        putValue(E_pric_RadarFrontCenter_TrajPointACCObj7_TrajPointACCObj7_dVarYv_uw_Rv, rawValue);
        rawValue= 0;
        putValue(E_pric_RadarFrontCenter_TrajPointACCObj7_TrajPointACCObj7_Stand_b_Rv, rawValue);
        rawValue= 0;
        putValue(E_pric_RadarFrontCenter_TrajPointACCObj7_TrajPointACCObj7_Valid_b_Rv, rawValue);
        rawValue= -32768;
        putValue(E_pric_RadarFrontCenter_TrajPointACCObj7_TrajPointACCObj7_dyv_sw_Rv, rawValue);
        rawValue= 0;
        putValue(E_pric_RadarFrontCenter_TrajPointACCObj7_TrajPointACCObj7_Stopped_b_Rv, rawValue);
        rawValue= -32768;
        putValue(E_pric_RadarFrontCenter_TrajPointACCObj7_TrajPointACCObj7_dxv_sw_Rv, rawValue);
        rawValue= 0;
        putValue(E_pric_RadarFrontCenter_TrajPointACCObj7_TrajPointACCObj7_InvDir_b_Rv, rawValue);
      break;
   }
}

on envVar E_pric_RadarFrontCenter_TrajPointACCObj7_Dlc
{
    if(getValue(E_pric_RadarFrontCenter_TrajPointACCObj7_enDlc))
    {
        Msg_TrajPointACCObj7.dlc =getValue(this);
    }
    else
    {
       Dbc_dlc = 16;
	   Msg_TrajPointACCObj7.dlc = Calc_Canfd_dlc(Dbc_dlc);
	   	
  }
}

on envVar E_pric_RadarFrontCenter_TrajPointACCObj7_enDlc
{
    //For Messages with DLC = 8, set wrong DLC to smaller than defined DLC
    //For Messages with DLC < 8 set wrong DLC to smaller/longer than defined DLC
    if(getValue(this))
    {
        Msg_TrajPointACCObj7.dlc =getValue(E_pric_RadarFrontCenter_TrajPointACCObj7_Dlc);
    }
    else
    {
       Dbc_dlc = 16;
	   Msg_TrajPointACCObj7.dlc = Calc_Canfd_dlc(Dbc_dlc);
			
    }
}

on envVar E_pric_RadarFrontCenter_TrajPointACCObj7_TrajPointACCObj7_CRC_wrongvalctr
{
    //update disturb count
    //disturb value range:(-1 = always send wrong value),( X>0 ,x is the number of Messages with wrong CHK sent)
    TrajPointACCObj7_TrajPointACCObj7_CRC_wrongvalctr =getValue(this);    
}
on envVar E_pric_RadarFrontCenter_TrajPointACCObj7_TrajPointACCObj7_MsgCtr_wrongvalctr
{
    //update disturb count
    //disturb value range:(-1 = always send wrong value),( X>0 ,x is the number of Messages with wrong CHK sent)
    TrajPointACCObj7_TrajPointACCObj7_MsgCtr_wrongvalctr =getValue(this);    
}
on envVar E_pric_RadarFrontCenter_TrajPointACCObj7_TrajPointACCObj7_blockCtr_wrongvalctr
{
    //update disturb count
    //disturb value range:(-1 = always send wrong value),( X>0 ,x is the number of Messages with wrong CHK sent)
    TrajPointACCObj7_TrajPointACCObj7_blockCtr_wrongvalctr =getValue(this);    
}

on envVar E_pric_RadarFrontCenter_TrajPointACCObj7_TrajPointACCObj7_wExistProb_ub_Rv
{
    qword rawValue = 0ll;
    float rawValue_float = 0.0;
    float phyValue = 0.0;        

    //set the signal with updated raw value
    {
        rawValue = getvalue(this);
        if(chgEv_TrajPointACCObj7_TrajPointACCObj7_wExistProb_ub == 0)
        {
            //type conversion to float
            rawValue_float = rawValue;        
            // raw to physical conversion
            phyValue = ((rawValue_float *0.00390625)+(0));
            putValue(E_pric_RadarFrontCenter_TrajPointACCObj7_TrajPointACCObj7_wExistProb_ub_Pv, phyValue);
            chgEv_TrajPointACCObj7_TrajPointACCObj7_wExistProb_ub = 1;
        }
        else
        {
            chgEv_TrajPointACCObj7_TrajPointACCObj7_wExistProb_ub = 0;
        }    
        //update the signal value
        Msg_TrajPointACCObj7.TrajPointACCObj7_wExistProb_ub=rawValue;        
    }                                                                           
}

on envVar E_pric_RadarFrontCenter_TrajPointACCObj7_TrajPointACCObj7_wExistProb_ub_Pv
{
    qword rawValue = 0ll;
    float phyValue = 0.0;
    
    //update the raw value with physical value 
    {
        if(chgEv_TrajPointACCObj7_TrajPointACCObj7_wExistProb_ub == 0)
        {
            phyValue = getvalue(this);
            // physical to raw conversion
            rawValue = ((phyValue -(0))/0.00390625);
            putValue(E_pric_RadarFrontCenter_TrajPointACCObj7_TrajPointACCObj7_wExistProb_ub_Rv, rawValue);
            chgEv_TrajPointACCObj7_TrajPointACCObj7_wExistProb_ub = 1;  
        }
        else
        {
            chgEv_TrajPointACCObj7_TrajPointACCObj7_wExistProb_ub = 0;
        }
    }
}


 
on envVar E_pric_RadarFrontCenter_TrajPointACCObj7_TrajPointACCObj7_dVarXv_uw_Rv
{
    qword rawValue = 0ll;
    float rawValue_float = 0.0;
    float phyValue = 0.0;        

    //set the signal with updated raw value
    {
        rawValue = getvalue(this);
        if(chgEv_TrajPointACCObj7_TrajPointACCObj7_dVarXv_uw == 0)
        {
            //type conversion to float
            rawValue_float = rawValue;        
            // raw to physical conversion
            phyValue = ((rawValue_float *0.00195313)+(0));
            putValue(E_pric_RadarFrontCenter_TrajPointACCObj7_TrajPointACCObj7_dVarXv_uw_Pv, phyValue);
            chgEv_TrajPointACCObj7_TrajPointACCObj7_dVarXv_uw = 1;
        }
        else
        {
            chgEv_TrajPointACCObj7_TrajPointACCObj7_dVarXv_uw = 0;
        }    
        //update the signal value
        Msg_TrajPointACCObj7.TrajPointACCObj7_dVarXv_uw=rawValue;        
    }                                                                           
}

on envVar E_pric_RadarFrontCenter_TrajPointACCObj7_TrajPointACCObj7_dVarXv_uw_Pv
{
    qword rawValue = 0ll;
    float phyValue = 0.0;
    
    //update the raw value with physical value 
    {
        if(chgEv_TrajPointACCObj7_TrajPointACCObj7_dVarXv_uw == 0)
        {
            phyValue = getvalue(this);
            // physical to raw conversion
            rawValue = ((phyValue -(0))/0.00195313);
            putValue(E_pric_RadarFrontCenter_TrajPointACCObj7_TrajPointACCObj7_dVarXv_uw_Rv, rawValue);
            chgEv_TrajPointACCObj7_TrajPointACCObj7_dVarXv_uw = 1;  
        }
        else
        {
            chgEv_TrajPointACCObj7_TrajPointACCObj7_dVarXv_uw = 0;
        }
    }
}


 
on envVar E_pric_RadarFrontCenter_TrajPointACCObj7_TrajPointACCObj7_Drive_b_Rv
{
    qword rawValue = 0ll;
    float rawValue_float = 0.0;
    float phyValue = 0.0;        

    //set the signal with updated raw value
    if(getValue(E_pric_RadarFrontCenter_TrajPointACCObj7_TrajPointACCObj7_Drive_b_SetVt)==0)
    {
        rawValue = getvalue(this);
        if(chgEv_TrajPointACCObj7_TrajPointACCObj7_Drive_b == 0)
        {
            //type conversion to float
            rawValue_float = rawValue;        
            // raw to physical conversion
            phyValue = ((rawValue_float *1)+(0));
            putValue(E_pric_RadarFrontCenter_TrajPointACCObj7_TrajPointACCObj7_Drive_b_Pv, phyValue);
            chgEv_TrajPointACCObj7_TrajPointACCObj7_Drive_b = 1;
        }
        else
        {
            chgEv_TrajPointACCObj7_TrajPointACCObj7_Drive_b = 0;
        }    
        //update the signal value
        Msg_TrajPointACCObj7.TrajPointACCObj7_Drive_b=rawValue;        
    }                                                                           
}

on envVar E_pric_RadarFrontCenter_TrajPointACCObj7_TrajPointACCObj7_Drive_b_Pv
{
    qword rawValue = 0ll;
    float phyValue = 0.0;
    
    //update the raw value with physical value 
    if(getValue(E_pric_RadarFrontCenter_TrajPointACCObj7_TrajPointACCObj7_Drive_b_SetVt)==0)
    {
        if(chgEv_TrajPointACCObj7_TrajPointACCObj7_Drive_b == 0)
        {
            phyValue = getvalue(this);
            // physical to raw conversion
            rawValue = ((phyValue -(0))/1);
            putValue(E_pric_RadarFrontCenter_TrajPointACCObj7_TrajPointACCObj7_Drive_b_Rv, rawValue);
            chgEv_TrajPointACCObj7_TrajPointACCObj7_Drive_b = 1;  
        }
        else
        {
            chgEv_TrajPointACCObj7_TrajPointACCObj7_Drive_b = 0;
        }
    }
}

on envVar E_pric_RadarFrontCenter_TrajPointACCObj7_TrajPointACCObj7_Drive_b_Vt
{
    qword rawValue = 0ll;
    if(getValue(E_pric_RadarFrontCenter_TrajPointACCObj7_TrajPointACCObj7_Drive_b_SetVt))
    {
        //update the signal value
        Msg_TrajPointACCObj7.TrajPointACCObj7_Drive_b=getValue(this);
    }
}

on envVar E_pric_RadarFrontCenter_TrajPointACCObj7_TrajPointACCObj7_Drive_b_SetVt
{
    if(getValue(E_pric_RadarFrontCenter_TrajPointACCObj7_TrajPointACCObj7_Drive_b_SetVt))
    {
        //update the signal value
        Msg_TrajPointACCObj7.TrajPointACCObj7_Drive_b=getvalue(E_pric_RadarFrontCenter_TrajPointACCObj7_TrajPointACCObj7_Drive_b_Vt);
    }
    else
    {
        Msg_TrajPointACCObj7.TrajPointACCObj7_Drive_b=getValue(E_pric_RadarFrontCenter_TrajPointACCObj7_TrajPointACCObj7_Drive_b_Rv);
    }
}
 
on envVar E_pric_RadarFrontCenter_TrajPointACCObj7_TrajPointACCObj7_TrajEnd_b_Rv
{
    qword rawValue = 0ll;
    float rawValue_float = 0.0;
    float phyValue = 0.0;        

    //set the signal with updated raw value
    if(getValue(E_pric_RadarFrontCenter_TrajPointACCObj7_TrajPointACCObj7_TrajEnd_b_SetVt)==0)
    {
        rawValue = getvalue(this);
        if(chgEv_TrajPointACCObj7_TrajPointACCObj7_TrajEnd_b == 0)
        {
            //type conversion to float
            rawValue_float = rawValue;        
            // raw to physical conversion
            phyValue = ((rawValue_float *1)+(0));
            putValue(E_pric_RadarFrontCenter_TrajPointACCObj7_TrajPointACCObj7_TrajEnd_b_Pv, phyValue);
            chgEv_TrajPointACCObj7_TrajPointACCObj7_TrajEnd_b = 1;
        }
        else
        {
            chgEv_TrajPointACCObj7_TrajPointACCObj7_TrajEnd_b = 0;
        }    
        //update the signal value
        Msg_TrajPointACCObj7.TrajPointACCObj7_TrajEnd_b=rawValue;        
    }                                                                           
}

on envVar E_pric_RadarFrontCenter_TrajPointACCObj7_TrajPointACCObj7_TrajEnd_b_Pv
{
    qword rawValue = 0ll;
    float phyValue = 0.0;
    
    //update the raw value with physical value 
    if(getValue(E_pric_RadarFrontCenter_TrajPointACCObj7_TrajPointACCObj7_TrajEnd_b_SetVt)==0)
    {
        if(chgEv_TrajPointACCObj7_TrajPointACCObj7_TrajEnd_b == 0)
        {
            phyValue = getvalue(this);
            // physical to raw conversion
            rawValue = ((phyValue -(0))/1);
            putValue(E_pric_RadarFrontCenter_TrajPointACCObj7_TrajPointACCObj7_TrajEnd_b_Rv, rawValue);
            chgEv_TrajPointACCObj7_TrajPointACCObj7_TrajEnd_b = 1;  
        }
        else
        {
            chgEv_TrajPointACCObj7_TrajPointACCObj7_TrajEnd_b = 0;
        }
    }
}

on envVar E_pric_RadarFrontCenter_TrajPointACCObj7_TrajPointACCObj7_TrajEnd_b_Vt
{
    qword rawValue = 0ll;
    if(getValue(E_pric_RadarFrontCenter_TrajPointACCObj7_TrajPointACCObj7_TrajEnd_b_SetVt))
    {
        //update the signal value
        Msg_TrajPointACCObj7.TrajPointACCObj7_TrajEnd_b=getValue(this);
    }
}

on envVar E_pric_RadarFrontCenter_TrajPointACCObj7_TrajPointACCObj7_TrajEnd_b_SetVt
{
    if(getValue(E_pric_RadarFrontCenter_TrajPointACCObj7_TrajPointACCObj7_TrajEnd_b_SetVt))
    {
        //update the signal value
        Msg_TrajPointACCObj7.TrajPointACCObj7_TrajEnd_b=getvalue(E_pric_RadarFrontCenter_TrajPointACCObj7_TrajPointACCObj7_TrajEnd_b_Vt);
    }
    else
    {
        Msg_TrajPointACCObj7.TrajPointACCObj7_TrajEnd_b=getValue(E_pric_RadarFrontCenter_TrajPointACCObj7_TrajPointACCObj7_TrajEnd_b_Rv);
    }
}
 
on envVar E_pric_RadarFrontCenter_TrajPointACCObj7_TrajPointACCObj7_timestamp_Rv
{
    qword rawValue = 0ll;
    float rawValue_float = 0.0;
    float phyValue = 0.0;        

    //set the signal with updated raw value
    {
        rawValue = getvalue(this);
        if(chgEv_TrajPointACCObj7_TrajPointACCObj7_timestamp == 0)
        {
            //type conversion to float
            rawValue_float = rawValue;        
            // raw to physical conversion
            phyValue = ((rawValue_float *0.000488281)+(0));
            putValue(E_pric_RadarFrontCenter_TrajPointACCObj7_TrajPointACCObj7_timestamp_Pv, phyValue);
            chgEv_TrajPointACCObj7_TrajPointACCObj7_timestamp = 1;
        }
        else
        {
            chgEv_TrajPointACCObj7_TrajPointACCObj7_timestamp = 0;
        }    
        //update the signal value
        Msg_TrajPointACCObj7.TrajPointACCObj7_timestamp=rawValue;        
    }                                                                           
}

on envVar E_pric_RadarFrontCenter_TrajPointACCObj7_TrajPointACCObj7_timestamp_Pv
{
    qword rawValue = 0ll;
    float phyValue = 0.0;
    
    //update the raw value with physical value 
    {
        if(chgEv_TrajPointACCObj7_TrajPointACCObj7_timestamp == 0)
        {
            phyValue = getvalue(this);
            // physical to raw conversion
            rawValue = ((phyValue -(0))/0.000488281);
            putValue(E_pric_RadarFrontCenter_TrajPointACCObj7_TrajPointACCObj7_timestamp_Rv, rawValue);
            chgEv_TrajPointACCObj7_TrajPointACCObj7_timestamp = 1;  
        }
        else
        {
            chgEv_TrajPointACCObj7_TrajPointACCObj7_timestamp = 0;
        }
    }
}


 
on envVar E_pric_RadarFrontCenter_TrajPointACCObj7_TrajPointACCObj7_dVarYv_uw_Rv
{
    qword rawValue = 0ll;
    float rawValue_float = 0.0;
    float phyValue = 0.0;        

    //set the signal with updated raw value
    {
        rawValue = getvalue(this);
        if(chgEv_TrajPointACCObj7_TrajPointACCObj7_dVarYv_uw == 0)
        {
            //type conversion to float
            rawValue_float = rawValue;        
            // raw to physical conversion
            phyValue = ((rawValue_float *0.00195313)+(0));
            putValue(E_pric_RadarFrontCenter_TrajPointACCObj7_TrajPointACCObj7_dVarYv_uw_Pv, phyValue);
            chgEv_TrajPointACCObj7_TrajPointACCObj7_dVarYv_uw = 1;
        }
        else
        {
            chgEv_TrajPointACCObj7_TrajPointACCObj7_dVarYv_uw = 0;
        }    
        //update the signal value
        Msg_TrajPointACCObj7.TrajPointACCObj7_dVarYv_uw=rawValue;        
    }                                                                           
}

on envVar E_pric_RadarFrontCenter_TrajPointACCObj7_TrajPointACCObj7_dVarYv_uw_Pv
{
    qword rawValue = 0ll;
    float phyValue = 0.0;
    
    //update the raw value with physical value 
    {
        if(chgEv_TrajPointACCObj7_TrajPointACCObj7_dVarYv_uw == 0)
        {
            phyValue = getvalue(this);
            // physical to raw conversion
            rawValue = ((phyValue -(0))/0.00195313);
            putValue(E_pric_RadarFrontCenter_TrajPointACCObj7_TrajPointACCObj7_dVarYv_uw_Rv, rawValue);
            chgEv_TrajPointACCObj7_TrajPointACCObj7_dVarYv_uw = 1;  
        }
        else
        {
            chgEv_TrajPointACCObj7_TrajPointACCObj7_dVarYv_uw = 0;
        }
    }
}


 
on envVar E_pric_RadarFrontCenter_TrajPointACCObj7_TrajPointACCObj7_Stand_b_Rv
{
    qword rawValue = 0ll;
    float rawValue_float = 0.0;
    float phyValue = 0.0;        

    //set the signal with updated raw value
    if(getValue(E_pric_RadarFrontCenter_TrajPointACCObj7_TrajPointACCObj7_Stand_b_SetVt)==0)
    {
        rawValue = getvalue(this);
        if(chgEv_TrajPointACCObj7_TrajPointACCObj7_Stand_b == 0)
        {
            //type conversion to float
            rawValue_float = rawValue;        
            // raw to physical conversion
            phyValue = ((rawValue_float *1)+(0));
            putValue(E_pric_RadarFrontCenter_TrajPointACCObj7_TrajPointACCObj7_Stand_b_Pv, phyValue);
            chgEv_TrajPointACCObj7_TrajPointACCObj7_Stand_b = 1;
        }
        else
        {
            chgEv_TrajPointACCObj7_TrajPointACCObj7_Stand_b = 0;
        }    
        //update the signal value
        Msg_TrajPointACCObj7.TrajPointACCObj7_Stand_b=rawValue;        
    }                                                                           
}

on envVar E_pric_RadarFrontCenter_TrajPointACCObj7_TrajPointACCObj7_Stand_b_Pv
{
    qword rawValue = 0ll;
    float phyValue = 0.0;
    
    //update the raw value with physical value 
    if(getValue(E_pric_RadarFrontCenter_TrajPointACCObj7_TrajPointACCObj7_Stand_b_SetVt)==0)
    {
        if(chgEv_TrajPointACCObj7_TrajPointACCObj7_Stand_b == 0)
        {
            phyValue = getvalue(this);
            // physical to raw conversion
            rawValue = ((phyValue -(0))/1);
            putValue(E_pric_RadarFrontCenter_TrajPointACCObj7_TrajPointACCObj7_Stand_b_Rv, rawValue);
            chgEv_TrajPointACCObj7_TrajPointACCObj7_Stand_b = 1;  
        }
        else
        {
            chgEv_TrajPointACCObj7_TrajPointACCObj7_Stand_b = 0;
        }
    }
}

on envVar E_pric_RadarFrontCenter_TrajPointACCObj7_TrajPointACCObj7_Stand_b_Vt
{
    qword rawValue = 0ll;
    if(getValue(E_pric_RadarFrontCenter_TrajPointACCObj7_TrajPointACCObj7_Stand_b_SetVt))
    {
        //update the signal value
        Msg_TrajPointACCObj7.TrajPointACCObj7_Stand_b=getValue(this);
    }
}

on envVar E_pric_RadarFrontCenter_TrajPointACCObj7_TrajPointACCObj7_Stand_b_SetVt
{
    if(getValue(E_pric_RadarFrontCenter_TrajPointACCObj7_TrajPointACCObj7_Stand_b_SetVt))
    {
        //update the signal value
        Msg_TrajPointACCObj7.TrajPointACCObj7_Stand_b=getvalue(E_pric_RadarFrontCenter_TrajPointACCObj7_TrajPointACCObj7_Stand_b_Vt);
    }
    else
    {
        Msg_TrajPointACCObj7.TrajPointACCObj7_Stand_b=getValue(E_pric_RadarFrontCenter_TrajPointACCObj7_TrajPointACCObj7_Stand_b_Rv);
    }
}
 
on envVar E_pric_RadarFrontCenter_TrajPointACCObj7_TrajPointACCObj7_Valid_b_Rv
{
    qword rawValue = 0ll;
    float rawValue_float = 0.0;
    float phyValue = 0.0;        

    //set the signal with updated raw value
    if(getValue(E_pric_RadarFrontCenter_TrajPointACCObj7_TrajPointACCObj7_Valid_b_SetVt)==0)
    {
        rawValue = getvalue(this);
        if(chgEv_TrajPointACCObj7_TrajPointACCObj7_Valid_b == 0)
        {
            //type conversion to float
            rawValue_float = rawValue;        
            // raw to physical conversion
            phyValue = ((rawValue_float *1)+(0));
            putValue(E_pric_RadarFrontCenter_TrajPointACCObj7_TrajPointACCObj7_Valid_b_Pv, phyValue);
            chgEv_TrajPointACCObj7_TrajPointACCObj7_Valid_b = 1;
        }
        else
        {
            chgEv_TrajPointACCObj7_TrajPointACCObj7_Valid_b = 0;
        }    
        //update the signal value
        Msg_TrajPointACCObj7.TrajPointACCObj7_Valid_b=rawValue;        
    }                                                                           
}

on envVar E_pric_RadarFrontCenter_TrajPointACCObj7_TrajPointACCObj7_Valid_b_Pv
{
    qword rawValue = 0ll;
    float phyValue = 0.0;
    
    //update the raw value with physical value 
    if(getValue(E_pric_RadarFrontCenter_TrajPointACCObj7_TrajPointACCObj7_Valid_b_SetVt)==0)
    {
        if(chgEv_TrajPointACCObj7_TrajPointACCObj7_Valid_b == 0)
        {
            phyValue = getvalue(this);
            // physical to raw conversion
            rawValue = ((phyValue -(0))/1);
            putValue(E_pric_RadarFrontCenter_TrajPointACCObj7_TrajPointACCObj7_Valid_b_Rv, rawValue);
            chgEv_TrajPointACCObj7_TrajPointACCObj7_Valid_b = 1;  
        }
        else
        {
            chgEv_TrajPointACCObj7_TrajPointACCObj7_Valid_b = 0;
        }
    }
}

on envVar E_pric_RadarFrontCenter_TrajPointACCObj7_TrajPointACCObj7_Valid_b_Vt
{
    qword rawValue = 0ll;
    if(getValue(E_pric_RadarFrontCenter_TrajPointACCObj7_TrajPointACCObj7_Valid_b_SetVt))
    {
        //update the signal value
        Msg_TrajPointACCObj7.TrajPointACCObj7_Valid_b=getValue(this);
    }
}

on envVar E_pric_RadarFrontCenter_TrajPointACCObj7_TrajPointACCObj7_Valid_b_SetVt
{
    if(getValue(E_pric_RadarFrontCenter_TrajPointACCObj7_TrajPointACCObj7_Valid_b_SetVt))
    {
        //update the signal value
        Msg_TrajPointACCObj7.TrajPointACCObj7_Valid_b=getvalue(E_pric_RadarFrontCenter_TrajPointACCObj7_TrajPointACCObj7_Valid_b_Vt);
    }
    else
    {
        Msg_TrajPointACCObj7.TrajPointACCObj7_Valid_b=getValue(E_pric_RadarFrontCenter_TrajPointACCObj7_TrajPointACCObj7_Valid_b_Rv);
    }
}
 
on envVar E_pric_RadarFrontCenter_TrajPointACCObj7_TrajPointACCObj7_dyv_sw_Rv
{
    qword rawValue = 0ll;
    float rawValue_float = 0.0;
    float phyValue = 0.0;        

    //set the signal with updated raw value
    {
        rawValue = getvalue(this);
        if(chgEv_TrajPointACCObj7_TrajPointACCObj7_dyv_sw == 0)
        {
            //type conversion to float
            rawValue_float = rawValue;        
            // raw to physical conversion
            phyValue = ((rawValue_float *0.0078125)+(0));
            putValue(E_pric_RadarFrontCenter_TrajPointACCObj7_TrajPointACCObj7_dyv_sw_Pv, phyValue);
            chgEv_TrajPointACCObj7_TrajPointACCObj7_dyv_sw = 1;
        }
        else
        {
            chgEv_TrajPointACCObj7_TrajPointACCObj7_dyv_sw = 0;
        }    
        //update the signal value
        Msg_TrajPointACCObj7.TrajPointACCObj7_dyv_sw=rawValue;        
    }                                                                           
}

on envVar E_pric_RadarFrontCenter_TrajPointACCObj7_TrajPointACCObj7_dyv_sw_Pv
{
    qword rawValue = 0ll;
    float phyValue = 0.0;
    
    //update the raw value with physical value 
    {
        if(chgEv_TrajPointACCObj7_TrajPointACCObj7_dyv_sw == 0)
        {
            phyValue = getvalue(this);
            // physical to raw conversion
            rawValue = ((phyValue -(0))/0.0078125);
            putValue(E_pric_RadarFrontCenter_TrajPointACCObj7_TrajPointACCObj7_dyv_sw_Rv, rawValue);
            chgEv_TrajPointACCObj7_TrajPointACCObj7_dyv_sw = 1;  
        }
        else
        {
            chgEv_TrajPointACCObj7_TrajPointACCObj7_dyv_sw = 0;
        }
    }
}


 
on envVar E_pric_RadarFrontCenter_TrajPointACCObj7_TrajPointACCObj7_Stopped_b_Rv
{
    qword rawValue = 0ll;
    float rawValue_float = 0.0;
    float phyValue = 0.0;        

    //set the signal with updated raw value
    if(getValue(E_pric_RadarFrontCenter_TrajPointACCObj7_TrajPointACCObj7_Stopped_b_SetVt)==0)
    {
        rawValue = getvalue(this);
        if(chgEv_TrajPointACCObj7_TrajPointACCObj7_Stopped_b == 0)
        {
            //type conversion to float
            rawValue_float = rawValue;        
            // raw to physical conversion
            phyValue = ((rawValue_float *1)+(0));
            putValue(E_pric_RadarFrontCenter_TrajPointACCObj7_TrajPointACCObj7_Stopped_b_Pv, phyValue);
            chgEv_TrajPointACCObj7_TrajPointACCObj7_Stopped_b = 1;
        }
        else
        {
            chgEv_TrajPointACCObj7_TrajPointACCObj7_Stopped_b = 0;
        }    
        //update the signal value
        Msg_TrajPointACCObj7.TrajPointACCObj7_Stopped_b=rawValue;        
    }                                                                           
}

on envVar E_pric_RadarFrontCenter_TrajPointACCObj7_TrajPointACCObj7_Stopped_b_Pv
{
    qword rawValue = 0ll;
    float phyValue = 0.0;
    
    //update the raw value with physical value 
    if(getValue(E_pric_RadarFrontCenter_TrajPointACCObj7_TrajPointACCObj7_Stopped_b_SetVt)==0)
    {
        if(chgEv_TrajPointACCObj7_TrajPointACCObj7_Stopped_b == 0)
        {
            phyValue = getvalue(this);
            // physical to raw conversion
            rawValue = ((phyValue -(0))/1);
            putValue(E_pric_RadarFrontCenter_TrajPointACCObj7_TrajPointACCObj7_Stopped_b_Rv, rawValue);
            chgEv_TrajPointACCObj7_TrajPointACCObj7_Stopped_b = 1;  
        }
        else
        {
            chgEv_TrajPointACCObj7_TrajPointACCObj7_Stopped_b = 0;
        }
    }
}

on envVar E_pric_RadarFrontCenter_TrajPointACCObj7_TrajPointACCObj7_Stopped_b_Vt
{
    qword rawValue = 0ll;
    if(getValue(E_pric_RadarFrontCenter_TrajPointACCObj7_TrajPointACCObj7_Stopped_b_SetVt))
    {
        //update the signal value
        Msg_TrajPointACCObj7.TrajPointACCObj7_Stopped_b=getValue(this);
    }
}

on envVar E_pric_RadarFrontCenter_TrajPointACCObj7_TrajPointACCObj7_Stopped_b_SetVt
{
    if(getValue(E_pric_RadarFrontCenter_TrajPointACCObj7_TrajPointACCObj7_Stopped_b_SetVt))
    {
        //update the signal value
        Msg_TrajPointACCObj7.TrajPointACCObj7_Stopped_b=getvalue(E_pric_RadarFrontCenter_TrajPointACCObj7_TrajPointACCObj7_Stopped_b_Vt);
    }
    else
    {
        Msg_TrajPointACCObj7.TrajPointACCObj7_Stopped_b=getValue(E_pric_RadarFrontCenter_TrajPointACCObj7_TrajPointACCObj7_Stopped_b_Rv);
    }
}
 
on envVar E_pric_RadarFrontCenter_TrajPointACCObj7_TrajPointACCObj7_dxv_sw_Rv
{
    qword rawValue = 0ll;
    float rawValue_float = 0.0;
    float phyValue = 0.0;        

    //set the signal with updated raw value
    {
        rawValue = getvalue(this);
        if(chgEv_TrajPointACCObj7_TrajPointACCObj7_dxv_sw == 0)
        {
            //type conversion to float
            rawValue_float = rawValue;        
            // raw to physical conversion
            phyValue = ((rawValue_float *0.0078125)+(0));
            putValue(E_pric_RadarFrontCenter_TrajPointACCObj7_TrajPointACCObj7_dxv_sw_Pv, phyValue);
            chgEv_TrajPointACCObj7_TrajPointACCObj7_dxv_sw = 1;
        }
        else
        {
            chgEv_TrajPointACCObj7_TrajPointACCObj7_dxv_sw = 0;
        }    
        //update the signal value
        Msg_TrajPointACCObj7.TrajPointACCObj7_dxv_sw=rawValue;        
    }                                                                           
}

on envVar E_pric_RadarFrontCenter_TrajPointACCObj7_TrajPointACCObj7_dxv_sw_Pv
{
    qword rawValue = 0ll;
    float phyValue = 0.0;
    
    //update the raw value with physical value 
    {
        if(chgEv_TrajPointACCObj7_TrajPointACCObj7_dxv_sw == 0)
        {
            phyValue = getvalue(this);
            // physical to raw conversion
            rawValue = ((phyValue -(0))/0.0078125);
            putValue(E_pric_RadarFrontCenter_TrajPointACCObj7_TrajPointACCObj7_dxv_sw_Rv, rawValue);
            chgEv_TrajPointACCObj7_TrajPointACCObj7_dxv_sw = 1;  
        }
        else
        {
            chgEv_TrajPointACCObj7_TrajPointACCObj7_dxv_sw = 0;
        }
    }
}


 
on envVar E_pric_RadarFrontCenter_TrajPointACCObj7_TrajPointACCObj7_InvDir_b_Rv
{
    qword rawValue = 0ll;
    float rawValue_float = 0.0;
    float phyValue = 0.0;        

    //set the signal with updated raw value
    if(getValue(E_pric_RadarFrontCenter_TrajPointACCObj7_TrajPointACCObj7_InvDir_b_SetVt)==0)
    {
        rawValue = getvalue(this);
        if(chgEv_TrajPointACCObj7_TrajPointACCObj7_InvDir_b == 0)
        {
            //type conversion to float
            rawValue_float = rawValue;        
            // raw to physical conversion
            phyValue = ((rawValue_float *1)+(0));
            putValue(E_pric_RadarFrontCenter_TrajPointACCObj7_TrajPointACCObj7_InvDir_b_Pv, phyValue);
            chgEv_TrajPointACCObj7_TrajPointACCObj7_InvDir_b = 1;
        }
        else
        {
            chgEv_TrajPointACCObj7_TrajPointACCObj7_InvDir_b = 0;
        }    
        //update the signal value
        Msg_TrajPointACCObj7.TrajPointACCObj7_InvDir_b=rawValue;        
    }                                                                           
}

on envVar E_pric_RadarFrontCenter_TrajPointACCObj7_TrajPointACCObj7_InvDir_b_Pv
{
    qword rawValue = 0ll;
    float phyValue = 0.0;
    
    //update the raw value with physical value 
    if(getValue(E_pric_RadarFrontCenter_TrajPointACCObj7_TrajPointACCObj7_InvDir_b_SetVt)==0)
    {
        if(chgEv_TrajPointACCObj7_TrajPointACCObj7_InvDir_b == 0)
        {
            phyValue = getvalue(this);
            // physical to raw conversion
            rawValue = ((phyValue -(0))/1);
            putValue(E_pric_RadarFrontCenter_TrajPointACCObj7_TrajPointACCObj7_InvDir_b_Rv, rawValue);
            chgEv_TrajPointACCObj7_TrajPointACCObj7_InvDir_b = 1;  
        }
        else
        {
            chgEv_TrajPointACCObj7_TrajPointACCObj7_InvDir_b = 0;
        }
    }
}

on envVar E_pric_RadarFrontCenter_TrajPointACCObj7_TrajPointACCObj7_InvDir_b_Vt
{
    qword rawValue = 0ll;
    if(getValue(E_pric_RadarFrontCenter_TrajPointACCObj7_TrajPointACCObj7_InvDir_b_SetVt))
    {
        //update the signal value
        Msg_TrajPointACCObj7.TrajPointACCObj7_InvDir_b=getValue(this);
    }
}

on envVar E_pric_RadarFrontCenter_TrajPointACCObj7_TrajPointACCObj7_InvDir_b_SetVt
{
    if(getValue(E_pric_RadarFrontCenter_TrajPointACCObj7_TrajPointACCObj7_InvDir_b_SetVt))
    {
        //update the signal value
        Msg_TrajPointACCObj7.TrajPointACCObj7_InvDir_b=getvalue(E_pric_RadarFrontCenter_TrajPointACCObj7_TrajPointACCObj7_InvDir_b_Vt);
    }
    else
    {
        Msg_TrajPointACCObj7.TrajPointACCObj7_InvDir_b=getValue(E_pric_RadarFrontCenter_TrajPointACCObj7_TrajPointACCObj7_InvDir_b_Rv);
    }
}
 
on envVar E_pric_RadarFrontCenter_TrajPointACCObj6_tx
{
    if(getValue(this))
    {       
        
        //update the BZ Signal
        if(TrajPointACCObj6_TrajPointACCObj6_MsgCtr_wrongvalctr == 0)
        {
            update_TrajPointACCObj6_TrajPointACCObj6_MsgCtr_counter();
            Msg_TrajPointACCObj6.TrajPointACCObj6_MsgCtr= TrajPointACCObj6_TrajPointACCObj6_MsgCtr_counter;
        }
        else if(TrajPointACCObj6_TrajPointACCObj6_MsgCtr_wrongvalctr > 0)
        {
             TrajPointACCObj6_TrajPointACCObj6_MsgCtr_wrongvalctr--;
              // if counter becomes zero, update panel controller to zero
             if(TrajPointACCObj6_TrajPointACCObj6_MsgCtr_wrongvalctr == 0)
             {
                 putValue(E_pric_RadarFrontCenter_TrajPointACCObj6_TrajPointACCObj6_MsgCtr_wrongvalctr,0);
             }
        }
        else
        {
            //do nothing
        }        
        //update the BZ Signal
        if(TrajPointACCObj6_TrajPointACCObj6_blockCtr_wrongvalctr == 0)
        {
            update_TrajPointACCObj6_TrajPointACCObj6_blockCtr_counter();
            Msg_TrajPointACCObj6.TrajPointACCObj6_blockCtr= TrajPointACCObj6_TrajPointACCObj6_blockCtr_counter;
        }
        else if(TrajPointACCObj6_TrajPointACCObj6_blockCtr_wrongvalctr > 0)
        {
             TrajPointACCObj6_TrajPointACCObj6_blockCtr_wrongvalctr--;
              // if counter becomes zero, update panel controller to zero
             if(TrajPointACCObj6_TrajPointACCObj6_blockCtr_wrongvalctr == 0)
             {
                 putValue(E_pric_RadarFrontCenter_TrajPointACCObj6_TrajPointACCObj6_blockCtr_wrongvalctr,0);
             }
        }
        else
        {
            //do nothing
        }        
        //calculate the CRC checksum
        update_TrajPointACCObj6_ChkSum_Checksum();

        output(Msg_TrajPointACCObj6);        
    }
}

on envVar E_pric_RadarFrontCenter_TrajPointACCObj6_Range
{
    qword rawstatus = 0ll;
    qword rawValue = 0ll;    
    
    rawstatus = getvalue(this);    
    // set all the signals with min raw /max raw /init raw
    switch (rawstatus) 
    {
     case(0) :
        rawValue= 0;
        putValue(E_pric_RadarFrontCenter_TrajPointACCObj6_TrajPointACCObj6_Stand_b_Rv, rawValue);
        rawValue= 0;
        putValue(E_pric_RadarFrontCenter_TrajPointACCObj6_TrajPointACCObj6_wExistProb_ub_Rv, rawValue);
        rawValue= 0;
        putValue(E_pric_RadarFrontCenter_TrajPointACCObj6_TrajPointACCObj6_InvDir_b_Rv, rawValue);
        rawValue= 0;
        putValue(E_pric_RadarFrontCenter_TrajPointACCObj6_TrajPointACCObj6_Valid_b_Rv, rawValue);
        rawValue= 0;
        putValue(E_pric_RadarFrontCenter_TrajPointACCObj6_TrajPointACCObj6_dVarYv_uw_Rv, rawValue);
        rawValue= -32768;
        putValue(E_pric_RadarFrontCenter_TrajPointACCObj6_TrajPointACCObj6_dxv_sw_Rv, rawValue);
        rawValue= 0;
        putValue(E_pric_RadarFrontCenter_TrajPointACCObj6_TrajPointACCObj6_timestamp_Rv, rawValue);
        rawValue= 0;
        putValue(E_pric_RadarFrontCenter_TrajPointACCObj6_TrajPointACCObj6_dVarXv_uw_Rv, rawValue);
        rawValue= 0;
        putValue(E_pric_RadarFrontCenter_TrajPointACCObj6_TrajPointACCObj6_Stopped_b_Rv, rawValue);
        rawValue= -32768;
        putValue(E_pric_RadarFrontCenter_TrajPointACCObj6_TrajPointACCObj6_dyv_sw_Rv, rawValue);
        rawValue= 0;
        putValue(E_pric_RadarFrontCenter_TrajPointACCObj6_TrajPointACCObj6_Drive_b_Rv, rawValue);
        rawValue= 0;
        putValue(E_pric_RadarFrontCenter_TrajPointACCObj6_TrajPointACCObj6_TrajEnd_b_Rv, rawValue);
        break;
     case(1) :
        rawValue= 1;
        putValue(E_pric_RadarFrontCenter_TrajPointACCObj6_TrajPointACCObj6_Stand_b_Rv, rawValue);
        rawValue= 255;
        putValue(E_pric_RadarFrontCenter_TrajPointACCObj6_TrajPointACCObj6_wExistProb_ub_Rv, rawValue);
        rawValue= 1;
        putValue(E_pric_RadarFrontCenter_TrajPointACCObj6_TrajPointACCObj6_InvDir_b_Rv, rawValue);
        rawValue= 1;
        putValue(E_pric_RadarFrontCenter_TrajPointACCObj6_TrajPointACCObj6_Valid_b_Rv, rawValue);
        rawValue= 65534;
        putValue(E_pric_RadarFrontCenter_TrajPointACCObj6_TrajPointACCObj6_dVarYv_uw_Rv, rawValue);
        rawValue= 32767;
        putValue(E_pric_RadarFrontCenter_TrajPointACCObj6_TrajPointACCObj6_dxv_sw_Rv, rawValue);
        rawValue= 65536;
        putValue(E_pric_RadarFrontCenter_TrajPointACCObj6_TrajPointACCObj6_timestamp_Rv, rawValue);
        rawValue= 65534;
        putValue(E_pric_RadarFrontCenter_TrajPointACCObj6_TrajPointACCObj6_dVarXv_uw_Rv, rawValue);
        rawValue= 1;
        putValue(E_pric_RadarFrontCenter_TrajPointACCObj6_TrajPointACCObj6_Stopped_b_Rv, rawValue);
        rawValue= 32767;
        putValue(E_pric_RadarFrontCenter_TrajPointACCObj6_TrajPointACCObj6_dyv_sw_Rv, rawValue);
        rawValue= 1;
        putValue(E_pric_RadarFrontCenter_TrajPointACCObj6_TrajPointACCObj6_Drive_b_Rv, rawValue);
        rawValue= 1;
        putValue(E_pric_RadarFrontCenter_TrajPointACCObj6_TrajPointACCObj6_TrajEnd_b_Rv, rawValue);
        break;
     default :
        rawValue= 0;
        putValue(E_pric_RadarFrontCenter_TrajPointACCObj6_TrajPointACCObj6_Stand_b_Rv, rawValue);
        rawValue= 0;
        putValue(E_pric_RadarFrontCenter_TrajPointACCObj6_TrajPointACCObj6_wExistProb_ub_Rv, rawValue);
        rawValue= 0;
        putValue(E_pric_RadarFrontCenter_TrajPointACCObj6_TrajPointACCObj6_InvDir_b_Rv, rawValue);
        rawValue= 0;
        putValue(E_pric_RadarFrontCenter_TrajPointACCObj6_TrajPointACCObj6_Valid_b_Rv, rawValue);
        rawValue= 0;
        putValue(E_pric_RadarFrontCenter_TrajPointACCObj6_TrajPointACCObj6_dVarYv_uw_Rv, rawValue);
        rawValue= -32768;
        putValue(E_pric_RadarFrontCenter_TrajPointACCObj6_TrajPointACCObj6_dxv_sw_Rv, rawValue);
        rawValue= 0;
        putValue(E_pric_RadarFrontCenter_TrajPointACCObj6_TrajPointACCObj6_timestamp_Rv, rawValue);
        rawValue= 0;
        putValue(E_pric_RadarFrontCenter_TrajPointACCObj6_TrajPointACCObj6_dVarXv_uw_Rv, rawValue);
        rawValue= 0;
        putValue(E_pric_RadarFrontCenter_TrajPointACCObj6_TrajPointACCObj6_Stopped_b_Rv, rawValue);
        rawValue= -32768;
        putValue(E_pric_RadarFrontCenter_TrajPointACCObj6_TrajPointACCObj6_dyv_sw_Rv, rawValue);
        rawValue= 0;
        putValue(E_pric_RadarFrontCenter_TrajPointACCObj6_TrajPointACCObj6_Drive_b_Rv, rawValue);
        rawValue= 0;
        putValue(E_pric_RadarFrontCenter_TrajPointACCObj6_TrajPointACCObj6_TrajEnd_b_Rv, rawValue);
      break;
   }
}

on envVar E_pric_RadarFrontCenter_TrajPointACCObj6_Dlc
{
    if(getValue(E_pric_RadarFrontCenter_TrajPointACCObj6_enDlc))
    {
        Msg_TrajPointACCObj6.dlc =getValue(this);
    }
    else
    {
       Dbc_dlc = 16;
	   Msg_TrajPointACCObj6.dlc = Calc_Canfd_dlc(Dbc_dlc);
	   	
  }
}

on envVar E_pric_RadarFrontCenter_TrajPointACCObj6_enDlc
{
    //For Messages with DLC = 8, set wrong DLC to smaller than defined DLC
    //For Messages with DLC < 8 set wrong DLC to smaller/longer than defined DLC
    if(getValue(this))
    {
        Msg_TrajPointACCObj6.dlc =getValue(E_pric_RadarFrontCenter_TrajPointACCObj6_Dlc);
    }
    else
    {
       Dbc_dlc = 16;
	   Msg_TrajPointACCObj6.dlc = Calc_Canfd_dlc(Dbc_dlc);
			
    }
}

on envVar E_pric_RadarFrontCenter_TrajPointACCObj6_TrajPointACCObj6_CRC_wrongvalctr
{
    //update disturb count
    //disturb value range:(-1 = always send wrong value),( X>0 ,x is the number of Messages with wrong CHK sent)
    TrajPointACCObj6_TrajPointACCObj6_CRC_wrongvalctr =getValue(this);    
}
on envVar E_pric_RadarFrontCenter_TrajPointACCObj6_TrajPointACCObj6_MsgCtr_wrongvalctr
{
    //update disturb count
    //disturb value range:(-1 = always send wrong value),( X>0 ,x is the number of Messages with wrong CHK sent)
    TrajPointACCObj6_TrajPointACCObj6_MsgCtr_wrongvalctr =getValue(this);    
}
on envVar E_pric_RadarFrontCenter_TrajPointACCObj6_TrajPointACCObj6_blockCtr_wrongvalctr
{
    //update disturb count
    //disturb value range:(-1 = always send wrong value),( X>0 ,x is the number of Messages with wrong CHK sent)
    TrajPointACCObj6_TrajPointACCObj6_blockCtr_wrongvalctr =getValue(this);    
}

on envVar E_pric_RadarFrontCenter_TrajPointACCObj6_TrajPointACCObj6_Stand_b_Rv
{
    qword rawValue = 0ll;
    float rawValue_float = 0.0;
    float phyValue = 0.0;        

    //set the signal with updated raw value
    if(getValue(E_pric_RadarFrontCenter_TrajPointACCObj6_TrajPointACCObj6_Stand_b_SetVt)==0)
    {
        rawValue = getvalue(this);
        if(chgEv_TrajPointACCObj6_TrajPointACCObj6_Stand_b == 0)
        {
            //type conversion to float
            rawValue_float = rawValue;        
            // raw to physical conversion
            phyValue = ((rawValue_float *1)+(0));
            putValue(E_pric_RadarFrontCenter_TrajPointACCObj6_TrajPointACCObj6_Stand_b_Pv, phyValue);
            chgEv_TrajPointACCObj6_TrajPointACCObj6_Stand_b = 1;
        }
        else
        {
            chgEv_TrajPointACCObj6_TrajPointACCObj6_Stand_b = 0;
        }    
        //update the signal value
        Msg_TrajPointACCObj6.TrajPointACCObj6_Stand_b=rawValue;        
    }                                                                           
}

on envVar E_pric_RadarFrontCenter_TrajPointACCObj6_TrajPointACCObj6_Stand_b_Pv
{
    qword rawValue = 0ll;
    float phyValue = 0.0;
    
    //update the raw value with physical value 
    if(getValue(E_pric_RadarFrontCenter_TrajPointACCObj6_TrajPointACCObj6_Stand_b_SetVt)==0)
    {
        if(chgEv_TrajPointACCObj6_TrajPointACCObj6_Stand_b == 0)
        {
            phyValue = getvalue(this);
            // physical to raw conversion
            rawValue = ((phyValue -(0))/1);
            putValue(E_pric_RadarFrontCenter_TrajPointACCObj6_TrajPointACCObj6_Stand_b_Rv, rawValue);
            chgEv_TrajPointACCObj6_TrajPointACCObj6_Stand_b = 1;  
        }
        else
        {
            chgEv_TrajPointACCObj6_TrajPointACCObj6_Stand_b = 0;
        }
    }
}

on envVar E_pric_RadarFrontCenter_TrajPointACCObj6_TrajPointACCObj6_Stand_b_Vt
{
    qword rawValue = 0ll;
    if(getValue(E_pric_RadarFrontCenter_TrajPointACCObj6_TrajPointACCObj6_Stand_b_SetVt))
    {
        //update the signal value
        Msg_TrajPointACCObj6.TrajPointACCObj6_Stand_b=getValue(this);
    }
}

on envVar E_pric_RadarFrontCenter_TrajPointACCObj6_TrajPointACCObj6_Stand_b_SetVt
{
    if(getValue(E_pric_RadarFrontCenter_TrajPointACCObj6_TrajPointACCObj6_Stand_b_SetVt))
    {
        //update the signal value
        Msg_TrajPointACCObj6.TrajPointACCObj6_Stand_b=getvalue(E_pric_RadarFrontCenter_TrajPointACCObj6_TrajPointACCObj6_Stand_b_Vt);
    }
    else
    {
        Msg_TrajPointACCObj6.TrajPointACCObj6_Stand_b=getValue(E_pric_RadarFrontCenter_TrajPointACCObj6_TrajPointACCObj6_Stand_b_Rv);
    }
}
 
on envVar E_pric_RadarFrontCenter_TrajPointACCObj6_TrajPointACCObj6_wExistProb_ub_Rv
{
    qword rawValue = 0ll;
    float rawValue_float = 0.0;
    float phyValue = 0.0;        

    //set the signal with updated raw value
    {
        rawValue = getvalue(this);
        if(chgEv_TrajPointACCObj6_TrajPointACCObj6_wExistProb_ub == 0)
        {
            //type conversion to float
            rawValue_float = rawValue;        
            // raw to physical conversion
            phyValue = ((rawValue_float *0.00390625)+(0));
            putValue(E_pric_RadarFrontCenter_TrajPointACCObj6_TrajPointACCObj6_wExistProb_ub_Pv, phyValue);
            chgEv_TrajPointACCObj6_TrajPointACCObj6_wExistProb_ub = 1;
        }
        else
        {
            chgEv_TrajPointACCObj6_TrajPointACCObj6_wExistProb_ub = 0;
        }    
        //update the signal value
        Msg_TrajPointACCObj6.TrajPointACCObj6_wExistProb_ub=rawValue;        
    }                                                                           
}

on envVar E_pric_RadarFrontCenter_TrajPointACCObj6_TrajPointACCObj6_wExistProb_ub_Pv
{
    qword rawValue = 0ll;
    float phyValue = 0.0;
    
    //update the raw value with physical value 
    {
        if(chgEv_TrajPointACCObj6_TrajPointACCObj6_wExistProb_ub == 0)
        {
            phyValue = getvalue(this);
            // physical to raw conversion
            rawValue = ((phyValue -(0))/0.00390625);
            putValue(E_pric_RadarFrontCenter_TrajPointACCObj6_TrajPointACCObj6_wExistProb_ub_Rv, rawValue);
            chgEv_TrajPointACCObj6_TrajPointACCObj6_wExistProb_ub = 1;  
        }
        else
        {
            chgEv_TrajPointACCObj6_TrajPointACCObj6_wExistProb_ub = 0;
        }
    }
}


 
on envVar E_pric_RadarFrontCenter_TrajPointACCObj6_TrajPointACCObj6_InvDir_b_Rv
{
    qword rawValue = 0ll;
    float rawValue_float = 0.0;
    float phyValue = 0.0;        

    //set the signal with updated raw value
    if(getValue(E_pric_RadarFrontCenter_TrajPointACCObj6_TrajPointACCObj6_InvDir_b_SetVt)==0)
    {
        rawValue = getvalue(this);
        if(chgEv_TrajPointACCObj6_TrajPointACCObj6_InvDir_b == 0)
        {
            //type conversion to float
            rawValue_float = rawValue;        
            // raw to physical conversion
            phyValue = ((rawValue_float *1)+(0));
            putValue(E_pric_RadarFrontCenter_TrajPointACCObj6_TrajPointACCObj6_InvDir_b_Pv, phyValue);
            chgEv_TrajPointACCObj6_TrajPointACCObj6_InvDir_b = 1;
        }
        else
        {
            chgEv_TrajPointACCObj6_TrajPointACCObj6_InvDir_b = 0;
        }    
        //update the signal value
        Msg_TrajPointACCObj6.TrajPointACCObj6_InvDir_b=rawValue;        
    }                                                                           
}

on envVar E_pric_RadarFrontCenter_TrajPointACCObj6_TrajPointACCObj6_InvDir_b_Pv
{
    qword rawValue = 0ll;
    float phyValue = 0.0;
    
    //update the raw value with physical value 
    if(getValue(E_pric_RadarFrontCenter_TrajPointACCObj6_TrajPointACCObj6_InvDir_b_SetVt)==0)
    {
        if(chgEv_TrajPointACCObj6_TrajPointACCObj6_InvDir_b == 0)
        {
            phyValue = getvalue(this);
            // physical to raw conversion
            rawValue = ((phyValue -(0))/1);
            putValue(E_pric_RadarFrontCenter_TrajPointACCObj6_TrajPointACCObj6_InvDir_b_Rv, rawValue);
            chgEv_TrajPointACCObj6_TrajPointACCObj6_InvDir_b = 1;  
        }
        else
        {
            chgEv_TrajPointACCObj6_TrajPointACCObj6_InvDir_b = 0;
        }
    }
}

on envVar E_pric_RadarFrontCenter_TrajPointACCObj6_TrajPointACCObj6_InvDir_b_Vt
{
    qword rawValue = 0ll;
    if(getValue(E_pric_RadarFrontCenter_TrajPointACCObj6_TrajPointACCObj6_InvDir_b_SetVt))
    {
        //update the signal value
        Msg_TrajPointACCObj6.TrajPointACCObj6_InvDir_b=getValue(this);
    }
}

on envVar E_pric_RadarFrontCenter_TrajPointACCObj6_TrajPointACCObj6_InvDir_b_SetVt
{
    if(getValue(E_pric_RadarFrontCenter_TrajPointACCObj6_TrajPointACCObj6_InvDir_b_SetVt))
    {
        //update the signal value
        Msg_TrajPointACCObj6.TrajPointACCObj6_InvDir_b=getvalue(E_pric_RadarFrontCenter_TrajPointACCObj6_TrajPointACCObj6_InvDir_b_Vt);
    }
    else
    {
        Msg_TrajPointACCObj6.TrajPointACCObj6_InvDir_b=getValue(E_pric_RadarFrontCenter_TrajPointACCObj6_TrajPointACCObj6_InvDir_b_Rv);
    }
}
 
on envVar E_pric_RadarFrontCenter_TrajPointACCObj6_TrajPointACCObj6_Valid_b_Rv
{
    qword rawValue = 0ll;
    float rawValue_float = 0.0;
    float phyValue = 0.0;        

    //set the signal with updated raw value
    if(getValue(E_pric_RadarFrontCenter_TrajPointACCObj6_TrajPointACCObj6_Valid_b_SetVt)==0)
    {
        rawValue = getvalue(this);
        if(chgEv_TrajPointACCObj6_TrajPointACCObj6_Valid_b == 0)
        {
            //type conversion to float
            rawValue_float = rawValue;        
            // raw to physical conversion
            phyValue = ((rawValue_float *1)+(0));
            putValue(E_pric_RadarFrontCenter_TrajPointACCObj6_TrajPointACCObj6_Valid_b_Pv, phyValue);
            chgEv_TrajPointACCObj6_TrajPointACCObj6_Valid_b = 1;
        }
        else
        {
            chgEv_TrajPointACCObj6_TrajPointACCObj6_Valid_b = 0;
        }    
        //update the signal value
        Msg_TrajPointACCObj6.TrajPointACCObj6_Valid_b=rawValue;        
    }                                                                           
}

on envVar E_pric_RadarFrontCenter_TrajPointACCObj6_TrajPointACCObj6_Valid_b_Pv
{
    qword rawValue = 0ll;
    float phyValue = 0.0;
    
    //update the raw value with physical value 
    if(getValue(E_pric_RadarFrontCenter_TrajPointACCObj6_TrajPointACCObj6_Valid_b_SetVt)==0)
    {
        if(chgEv_TrajPointACCObj6_TrajPointACCObj6_Valid_b == 0)
        {
            phyValue = getvalue(this);
            // physical to raw conversion
            rawValue = ((phyValue -(0))/1);
            putValue(E_pric_RadarFrontCenter_TrajPointACCObj6_TrajPointACCObj6_Valid_b_Rv, rawValue);
            chgEv_TrajPointACCObj6_TrajPointACCObj6_Valid_b = 1;  
        }
        else
        {
            chgEv_TrajPointACCObj6_TrajPointACCObj6_Valid_b = 0;
        }
    }
}

on envVar E_pric_RadarFrontCenter_TrajPointACCObj6_TrajPointACCObj6_Valid_b_Vt
{
    qword rawValue = 0ll;
    if(getValue(E_pric_RadarFrontCenter_TrajPointACCObj6_TrajPointACCObj6_Valid_b_SetVt))
    {
        //update the signal value
        Msg_TrajPointACCObj6.TrajPointACCObj6_Valid_b=getValue(this);
    }
}

on envVar E_pric_RadarFrontCenter_TrajPointACCObj6_TrajPointACCObj6_Valid_b_SetVt
{
    if(getValue(E_pric_RadarFrontCenter_TrajPointACCObj6_TrajPointACCObj6_Valid_b_SetVt))
    {
        //update the signal value
        Msg_TrajPointACCObj6.TrajPointACCObj6_Valid_b=getvalue(E_pric_RadarFrontCenter_TrajPointACCObj6_TrajPointACCObj6_Valid_b_Vt);
    }
    else
    {
        Msg_TrajPointACCObj6.TrajPointACCObj6_Valid_b=getValue(E_pric_RadarFrontCenter_TrajPointACCObj6_TrajPointACCObj6_Valid_b_Rv);
    }
}
 
on envVar E_pric_RadarFrontCenter_TrajPointACCObj6_TrajPointACCObj6_dVarYv_uw_Rv
{
    qword rawValue = 0ll;
    float rawValue_float = 0.0;
    float phyValue = 0.0;        

    //set the signal with updated raw value
    {
        rawValue = getvalue(this);
        if(chgEv_TrajPointACCObj6_TrajPointACCObj6_dVarYv_uw == 0)
        {
            //type conversion to float
            rawValue_float = rawValue;        
            // raw to physical conversion
            phyValue = ((rawValue_float *0.00195313)+(0));
            putValue(E_pric_RadarFrontCenter_TrajPointACCObj6_TrajPointACCObj6_dVarYv_uw_Pv, phyValue);
            chgEv_TrajPointACCObj6_TrajPointACCObj6_dVarYv_uw = 1;
        }
        else
        {
            chgEv_TrajPointACCObj6_TrajPointACCObj6_dVarYv_uw = 0;
        }    
        //update the signal value
        Msg_TrajPointACCObj6.TrajPointACCObj6_dVarYv_uw=rawValue;        
    }                                                                           
}

on envVar E_pric_RadarFrontCenter_TrajPointACCObj6_TrajPointACCObj6_dVarYv_uw_Pv
{
    qword rawValue = 0ll;
    float phyValue = 0.0;
    
    //update the raw value with physical value 
    {
        if(chgEv_TrajPointACCObj6_TrajPointACCObj6_dVarYv_uw == 0)
        {
            phyValue = getvalue(this);
            // physical to raw conversion
            rawValue = ((phyValue -(0))/0.00195313);
            putValue(E_pric_RadarFrontCenter_TrajPointACCObj6_TrajPointACCObj6_dVarYv_uw_Rv, rawValue);
            chgEv_TrajPointACCObj6_TrajPointACCObj6_dVarYv_uw = 1;  
        }
        else
        {
            chgEv_TrajPointACCObj6_TrajPointACCObj6_dVarYv_uw = 0;
        }
    }
}


 
on envVar E_pric_RadarFrontCenter_TrajPointACCObj6_TrajPointACCObj6_dxv_sw_Rv
{
    qword rawValue = 0ll;
    float rawValue_float = 0.0;
    float phyValue = 0.0;        

    //set the signal with updated raw value
    {
        rawValue = getvalue(this);
        if(chgEv_TrajPointACCObj6_TrajPointACCObj6_dxv_sw == 0)
        {
            //type conversion to float
            rawValue_float = rawValue;        
            // raw to physical conversion
            phyValue = ((rawValue_float *0.0078125)+(0));
            putValue(E_pric_RadarFrontCenter_TrajPointACCObj6_TrajPointACCObj6_dxv_sw_Pv, phyValue);
            chgEv_TrajPointACCObj6_TrajPointACCObj6_dxv_sw = 1;
        }
        else
        {
            chgEv_TrajPointACCObj6_TrajPointACCObj6_dxv_sw = 0;
        }    
        //update the signal value
        Msg_TrajPointACCObj6.TrajPointACCObj6_dxv_sw=rawValue;        
    }                                                                           
}

on envVar E_pric_RadarFrontCenter_TrajPointACCObj6_TrajPointACCObj6_dxv_sw_Pv
{
    qword rawValue = 0ll;
    float phyValue = 0.0;
    
    //update the raw value with physical value 
    {
        if(chgEv_TrajPointACCObj6_TrajPointACCObj6_dxv_sw == 0)
        {
            phyValue = getvalue(this);
            // physical to raw conversion
            rawValue = ((phyValue -(0))/0.0078125);
            putValue(E_pric_RadarFrontCenter_TrajPointACCObj6_TrajPointACCObj6_dxv_sw_Rv, rawValue);
            chgEv_TrajPointACCObj6_TrajPointACCObj6_dxv_sw = 1;  
        }
        else
        {
            chgEv_TrajPointACCObj6_TrajPointACCObj6_dxv_sw = 0;
        }
    }
}


 
on envVar E_pric_RadarFrontCenter_TrajPointACCObj6_TrajPointACCObj6_timestamp_Rv
{
    qword rawValue = 0ll;
    float rawValue_float = 0.0;
    float phyValue = 0.0;        

    //set the signal with updated raw value
    {
        rawValue = getvalue(this);
        if(chgEv_TrajPointACCObj6_TrajPointACCObj6_timestamp == 0)
        {
            //type conversion to float
            rawValue_float = rawValue;        
            // raw to physical conversion
            phyValue = ((rawValue_float *0.000488281)+(0));
            putValue(E_pric_RadarFrontCenter_TrajPointACCObj6_TrajPointACCObj6_timestamp_Pv, phyValue);
            chgEv_TrajPointACCObj6_TrajPointACCObj6_timestamp = 1;
        }
        else
        {
            chgEv_TrajPointACCObj6_TrajPointACCObj6_timestamp = 0;
        }    
        //update the signal value
        Msg_TrajPointACCObj6.TrajPointACCObj6_timestamp=rawValue;        
    }                                                                           
}

on envVar E_pric_RadarFrontCenter_TrajPointACCObj6_TrajPointACCObj6_timestamp_Pv
{
    qword rawValue = 0ll;
    float phyValue = 0.0;
    
    //update the raw value with physical value 
    {
        if(chgEv_TrajPointACCObj6_TrajPointACCObj6_timestamp == 0)
        {
            phyValue = getvalue(this);
            // physical to raw conversion
            rawValue = ((phyValue -(0))/0.000488281);
            putValue(E_pric_RadarFrontCenter_TrajPointACCObj6_TrajPointACCObj6_timestamp_Rv, rawValue);
            chgEv_TrajPointACCObj6_TrajPointACCObj6_timestamp = 1;  
        }
        else
        {
            chgEv_TrajPointACCObj6_TrajPointACCObj6_timestamp = 0;
        }
    }
}


 
on envVar E_pric_RadarFrontCenter_TrajPointACCObj6_TrajPointACCObj6_dVarXv_uw_Rv
{
    qword rawValue = 0ll;
    float rawValue_float = 0.0;
    float phyValue = 0.0;        

    //set the signal with updated raw value
    {
        rawValue = getvalue(this);
        if(chgEv_TrajPointACCObj6_TrajPointACCObj6_dVarXv_uw == 0)
        {
            //type conversion to float
            rawValue_float = rawValue;        
            // raw to physical conversion
            phyValue = ((rawValue_float *0.00195313)+(0));
            putValue(E_pric_RadarFrontCenter_TrajPointACCObj6_TrajPointACCObj6_dVarXv_uw_Pv, phyValue);
            chgEv_TrajPointACCObj6_TrajPointACCObj6_dVarXv_uw = 1;
        }
        else
        {
            chgEv_TrajPointACCObj6_TrajPointACCObj6_dVarXv_uw = 0;
        }    
        //update the signal value
        Msg_TrajPointACCObj6.TrajPointACCObj6_dVarXv_uw=rawValue;        
    }                                                                           
}

on envVar E_pric_RadarFrontCenter_TrajPointACCObj6_TrajPointACCObj6_dVarXv_uw_Pv
{
    qword rawValue = 0ll;
    float phyValue = 0.0;
    
    //update the raw value with physical value 
    {
        if(chgEv_TrajPointACCObj6_TrajPointACCObj6_dVarXv_uw == 0)
        {
            phyValue = getvalue(this);
            // physical to raw conversion
            rawValue = ((phyValue -(0))/0.00195313);
            putValue(E_pric_RadarFrontCenter_TrajPointACCObj6_TrajPointACCObj6_dVarXv_uw_Rv, rawValue);
            chgEv_TrajPointACCObj6_TrajPointACCObj6_dVarXv_uw = 1;  
        }
        else
        {
            chgEv_TrajPointACCObj6_TrajPointACCObj6_dVarXv_uw = 0;
        }
    }
}


 
on envVar E_pric_RadarFrontCenter_TrajPointACCObj6_TrajPointACCObj6_Stopped_b_Rv
{
    qword rawValue = 0ll;
    float rawValue_float = 0.0;
    float phyValue = 0.0;        

    //set the signal with updated raw value
    if(getValue(E_pric_RadarFrontCenter_TrajPointACCObj6_TrajPointACCObj6_Stopped_b_SetVt)==0)
    {
        rawValue = getvalue(this);
        if(chgEv_TrajPointACCObj6_TrajPointACCObj6_Stopped_b == 0)
        {
            //type conversion to float
            rawValue_float = rawValue;        
            // raw to physical conversion
            phyValue = ((rawValue_float *1)+(0));
            putValue(E_pric_RadarFrontCenter_TrajPointACCObj6_TrajPointACCObj6_Stopped_b_Pv, phyValue);
            chgEv_TrajPointACCObj6_TrajPointACCObj6_Stopped_b = 1;
        }
        else
        {
            chgEv_TrajPointACCObj6_TrajPointACCObj6_Stopped_b = 0;
        }    
        //update the signal value
        Msg_TrajPointACCObj6.TrajPointACCObj6_Stopped_b=rawValue;        
    }                                                                           
}

on envVar E_pric_RadarFrontCenter_TrajPointACCObj6_TrajPointACCObj6_Stopped_b_Pv
{
    qword rawValue = 0ll;
    float phyValue = 0.0;
    
    //update the raw value with physical value 
    if(getValue(E_pric_RadarFrontCenter_TrajPointACCObj6_TrajPointACCObj6_Stopped_b_SetVt)==0)
    {
        if(chgEv_TrajPointACCObj6_TrajPointACCObj6_Stopped_b == 0)
        {
            phyValue = getvalue(this);
            // physical to raw conversion
            rawValue = ((phyValue -(0))/1);
            putValue(E_pric_RadarFrontCenter_TrajPointACCObj6_TrajPointACCObj6_Stopped_b_Rv, rawValue);
            chgEv_TrajPointACCObj6_TrajPointACCObj6_Stopped_b = 1;  
        }
        else
        {
            chgEv_TrajPointACCObj6_TrajPointACCObj6_Stopped_b = 0;
        }
    }
}

on envVar E_pric_RadarFrontCenter_TrajPointACCObj6_TrajPointACCObj6_Stopped_b_Vt
{
    qword rawValue = 0ll;
    if(getValue(E_pric_RadarFrontCenter_TrajPointACCObj6_TrajPointACCObj6_Stopped_b_SetVt))
    {
        //update the signal value
        Msg_TrajPointACCObj6.TrajPointACCObj6_Stopped_b=getValue(this);
    }
}

on envVar E_pric_RadarFrontCenter_TrajPointACCObj6_TrajPointACCObj6_Stopped_b_SetVt
{
    if(getValue(E_pric_RadarFrontCenter_TrajPointACCObj6_TrajPointACCObj6_Stopped_b_SetVt))
    {
        //update the signal value
        Msg_TrajPointACCObj6.TrajPointACCObj6_Stopped_b=getvalue(E_pric_RadarFrontCenter_TrajPointACCObj6_TrajPointACCObj6_Stopped_b_Vt);
    }
    else
    {
        Msg_TrajPointACCObj6.TrajPointACCObj6_Stopped_b=getValue(E_pric_RadarFrontCenter_TrajPointACCObj6_TrajPointACCObj6_Stopped_b_Rv);
    }
}
 
on envVar E_pric_RadarFrontCenter_TrajPointACCObj6_TrajPointACCObj6_dyv_sw_Rv
{
    qword rawValue = 0ll;
    float rawValue_float = 0.0;
    float phyValue = 0.0;        

    //set the signal with updated raw value
    {
        rawValue = getvalue(this);
        if(chgEv_TrajPointACCObj6_TrajPointACCObj6_dyv_sw == 0)
        {
            //type conversion to float
            rawValue_float = rawValue;        
            // raw to physical conversion
            phyValue = ((rawValue_float *0.0078125)+(0));
            putValue(E_pric_RadarFrontCenter_TrajPointACCObj6_TrajPointACCObj6_dyv_sw_Pv, phyValue);
            chgEv_TrajPointACCObj6_TrajPointACCObj6_dyv_sw = 1;
        }
        else
        {
            chgEv_TrajPointACCObj6_TrajPointACCObj6_dyv_sw = 0;
        }    
        //update the signal value
        Msg_TrajPointACCObj6.TrajPointACCObj6_dyv_sw=rawValue;        
    }                                                                           
}

on envVar E_pric_RadarFrontCenter_TrajPointACCObj6_TrajPointACCObj6_dyv_sw_Pv
{
    qword rawValue = 0ll;
    float phyValue = 0.0;
    
    //update the raw value with physical value 
    {
        if(chgEv_TrajPointACCObj6_TrajPointACCObj6_dyv_sw == 0)
        {
            phyValue = getvalue(this);
            // physical to raw conversion
            rawValue = ((phyValue -(0))/0.0078125);
            putValue(E_pric_RadarFrontCenter_TrajPointACCObj6_TrajPointACCObj6_dyv_sw_Rv, rawValue);
            chgEv_TrajPointACCObj6_TrajPointACCObj6_dyv_sw = 1;  
        }
        else
        {
            chgEv_TrajPointACCObj6_TrajPointACCObj6_dyv_sw = 0;
        }
    }
}


 
on envVar E_pric_RadarFrontCenter_TrajPointACCObj6_TrajPointACCObj6_Drive_b_Rv
{
    qword rawValue = 0ll;
    float rawValue_float = 0.0;
    float phyValue = 0.0;        

    //set the signal with updated raw value
    if(getValue(E_pric_RadarFrontCenter_TrajPointACCObj6_TrajPointACCObj6_Drive_b_SetVt)==0)
    {
        rawValue = getvalue(this);
        if(chgEv_TrajPointACCObj6_TrajPointACCObj6_Drive_b == 0)
        {
            //type conversion to float
            rawValue_float = rawValue;        
            // raw to physical conversion
            phyValue = ((rawValue_float *1)+(0));
            putValue(E_pric_RadarFrontCenter_TrajPointACCObj6_TrajPointACCObj6_Drive_b_Pv, phyValue);
            chgEv_TrajPointACCObj6_TrajPointACCObj6_Drive_b = 1;
        }
        else
        {
            chgEv_TrajPointACCObj6_TrajPointACCObj6_Drive_b = 0;
        }    
        //update the signal value
        Msg_TrajPointACCObj6.TrajPointACCObj6_Drive_b=rawValue;        
    }                                                                           
}

on envVar E_pric_RadarFrontCenter_TrajPointACCObj6_TrajPointACCObj6_Drive_b_Pv
{
    qword rawValue = 0ll;
    float phyValue = 0.0;
    
    //update the raw value with physical value 
    if(getValue(E_pric_RadarFrontCenter_TrajPointACCObj6_TrajPointACCObj6_Drive_b_SetVt)==0)
    {
        if(chgEv_TrajPointACCObj6_TrajPointACCObj6_Drive_b == 0)
        {
            phyValue = getvalue(this);
            // physical to raw conversion
            rawValue = ((phyValue -(0))/1);
            putValue(E_pric_RadarFrontCenter_TrajPointACCObj6_TrajPointACCObj6_Drive_b_Rv, rawValue);
            chgEv_TrajPointACCObj6_TrajPointACCObj6_Drive_b = 1;  
        }
        else
        {
            chgEv_TrajPointACCObj6_TrajPointACCObj6_Drive_b = 0;
        }
    }
}

on envVar E_pric_RadarFrontCenter_TrajPointACCObj6_TrajPointACCObj6_Drive_b_Vt
{
    qword rawValue = 0ll;
    if(getValue(E_pric_RadarFrontCenter_TrajPointACCObj6_TrajPointACCObj6_Drive_b_SetVt))
    {
        //update the signal value
        Msg_TrajPointACCObj6.TrajPointACCObj6_Drive_b=getValue(this);
    }
}

on envVar E_pric_RadarFrontCenter_TrajPointACCObj6_TrajPointACCObj6_Drive_b_SetVt
{
    if(getValue(E_pric_RadarFrontCenter_TrajPointACCObj6_TrajPointACCObj6_Drive_b_SetVt))
    {
        //update the signal value
        Msg_TrajPointACCObj6.TrajPointACCObj6_Drive_b=getvalue(E_pric_RadarFrontCenter_TrajPointACCObj6_TrajPointACCObj6_Drive_b_Vt);
    }
    else
    {
        Msg_TrajPointACCObj6.TrajPointACCObj6_Drive_b=getValue(E_pric_RadarFrontCenter_TrajPointACCObj6_TrajPointACCObj6_Drive_b_Rv);
    }
}
 
on envVar E_pric_RadarFrontCenter_TrajPointACCObj6_TrajPointACCObj6_TrajEnd_b_Rv
{
    qword rawValue = 0ll;
    float rawValue_float = 0.0;
    float phyValue = 0.0;        

    //set the signal with updated raw value
    if(getValue(E_pric_RadarFrontCenter_TrajPointACCObj6_TrajPointACCObj6_TrajEnd_b_SetVt)==0)
    {
        rawValue = getvalue(this);
        if(chgEv_TrajPointACCObj6_TrajPointACCObj6_TrajEnd_b == 0)
        {
            //type conversion to float
            rawValue_float = rawValue;        
            // raw to physical conversion
            phyValue = ((rawValue_float *1)+(0));
            putValue(E_pric_RadarFrontCenter_TrajPointACCObj6_TrajPointACCObj6_TrajEnd_b_Pv, phyValue);
            chgEv_TrajPointACCObj6_TrajPointACCObj6_TrajEnd_b = 1;
        }
        else
        {
            chgEv_TrajPointACCObj6_TrajPointACCObj6_TrajEnd_b = 0;
        }    
        //update the signal value
        Msg_TrajPointACCObj6.TrajPointACCObj6_TrajEnd_b=rawValue;        
    }                                                                           
}

on envVar E_pric_RadarFrontCenter_TrajPointACCObj6_TrajPointACCObj6_TrajEnd_b_Pv
{
    qword rawValue = 0ll;
    float phyValue = 0.0;
    
    //update the raw value with physical value 
    if(getValue(E_pric_RadarFrontCenter_TrajPointACCObj6_TrajPointACCObj6_TrajEnd_b_SetVt)==0)
    {
        if(chgEv_TrajPointACCObj6_TrajPointACCObj6_TrajEnd_b == 0)
        {
            phyValue = getvalue(this);
            // physical to raw conversion
            rawValue = ((phyValue -(0))/1);
            putValue(E_pric_RadarFrontCenter_TrajPointACCObj6_TrajPointACCObj6_TrajEnd_b_Rv, rawValue);
            chgEv_TrajPointACCObj6_TrajPointACCObj6_TrajEnd_b = 1;  
        }
        else
        {
            chgEv_TrajPointACCObj6_TrajPointACCObj6_TrajEnd_b = 0;
        }
    }
}

on envVar E_pric_RadarFrontCenter_TrajPointACCObj6_TrajPointACCObj6_TrajEnd_b_Vt
{
    qword rawValue = 0ll;
    if(getValue(E_pric_RadarFrontCenter_TrajPointACCObj6_TrajPointACCObj6_TrajEnd_b_SetVt))
    {
        //update the signal value
        Msg_TrajPointACCObj6.TrajPointACCObj6_TrajEnd_b=getValue(this);
    }
}

on envVar E_pric_RadarFrontCenter_TrajPointACCObj6_TrajPointACCObj6_TrajEnd_b_SetVt
{
    if(getValue(E_pric_RadarFrontCenter_TrajPointACCObj6_TrajPointACCObj6_TrajEnd_b_SetVt))
    {
        //update the signal value
        Msg_TrajPointACCObj6.TrajPointACCObj6_TrajEnd_b=getvalue(E_pric_RadarFrontCenter_TrajPointACCObj6_TrajPointACCObj6_TrajEnd_b_Vt);
    }
    else
    {
        Msg_TrajPointACCObj6.TrajPointACCObj6_TrajEnd_b=getValue(E_pric_RadarFrontCenter_TrajPointACCObj6_TrajPointACCObj6_TrajEnd_b_Rv);
    }
}
 
on envVar E_pric_RadarFrontCenter_TrajPointACCObj5_tx
{
    if(getValue(this))
    {       
        
        //update the BZ Signal
        if(TrajPointACCObj5_TrajPointACCObj5_blockCtr_wrongvalctr == 0)
        {
            update_TrajPointACCObj5_TrajPointACCObj5_blockCtr_counter();
            Msg_TrajPointACCObj5.TrajPointACCObj5_blockCtr= TrajPointACCObj5_TrajPointACCObj5_blockCtr_counter;
        }
        else if(TrajPointACCObj5_TrajPointACCObj5_blockCtr_wrongvalctr > 0)
        {
             TrajPointACCObj5_TrajPointACCObj5_blockCtr_wrongvalctr--;
              // if counter becomes zero, update panel controller to zero
             if(TrajPointACCObj5_TrajPointACCObj5_blockCtr_wrongvalctr == 0)
             {
                 putValue(E_pric_RadarFrontCenter_TrajPointACCObj5_TrajPointACCObj5_blockCtr_wrongvalctr,0);
             }
        }
        else
        {
            //do nothing
        }        
        //update the BZ Signal
        if(TrajPointACCObj5_TrajPointACCObj5_MsgCtr_wrongvalctr == 0)
        {
            update_TrajPointACCObj5_TrajPointACCObj5_MsgCtr_counter();
            Msg_TrajPointACCObj5.TrajPointACCObj5_MsgCtr= TrajPointACCObj5_TrajPointACCObj5_MsgCtr_counter;
        }
        else if(TrajPointACCObj5_TrajPointACCObj5_MsgCtr_wrongvalctr > 0)
        {
             TrajPointACCObj5_TrajPointACCObj5_MsgCtr_wrongvalctr--;
              // if counter becomes zero, update panel controller to zero
             if(TrajPointACCObj5_TrajPointACCObj5_MsgCtr_wrongvalctr == 0)
             {
                 putValue(E_pric_RadarFrontCenter_TrajPointACCObj5_TrajPointACCObj5_MsgCtr_wrongvalctr,0);
             }
        }
        else
        {
            //do nothing
        }        
        //calculate the CRC checksum
        update_TrajPointACCObj5_ChkSum_Checksum();

        output(Msg_TrajPointACCObj5);        
    }
}

on envVar E_pric_RadarFrontCenter_TrajPointACCObj5_Range
{
    qword rawstatus = 0ll;
    qword rawValue = 0ll;    
    
    rawstatus = getvalue(this);    
    // set all the signals with min raw /max raw /init raw
    switch (rawstatus) 
    {
     case(0) :
        rawValue= -32768;
        putValue(E_pric_RadarFrontCenter_TrajPointACCObj5_TrajPointACCObj5_dxv_sw_Rv, rawValue);
        rawValue= 0;
        putValue(E_pric_RadarFrontCenter_TrajPointACCObj5_TrajPointACCObj5_timestamp_Rv, rawValue);
        rawValue= 0;
        putValue(E_pric_RadarFrontCenter_TrajPointACCObj5_TrajPointACCObj5_dVarYv_uw_Rv, rawValue);
        rawValue= 0;
        putValue(E_pric_RadarFrontCenter_TrajPointACCObj5_TrajPointACCObj5_InvDir_b_Rv, rawValue);
        rawValue= 0;
        putValue(E_pric_RadarFrontCenter_TrajPointACCObj5_TrajPointACCObj5_Valid_b_Rv, rawValue);
        rawValue= 0;
        putValue(E_pric_RadarFrontCenter_TrajPointACCObj5_TrajPointACCObj5_wExistProb_ub_Rv, rawValue);
        rawValue= 0;
        putValue(E_pric_RadarFrontCenter_TrajPointACCObj5_TrajPointACCObj5_TrajEnd_b_Rv, rawValue);
        rawValue= 0;
        putValue(E_pric_RadarFrontCenter_TrajPointACCObj5_TrajPointACCObj5_dVarXv_uw_Rv, rawValue);
        rawValue= -32768;
        putValue(E_pric_RadarFrontCenter_TrajPointACCObj5_TrajPointACCObj5_dyv_sw_Rv, rawValue);
        rawValue= 0;
        putValue(E_pric_RadarFrontCenter_TrajPointACCObj5_TrajPointACCObj5_Drive_b_Rv, rawValue);
        rawValue= 0;
        putValue(E_pric_RadarFrontCenter_TrajPointACCObj5_TrajPointACCObj5_Stand_b_Rv, rawValue);
        rawValue= 0;
        putValue(E_pric_RadarFrontCenter_TrajPointACCObj5_TrajPointACCObj5_Stopped_b_Rv, rawValue);
        break;
     case(1) :
        rawValue= 32767;
        putValue(E_pric_RadarFrontCenter_TrajPointACCObj5_TrajPointACCObj5_dxv_sw_Rv, rawValue);
        rawValue= 65536;
        putValue(E_pric_RadarFrontCenter_TrajPointACCObj5_TrajPointACCObj5_timestamp_Rv, rawValue);
        rawValue= 65534;
        putValue(E_pric_RadarFrontCenter_TrajPointACCObj5_TrajPointACCObj5_dVarYv_uw_Rv, rawValue);
        rawValue= 1;
        putValue(E_pric_RadarFrontCenter_TrajPointACCObj5_TrajPointACCObj5_InvDir_b_Rv, rawValue);
        rawValue= 1;
        putValue(E_pric_RadarFrontCenter_TrajPointACCObj5_TrajPointACCObj5_Valid_b_Rv, rawValue);
        rawValue= 255;
        putValue(E_pric_RadarFrontCenter_TrajPointACCObj5_TrajPointACCObj5_wExistProb_ub_Rv, rawValue);
        rawValue= 1;
        putValue(E_pric_RadarFrontCenter_TrajPointACCObj5_TrajPointACCObj5_TrajEnd_b_Rv, rawValue);
        rawValue= 65534;
        putValue(E_pric_RadarFrontCenter_TrajPointACCObj5_TrajPointACCObj5_dVarXv_uw_Rv, rawValue);
        rawValue= 32767;
        putValue(E_pric_RadarFrontCenter_TrajPointACCObj5_TrajPointACCObj5_dyv_sw_Rv, rawValue);
        rawValue= 1;
        putValue(E_pric_RadarFrontCenter_TrajPointACCObj5_TrajPointACCObj5_Drive_b_Rv, rawValue);
        rawValue= 1;
        putValue(E_pric_RadarFrontCenter_TrajPointACCObj5_TrajPointACCObj5_Stand_b_Rv, rawValue);
        rawValue= 1;
        putValue(E_pric_RadarFrontCenter_TrajPointACCObj5_TrajPointACCObj5_Stopped_b_Rv, rawValue);
        break;
     default :
        rawValue= -32768;
        putValue(E_pric_RadarFrontCenter_TrajPointACCObj5_TrajPointACCObj5_dxv_sw_Rv, rawValue);
        rawValue= 0;
        putValue(E_pric_RadarFrontCenter_TrajPointACCObj5_TrajPointACCObj5_timestamp_Rv, rawValue);
        rawValue= 0;
        putValue(E_pric_RadarFrontCenter_TrajPointACCObj5_TrajPointACCObj5_dVarYv_uw_Rv, rawValue);
        rawValue= 0;
        putValue(E_pric_RadarFrontCenter_TrajPointACCObj5_TrajPointACCObj5_InvDir_b_Rv, rawValue);
        rawValue= 0;
        putValue(E_pric_RadarFrontCenter_TrajPointACCObj5_TrajPointACCObj5_Valid_b_Rv, rawValue);
        rawValue= 0;
        putValue(E_pric_RadarFrontCenter_TrajPointACCObj5_TrajPointACCObj5_wExistProb_ub_Rv, rawValue);
        rawValue= 0;
        putValue(E_pric_RadarFrontCenter_TrajPointACCObj5_TrajPointACCObj5_TrajEnd_b_Rv, rawValue);
        rawValue= 0;
        putValue(E_pric_RadarFrontCenter_TrajPointACCObj5_TrajPointACCObj5_dVarXv_uw_Rv, rawValue);
        rawValue= -32768;
        putValue(E_pric_RadarFrontCenter_TrajPointACCObj5_TrajPointACCObj5_dyv_sw_Rv, rawValue);
        rawValue= 0;
        putValue(E_pric_RadarFrontCenter_TrajPointACCObj5_TrajPointACCObj5_Drive_b_Rv, rawValue);
        rawValue= 0;
        putValue(E_pric_RadarFrontCenter_TrajPointACCObj5_TrajPointACCObj5_Stand_b_Rv, rawValue);
        rawValue= 0;
        putValue(E_pric_RadarFrontCenter_TrajPointACCObj5_TrajPointACCObj5_Stopped_b_Rv, rawValue);
      break;
   }
}

on envVar E_pric_RadarFrontCenter_TrajPointACCObj5_Dlc
{
    if(getValue(E_pric_RadarFrontCenter_TrajPointACCObj5_enDlc))
    {
        Msg_TrajPointACCObj5.dlc =getValue(this);
    }
    else
    {
       Dbc_dlc = 16;
	   Msg_TrajPointACCObj5.dlc = Calc_Canfd_dlc(Dbc_dlc);
	   	
  }
}

on envVar E_pric_RadarFrontCenter_TrajPointACCObj5_enDlc
{
    //For Messages with DLC = 8, set wrong DLC to smaller than defined DLC
    //For Messages with DLC < 8 set wrong DLC to smaller/longer than defined DLC
    if(getValue(this))
    {
        Msg_TrajPointACCObj5.dlc =getValue(E_pric_RadarFrontCenter_TrajPointACCObj5_Dlc);
    }
    else
    {
       Dbc_dlc = 16;
	   Msg_TrajPointACCObj5.dlc = Calc_Canfd_dlc(Dbc_dlc);
			
    }
}

on envVar E_pric_RadarFrontCenter_TrajPointACCObj5_TrajPointACCObj5_CRC_wrongvalctr
{
    //update disturb count
    //disturb value range:(-1 = always send wrong value),( X>0 ,x is the number of Messages with wrong CHK sent)
    TrajPointACCObj5_TrajPointACCObj5_CRC_wrongvalctr =getValue(this);    
}
on envVar E_pric_RadarFrontCenter_TrajPointACCObj5_TrajPointACCObj5_MsgCtr_wrongvalctr
{
    //update disturb count
    //disturb value range:(-1 = always send wrong value),( X>0 ,x is the number of Messages with wrong CHK sent)
    TrajPointACCObj5_TrajPointACCObj5_MsgCtr_wrongvalctr =getValue(this);    
}
on envVar E_pric_RadarFrontCenter_TrajPointACCObj5_TrajPointACCObj5_blockCtr_wrongvalctr
{
    //update disturb count
    //disturb value range:(-1 = always send wrong value),( X>0 ,x is the number of Messages with wrong CHK sent)
    TrajPointACCObj5_TrajPointACCObj5_blockCtr_wrongvalctr =getValue(this);    
}

on envVar E_pric_RadarFrontCenter_TrajPointACCObj5_TrajPointACCObj5_dxv_sw_Rv
{
    qword rawValue = 0ll;
    float rawValue_float = 0.0;
    float phyValue = 0.0;        

    //set the signal with updated raw value
    {
        rawValue = getvalue(this);
        if(chgEv_TrajPointACCObj5_TrajPointACCObj5_dxv_sw == 0)
        {
            //type conversion to float
            rawValue_float = rawValue;        
            // raw to physical conversion
            phyValue = ((rawValue_float *0.0078125)+(0));
            putValue(E_pric_RadarFrontCenter_TrajPointACCObj5_TrajPointACCObj5_dxv_sw_Pv, phyValue);
            chgEv_TrajPointACCObj5_TrajPointACCObj5_dxv_sw = 1;
        }
        else
        {
            chgEv_TrajPointACCObj5_TrajPointACCObj5_dxv_sw = 0;
        }    
        //update the signal value
        Msg_TrajPointACCObj5.TrajPointACCObj5_dxv_sw=rawValue;        
    }                                                                           
}

on envVar E_pric_RadarFrontCenter_TrajPointACCObj5_TrajPointACCObj5_dxv_sw_Pv
{
    qword rawValue = 0ll;
    float phyValue = 0.0;
    
    //update the raw value with physical value 
    {
        if(chgEv_TrajPointACCObj5_TrajPointACCObj5_dxv_sw == 0)
        {
            phyValue = getvalue(this);
            // physical to raw conversion
            rawValue = ((phyValue -(0))/0.0078125);
            putValue(E_pric_RadarFrontCenter_TrajPointACCObj5_TrajPointACCObj5_dxv_sw_Rv, rawValue);
            chgEv_TrajPointACCObj5_TrajPointACCObj5_dxv_sw = 1;  
        }
        else
        {
            chgEv_TrajPointACCObj5_TrajPointACCObj5_dxv_sw = 0;
        }
    }
}


 
on envVar E_pric_RadarFrontCenter_TrajPointACCObj5_TrajPointACCObj5_timestamp_Rv
{
    qword rawValue = 0ll;
    float rawValue_float = 0.0;
    float phyValue = 0.0;        

    //set the signal with updated raw value
    {
        rawValue = getvalue(this);
        if(chgEv_TrajPointACCObj5_TrajPointACCObj5_timestamp == 0)
        {
            //type conversion to float
            rawValue_float = rawValue;        
            // raw to physical conversion
            phyValue = ((rawValue_float *0.000488281)+(0));
            putValue(E_pric_RadarFrontCenter_TrajPointACCObj5_TrajPointACCObj5_timestamp_Pv, phyValue);
            chgEv_TrajPointACCObj5_TrajPointACCObj5_timestamp = 1;
        }
        else
        {
            chgEv_TrajPointACCObj5_TrajPointACCObj5_timestamp = 0;
        }    
        //update the signal value
        Msg_TrajPointACCObj5.TrajPointACCObj5_timestamp=rawValue;        
    }                                                                           
}

on envVar E_pric_RadarFrontCenter_TrajPointACCObj5_TrajPointACCObj5_timestamp_Pv
{
    qword rawValue = 0ll;
    float phyValue = 0.0;
    
    //update the raw value with physical value 
    {
        if(chgEv_TrajPointACCObj5_TrajPointACCObj5_timestamp == 0)
        {
            phyValue = getvalue(this);
            // physical to raw conversion
            rawValue = ((phyValue -(0))/0.000488281);
            putValue(E_pric_RadarFrontCenter_TrajPointACCObj5_TrajPointACCObj5_timestamp_Rv, rawValue);
            chgEv_TrajPointACCObj5_TrajPointACCObj5_timestamp = 1;  
        }
        else
        {
            chgEv_TrajPointACCObj5_TrajPointACCObj5_timestamp = 0;
        }
    }
}


 
on envVar E_pric_RadarFrontCenter_TrajPointACCObj5_TrajPointACCObj5_dVarYv_uw_Rv
{
    qword rawValue = 0ll;
    float rawValue_float = 0.0;
    float phyValue = 0.0;        

    //set the signal with updated raw value
    {
        rawValue = getvalue(this);
        if(chgEv_TrajPointACCObj5_TrajPointACCObj5_dVarYv_uw == 0)
        {
            //type conversion to float
            rawValue_float = rawValue;        
            // raw to physical conversion
            phyValue = ((rawValue_float *0.00195313)+(0));
            putValue(E_pric_RadarFrontCenter_TrajPointACCObj5_TrajPointACCObj5_dVarYv_uw_Pv, phyValue);
            chgEv_TrajPointACCObj5_TrajPointACCObj5_dVarYv_uw = 1;
        }
        else
        {
            chgEv_TrajPointACCObj5_TrajPointACCObj5_dVarYv_uw = 0;
        }    
        //update the signal value
        Msg_TrajPointACCObj5.TrajPointACCObj5_dVarYv_uw=rawValue;        
    }                                                                           
}

on envVar E_pric_RadarFrontCenter_TrajPointACCObj5_TrajPointACCObj5_dVarYv_uw_Pv
{
    qword rawValue = 0ll;
    float phyValue = 0.0;
    
    //update the raw value with physical value 
    {
        if(chgEv_TrajPointACCObj5_TrajPointACCObj5_dVarYv_uw == 0)
        {
            phyValue = getvalue(this);
            // physical to raw conversion
            rawValue = ((phyValue -(0))/0.00195313);
            putValue(E_pric_RadarFrontCenter_TrajPointACCObj5_TrajPointACCObj5_dVarYv_uw_Rv, rawValue);
            chgEv_TrajPointACCObj5_TrajPointACCObj5_dVarYv_uw = 1;  
        }
        else
        {
            chgEv_TrajPointACCObj5_TrajPointACCObj5_dVarYv_uw = 0;
        }
    }
}


 
on envVar E_pric_RadarFrontCenter_TrajPointACCObj5_TrajPointACCObj5_InvDir_b_Rv
{
    qword rawValue = 0ll;
    float rawValue_float = 0.0;
    float phyValue = 0.0;        

    //set the signal with updated raw value
    if(getValue(E_pric_RadarFrontCenter_TrajPointACCObj5_TrajPointACCObj5_InvDir_b_SetVt)==0)
    {
        rawValue = getvalue(this);
        if(chgEv_TrajPointACCObj5_TrajPointACCObj5_InvDir_b == 0)
        {
            //type conversion to float
            rawValue_float = rawValue;        
            // raw to physical conversion
            phyValue = ((rawValue_float *1)+(0));
            putValue(E_pric_RadarFrontCenter_TrajPointACCObj5_TrajPointACCObj5_InvDir_b_Pv, phyValue);
            chgEv_TrajPointACCObj5_TrajPointACCObj5_InvDir_b = 1;
        }
        else
        {
            chgEv_TrajPointACCObj5_TrajPointACCObj5_InvDir_b = 0;
        }    
        //update the signal value
        Msg_TrajPointACCObj5.TrajPointACCObj5_InvDir_b=rawValue;        
    }                                                                           
}

on envVar E_pric_RadarFrontCenter_TrajPointACCObj5_TrajPointACCObj5_InvDir_b_Pv
{
    qword rawValue = 0ll;
    float phyValue = 0.0;
    
    //update the raw value with physical value 
    if(getValue(E_pric_RadarFrontCenter_TrajPointACCObj5_TrajPointACCObj5_InvDir_b_SetVt)==0)
    {
        if(chgEv_TrajPointACCObj5_TrajPointACCObj5_InvDir_b == 0)
        {
            phyValue = getvalue(this);
            // physical to raw conversion
            rawValue = ((phyValue -(0))/1);
            putValue(E_pric_RadarFrontCenter_TrajPointACCObj5_TrajPointACCObj5_InvDir_b_Rv, rawValue);
            chgEv_TrajPointACCObj5_TrajPointACCObj5_InvDir_b = 1;  
        }
        else
        {
            chgEv_TrajPointACCObj5_TrajPointACCObj5_InvDir_b = 0;
        }
    }
}

on envVar E_pric_RadarFrontCenter_TrajPointACCObj5_TrajPointACCObj5_InvDir_b_Vt
{
    qword rawValue = 0ll;
    if(getValue(E_pric_RadarFrontCenter_TrajPointACCObj5_TrajPointACCObj5_InvDir_b_SetVt))
    {
        //update the signal value
        Msg_TrajPointACCObj5.TrajPointACCObj5_InvDir_b=getValue(this);
    }
}

on envVar E_pric_RadarFrontCenter_TrajPointACCObj5_TrajPointACCObj5_InvDir_b_SetVt
{
    if(getValue(E_pric_RadarFrontCenter_TrajPointACCObj5_TrajPointACCObj5_InvDir_b_SetVt))
    {
        //update the signal value
        Msg_TrajPointACCObj5.TrajPointACCObj5_InvDir_b=getvalue(E_pric_RadarFrontCenter_TrajPointACCObj5_TrajPointACCObj5_InvDir_b_Vt);
    }
    else
    {
        Msg_TrajPointACCObj5.TrajPointACCObj5_InvDir_b=getValue(E_pric_RadarFrontCenter_TrajPointACCObj5_TrajPointACCObj5_InvDir_b_Rv);
    }
}
 
on envVar E_pric_RadarFrontCenter_TrajPointACCObj5_TrajPointACCObj5_Valid_b_Rv
{
    qword rawValue = 0ll;
    float rawValue_float = 0.0;
    float phyValue = 0.0;        

    //set the signal with updated raw value
    if(getValue(E_pric_RadarFrontCenter_TrajPointACCObj5_TrajPointACCObj5_Valid_b_SetVt)==0)
    {
        rawValue = getvalue(this);
        if(chgEv_TrajPointACCObj5_TrajPointACCObj5_Valid_b == 0)
        {
            //type conversion to float
            rawValue_float = rawValue;        
            // raw to physical conversion
            phyValue = ((rawValue_float *1)+(0));
            putValue(E_pric_RadarFrontCenter_TrajPointACCObj5_TrajPointACCObj5_Valid_b_Pv, phyValue);
            chgEv_TrajPointACCObj5_TrajPointACCObj5_Valid_b = 1;
        }
        else
        {
            chgEv_TrajPointACCObj5_TrajPointACCObj5_Valid_b = 0;
        }    
        //update the signal value
        Msg_TrajPointACCObj5.TrajPointACCObj5_Valid_b=rawValue;        
    }                                                                           
}

on envVar E_pric_RadarFrontCenter_TrajPointACCObj5_TrajPointACCObj5_Valid_b_Pv
{
    qword rawValue = 0ll;
    float phyValue = 0.0;
    
    //update the raw value with physical value 
    if(getValue(E_pric_RadarFrontCenter_TrajPointACCObj5_TrajPointACCObj5_Valid_b_SetVt)==0)
    {
        if(chgEv_TrajPointACCObj5_TrajPointACCObj5_Valid_b == 0)
        {
            phyValue = getvalue(this);
            // physical to raw conversion
            rawValue = ((phyValue -(0))/1);
            putValue(E_pric_RadarFrontCenter_TrajPointACCObj5_TrajPointACCObj5_Valid_b_Rv, rawValue);
            chgEv_TrajPointACCObj5_TrajPointACCObj5_Valid_b = 1;  
        }
        else
        {
            chgEv_TrajPointACCObj5_TrajPointACCObj5_Valid_b = 0;
        }
    }
}

on envVar E_pric_RadarFrontCenter_TrajPointACCObj5_TrajPointACCObj5_Valid_b_Vt
{
    qword rawValue = 0ll;
    if(getValue(E_pric_RadarFrontCenter_TrajPointACCObj5_TrajPointACCObj5_Valid_b_SetVt))
    {
        //update the signal value
        Msg_TrajPointACCObj5.TrajPointACCObj5_Valid_b=getValue(this);
    }
}

on envVar E_pric_RadarFrontCenter_TrajPointACCObj5_TrajPointACCObj5_Valid_b_SetVt
{
    if(getValue(E_pric_RadarFrontCenter_TrajPointACCObj5_TrajPointACCObj5_Valid_b_SetVt))
    {
        //update the signal value
        Msg_TrajPointACCObj5.TrajPointACCObj5_Valid_b=getvalue(E_pric_RadarFrontCenter_TrajPointACCObj5_TrajPointACCObj5_Valid_b_Vt);
    }
    else
    {
        Msg_TrajPointACCObj5.TrajPointACCObj5_Valid_b=getValue(E_pric_RadarFrontCenter_TrajPointACCObj5_TrajPointACCObj5_Valid_b_Rv);
    }
}
 
on envVar E_pric_RadarFrontCenter_TrajPointACCObj5_TrajPointACCObj5_wExistProb_ub_Rv
{
    qword rawValue = 0ll;
    float rawValue_float = 0.0;
    float phyValue = 0.0;        

    //set the signal with updated raw value
    {
        rawValue = getvalue(this);
        if(chgEv_TrajPointACCObj5_TrajPointACCObj5_wExistProb_ub == 0)
        {
            //type conversion to float
            rawValue_float = rawValue;        
            // raw to physical conversion
            phyValue = ((rawValue_float *0.00390625)+(0));
            putValue(E_pric_RadarFrontCenter_TrajPointACCObj5_TrajPointACCObj5_wExistProb_ub_Pv, phyValue);
            chgEv_TrajPointACCObj5_TrajPointACCObj5_wExistProb_ub = 1;
        }
        else
        {
            chgEv_TrajPointACCObj5_TrajPointACCObj5_wExistProb_ub = 0;
        }    
        //update the signal value
        Msg_TrajPointACCObj5.TrajPointACCObj5_wExistProb_ub=rawValue;        
    }                                                                           
}

on envVar E_pric_RadarFrontCenter_TrajPointACCObj5_TrajPointACCObj5_wExistProb_ub_Pv
{
    qword rawValue = 0ll;
    float phyValue = 0.0;
    
    //update the raw value with physical value 
    {
        if(chgEv_TrajPointACCObj5_TrajPointACCObj5_wExistProb_ub == 0)
        {
            phyValue = getvalue(this);
            // physical to raw conversion
            rawValue = ((phyValue -(0))/0.00390625);
            putValue(E_pric_RadarFrontCenter_TrajPointACCObj5_TrajPointACCObj5_wExistProb_ub_Rv, rawValue);
            chgEv_TrajPointACCObj5_TrajPointACCObj5_wExistProb_ub = 1;  
        }
        else
        {
            chgEv_TrajPointACCObj5_TrajPointACCObj5_wExistProb_ub = 0;
        }
    }
}


 
on envVar E_pric_RadarFrontCenter_TrajPointACCObj5_TrajPointACCObj5_TrajEnd_b_Rv
{
    qword rawValue = 0ll;
    float rawValue_float = 0.0;
    float phyValue = 0.0;        

    //set the signal with updated raw value
    if(getValue(E_pric_RadarFrontCenter_TrajPointACCObj5_TrajPointACCObj5_TrajEnd_b_SetVt)==0)
    {
        rawValue = getvalue(this);
        if(chgEv_TrajPointACCObj5_TrajPointACCObj5_TrajEnd_b == 0)
        {
            //type conversion to float
            rawValue_float = rawValue;        
            // raw to physical conversion
            phyValue = ((rawValue_float *1)+(0));
            putValue(E_pric_RadarFrontCenter_TrajPointACCObj5_TrajPointACCObj5_TrajEnd_b_Pv, phyValue);
            chgEv_TrajPointACCObj5_TrajPointACCObj5_TrajEnd_b = 1;
        }
        else
        {
            chgEv_TrajPointACCObj5_TrajPointACCObj5_TrajEnd_b = 0;
        }    
        //update the signal value
        Msg_TrajPointACCObj5.TrajPointACCObj5_TrajEnd_b=rawValue;        
    }                                                                           
}

on envVar E_pric_RadarFrontCenter_TrajPointACCObj5_TrajPointACCObj5_TrajEnd_b_Pv
{
    qword rawValue = 0ll;
    float phyValue = 0.0;
    
    //update the raw value with physical value 
    if(getValue(E_pric_RadarFrontCenter_TrajPointACCObj5_TrajPointACCObj5_TrajEnd_b_SetVt)==0)
    {
        if(chgEv_TrajPointACCObj5_TrajPointACCObj5_TrajEnd_b == 0)
        {
            phyValue = getvalue(this);
            // physical to raw conversion
            rawValue = ((phyValue -(0))/1);
            putValue(E_pric_RadarFrontCenter_TrajPointACCObj5_TrajPointACCObj5_TrajEnd_b_Rv, rawValue);
            chgEv_TrajPointACCObj5_TrajPointACCObj5_TrajEnd_b = 1;  
        }
        else
        {
            chgEv_TrajPointACCObj5_TrajPointACCObj5_TrajEnd_b = 0;
        }
    }
}

on envVar E_pric_RadarFrontCenter_TrajPointACCObj5_TrajPointACCObj5_TrajEnd_b_Vt
{
    qword rawValue = 0ll;
    if(getValue(E_pric_RadarFrontCenter_TrajPointACCObj5_TrajPointACCObj5_TrajEnd_b_SetVt))
    {
        //update the signal value
        Msg_TrajPointACCObj5.TrajPointACCObj5_TrajEnd_b=getValue(this);
    }
}

on envVar E_pric_RadarFrontCenter_TrajPointACCObj5_TrajPointACCObj5_TrajEnd_b_SetVt
{
    if(getValue(E_pric_RadarFrontCenter_TrajPointACCObj5_TrajPointACCObj5_TrajEnd_b_SetVt))
    {
        //update the signal value
        Msg_TrajPointACCObj5.TrajPointACCObj5_TrajEnd_b=getvalue(E_pric_RadarFrontCenter_TrajPointACCObj5_TrajPointACCObj5_TrajEnd_b_Vt);
    }
    else
    {
        Msg_TrajPointACCObj5.TrajPointACCObj5_TrajEnd_b=getValue(E_pric_RadarFrontCenter_TrajPointACCObj5_TrajPointACCObj5_TrajEnd_b_Rv);
    }
}
 
on envVar E_pric_RadarFrontCenter_TrajPointACCObj5_TrajPointACCObj5_dVarXv_uw_Rv
{
    qword rawValue = 0ll;
    float rawValue_float = 0.0;
    float phyValue = 0.0;        

    //set the signal with updated raw value
    {
        rawValue = getvalue(this);
        if(chgEv_TrajPointACCObj5_TrajPointACCObj5_dVarXv_uw == 0)
        {
            //type conversion to float
            rawValue_float = rawValue;        
            // raw to physical conversion
            phyValue = ((rawValue_float *0.00195313)+(0));
            putValue(E_pric_RadarFrontCenter_TrajPointACCObj5_TrajPointACCObj5_dVarXv_uw_Pv, phyValue);
            chgEv_TrajPointACCObj5_TrajPointACCObj5_dVarXv_uw = 1;
        }
        else
        {
            chgEv_TrajPointACCObj5_TrajPointACCObj5_dVarXv_uw = 0;
        }    
        //update the signal value
        Msg_TrajPointACCObj5.TrajPointACCObj5_dVarXv_uw=rawValue;        
    }                                                                           
}

on envVar E_pric_RadarFrontCenter_TrajPointACCObj5_TrajPointACCObj5_dVarXv_uw_Pv
{
    qword rawValue = 0ll;
    float phyValue = 0.0;
    
    //update the raw value with physical value 
    {
        if(chgEv_TrajPointACCObj5_TrajPointACCObj5_dVarXv_uw == 0)
        {
            phyValue = getvalue(this);
            // physical to raw conversion
            rawValue = ((phyValue -(0))/0.00195313);
            putValue(E_pric_RadarFrontCenter_TrajPointACCObj5_TrajPointACCObj5_dVarXv_uw_Rv, rawValue);
            chgEv_TrajPointACCObj5_TrajPointACCObj5_dVarXv_uw = 1;  
        }
        else
        {
            chgEv_TrajPointACCObj5_TrajPointACCObj5_dVarXv_uw = 0;
        }
    }
}


 
on envVar E_pric_RadarFrontCenter_TrajPointACCObj5_TrajPointACCObj5_dyv_sw_Rv
{
    qword rawValue = 0ll;
    float rawValue_float = 0.0;
    float phyValue = 0.0;        

    //set the signal with updated raw value
    {
        rawValue = getvalue(this);
        if(chgEv_TrajPointACCObj5_TrajPointACCObj5_dyv_sw == 0)
        {
            //type conversion to float
            rawValue_float = rawValue;        
            // raw to physical conversion
            phyValue = ((rawValue_float *0.0078125)+(0));
            putValue(E_pric_RadarFrontCenter_TrajPointACCObj5_TrajPointACCObj5_dyv_sw_Pv, phyValue);
            chgEv_TrajPointACCObj5_TrajPointACCObj5_dyv_sw = 1;
        }
        else
        {
            chgEv_TrajPointACCObj5_TrajPointACCObj5_dyv_sw = 0;
        }    
        //update the signal value
        Msg_TrajPointACCObj5.TrajPointACCObj5_dyv_sw=rawValue;        
    }                                                                           
}

on envVar E_pric_RadarFrontCenter_TrajPointACCObj5_TrajPointACCObj5_dyv_sw_Pv
{
    qword rawValue = 0ll;
    float phyValue = 0.0;
    
    //update the raw value with physical value 
    {
        if(chgEv_TrajPointACCObj5_TrajPointACCObj5_dyv_sw == 0)
        {
            phyValue = getvalue(this);
            // physical to raw conversion
            rawValue = ((phyValue -(0))/0.0078125);
            putValue(E_pric_RadarFrontCenter_TrajPointACCObj5_TrajPointACCObj5_dyv_sw_Rv, rawValue);
            chgEv_TrajPointACCObj5_TrajPointACCObj5_dyv_sw = 1;  
        }
        else
        {
            chgEv_TrajPointACCObj5_TrajPointACCObj5_dyv_sw = 0;
        }
    }
}


 
on envVar E_pric_RadarFrontCenter_TrajPointACCObj5_TrajPointACCObj5_Drive_b_Rv
{
    qword rawValue = 0ll;
    float rawValue_float = 0.0;
    float phyValue = 0.0;        

    //set the signal with updated raw value
    if(getValue(E_pric_RadarFrontCenter_TrajPointACCObj5_TrajPointACCObj5_Drive_b_SetVt)==0)
    {
        rawValue = getvalue(this);
        if(chgEv_TrajPointACCObj5_TrajPointACCObj5_Drive_b == 0)
        {
            //type conversion to float
            rawValue_float = rawValue;        
            // raw to physical conversion
            phyValue = ((rawValue_float *1)+(0));
            putValue(E_pric_RadarFrontCenter_TrajPointACCObj5_TrajPointACCObj5_Drive_b_Pv, phyValue);
            chgEv_TrajPointACCObj5_TrajPointACCObj5_Drive_b = 1;
        }
        else
        {
            chgEv_TrajPointACCObj5_TrajPointACCObj5_Drive_b = 0;
        }    
        //update the signal value
        Msg_TrajPointACCObj5.TrajPointACCObj5_Drive_b=rawValue;        
    }                                                                           
}

on envVar E_pric_RadarFrontCenter_TrajPointACCObj5_TrajPointACCObj5_Drive_b_Pv
{
    qword rawValue = 0ll;
    float phyValue = 0.0;
    
    //update the raw value with physical value 
    if(getValue(E_pric_RadarFrontCenter_TrajPointACCObj5_TrajPointACCObj5_Drive_b_SetVt)==0)
    {
        if(chgEv_TrajPointACCObj5_TrajPointACCObj5_Drive_b == 0)
        {
            phyValue = getvalue(this);
            // physical to raw conversion
            rawValue = ((phyValue -(0))/1);
            putValue(E_pric_RadarFrontCenter_TrajPointACCObj5_TrajPointACCObj5_Drive_b_Rv, rawValue);
            chgEv_TrajPointACCObj5_TrajPointACCObj5_Drive_b = 1;  
        }
        else
        {
            chgEv_TrajPointACCObj5_TrajPointACCObj5_Drive_b = 0;
        }
    }
}

on envVar E_pric_RadarFrontCenter_TrajPointACCObj5_TrajPointACCObj5_Drive_b_Vt
{
    qword rawValue = 0ll;
    if(getValue(E_pric_RadarFrontCenter_TrajPointACCObj5_TrajPointACCObj5_Drive_b_SetVt))
    {
        //update the signal value
        Msg_TrajPointACCObj5.TrajPointACCObj5_Drive_b=getValue(this);
    }
}

on envVar E_pric_RadarFrontCenter_TrajPointACCObj5_TrajPointACCObj5_Drive_b_SetVt
{
    if(getValue(E_pric_RadarFrontCenter_TrajPointACCObj5_TrajPointACCObj5_Drive_b_SetVt))
    {
        //update the signal value
        Msg_TrajPointACCObj5.TrajPointACCObj5_Drive_b=getvalue(E_pric_RadarFrontCenter_TrajPointACCObj5_TrajPointACCObj5_Drive_b_Vt);
    }
    else
    {
        Msg_TrajPointACCObj5.TrajPointACCObj5_Drive_b=getValue(E_pric_RadarFrontCenter_TrajPointACCObj5_TrajPointACCObj5_Drive_b_Rv);
    }
}
 
on envVar E_pric_RadarFrontCenter_TrajPointACCObj5_TrajPointACCObj5_Stand_b_Rv
{
    qword rawValue = 0ll;
    float rawValue_float = 0.0;
    float phyValue = 0.0;        

    //set the signal with updated raw value
    if(getValue(E_pric_RadarFrontCenter_TrajPointACCObj5_TrajPointACCObj5_Stand_b_SetVt)==0)
    {
        rawValue = getvalue(this);
        if(chgEv_TrajPointACCObj5_TrajPointACCObj5_Stand_b == 0)
        {
            //type conversion to float
            rawValue_float = rawValue;        
            // raw to physical conversion
            phyValue = ((rawValue_float *1)+(0));
            putValue(E_pric_RadarFrontCenter_TrajPointACCObj5_TrajPointACCObj5_Stand_b_Pv, phyValue);
            chgEv_TrajPointACCObj5_TrajPointACCObj5_Stand_b = 1;
        }
        else
        {
            chgEv_TrajPointACCObj5_TrajPointACCObj5_Stand_b = 0;
        }    
        //update the signal value
        Msg_TrajPointACCObj5.TrajPointACCObj5_Stand_b=rawValue;        
    }                                                                           
}

on envVar E_pric_RadarFrontCenter_TrajPointACCObj5_TrajPointACCObj5_Stand_b_Pv
{
    qword rawValue = 0ll;
    float phyValue = 0.0;
    
    //update the raw value with physical value 
    if(getValue(E_pric_RadarFrontCenter_TrajPointACCObj5_TrajPointACCObj5_Stand_b_SetVt)==0)
    {
        if(chgEv_TrajPointACCObj5_TrajPointACCObj5_Stand_b == 0)
        {
            phyValue = getvalue(this);
            // physical to raw conversion
            rawValue = ((phyValue -(0))/1);
            putValue(E_pric_RadarFrontCenter_TrajPointACCObj5_TrajPointACCObj5_Stand_b_Rv, rawValue);
            chgEv_TrajPointACCObj5_TrajPointACCObj5_Stand_b = 1;  
        }
        else
        {
            chgEv_TrajPointACCObj5_TrajPointACCObj5_Stand_b = 0;
        }
    }
}

on envVar E_pric_RadarFrontCenter_TrajPointACCObj5_TrajPointACCObj5_Stand_b_Vt
{
    qword rawValue = 0ll;
    if(getValue(E_pric_RadarFrontCenter_TrajPointACCObj5_TrajPointACCObj5_Stand_b_SetVt))
    {
        //update the signal value
        Msg_TrajPointACCObj5.TrajPointACCObj5_Stand_b=getValue(this);
    }
}

on envVar E_pric_RadarFrontCenter_TrajPointACCObj5_TrajPointACCObj5_Stand_b_SetVt
{
    if(getValue(E_pric_RadarFrontCenter_TrajPointACCObj5_TrajPointACCObj5_Stand_b_SetVt))
    {
        //update the signal value
        Msg_TrajPointACCObj5.TrajPointACCObj5_Stand_b=getvalue(E_pric_RadarFrontCenter_TrajPointACCObj5_TrajPointACCObj5_Stand_b_Vt);
    }
    else
    {
        Msg_TrajPointACCObj5.TrajPointACCObj5_Stand_b=getValue(E_pric_RadarFrontCenter_TrajPointACCObj5_TrajPointACCObj5_Stand_b_Rv);
    }
}
 
on envVar E_pric_RadarFrontCenter_TrajPointACCObj5_TrajPointACCObj5_Stopped_b_Rv
{
    qword rawValue = 0ll;
    float rawValue_float = 0.0;
    float phyValue = 0.0;        

    //set the signal with updated raw value
    if(getValue(E_pric_RadarFrontCenter_TrajPointACCObj5_TrajPointACCObj5_Stopped_b_SetVt)==0)
    {
        rawValue = getvalue(this);
        if(chgEv_TrajPointACCObj5_TrajPointACCObj5_Stopped_b == 0)
        {
            //type conversion to float
            rawValue_float = rawValue;        
            // raw to physical conversion
            phyValue = ((rawValue_float *1)+(0));
            putValue(E_pric_RadarFrontCenter_TrajPointACCObj5_TrajPointACCObj5_Stopped_b_Pv, phyValue);
            chgEv_TrajPointACCObj5_TrajPointACCObj5_Stopped_b = 1;
        }
        else
        {
            chgEv_TrajPointACCObj5_TrajPointACCObj5_Stopped_b = 0;
        }    
        //update the signal value
        Msg_TrajPointACCObj5.TrajPointACCObj5_Stopped_b=rawValue;        
    }                                                                           
}

on envVar E_pric_RadarFrontCenter_TrajPointACCObj5_TrajPointACCObj5_Stopped_b_Pv
{
    qword rawValue = 0ll;
    float phyValue = 0.0;
    
    //update the raw value with physical value 
    if(getValue(E_pric_RadarFrontCenter_TrajPointACCObj5_TrajPointACCObj5_Stopped_b_SetVt)==0)
    {
        if(chgEv_TrajPointACCObj5_TrajPointACCObj5_Stopped_b == 0)
        {
            phyValue = getvalue(this);
            // physical to raw conversion
            rawValue = ((phyValue -(0))/1);
            putValue(E_pric_RadarFrontCenter_TrajPointACCObj5_TrajPointACCObj5_Stopped_b_Rv, rawValue);
            chgEv_TrajPointACCObj5_TrajPointACCObj5_Stopped_b = 1;  
        }
        else
        {
            chgEv_TrajPointACCObj5_TrajPointACCObj5_Stopped_b = 0;
        }
    }
}

on envVar E_pric_RadarFrontCenter_TrajPointACCObj5_TrajPointACCObj5_Stopped_b_Vt
{
    qword rawValue = 0ll;
    if(getValue(E_pric_RadarFrontCenter_TrajPointACCObj5_TrajPointACCObj5_Stopped_b_SetVt))
    {
        //update the signal value
        Msg_TrajPointACCObj5.TrajPointACCObj5_Stopped_b=getValue(this);
    }
}

on envVar E_pric_RadarFrontCenter_TrajPointACCObj5_TrajPointACCObj5_Stopped_b_SetVt
{
    if(getValue(E_pric_RadarFrontCenter_TrajPointACCObj5_TrajPointACCObj5_Stopped_b_SetVt))
    {
        //update the signal value
        Msg_TrajPointACCObj5.TrajPointACCObj5_Stopped_b=getvalue(E_pric_RadarFrontCenter_TrajPointACCObj5_TrajPointACCObj5_Stopped_b_Vt);
    }
    else
    {
        Msg_TrajPointACCObj5.TrajPointACCObj5_Stopped_b=getValue(E_pric_RadarFrontCenter_TrajPointACCObj5_TrajPointACCObj5_Stopped_b_Rv);
    }
}
 
on envVar E_pric_RadarFrontCenter_TrajPointACCObj4_tx
{
    if(getValue(this))
    {       
        
        //update the BZ Signal
        if(TrajPointACCObj4_TrajPointACCObj4_blockCtr_wrongvalctr == 0)
        {
            update_TrajPointACCObj4_TrajPointACCObj4_blockCtr_counter();
            Msg_TrajPointACCObj4.TrajPointACCObj4_blockCtr= TrajPointACCObj4_TrajPointACCObj4_blockCtr_counter;
        }
        else if(TrajPointACCObj4_TrajPointACCObj4_blockCtr_wrongvalctr > 0)
        {
             TrajPointACCObj4_TrajPointACCObj4_blockCtr_wrongvalctr--;
              // if counter becomes zero, update panel controller to zero
             if(TrajPointACCObj4_TrajPointACCObj4_blockCtr_wrongvalctr == 0)
             {
                 putValue(E_pric_RadarFrontCenter_TrajPointACCObj4_TrajPointACCObj4_blockCtr_wrongvalctr,0);
             }
        }
        else
        {
            //do nothing
        }        
        //update the BZ Signal
        if(TrajPointACCObj4_TrajPointACCObj4_MsgCtr_wrongvalctr == 0)
        {
            update_TrajPointACCObj4_TrajPointACCObj4_MsgCtr_counter();
            Msg_TrajPointACCObj4.TrajPointACCObj4_MsgCtr= TrajPointACCObj4_TrajPointACCObj4_MsgCtr_counter;
        }
        else if(TrajPointACCObj4_TrajPointACCObj4_MsgCtr_wrongvalctr > 0)
        {
             TrajPointACCObj4_TrajPointACCObj4_MsgCtr_wrongvalctr--;
              // if counter becomes zero, update panel controller to zero
             if(TrajPointACCObj4_TrajPointACCObj4_MsgCtr_wrongvalctr == 0)
             {
                 putValue(E_pric_RadarFrontCenter_TrajPointACCObj4_TrajPointACCObj4_MsgCtr_wrongvalctr,0);
             }
        }
        else
        {
            //do nothing
        }        
        //calculate the CRC checksum
        update_TrajPointACCObj4_ChkSum_Checksum();

        output(Msg_TrajPointACCObj4);        
    }
}

on envVar E_pric_RadarFrontCenter_TrajPointACCObj4_Range
{
    qword rawstatus = 0ll;
    qword rawValue = 0ll;    
    
    rawstatus = getvalue(this);    
    // set all the signals with min raw /max raw /init raw
    switch (rawstatus) 
    {
     case(0) :
        rawValue= 0;
        putValue(E_pric_RadarFrontCenter_TrajPointACCObj4_TrajPointACCObj4_Stopped_b_Rv, rawValue);
        rawValue= 0;
        putValue(E_pric_RadarFrontCenter_TrajPointACCObj4_TrajPointACCObj4_Valid_b_Rv, rawValue);
        rawValue= 0;
        putValue(E_pric_RadarFrontCenter_TrajPointACCObj4_TrajPointACCObj4_TrajEnd_b_Rv, rawValue);
        rawValue= 0;
        putValue(E_pric_RadarFrontCenter_TrajPointACCObj4_TrajPointACCObj4_Stand_b_Rv, rawValue);
        rawValue= 0;
        putValue(E_pric_RadarFrontCenter_TrajPointACCObj4_TrajPointACCObj4_timestamp_Rv, rawValue);
        rawValue= 0;
        putValue(E_pric_RadarFrontCenter_TrajPointACCObj4_TrajPointACCObj4_wExistProb_ub_Rv, rawValue);
        rawValue= 0;
        putValue(E_pric_RadarFrontCenter_TrajPointACCObj4_TrajPointACCObj4_InvDir_b_Rv, rawValue);
        rawValue= 0;
        putValue(E_pric_RadarFrontCenter_TrajPointACCObj4_TrajPointACCObj4_dVarXv_uw_Rv, rawValue);
        rawValue= 0;
        putValue(E_pric_RadarFrontCenter_TrajPointACCObj4_TrajPointACCObj4_dVarYv_uw_Rv, rawValue);
        rawValue= 0;
        putValue(E_pric_RadarFrontCenter_TrajPointACCObj4_TrajPointACCObj4_Drive_b_Rv, rawValue);
        rawValue= -32768;
        putValue(E_pric_RadarFrontCenter_TrajPointACCObj4_TrajPointACCObj4_dxv_sw_Rv, rawValue);
        rawValue= -32768;
        putValue(E_pric_RadarFrontCenter_TrajPointACCObj4_TrajPointACCObj4_dyv_sw_Rv, rawValue);
        break;
     case(1) :
        rawValue= 1;
        putValue(E_pric_RadarFrontCenter_TrajPointACCObj4_TrajPointACCObj4_Stopped_b_Rv, rawValue);
        rawValue= 1;
        putValue(E_pric_RadarFrontCenter_TrajPointACCObj4_TrajPointACCObj4_Valid_b_Rv, rawValue);
        rawValue= 1;
        putValue(E_pric_RadarFrontCenter_TrajPointACCObj4_TrajPointACCObj4_TrajEnd_b_Rv, rawValue);
        rawValue= 1;
        putValue(E_pric_RadarFrontCenter_TrajPointACCObj4_TrajPointACCObj4_Stand_b_Rv, rawValue);
        rawValue= 65536;
        putValue(E_pric_RadarFrontCenter_TrajPointACCObj4_TrajPointACCObj4_timestamp_Rv, rawValue);
        rawValue= 255;
        putValue(E_pric_RadarFrontCenter_TrajPointACCObj4_TrajPointACCObj4_wExistProb_ub_Rv, rawValue);
        rawValue= 1;
        putValue(E_pric_RadarFrontCenter_TrajPointACCObj4_TrajPointACCObj4_InvDir_b_Rv, rawValue);
        rawValue= 65534;
        putValue(E_pric_RadarFrontCenter_TrajPointACCObj4_TrajPointACCObj4_dVarXv_uw_Rv, rawValue);
        rawValue= 65534;
        putValue(E_pric_RadarFrontCenter_TrajPointACCObj4_TrajPointACCObj4_dVarYv_uw_Rv, rawValue);
        rawValue= 1;
        putValue(E_pric_RadarFrontCenter_TrajPointACCObj4_TrajPointACCObj4_Drive_b_Rv, rawValue);
        rawValue= 32767;
        putValue(E_pric_RadarFrontCenter_TrajPointACCObj4_TrajPointACCObj4_dxv_sw_Rv, rawValue);
        rawValue= 32767;
        putValue(E_pric_RadarFrontCenter_TrajPointACCObj4_TrajPointACCObj4_dyv_sw_Rv, rawValue);
        break;
     default :
        rawValue= 0;
        putValue(E_pric_RadarFrontCenter_TrajPointACCObj4_TrajPointACCObj4_Stopped_b_Rv, rawValue);
        rawValue= 0;
        putValue(E_pric_RadarFrontCenter_TrajPointACCObj4_TrajPointACCObj4_Valid_b_Rv, rawValue);
        rawValue= 0;
        putValue(E_pric_RadarFrontCenter_TrajPointACCObj4_TrajPointACCObj4_TrajEnd_b_Rv, rawValue);
        rawValue= 0;
        putValue(E_pric_RadarFrontCenter_TrajPointACCObj4_TrajPointACCObj4_Stand_b_Rv, rawValue);
        rawValue= 0;
        putValue(E_pric_RadarFrontCenter_TrajPointACCObj4_TrajPointACCObj4_timestamp_Rv, rawValue);
        rawValue= 0;
        putValue(E_pric_RadarFrontCenter_TrajPointACCObj4_TrajPointACCObj4_wExistProb_ub_Rv, rawValue);
        rawValue= 0;
        putValue(E_pric_RadarFrontCenter_TrajPointACCObj4_TrajPointACCObj4_InvDir_b_Rv, rawValue);
        rawValue= 0;
        putValue(E_pric_RadarFrontCenter_TrajPointACCObj4_TrajPointACCObj4_dVarXv_uw_Rv, rawValue);
        rawValue= 0;
        putValue(E_pric_RadarFrontCenter_TrajPointACCObj4_TrajPointACCObj4_dVarYv_uw_Rv, rawValue);
        rawValue= 0;
        putValue(E_pric_RadarFrontCenter_TrajPointACCObj4_TrajPointACCObj4_Drive_b_Rv, rawValue);
        rawValue= -32768;
        putValue(E_pric_RadarFrontCenter_TrajPointACCObj4_TrajPointACCObj4_dxv_sw_Rv, rawValue);
        rawValue= -32768;
        putValue(E_pric_RadarFrontCenter_TrajPointACCObj4_TrajPointACCObj4_dyv_sw_Rv, rawValue);
      break;
   }
}

on envVar E_pric_RadarFrontCenter_TrajPointACCObj4_Dlc
{
    if(getValue(E_pric_RadarFrontCenter_TrajPointACCObj4_enDlc))
    {
        Msg_TrajPointACCObj4.dlc =getValue(this);
    }
    else
    {
       Dbc_dlc = 16;
	   Msg_TrajPointACCObj4.dlc = Calc_Canfd_dlc(Dbc_dlc);
	   	
  }
}

on envVar E_pric_RadarFrontCenter_TrajPointACCObj4_enDlc
{
    //For Messages with DLC = 8, set wrong DLC to smaller than defined DLC
    //For Messages with DLC < 8 set wrong DLC to smaller/longer than defined DLC
    if(getValue(this))
    {
        Msg_TrajPointACCObj4.dlc =getValue(E_pric_RadarFrontCenter_TrajPointACCObj4_Dlc);
    }
    else
    {
       Dbc_dlc = 16;
	   Msg_TrajPointACCObj4.dlc = Calc_Canfd_dlc(Dbc_dlc);
			
    }
}

on envVar E_pric_RadarFrontCenter_TrajPointACCObj4_TrajPointACCObj4_CRC_wrongvalctr
{
    //update disturb count
    //disturb value range:(-1 = always send wrong value),( X>0 ,x is the number of Messages with wrong CHK sent)
    TrajPointACCObj4_TrajPointACCObj4_CRC_wrongvalctr =getValue(this);    
}
on envVar E_pric_RadarFrontCenter_TrajPointACCObj4_TrajPointACCObj4_MsgCtr_wrongvalctr
{
    //update disturb count
    //disturb value range:(-1 = always send wrong value),( X>0 ,x is the number of Messages with wrong CHK sent)
    TrajPointACCObj4_TrajPointACCObj4_MsgCtr_wrongvalctr =getValue(this);    
}
on envVar E_pric_RadarFrontCenter_TrajPointACCObj4_TrajPointACCObj4_blockCtr_wrongvalctr
{
    //update disturb count
    //disturb value range:(-1 = always send wrong value),( X>0 ,x is the number of Messages with wrong CHK sent)
    TrajPointACCObj4_TrajPointACCObj4_blockCtr_wrongvalctr =getValue(this);    
}

on envVar E_pric_RadarFrontCenter_TrajPointACCObj4_TrajPointACCObj4_Stopped_b_Rv
{
    qword rawValue = 0ll;
    float rawValue_float = 0.0;
    float phyValue = 0.0;        

    //set the signal with updated raw value
    if(getValue(E_pric_RadarFrontCenter_TrajPointACCObj4_TrajPointACCObj4_Stopped_b_SetVt)==0)
    {
        rawValue = getvalue(this);
        if(chgEv_TrajPointACCObj4_TrajPointACCObj4_Stopped_b == 0)
        {
            //type conversion to float
            rawValue_float = rawValue;        
            // raw to physical conversion
            phyValue = ((rawValue_float *1)+(0));
            putValue(E_pric_RadarFrontCenter_TrajPointACCObj4_TrajPointACCObj4_Stopped_b_Pv, phyValue);
            chgEv_TrajPointACCObj4_TrajPointACCObj4_Stopped_b = 1;
        }
        else
        {
            chgEv_TrajPointACCObj4_TrajPointACCObj4_Stopped_b = 0;
        }    
        //update the signal value
        Msg_TrajPointACCObj4.TrajPointACCObj4_Stopped_b=rawValue;        
    }                                                                           
}

on envVar E_pric_RadarFrontCenter_TrajPointACCObj4_TrajPointACCObj4_Stopped_b_Pv
{
    qword rawValue = 0ll;
    float phyValue = 0.0;
    
    //update the raw value with physical value 
    if(getValue(E_pric_RadarFrontCenter_TrajPointACCObj4_TrajPointACCObj4_Stopped_b_SetVt)==0)
    {
        if(chgEv_TrajPointACCObj4_TrajPointACCObj4_Stopped_b == 0)
        {
            phyValue = getvalue(this);
            // physical to raw conversion
            rawValue = ((phyValue -(0))/1);
            putValue(E_pric_RadarFrontCenter_TrajPointACCObj4_TrajPointACCObj4_Stopped_b_Rv, rawValue);
            chgEv_TrajPointACCObj4_TrajPointACCObj4_Stopped_b = 1;  
        }
        else
        {
            chgEv_TrajPointACCObj4_TrajPointACCObj4_Stopped_b = 0;
        }
    }
}

on envVar E_pric_RadarFrontCenter_TrajPointACCObj4_TrajPointACCObj4_Stopped_b_Vt
{
    qword rawValue = 0ll;
    if(getValue(E_pric_RadarFrontCenter_TrajPointACCObj4_TrajPointACCObj4_Stopped_b_SetVt))
    {
        //update the signal value
        Msg_TrajPointACCObj4.TrajPointACCObj4_Stopped_b=getValue(this);
    }
}

on envVar E_pric_RadarFrontCenter_TrajPointACCObj4_TrajPointACCObj4_Stopped_b_SetVt
{
    if(getValue(E_pric_RadarFrontCenter_TrajPointACCObj4_TrajPointACCObj4_Stopped_b_SetVt))
    {
        //update the signal value
        Msg_TrajPointACCObj4.TrajPointACCObj4_Stopped_b=getvalue(E_pric_RadarFrontCenter_TrajPointACCObj4_TrajPointACCObj4_Stopped_b_Vt);
    }
    else
    {
        Msg_TrajPointACCObj4.TrajPointACCObj4_Stopped_b=getValue(E_pric_RadarFrontCenter_TrajPointACCObj4_TrajPointACCObj4_Stopped_b_Rv);
    }
}
 
on envVar E_pric_RadarFrontCenter_TrajPointACCObj4_TrajPointACCObj4_Valid_b_Rv
{
    qword rawValue = 0ll;
    float rawValue_float = 0.0;
    float phyValue = 0.0;        

    //set the signal with updated raw value
    if(getValue(E_pric_RadarFrontCenter_TrajPointACCObj4_TrajPointACCObj4_Valid_b_SetVt)==0)
    {
        rawValue = getvalue(this);
        if(chgEv_TrajPointACCObj4_TrajPointACCObj4_Valid_b == 0)
        {
            //type conversion to float
            rawValue_float = rawValue;        
            // raw to physical conversion
            phyValue = ((rawValue_float *1)+(0));
            putValue(E_pric_RadarFrontCenter_TrajPointACCObj4_TrajPointACCObj4_Valid_b_Pv, phyValue);
            chgEv_TrajPointACCObj4_TrajPointACCObj4_Valid_b = 1;
        }
        else
        {
            chgEv_TrajPointACCObj4_TrajPointACCObj4_Valid_b = 0;
        }    
        //update the signal value
        Msg_TrajPointACCObj4.TrajPointACCObj4_Valid_b=rawValue;        
    }                                                                           
}

on envVar E_pric_RadarFrontCenter_TrajPointACCObj4_TrajPointACCObj4_Valid_b_Pv
{
    qword rawValue = 0ll;
    float phyValue = 0.0;
    
    //update the raw value with physical value 
    if(getValue(E_pric_RadarFrontCenter_TrajPointACCObj4_TrajPointACCObj4_Valid_b_SetVt)==0)
    {
        if(chgEv_TrajPointACCObj4_TrajPointACCObj4_Valid_b == 0)
        {
            phyValue = getvalue(this);
            // physical to raw conversion
            rawValue = ((phyValue -(0))/1);
            putValue(E_pric_RadarFrontCenter_TrajPointACCObj4_TrajPointACCObj4_Valid_b_Rv, rawValue);
            chgEv_TrajPointACCObj4_TrajPointACCObj4_Valid_b = 1;  
        }
        else
        {
            chgEv_TrajPointACCObj4_TrajPointACCObj4_Valid_b = 0;
        }
    }
}

on envVar E_pric_RadarFrontCenter_TrajPointACCObj4_TrajPointACCObj4_Valid_b_Vt
{
    qword rawValue = 0ll;
    if(getValue(E_pric_RadarFrontCenter_TrajPointACCObj4_TrajPointACCObj4_Valid_b_SetVt))
    {
        //update the signal value
        Msg_TrajPointACCObj4.TrajPointACCObj4_Valid_b=getValue(this);
    }
}

on envVar E_pric_RadarFrontCenter_TrajPointACCObj4_TrajPointACCObj4_Valid_b_SetVt
{
    if(getValue(E_pric_RadarFrontCenter_TrajPointACCObj4_TrajPointACCObj4_Valid_b_SetVt))
    {
        //update the signal value
        Msg_TrajPointACCObj4.TrajPointACCObj4_Valid_b=getvalue(E_pric_RadarFrontCenter_TrajPointACCObj4_TrajPointACCObj4_Valid_b_Vt);
    }
    else
    {
        Msg_TrajPointACCObj4.TrajPointACCObj4_Valid_b=getValue(E_pric_RadarFrontCenter_TrajPointACCObj4_TrajPointACCObj4_Valid_b_Rv);
    }
}
 
on envVar E_pric_RadarFrontCenter_TrajPointACCObj4_TrajPointACCObj4_TrajEnd_b_Rv
{
    qword rawValue = 0ll;
    float rawValue_float = 0.0;
    float phyValue = 0.0;        

    //set the signal with updated raw value
    if(getValue(E_pric_RadarFrontCenter_TrajPointACCObj4_TrajPointACCObj4_TrajEnd_b_SetVt)==0)
    {
        rawValue = getvalue(this);
        if(chgEv_TrajPointACCObj4_TrajPointACCObj4_TrajEnd_b == 0)
        {
            //type conversion to float
            rawValue_float = rawValue;        
            // raw to physical conversion
            phyValue = ((rawValue_float *1)+(0));
            putValue(E_pric_RadarFrontCenter_TrajPointACCObj4_TrajPointACCObj4_TrajEnd_b_Pv, phyValue);
            chgEv_TrajPointACCObj4_TrajPointACCObj4_TrajEnd_b = 1;
        }
        else
        {
            chgEv_TrajPointACCObj4_TrajPointACCObj4_TrajEnd_b = 0;
        }    
        //update the signal value
        Msg_TrajPointACCObj4.TrajPointACCObj4_TrajEnd_b=rawValue;        
    }                                                                           
}

on envVar E_pric_RadarFrontCenter_TrajPointACCObj4_TrajPointACCObj4_TrajEnd_b_Pv
{
    qword rawValue = 0ll;
    float phyValue = 0.0;
    
    //update the raw value with physical value 
    if(getValue(E_pric_RadarFrontCenter_TrajPointACCObj4_TrajPointACCObj4_TrajEnd_b_SetVt)==0)
    {
        if(chgEv_TrajPointACCObj4_TrajPointACCObj4_TrajEnd_b == 0)
        {
            phyValue = getvalue(this);
            // physical to raw conversion
            rawValue = ((phyValue -(0))/1);
            putValue(E_pric_RadarFrontCenter_TrajPointACCObj4_TrajPointACCObj4_TrajEnd_b_Rv, rawValue);
            chgEv_TrajPointACCObj4_TrajPointACCObj4_TrajEnd_b = 1;  
        }
        else
        {
            chgEv_TrajPointACCObj4_TrajPointACCObj4_TrajEnd_b = 0;
        }
    }
}

on envVar E_pric_RadarFrontCenter_TrajPointACCObj4_TrajPointACCObj4_TrajEnd_b_Vt
{
    qword rawValue = 0ll;
    if(getValue(E_pric_RadarFrontCenter_TrajPointACCObj4_TrajPointACCObj4_TrajEnd_b_SetVt))
    {
        //update the signal value
        Msg_TrajPointACCObj4.TrajPointACCObj4_TrajEnd_b=getValue(this);
    }
}

on envVar E_pric_RadarFrontCenter_TrajPointACCObj4_TrajPointACCObj4_TrajEnd_b_SetVt
{
    if(getValue(E_pric_RadarFrontCenter_TrajPointACCObj4_TrajPointACCObj4_TrajEnd_b_SetVt))
    {
        //update the signal value
        Msg_TrajPointACCObj4.TrajPointACCObj4_TrajEnd_b=getvalue(E_pric_RadarFrontCenter_TrajPointACCObj4_TrajPointACCObj4_TrajEnd_b_Vt);
    }
    else
    {
        Msg_TrajPointACCObj4.TrajPointACCObj4_TrajEnd_b=getValue(E_pric_RadarFrontCenter_TrajPointACCObj4_TrajPointACCObj4_TrajEnd_b_Rv);
    }
}
 
on envVar E_pric_RadarFrontCenter_TrajPointACCObj4_TrajPointACCObj4_Stand_b_Rv
{
    qword rawValue = 0ll;
    float rawValue_float = 0.0;
    float phyValue = 0.0;        

    //set the signal with updated raw value
    if(getValue(E_pric_RadarFrontCenter_TrajPointACCObj4_TrajPointACCObj4_Stand_b_SetVt)==0)
    {
        rawValue = getvalue(this);
        if(chgEv_TrajPointACCObj4_TrajPointACCObj4_Stand_b == 0)
        {
            //type conversion to float
            rawValue_float = rawValue;        
            // raw to physical conversion
            phyValue = ((rawValue_float *1)+(0));
            putValue(E_pric_RadarFrontCenter_TrajPointACCObj4_TrajPointACCObj4_Stand_b_Pv, phyValue);
            chgEv_TrajPointACCObj4_TrajPointACCObj4_Stand_b = 1;
        }
        else
        {
            chgEv_TrajPointACCObj4_TrajPointACCObj4_Stand_b = 0;
        }    
        //update the signal value
        Msg_TrajPointACCObj4.TrajPointACCObj4_Stand_b=rawValue;        
    }                                                                           
}

on envVar E_pric_RadarFrontCenter_TrajPointACCObj4_TrajPointACCObj4_Stand_b_Pv
{
    qword rawValue = 0ll;
    float phyValue = 0.0;
    
    //update the raw value with physical value 
    if(getValue(E_pric_RadarFrontCenter_TrajPointACCObj4_TrajPointACCObj4_Stand_b_SetVt)==0)
    {
        if(chgEv_TrajPointACCObj4_TrajPointACCObj4_Stand_b == 0)
        {
            phyValue = getvalue(this);
            // physical to raw conversion
            rawValue = ((phyValue -(0))/1);
            putValue(E_pric_RadarFrontCenter_TrajPointACCObj4_TrajPointACCObj4_Stand_b_Rv, rawValue);
            chgEv_TrajPointACCObj4_TrajPointACCObj4_Stand_b = 1;  
        }
        else
        {
            chgEv_TrajPointACCObj4_TrajPointACCObj4_Stand_b = 0;
        }
    }
}

on envVar E_pric_RadarFrontCenter_TrajPointACCObj4_TrajPointACCObj4_Stand_b_Vt
{
    qword rawValue = 0ll;
    if(getValue(E_pric_RadarFrontCenter_TrajPointACCObj4_TrajPointACCObj4_Stand_b_SetVt))
    {
        //update the signal value
        Msg_TrajPointACCObj4.TrajPointACCObj4_Stand_b=getValue(this);
    }
}

on envVar E_pric_RadarFrontCenter_TrajPointACCObj4_TrajPointACCObj4_Stand_b_SetVt
{
    if(getValue(E_pric_RadarFrontCenter_TrajPointACCObj4_TrajPointACCObj4_Stand_b_SetVt))
    {
        //update the signal value
        Msg_TrajPointACCObj4.TrajPointACCObj4_Stand_b=getvalue(E_pric_RadarFrontCenter_TrajPointACCObj4_TrajPointACCObj4_Stand_b_Vt);
    }
    else
    {
        Msg_TrajPointACCObj4.TrajPointACCObj4_Stand_b=getValue(E_pric_RadarFrontCenter_TrajPointACCObj4_TrajPointACCObj4_Stand_b_Rv);
    }
}
 
on envVar E_pric_RadarFrontCenter_TrajPointACCObj4_TrajPointACCObj4_timestamp_Rv
{
    qword rawValue = 0ll;
    float rawValue_float = 0.0;
    float phyValue = 0.0;        

    //set the signal with updated raw value
    {
        rawValue = getvalue(this);
        if(chgEv_TrajPointACCObj4_TrajPointACCObj4_timestamp == 0)
        {
            //type conversion to float
            rawValue_float = rawValue;        
            // raw to physical conversion
            phyValue = ((rawValue_float *0.000488281)+(0));
            putValue(E_pric_RadarFrontCenter_TrajPointACCObj4_TrajPointACCObj4_timestamp_Pv, phyValue);
            chgEv_TrajPointACCObj4_TrajPointACCObj4_timestamp = 1;
        }
        else
        {
            chgEv_TrajPointACCObj4_TrajPointACCObj4_timestamp = 0;
        }    
        //update the signal value
        Msg_TrajPointACCObj4.TrajPointACCObj4_timestamp=rawValue;        
    }                                                                           
}

on envVar E_pric_RadarFrontCenter_TrajPointACCObj4_TrajPointACCObj4_timestamp_Pv
{
    qword rawValue = 0ll;
    float phyValue = 0.0;
    
    //update the raw value with physical value 
    {
        if(chgEv_TrajPointACCObj4_TrajPointACCObj4_timestamp == 0)
        {
            phyValue = getvalue(this);
            // physical to raw conversion
            rawValue = ((phyValue -(0))/0.000488281);
            putValue(E_pric_RadarFrontCenter_TrajPointACCObj4_TrajPointACCObj4_timestamp_Rv, rawValue);
            chgEv_TrajPointACCObj4_TrajPointACCObj4_timestamp = 1;  
        }
        else
        {
            chgEv_TrajPointACCObj4_TrajPointACCObj4_timestamp = 0;
        }
    }
}


 
on envVar E_pric_RadarFrontCenter_TrajPointACCObj4_TrajPointACCObj4_wExistProb_ub_Rv
{
    qword rawValue = 0ll;
    float rawValue_float = 0.0;
    float phyValue = 0.0;        

    //set the signal with updated raw value
    {
        rawValue = getvalue(this);
        if(chgEv_TrajPointACCObj4_TrajPointACCObj4_wExistProb_ub == 0)
        {
            //type conversion to float
            rawValue_float = rawValue;        
            // raw to physical conversion
            phyValue = ((rawValue_float *0.00390625)+(0));
            putValue(E_pric_RadarFrontCenter_TrajPointACCObj4_TrajPointACCObj4_wExistProb_ub_Pv, phyValue);
            chgEv_TrajPointACCObj4_TrajPointACCObj4_wExistProb_ub = 1;
        }
        else
        {
            chgEv_TrajPointACCObj4_TrajPointACCObj4_wExistProb_ub = 0;
        }    
        //update the signal value
        Msg_TrajPointACCObj4.TrajPointACCObj4_wExistProb_ub=rawValue;        
    }                                                                           
}

on envVar E_pric_RadarFrontCenter_TrajPointACCObj4_TrajPointACCObj4_wExistProb_ub_Pv
{
    qword rawValue = 0ll;
    float phyValue = 0.0;
    
    //update the raw value with physical value 
    {
        if(chgEv_TrajPointACCObj4_TrajPointACCObj4_wExistProb_ub == 0)
        {
            phyValue = getvalue(this);
            // physical to raw conversion
            rawValue = ((phyValue -(0))/0.00390625);
            putValue(E_pric_RadarFrontCenter_TrajPointACCObj4_TrajPointACCObj4_wExistProb_ub_Rv, rawValue);
            chgEv_TrajPointACCObj4_TrajPointACCObj4_wExistProb_ub = 1;  
        }
        else
        {
            chgEv_TrajPointACCObj4_TrajPointACCObj4_wExistProb_ub = 0;
        }
    }
}


 
on envVar E_pric_RadarFrontCenter_TrajPointACCObj4_TrajPointACCObj4_InvDir_b_Rv
{
    qword rawValue = 0ll;
    float rawValue_float = 0.0;
    float phyValue = 0.0;        

    //set the signal with updated raw value
    if(getValue(E_pric_RadarFrontCenter_TrajPointACCObj4_TrajPointACCObj4_InvDir_b_SetVt)==0)
    {
        rawValue = getvalue(this);
        if(chgEv_TrajPointACCObj4_TrajPointACCObj4_InvDir_b == 0)
        {
            //type conversion to float
            rawValue_float = rawValue;        
            // raw to physical conversion
            phyValue = ((rawValue_float *1)+(0));
            putValue(E_pric_RadarFrontCenter_TrajPointACCObj4_TrajPointACCObj4_InvDir_b_Pv, phyValue);
            chgEv_TrajPointACCObj4_TrajPointACCObj4_InvDir_b = 1;
        }
        else
        {
            chgEv_TrajPointACCObj4_TrajPointACCObj4_InvDir_b = 0;
        }    
        //update the signal value
        Msg_TrajPointACCObj4.TrajPointACCObj4_InvDir_b=rawValue;        
    }                                                                           
}

on envVar E_pric_RadarFrontCenter_TrajPointACCObj4_TrajPointACCObj4_InvDir_b_Pv
{
    qword rawValue = 0ll;
    float phyValue = 0.0;
    
    //update the raw value with physical value 
    if(getValue(E_pric_RadarFrontCenter_TrajPointACCObj4_TrajPointACCObj4_InvDir_b_SetVt)==0)
    {
        if(chgEv_TrajPointACCObj4_TrajPointACCObj4_InvDir_b == 0)
        {
            phyValue = getvalue(this);
            // physical to raw conversion
            rawValue = ((phyValue -(0))/1);
            putValue(E_pric_RadarFrontCenter_TrajPointACCObj4_TrajPointACCObj4_InvDir_b_Rv, rawValue);
            chgEv_TrajPointACCObj4_TrajPointACCObj4_InvDir_b = 1;  
        }
        else
        {
            chgEv_TrajPointACCObj4_TrajPointACCObj4_InvDir_b = 0;
        }
    }
}

on envVar E_pric_RadarFrontCenter_TrajPointACCObj4_TrajPointACCObj4_InvDir_b_Vt
{
    qword rawValue = 0ll;
    if(getValue(E_pric_RadarFrontCenter_TrajPointACCObj4_TrajPointACCObj4_InvDir_b_SetVt))
    {
        //update the signal value
        Msg_TrajPointACCObj4.TrajPointACCObj4_InvDir_b=getValue(this);
    }
}

on envVar E_pric_RadarFrontCenter_TrajPointACCObj4_TrajPointACCObj4_InvDir_b_SetVt
{
    if(getValue(E_pric_RadarFrontCenter_TrajPointACCObj4_TrajPointACCObj4_InvDir_b_SetVt))
    {
        //update the signal value
        Msg_TrajPointACCObj4.TrajPointACCObj4_InvDir_b=getvalue(E_pric_RadarFrontCenter_TrajPointACCObj4_TrajPointACCObj4_InvDir_b_Vt);
    }
    else
    {
        Msg_TrajPointACCObj4.TrajPointACCObj4_InvDir_b=getValue(E_pric_RadarFrontCenter_TrajPointACCObj4_TrajPointACCObj4_InvDir_b_Rv);
    }
}
 
on envVar E_pric_RadarFrontCenter_TrajPointACCObj4_TrajPointACCObj4_dVarXv_uw_Rv
{
    qword rawValue = 0ll;
    float rawValue_float = 0.0;
    float phyValue = 0.0;        

    //set the signal with updated raw value
    {
        rawValue = getvalue(this);
        if(chgEv_TrajPointACCObj4_TrajPointACCObj4_dVarXv_uw == 0)
        {
            //type conversion to float
            rawValue_float = rawValue;        
            // raw to physical conversion
            phyValue = ((rawValue_float *0.00195313)+(0));
            putValue(E_pric_RadarFrontCenter_TrajPointACCObj4_TrajPointACCObj4_dVarXv_uw_Pv, phyValue);
            chgEv_TrajPointACCObj4_TrajPointACCObj4_dVarXv_uw = 1;
        }
        else
        {
            chgEv_TrajPointACCObj4_TrajPointACCObj4_dVarXv_uw = 0;
        }    
        //update the signal value
        Msg_TrajPointACCObj4.TrajPointACCObj4_dVarXv_uw=rawValue;        
    }                                                                           
}

on envVar E_pric_RadarFrontCenter_TrajPointACCObj4_TrajPointACCObj4_dVarXv_uw_Pv
{
    qword rawValue = 0ll;
    float phyValue = 0.0;
    
    //update the raw value with physical value 
    {
        if(chgEv_TrajPointACCObj4_TrajPointACCObj4_dVarXv_uw == 0)
        {
            phyValue = getvalue(this);
            // physical to raw conversion
            rawValue = ((phyValue -(0))/0.00195313);
            putValue(E_pric_RadarFrontCenter_TrajPointACCObj4_TrajPointACCObj4_dVarXv_uw_Rv, rawValue);
            chgEv_TrajPointACCObj4_TrajPointACCObj4_dVarXv_uw = 1;  
        }
        else
        {
            chgEv_TrajPointACCObj4_TrajPointACCObj4_dVarXv_uw = 0;
        }
    }
}


 
on envVar E_pric_RadarFrontCenter_TrajPointACCObj4_TrajPointACCObj4_dVarYv_uw_Rv
{
    qword rawValue = 0ll;
    float rawValue_float = 0.0;
    float phyValue = 0.0;        

    //set the signal with updated raw value
    {
        rawValue = getvalue(this);
        if(chgEv_TrajPointACCObj4_TrajPointACCObj4_dVarYv_uw == 0)
        {
            //type conversion to float
            rawValue_float = rawValue;        
            // raw to physical conversion
            phyValue = ((rawValue_float *0.00195313)+(0));
            putValue(E_pric_RadarFrontCenter_TrajPointACCObj4_TrajPointACCObj4_dVarYv_uw_Pv, phyValue);
            chgEv_TrajPointACCObj4_TrajPointACCObj4_dVarYv_uw = 1;
        }
        else
        {
            chgEv_TrajPointACCObj4_TrajPointACCObj4_dVarYv_uw = 0;
        }    
        //update the signal value
        Msg_TrajPointACCObj4.TrajPointACCObj4_dVarYv_uw=rawValue;        
    }                                                                           
}

on envVar E_pric_RadarFrontCenter_TrajPointACCObj4_TrajPointACCObj4_dVarYv_uw_Pv
{
    qword rawValue = 0ll;
    float phyValue = 0.0;
    
    //update the raw value with physical value 
    {
        if(chgEv_TrajPointACCObj4_TrajPointACCObj4_dVarYv_uw == 0)
        {
            phyValue = getvalue(this);
            // physical to raw conversion
            rawValue = ((phyValue -(0))/0.00195313);
            putValue(E_pric_RadarFrontCenter_TrajPointACCObj4_TrajPointACCObj4_dVarYv_uw_Rv, rawValue);
            chgEv_TrajPointACCObj4_TrajPointACCObj4_dVarYv_uw = 1;  
        }
        else
        {
            chgEv_TrajPointACCObj4_TrajPointACCObj4_dVarYv_uw = 0;
        }
    }
}


 
on envVar E_pric_RadarFrontCenter_TrajPointACCObj4_TrajPointACCObj4_Drive_b_Rv
{
    qword rawValue = 0ll;
    float rawValue_float = 0.0;
    float phyValue = 0.0;        

    //set the signal with updated raw value
    if(getValue(E_pric_RadarFrontCenter_TrajPointACCObj4_TrajPointACCObj4_Drive_b_SetVt)==0)
    {
        rawValue = getvalue(this);
        if(chgEv_TrajPointACCObj4_TrajPointACCObj4_Drive_b == 0)
        {
            //type conversion to float
            rawValue_float = rawValue;        
            // raw to physical conversion
            phyValue = ((rawValue_float *1)+(0));
            putValue(E_pric_RadarFrontCenter_TrajPointACCObj4_TrajPointACCObj4_Drive_b_Pv, phyValue);
            chgEv_TrajPointACCObj4_TrajPointACCObj4_Drive_b = 1;
        }
        else
        {
            chgEv_TrajPointACCObj4_TrajPointACCObj4_Drive_b = 0;
        }    
        //update the signal value
        Msg_TrajPointACCObj4.TrajPointACCObj4_Drive_b=rawValue;        
    }                                                                           
}

on envVar E_pric_RadarFrontCenter_TrajPointACCObj4_TrajPointACCObj4_Drive_b_Pv
{
    qword rawValue = 0ll;
    float phyValue = 0.0;
    
    //update the raw value with physical value 
    if(getValue(E_pric_RadarFrontCenter_TrajPointACCObj4_TrajPointACCObj4_Drive_b_SetVt)==0)
    {
        if(chgEv_TrajPointACCObj4_TrajPointACCObj4_Drive_b == 0)
        {
            phyValue = getvalue(this);
            // physical to raw conversion
            rawValue = ((phyValue -(0))/1);
            putValue(E_pric_RadarFrontCenter_TrajPointACCObj4_TrajPointACCObj4_Drive_b_Rv, rawValue);
            chgEv_TrajPointACCObj4_TrajPointACCObj4_Drive_b = 1;  
        }
        else
        {
            chgEv_TrajPointACCObj4_TrajPointACCObj4_Drive_b = 0;
        }
    }
}

on envVar E_pric_RadarFrontCenter_TrajPointACCObj4_TrajPointACCObj4_Drive_b_Vt
{
    qword rawValue = 0ll;
    if(getValue(E_pric_RadarFrontCenter_TrajPointACCObj4_TrajPointACCObj4_Drive_b_SetVt))
    {
        //update the signal value
        Msg_TrajPointACCObj4.TrajPointACCObj4_Drive_b=getValue(this);
    }
}

on envVar E_pric_RadarFrontCenter_TrajPointACCObj4_TrajPointACCObj4_Drive_b_SetVt
{
    if(getValue(E_pric_RadarFrontCenter_TrajPointACCObj4_TrajPointACCObj4_Drive_b_SetVt))
    {
        //update the signal value
        Msg_TrajPointACCObj4.TrajPointACCObj4_Drive_b=getvalue(E_pric_RadarFrontCenter_TrajPointACCObj4_TrajPointACCObj4_Drive_b_Vt);
    }
    else
    {
        Msg_TrajPointACCObj4.TrajPointACCObj4_Drive_b=getValue(E_pric_RadarFrontCenter_TrajPointACCObj4_TrajPointACCObj4_Drive_b_Rv);
    }
}
 
on envVar E_pric_RadarFrontCenter_TrajPointACCObj4_TrajPointACCObj4_dxv_sw_Rv
{
    qword rawValue = 0ll;
    float rawValue_float = 0.0;
    float phyValue = 0.0;        

    //set the signal with updated raw value
    {
        rawValue = getvalue(this);
        if(chgEv_TrajPointACCObj4_TrajPointACCObj4_dxv_sw == 0)
        {
            //type conversion to float
            rawValue_float = rawValue;        
            // raw to physical conversion
            phyValue = ((rawValue_float *0.0078125)+(0));
            putValue(E_pric_RadarFrontCenter_TrajPointACCObj4_TrajPointACCObj4_dxv_sw_Pv, phyValue);
            chgEv_TrajPointACCObj4_TrajPointACCObj4_dxv_sw = 1;
        }
        else
        {
            chgEv_TrajPointACCObj4_TrajPointACCObj4_dxv_sw = 0;
        }    
        //update the signal value
        Msg_TrajPointACCObj4.TrajPointACCObj4_dxv_sw=rawValue;        
    }                                                                           
}

on envVar E_pric_RadarFrontCenter_TrajPointACCObj4_TrajPointACCObj4_dxv_sw_Pv
{
    qword rawValue = 0ll;
    float phyValue = 0.0;
    
    //update the raw value with physical value 
    {
        if(chgEv_TrajPointACCObj4_TrajPointACCObj4_dxv_sw == 0)
        {
            phyValue = getvalue(this);
            // physical to raw conversion
            rawValue = ((phyValue -(0))/0.0078125);
            putValue(E_pric_RadarFrontCenter_TrajPointACCObj4_TrajPointACCObj4_dxv_sw_Rv, rawValue);
            chgEv_TrajPointACCObj4_TrajPointACCObj4_dxv_sw = 1;  
        }
        else
        {
            chgEv_TrajPointACCObj4_TrajPointACCObj4_dxv_sw = 0;
        }
    }
}


 
on envVar E_pric_RadarFrontCenter_TrajPointACCObj4_TrajPointACCObj4_dyv_sw_Rv
{
    qword rawValue = 0ll;
    float rawValue_float = 0.0;
    float phyValue = 0.0;        

    //set the signal with updated raw value
    {
        rawValue = getvalue(this);
        if(chgEv_TrajPointACCObj4_TrajPointACCObj4_dyv_sw == 0)
        {
            //type conversion to float
            rawValue_float = rawValue;        
            // raw to physical conversion
            phyValue = ((rawValue_float *0.0078125)+(0));
            putValue(E_pric_RadarFrontCenter_TrajPointACCObj4_TrajPointACCObj4_dyv_sw_Pv, phyValue);
            chgEv_TrajPointACCObj4_TrajPointACCObj4_dyv_sw = 1;
        }
        else
        {
            chgEv_TrajPointACCObj4_TrajPointACCObj4_dyv_sw = 0;
        }    
        //update the signal value
        Msg_TrajPointACCObj4.TrajPointACCObj4_dyv_sw=rawValue;        
    }                                                                           
}

on envVar E_pric_RadarFrontCenter_TrajPointACCObj4_TrajPointACCObj4_dyv_sw_Pv
{
    qword rawValue = 0ll;
    float phyValue = 0.0;
    
    //update the raw value with physical value 
    {
        if(chgEv_TrajPointACCObj4_TrajPointACCObj4_dyv_sw == 0)
        {
            phyValue = getvalue(this);
            // physical to raw conversion
            rawValue = ((phyValue -(0))/0.0078125);
            putValue(E_pric_RadarFrontCenter_TrajPointACCObj4_TrajPointACCObj4_dyv_sw_Rv, rawValue);
            chgEv_TrajPointACCObj4_TrajPointACCObj4_dyv_sw = 1;  
        }
        else
        {
            chgEv_TrajPointACCObj4_TrajPointACCObj4_dyv_sw = 0;
        }
    }
}


 
on envVar E_pric_RadarFrontCenter_TrajPointACCObj3_tx
{
    if(getValue(this))
    {       
        
        //update the BZ Signal
        if(TrajPointACCObj3_TrajPointACCObj3_MsgCtr_wrongvalctr == 0)
        {
            update_TrajPointACCObj3_TrajPointACCObj3_MsgCtr_counter();
            Msg_TrajPointACCObj3.TrajPointACCObj3_MsgCtr= TrajPointACCObj3_TrajPointACCObj3_MsgCtr_counter;
        }
        else if(TrajPointACCObj3_TrajPointACCObj3_MsgCtr_wrongvalctr > 0)
        {
             TrajPointACCObj3_TrajPointACCObj3_MsgCtr_wrongvalctr--;
              // if counter becomes zero, update panel controller to zero
             if(TrajPointACCObj3_TrajPointACCObj3_MsgCtr_wrongvalctr == 0)
             {
                 putValue(E_pric_RadarFrontCenter_TrajPointACCObj3_TrajPointACCObj3_MsgCtr_wrongvalctr,0);
             }
        }
        else
        {
            //do nothing
        }        
        //update the BZ Signal
        if(TrajPointACCObj3_TrajPointACCObj3_blockCtr_wrongvalctr == 0)
        {
            update_TrajPointACCObj3_TrajPointACCObj3_blockCtr_counter();
            Msg_TrajPointACCObj3.TrajPointACCObj3_blockCtr= TrajPointACCObj3_TrajPointACCObj3_blockCtr_counter;
        }
        else if(TrajPointACCObj3_TrajPointACCObj3_blockCtr_wrongvalctr > 0)
        {
             TrajPointACCObj3_TrajPointACCObj3_blockCtr_wrongvalctr--;
              // if counter becomes zero, update panel controller to zero
             if(TrajPointACCObj3_TrajPointACCObj3_blockCtr_wrongvalctr == 0)
             {
                 putValue(E_pric_RadarFrontCenter_TrajPointACCObj3_TrajPointACCObj3_blockCtr_wrongvalctr,0);
             }
        }
        else
        {
            //do nothing
        }        
        //calculate the CRC checksum
        update_TrajPointACCObj3_ChkSum_Checksum();

        output(Msg_TrajPointACCObj3);        
    }
}

on envVar E_pric_RadarFrontCenter_TrajPointACCObj3_Range
{
    qword rawstatus = 0ll;
    qword rawValue = 0ll;    
    
    rawstatus = getvalue(this);    
    // set all the signals with min raw /max raw /init raw
    switch (rawstatus) 
    {
     case(0) :
        rawValue= -32768;
        putValue(E_pric_RadarFrontCenter_TrajPointACCObj3_TrajPointACCObj3_dyv_sw_Rv, rawValue);
        rawValue= 0;
        putValue(E_pric_RadarFrontCenter_TrajPointACCObj3_TrajPointACCObj3_wExistProb_ub_Rv, rawValue);
        rawValue= 0;
        putValue(E_pric_RadarFrontCenter_TrajPointACCObj3_TrajPointACCObj3_dVarXv_uw_Rv, rawValue);
        rawValue= 0;
        putValue(E_pric_RadarFrontCenter_TrajPointACCObj3_TrajPointACCObj3_Stand_b_Rv, rawValue);
        rawValue= 0;
        putValue(E_pric_RadarFrontCenter_TrajPointACCObj3_TrajPointACCObj3_Valid_b_Rv, rawValue);
        rawValue= 0;
        putValue(E_pric_RadarFrontCenter_TrajPointACCObj3_TrajPointACCObj3_TrajEnd_b_Rv, rawValue);
        rawValue= 0;
        putValue(E_pric_RadarFrontCenter_TrajPointACCObj3_TrajPointACCObj3_InvDir_b_Rv, rawValue);
        rawValue= -32768;
        putValue(E_pric_RadarFrontCenter_TrajPointACCObj3_TrajPointACCObj3_dxv_sw_Rv, rawValue);
        rawValue= 0;
        putValue(E_pric_RadarFrontCenter_TrajPointACCObj3_TrajPointACCObj3_Drive_b_Rv, rawValue);
        rawValue= 0;
        putValue(E_pric_RadarFrontCenter_TrajPointACCObj3_TrajPointACCObj3_Stopped_b_Rv, rawValue);
        rawValue= 0;
        putValue(E_pric_RadarFrontCenter_TrajPointACCObj3_TrajPointACCObj3_dVarYv_uw_Rv, rawValue);
        rawValue= 0;
        putValue(E_pric_RadarFrontCenter_TrajPointACCObj3_TrajPointACCObj3_timestamp_Rv, rawValue);
        break;
     case(1) :
        rawValue= 32767;
        putValue(E_pric_RadarFrontCenter_TrajPointACCObj3_TrajPointACCObj3_dyv_sw_Rv, rawValue);
        rawValue= 255;
        putValue(E_pric_RadarFrontCenter_TrajPointACCObj3_TrajPointACCObj3_wExistProb_ub_Rv, rawValue);
        rawValue= 65534;
        putValue(E_pric_RadarFrontCenter_TrajPointACCObj3_TrajPointACCObj3_dVarXv_uw_Rv, rawValue);
        rawValue= 1;
        putValue(E_pric_RadarFrontCenter_TrajPointACCObj3_TrajPointACCObj3_Stand_b_Rv, rawValue);
        rawValue= 1;
        putValue(E_pric_RadarFrontCenter_TrajPointACCObj3_TrajPointACCObj3_Valid_b_Rv, rawValue);
        rawValue= 1;
        putValue(E_pric_RadarFrontCenter_TrajPointACCObj3_TrajPointACCObj3_TrajEnd_b_Rv, rawValue);
        rawValue= 1;
        putValue(E_pric_RadarFrontCenter_TrajPointACCObj3_TrajPointACCObj3_InvDir_b_Rv, rawValue);
        rawValue= 32767;
        putValue(E_pric_RadarFrontCenter_TrajPointACCObj3_TrajPointACCObj3_dxv_sw_Rv, rawValue);
        rawValue= 1;
        putValue(E_pric_RadarFrontCenter_TrajPointACCObj3_TrajPointACCObj3_Drive_b_Rv, rawValue);
        rawValue= 1;
        putValue(E_pric_RadarFrontCenter_TrajPointACCObj3_TrajPointACCObj3_Stopped_b_Rv, rawValue);
        rawValue= 65534;
        putValue(E_pric_RadarFrontCenter_TrajPointACCObj3_TrajPointACCObj3_dVarYv_uw_Rv, rawValue);
        rawValue= 65536;
        putValue(E_pric_RadarFrontCenter_TrajPointACCObj3_TrajPointACCObj3_timestamp_Rv, rawValue);
        break;
     default :
        rawValue= -32768;
        putValue(E_pric_RadarFrontCenter_TrajPointACCObj3_TrajPointACCObj3_dyv_sw_Rv, rawValue);
        rawValue= 0;
        putValue(E_pric_RadarFrontCenter_TrajPointACCObj3_TrajPointACCObj3_wExistProb_ub_Rv, rawValue);
        rawValue= 0;
        putValue(E_pric_RadarFrontCenter_TrajPointACCObj3_TrajPointACCObj3_dVarXv_uw_Rv, rawValue);
        rawValue= 0;
        putValue(E_pric_RadarFrontCenter_TrajPointACCObj3_TrajPointACCObj3_Stand_b_Rv, rawValue);
        rawValue= 0;
        putValue(E_pric_RadarFrontCenter_TrajPointACCObj3_TrajPointACCObj3_Valid_b_Rv, rawValue);
        rawValue= 0;
        putValue(E_pric_RadarFrontCenter_TrajPointACCObj3_TrajPointACCObj3_TrajEnd_b_Rv, rawValue);
        rawValue= 0;
        putValue(E_pric_RadarFrontCenter_TrajPointACCObj3_TrajPointACCObj3_InvDir_b_Rv, rawValue);
        rawValue= -32768;
        putValue(E_pric_RadarFrontCenter_TrajPointACCObj3_TrajPointACCObj3_dxv_sw_Rv, rawValue);
        rawValue= 0;
        putValue(E_pric_RadarFrontCenter_TrajPointACCObj3_TrajPointACCObj3_Drive_b_Rv, rawValue);
        rawValue= 0;
        putValue(E_pric_RadarFrontCenter_TrajPointACCObj3_TrajPointACCObj3_Stopped_b_Rv, rawValue);
        rawValue= 0;
        putValue(E_pric_RadarFrontCenter_TrajPointACCObj3_TrajPointACCObj3_dVarYv_uw_Rv, rawValue);
        rawValue= 0;
        putValue(E_pric_RadarFrontCenter_TrajPointACCObj3_TrajPointACCObj3_timestamp_Rv, rawValue);
      break;
   }
}

on envVar E_pric_RadarFrontCenter_TrajPointACCObj3_Dlc
{
    if(getValue(E_pric_RadarFrontCenter_TrajPointACCObj3_enDlc))
    {
        Msg_TrajPointACCObj3.dlc =getValue(this);
    }
    else
    {
       Dbc_dlc = 16;
	   Msg_TrajPointACCObj3.dlc = Calc_Canfd_dlc(Dbc_dlc);
	   	
  }
}

on envVar E_pric_RadarFrontCenter_TrajPointACCObj3_enDlc
{
    //For Messages with DLC = 8, set wrong DLC to smaller than defined DLC
    //For Messages with DLC < 8 set wrong DLC to smaller/longer than defined DLC
    if(getValue(this))
    {
        Msg_TrajPointACCObj3.dlc =getValue(E_pric_RadarFrontCenter_TrajPointACCObj3_Dlc);
    }
    else
    {
       Dbc_dlc = 16;
	   Msg_TrajPointACCObj3.dlc = Calc_Canfd_dlc(Dbc_dlc);
			
    }
}

on envVar E_pric_RadarFrontCenter_TrajPointACCObj3_TrajPointACCObj3_CRC_wrongvalctr
{
    //update disturb count
    //disturb value range:(-1 = always send wrong value),( X>0 ,x is the number of Messages with wrong CHK sent)
    TrajPointACCObj3_TrajPointACCObj3_CRC_wrongvalctr =getValue(this);    
}
on envVar E_pric_RadarFrontCenter_TrajPointACCObj3_TrajPointACCObj3_MsgCtr_wrongvalctr
{
    //update disturb count
    //disturb value range:(-1 = always send wrong value),( X>0 ,x is the number of Messages with wrong CHK sent)
    TrajPointACCObj3_TrajPointACCObj3_MsgCtr_wrongvalctr =getValue(this);    
}
on envVar E_pric_RadarFrontCenter_TrajPointACCObj3_TrajPointACCObj3_blockCtr_wrongvalctr
{
    //update disturb count
    //disturb value range:(-1 = always send wrong value),( X>0 ,x is the number of Messages with wrong CHK sent)
    TrajPointACCObj3_TrajPointACCObj3_blockCtr_wrongvalctr =getValue(this);    
}

on envVar E_pric_RadarFrontCenter_TrajPointACCObj3_TrajPointACCObj3_dyv_sw_Rv
{
    qword rawValue = 0ll;
    float rawValue_float = 0.0;
    float phyValue = 0.0;        

    //set the signal with updated raw value
    {
        rawValue = getvalue(this);
        if(chgEv_TrajPointACCObj3_TrajPointACCObj3_dyv_sw == 0)
        {
            //type conversion to float
            rawValue_float = rawValue;        
            // raw to physical conversion
            phyValue = ((rawValue_float *0.0078125)+(0));
            putValue(E_pric_RadarFrontCenter_TrajPointACCObj3_TrajPointACCObj3_dyv_sw_Pv, phyValue);
            chgEv_TrajPointACCObj3_TrajPointACCObj3_dyv_sw = 1;
        }
        else
        {
            chgEv_TrajPointACCObj3_TrajPointACCObj3_dyv_sw = 0;
        }    
        //update the signal value
        Msg_TrajPointACCObj3.TrajPointACCObj3_dyv_sw=rawValue;        
    }                                                                           
}

on envVar E_pric_RadarFrontCenter_TrajPointACCObj3_TrajPointACCObj3_dyv_sw_Pv
{
    qword rawValue = 0ll;
    float phyValue = 0.0;
    
    //update the raw value with physical value 
    {
        if(chgEv_TrajPointACCObj3_TrajPointACCObj3_dyv_sw == 0)
        {
            phyValue = getvalue(this);
            // physical to raw conversion
            rawValue = ((phyValue -(0))/0.0078125);
            putValue(E_pric_RadarFrontCenter_TrajPointACCObj3_TrajPointACCObj3_dyv_sw_Rv, rawValue);
            chgEv_TrajPointACCObj3_TrajPointACCObj3_dyv_sw = 1;  
        }
        else
        {
            chgEv_TrajPointACCObj3_TrajPointACCObj3_dyv_sw = 0;
        }
    }
}


 
on envVar E_pric_RadarFrontCenter_TrajPointACCObj3_TrajPointACCObj3_wExistProb_ub_Rv
{
    qword rawValue = 0ll;
    float rawValue_float = 0.0;
    float phyValue = 0.0;        

    //set the signal with updated raw value
    {
        rawValue = getvalue(this);
        if(chgEv_TrajPointACCObj3_TrajPointACCObj3_wExistProb_ub == 0)
        {
            //type conversion to float
            rawValue_float = rawValue;        
            // raw to physical conversion
            phyValue = ((rawValue_float *0.00390625)+(0));
            putValue(E_pric_RadarFrontCenter_TrajPointACCObj3_TrajPointACCObj3_wExistProb_ub_Pv, phyValue);
            chgEv_TrajPointACCObj3_TrajPointACCObj3_wExistProb_ub = 1;
        }
        else
        {
            chgEv_TrajPointACCObj3_TrajPointACCObj3_wExistProb_ub = 0;
        }    
        //update the signal value
        Msg_TrajPointACCObj3.TrajPointACCObj3_wExistProb_ub=rawValue;        
    }                                                                           
}

on envVar E_pric_RadarFrontCenter_TrajPointACCObj3_TrajPointACCObj3_wExistProb_ub_Pv
{
    qword rawValue = 0ll;
    float phyValue = 0.0;
    
    //update the raw value with physical value 
    {
        if(chgEv_TrajPointACCObj3_TrajPointACCObj3_wExistProb_ub == 0)
        {
            phyValue = getvalue(this);
            // physical to raw conversion
            rawValue = ((phyValue -(0))/0.00390625);
            putValue(E_pric_RadarFrontCenter_TrajPointACCObj3_TrajPointACCObj3_wExistProb_ub_Rv, rawValue);
            chgEv_TrajPointACCObj3_TrajPointACCObj3_wExistProb_ub = 1;  
        }
        else
        {
            chgEv_TrajPointACCObj3_TrajPointACCObj3_wExistProb_ub = 0;
        }
    }
}


 
on envVar E_pric_RadarFrontCenter_TrajPointACCObj3_TrajPointACCObj3_dVarXv_uw_Rv
{
    qword rawValue = 0ll;
    float rawValue_float = 0.0;
    float phyValue = 0.0;        

    //set the signal with updated raw value
    {
        rawValue = getvalue(this);
        if(chgEv_TrajPointACCObj3_TrajPointACCObj3_dVarXv_uw == 0)
        {
            //type conversion to float
            rawValue_float = rawValue;        
            // raw to physical conversion
            phyValue = ((rawValue_float *0.00195313)+(0));
            putValue(E_pric_RadarFrontCenter_TrajPointACCObj3_TrajPointACCObj3_dVarXv_uw_Pv, phyValue);
            chgEv_TrajPointACCObj3_TrajPointACCObj3_dVarXv_uw = 1;
        }
        else
        {
            chgEv_TrajPointACCObj3_TrajPointACCObj3_dVarXv_uw = 0;
        }    
        //update the signal value
        Msg_TrajPointACCObj3.TrajPointACCObj3_dVarXv_uw=rawValue;        
    }                                                                           
}

on envVar E_pric_RadarFrontCenter_TrajPointACCObj3_TrajPointACCObj3_dVarXv_uw_Pv
{
    qword rawValue = 0ll;
    float phyValue = 0.0;
    
    //update the raw value with physical value 
    {
        if(chgEv_TrajPointACCObj3_TrajPointACCObj3_dVarXv_uw == 0)
        {
            phyValue = getvalue(this);
            // physical to raw conversion
            rawValue = ((phyValue -(0))/0.00195313);
            putValue(E_pric_RadarFrontCenter_TrajPointACCObj3_TrajPointACCObj3_dVarXv_uw_Rv, rawValue);
            chgEv_TrajPointACCObj3_TrajPointACCObj3_dVarXv_uw = 1;  
        }
        else
        {
            chgEv_TrajPointACCObj3_TrajPointACCObj3_dVarXv_uw = 0;
        }
    }
}


 
on envVar E_pric_RadarFrontCenter_TrajPointACCObj3_TrajPointACCObj3_Stand_b_Rv
{
    qword rawValue = 0ll;
    float rawValue_float = 0.0;
    float phyValue = 0.0;        

    //set the signal with updated raw value
    if(getValue(E_pric_RadarFrontCenter_TrajPointACCObj3_TrajPointACCObj3_Stand_b_SetVt)==0)
    {
        rawValue = getvalue(this);
        if(chgEv_TrajPointACCObj3_TrajPointACCObj3_Stand_b == 0)
        {
            //type conversion to float
            rawValue_float = rawValue;        
            // raw to physical conversion
            phyValue = ((rawValue_float *1)+(0));
            putValue(E_pric_RadarFrontCenter_TrajPointACCObj3_TrajPointACCObj3_Stand_b_Pv, phyValue);
            chgEv_TrajPointACCObj3_TrajPointACCObj3_Stand_b = 1;
        }
        else
        {
            chgEv_TrajPointACCObj3_TrajPointACCObj3_Stand_b = 0;
        }    
        //update the signal value
        Msg_TrajPointACCObj3.TrajPointACCObj3_Stand_b=rawValue;        
    }                                                                           
}

on envVar E_pric_RadarFrontCenter_TrajPointACCObj3_TrajPointACCObj3_Stand_b_Pv
{
    qword rawValue = 0ll;
    float phyValue = 0.0;
    
    //update the raw value with physical value 
    if(getValue(E_pric_RadarFrontCenter_TrajPointACCObj3_TrajPointACCObj3_Stand_b_SetVt)==0)
    {
        if(chgEv_TrajPointACCObj3_TrajPointACCObj3_Stand_b == 0)
        {
            phyValue = getvalue(this);
            // physical to raw conversion
            rawValue = ((phyValue -(0))/1);
            putValue(E_pric_RadarFrontCenter_TrajPointACCObj3_TrajPointACCObj3_Stand_b_Rv, rawValue);
            chgEv_TrajPointACCObj3_TrajPointACCObj3_Stand_b = 1;  
        }
        else
        {
            chgEv_TrajPointACCObj3_TrajPointACCObj3_Stand_b = 0;
        }
    }
}

on envVar E_pric_RadarFrontCenter_TrajPointACCObj3_TrajPointACCObj3_Stand_b_Vt
{
    qword rawValue = 0ll;
    if(getValue(E_pric_RadarFrontCenter_TrajPointACCObj3_TrajPointACCObj3_Stand_b_SetVt))
    {
        //update the signal value
        Msg_TrajPointACCObj3.TrajPointACCObj3_Stand_b=getValue(this);
    }
}

on envVar E_pric_RadarFrontCenter_TrajPointACCObj3_TrajPointACCObj3_Stand_b_SetVt
{
    if(getValue(E_pric_RadarFrontCenter_TrajPointACCObj3_TrajPointACCObj3_Stand_b_SetVt))
    {
        //update the signal value
        Msg_TrajPointACCObj3.TrajPointACCObj3_Stand_b=getvalue(E_pric_RadarFrontCenter_TrajPointACCObj3_TrajPointACCObj3_Stand_b_Vt);
    }
    else
    {
        Msg_TrajPointACCObj3.TrajPointACCObj3_Stand_b=getValue(E_pric_RadarFrontCenter_TrajPointACCObj3_TrajPointACCObj3_Stand_b_Rv);
    }
}
 
on envVar E_pric_RadarFrontCenter_TrajPointACCObj3_TrajPointACCObj3_Valid_b_Rv
{
    qword rawValue = 0ll;
    float rawValue_float = 0.0;
    float phyValue = 0.0;        

    //set the signal with updated raw value
    if(getValue(E_pric_RadarFrontCenter_TrajPointACCObj3_TrajPointACCObj3_Valid_b_SetVt)==0)
    {
        rawValue = getvalue(this);
        if(chgEv_TrajPointACCObj3_TrajPointACCObj3_Valid_b == 0)
        {
            //type conversion to float
            rawValue_float = rawValue;        
            // raw to physical conversion
            phyValue = ((rawValue_float *1)+(0));
            putValue(E_pric_RadarFrontCenter_TrajPointACCObj3_TrajPointACCObj3_Valid_b_Pv, phyValue);
            chgEv_TrajPointACCObj3_TrajPointACCObj3_Valid_b = 1;
        }
        else
        {
            chgEv_TrajPointACCObj3_TrajPointACCObj3_Valid_b = 0;
        }    
        //update the signal value
        Msg_TrajPointACCObj3.TrajPointACCObj3_Valid_b=rawValue;        
    }                                                                           
}

on envVar E_pric_RadarFrontCenter_TrajPointACCObj3_TrajPointACCObj3_Valid_b_Pv
{
    qword rawValue = 0ll;
    float phyValue = 0.0;
    
    //update the raw value with physical value 
    if(getValue(E_pric_RadarFrontCenter_TrajPointACCObj3_TrajPointACCObj3_Valid_b_SetVt)==0)
    {
        if(chgEv_TrajPointACCObj3_TrajPointACCObj3_Valid_b == 0)
        {
            phyValue = getvalue(this);
            // physical to raw conversion
            rawValue = ((phyValue -(0))/1);
            putValue(E_pric_RadarFrontCenter_TrajPointACCObj3_TrajPointACCObj3_Valid_b_Rv, rawValue);
            chgEv_TrajPointACCObj3_TrajPointACCObj3_Valid_b = 1;  
        }
        else
        {
            chgEv_TrajPointACCObj3_TrajPointACCObj3_Valid_b = 0;
        }
    }
}

on envVar E_pric_RadarFrontCenter_TrajPointACCObj3_TrajPointACCObj3_Valid_b_Vt
{
    qword rawValue = 0ll;
    if(getValue(E_pric_RadarFrontCenter_TrajPointACCObj3_TrajPointACCObj3_Valid_b_SetVt))
    {
        //update the signal value
        Msg_TrajPointACCObj3.TrajPointACCObj3_Valid_b=getValue(this);
    }
}

on envVar E_pric_RadarFrontCenter_TrajPointACCObj3_TrajPointACCObj3_Valid_b_SetVt
{
    if(getValue(E_pric_RadarFrontCenter_TrajPointACCObj3_TrajPointACCObj3_Valid_b_SetVt))
    {
        //update the signal value
        Msg_TrajPointACCObj3.TrajPointACCObj3_Valid_b=getvalue(E_pric_RadarFrontCenter_TrajPointACCObj3_TrajPointACCObj3_Valid_b_Vt);
    }
    else
    {
        Msg_TrajPointACCObj3.TrajPointACCObj3_Valid_b=getValue(E_pric_RadarFrontCenter_TrajPointACCObj3_TrajPointACCObj3_Valid_b_Rv);
    }
}
 
on envVar E_pric_RadarFrontCenter_TrajPointACCObj3_TrajPointACCObj3_TrajEnd_b_Rv
{
    qword rawValue = 0ll;
    float rawValue_float = 0.0;
    float phyValue = 0.0;        

    //set the signal with updated raw value
    if(getValue(E_pric_RadarFrontCenter_TrajPointACCObj3_TrajPointACCObj3_TrajEnd_b_SetVt)==0)
    {
        rawValue = getvalue(this);
        if(chgEv_TrajPointACCObj3_TrajPointACCObj3_TrajEnd_b == 0)
        {
            //type conversion to float
            rawValue_float = rawValue;        
            // raw to physical conversion
            phyValue = ((rawValue_float *1)+(0));
            putValue(E_pric_RadarFrontCenter_TrajPointACCObj3_TrajPointACCObj3_TrajEnd_b_Pv, phyValue);
            chgEv_TrajPointACCObj3_TrajPointACCObj3_TrajEnd_b = 1;
        }
        else
        {
            chgEv_TrajPointACCObj3_TrajPointACCObj3_TrajEnd_b = 0;
        }    
        //update the signal value
        Msg_TrajPointACCObj3.TrajPointACCObj3_TrajEnd_b=rawValue;        
    }                                                                           
}

on envVar E_pric_RadarFrontCenter_TrajPointACCObj3_TrajPointACCObj3_TrajEnd_b_Pv
{
    qword rawValue = 0ll;
    float phyValue = 0.0;
    
    //update the raw value with physical value 
    if(getValue(E_pric_RadarFrontCenter_TrajPointACCObj3_TrajPointACCObj3_TrajEnd_b_SetVt)==0)
    {
        if(chgEv_TrajPointACCObj3_TrajPointACCObj3_TrajEnd_b == 0)
        {
            phyValue = getvalue(this);
            // physical to raw conversion
            rawValue = ((phyValue -(0))/1);
            putValue(E_pric_RadarFrontCenter_TrajPointACCObj3_TrajPointACCObj3_TrajEnd_b_Rv, rawValue);
            chgEv_TrajPointACCObj3_TrajPointACCObj3_TrajEnd_b = 1;  
        }
        else
        {
            chgEv_TrajPointACCObj3_TrajPointACCObj3_TrajEnd_b = 0;
        }
    }
}

on envVar E_pric_RadarFrontCenter_TrajPointACCObj3_TrajPointACCObj3_TrajEnd_b_Vt
{
    qword rawValue = 0ll;
    if(getValue(E_pric_RadarFrontCenter_TrajPointACCObj3_TrajPointACCObj3_TrajEnd_b_SetVt))
    {
        //update the signal value
        Msg_TrajPointACCObj3.TrajPointACCObj3_TrajEnd_b=getValue(this);
    }
}

on envVar E_pric_RadarFrontCenter_TrajPointACCObj3_TrajPointACCObj3_TrajEnd_b_SetVt
{
    if(getValue(E_pric_RadarFrontCenter_TrajPointACCObj3_TrajPointACCObj3_TrajEnd_b_SetVt))
    {
        //update the signal value
        Msg_TrajPointACCObj3.TrajPointACCObj3_TrajEnd_b=getvalue(E_pric_RadarFrontCenter_TrajPointACCObj3_TrajPointACCObj3_TrajEnd_b_Vt);
    }
    else
    {
        Msg_TrajPointACCObj3.TrajPointACCObj3_TrajEnd_b=getValue(E_pric_RadarFrontCenter_TrajPointACCObj3_TrajPointACCObj3_TrajEnd_b_Rv);
    }
}
 
on envVar E_pric_RadarFrontCenter_TrajPointACCObj3_TrajPointACCObj3_InvDir_b_Rv
{
    qword rawValue = 0ll;
    float rawValue_float = 0.0;
    float phyValue = 0.0;        

    //set the signal with updated raw value
    if(getValue(E_pric_RadarFrontCenter_TrajPointACCObj3_TrajPointACCObj3_InvDir_b_SetVt)==0)
    {
        rawValue = getvalue(this);
        if(chgEv_TrajPointACCObj3_TrajPointACCObj3_InvDir_b == 0)
        {
            //type conversion to float
            rawValue_float = rawValue;        
            // raw to physical conversion
            phyValue = ((rawValue_float *1)+(0));
            putValue(E_pric_RadarFrontCenter_TrajPointACCObj3_TrajPointACCObj3_InvDir_b_Pv, phyValue);
            chgEv_TrajPointACCObj3_TrajPointACCObj3_InvDir_b = 1;
        }
        else
        {
            chgEv_TrajPointACCObj3_TrajPointACCObj3_InvDir_b = 0;
        }    
        //update the signal value
        Msg_TrajPointACCObj3.TrajPointACCObj3_InvDir_b=rawValue;        
    }                                                                           
}

on envVar E_pric_RadarFrontCenter_TrajPointACCObj3_TrajPointACCObj3_InvDir_b_Pv
{
    qword rawValue = 0ll;
    float phyValue = 0.0;
    
    //update the raw value with physical value 
    if(getValue(E_pric_RadarFrontCenter_TrajPointACCObj3_TrajPointACCObj3_InvDir_b_SetVt)==0)
    {
        if(chgEv_TrajPointACCObj3_TrajPointACCObj3_InvDir_b == 0)
        {
            phyValue = getvalue(this);
            // physical to raw conversion
            rawValue = ((phyValue -(0))/1);
            putValue(E_pric_RadarFrontCenter_TrajPointACCObj3_TrajPointACCObj3_InvDir_b_Rv, rawValue);
            chgEv_TrajPointACCObj3_TrajPointACCObj3_InvDir_b = 1;  
        }
        else
        {
            chgEv_TrajPointACCObj3_TrajPointACCObj3_InvDir_b = 0;
        }
    }
}

on envVar E_pric_RadarFrontCenter_TrajPointACCObj3_TrajPointACCObj3_InvDir_b_Vt
{
    qword rawValue = 0ll;
    if(getValue(E_pric_RadarFrontCenter_TrajPointACCObj3_TrajPointACCObj3_InvDir_b_SetVt))
    {
        //update the signal value
        Msg_TrajPointACCObj3.TrajPointACCObj3_InvDir_b=getValue(this);
    }
}

on envVar E_pric_RadarFrontCenter_TrajPointACCObj3_TrajPointACCObj3_InvDir_b_SetVt
{
    if(getValue(E_pric_RadarFrontCenter_TrajPointACCObj3_TrajPointACCObj3_InvDir_b_SetVt))
    {
        //update the signal value
        Msg_TrajPointACCObj3.TrajPointACCObj3_InvDir_b=getvalue(E_pric_RadarFrontCenter_TrajPointACCObj3_TrajPointACCObj3_InvDir_b_Vt);
    }
    else
    {
        Msg_TrajPointACCObj3.TrajPointACCObj3_InvDir_b=getValue(E_pric_RadarFrontCenter_TrajPointACCObj3_TrajPointACCObj3_InvDir_b_Rv);
    }
}
 
on envVar E_pric_RadarFrontCenter_TrajPointACCObj3_TrajPointACCObj3_dxv_sw_Rv
{
    qword rawValue = 0ll;
    float rawValue_float = 0.0;
    float phyValue = 0.0;        

    //set the signal with updated raw value
    {
        rawValue = getvalue(this);
        if(chgEv_TrajPointACCObj3_TrajPointACCObj3_dxv_sw == 0)
        {
            //type conversion to float
            rawValue_float = rawValue;        
            // raw to physical conversion
            phyValue = ((rawValue_float *0.0078125)+(0));
            putValue(E_pric_RadarFrontCenter_TrajPointACCObj3_TrajPointACCObj3_dxv_sw_Pv, phyValue);
            chgEv_TrajPointACCObj3_TrajPointACCObj3_dxv_sw = 1;
        }
        else
        {
            chgEv_TrajPointACCObj3_TrajPointACCObj3_dxv_sw = 0;
        }    
        //update the signal value
        Msg_TrajPointACCObj3.TrajPointACCObj3_dxv_sw=rawValue;        
    }                                                                           
}

on envVar E_pric_RadarFrontCenter_TrajPointACCObj3_TrajPointACCObj3_dxv_sw_Pv
{
    qword rawValue = 0ll;
    float phyValue = 0.0;
    
    //update the raw value with physical value 
    {
        if(chgEv_TrajPointACCObj3_TrajPointACCObj3_dxv_sw == 0)
        {
            phyValue = getvalue(this);
            // physical to raw conversion
            rawValue = ((phyValue -(0))/0.0078125);
            putValue(E_pric_RadarFrontCenter_TrajPointACCObj3_TrajPointACCObj3_dxv_sw_Rv, rawValue);
            chgEv_TrajPointACCObj3_TrajPointACCObj3_dxv_sw = 1;  
        }
        else
        {
            chgEv_TrajPointACCObj3_TrajPointACCObj3_dxv_sw = 0;
        }
    }
}


 
on envVar E_pric_RadarFrontCenter_TrajPointACCObj3_TrajPointACCObj3_Drive_b_Rv
{
    qword rawValue = 0ll;
    float rawValue_float = 0.0;
    float phyValue = 0.0;        

    //set the signal with updated raw value
    if(getValue(E_pric_RadarFrontCenter_TrajPointACCObj3_TrajPointACCObj3_Drive_b_SetVt)==0)
    {
        rawValue = getvalue(this);
        if(chgEv_TrajPointACCObj3_TrajPointACCObj3_Drive_b == 0)
        {
            //type conversion to float
            rawValue_float = rawValue;        
            // raw to physical conversion
            phyValue = ((rawValue_float *1)+(0));
            putValue(E_pric_RadarFrontCenter_TrajPointACCObj3_TrajPointACCObj3_Drive_b_Pv, phyValue);
            chgEv_TrajPointACCObj3_TrajPointACCObj3_Drive_b = 1;
        }
        else
        {
            chgEv_TrajPointACCObj3_TrajPointACCObj3_Drive_b = 0;
        }    
        //update the signal value
        Msg_TrajPointACCObj3.TrajPointACCObj3_Drive_b=rawValue;        
    }                                                                           
}

on envVar E_pric_RadarFrontCenter_TrajPointACCObj3_TrajPointACCObj3_Drive_b_Pv
{
    qword rawValue = 0ll;
    float phyValue = 0.0;
    
    //update the raw value with physical value 
    if(getValue(E_pric_RadarFrontCenter_TrajPointACCObj3_TrajPointACCObj3_Drive_b_SetVt)==0)
    {
        if(chgEv_TrajPointACCObj3_TrajPointACCObj3_Drive_b == 0)
        {
            phyValue = getvalue(this);
            // physical to raw conversion
            rawValue = ((phyValue -(0))/1);
            putValue(E_pric_RadarFrontCenter_TrajPointACCObj3_TrajPointACCObj3_Drive_b_Rv, rawValue);
            chgEv_TrajPointACCObj3_TrajPointACCObj3_Drive_b = 1;  
        }
        else
        {
            chgEv_TrajPointACCObj3_TrajPointACCObj3_Drive_b = 0;
        }
    }
}

on envVar E_pric_RadarFrontCenter_TrajPointACCObj3_TrajPointACCObj3_Drive_b_Vt
{
    qword rawValue = 0ll;
    if(getValue(E_pric_RadarFrontCenter_TrajPointACCObj3_TrajPointACCObj3_Drive_b_SetVt))
    {
        //update the signal value
        Msg_TrajPointACCObj3.TrajPointACCObj3_Drive_b=getValue(this);
    }
}

on envVar E_pric_RadarFrontCenter_TrajPointACCObj3_TrajPointACCObj3_Drive_b_SetVt
{
    if(getValue(E_pric_RadarFrontCenter_TrajPointACCObj3_TrajPointACCObj3_Drive_b_SetVt))
    {
        //update the signal value
        Msg_TrajPointACCObj3.TrajPointACCObj3_Drive_b=getvalue(E_pric_RadarFrontCenter_TrajPointACCObj3_TrajPointACCObj3_Drive_b_Vt);
    }
    else
    {
        Msg_TrajPointACCObj3.TrajPointACCObj3_Drive_b=getValue(E_pric_RadarFrontCenter_TrajPointACCObj3_TrajPointACCObj3_Drive_b_Rv);
    }
}
 
on envVar E_pric_RadarFrontCenter_TrajPointACCObj3_TrajPointACCObj3_Stopped_b_Rv
{
    qword rawValue = 0ll;
    float rawValue_float = 0.0;
    float phyValue = 0.0;        

    //set the signal with updated raw value
    if(getValue(E_pric_RadarFrontCenter_TrajPointACCObj3_TrajPointACCObj3_Stopped_b_SetVt)==0)
    {
        rawValue = getvalue(this);
        if(chgEv_TrajPointACCObj3_TrajPointACCObj3_Stopped_b == 0)
        {
            //type conversion to float
            rawValue_float = rawValue;        
            // raw to physical conversion
            phyValue = ((rawValue_float *1)+(0));
            putValue(E_pric_RadarFrontCenter_TrajPointACCObj3_TrajPointACCObj3_Stopped_b_Pv, phyValue);
            chgEv_TrajPointACCObj3_TrajPointACCObj3_Stopped_b = 1;
        }
        else
        {
            chgEv_TrajPointACCObj3_TrajPointACCObj3_Stopped_b = 0;
        }    
        //update the signal value
        Msg_TrajPointACCObj3.TrajPointACCObj3_Stopped_b=rawValue;        
    }                                                                           
}

on envVar E_pric_RadarFrontCenter_TrajPointACCObj3_TrajPointACCObj3_Stopped_b_Pv
{
    qword rawValue = 0ll;
    float phyValue = 0.0;
    
    //update the raw value with physical value 
    if(getValue(E_pric_RadarFrontCenter_TrajPointACCObj3_TrajPointACCObj3_Stopped_b_SetVt)==0)
    {
        if(chgEv_TrajPointACCObj3_TrajPointACCObj3_Stopped_b == 0)
        {
            phyValue = getvalue(this);
            // physical to raw conversion
            rawValue = ((phyValue -(0))/1);
            putValue(E_pric_RadarFrontCenter_TrajPointACCObj3_TrajPointACCObj3_Stopped_b_Rv, rawValue);
            chgEv_TrajPointACCObj3_TrajPointACCObj3_Stopped_b = 1;  
        }
        else
        {
            chgEv_TrajPointACCObj3_TrajPointACCObj3_Stopped_b = 0;
        }
    }
}

on envVar E_pric_RadarFrontCenter_TrajPointACCObj3_TrajPointACCObj3_Stopped_b_Vt
{
    qword rawValue = 0ll;
    if(getValue(E_pric_RadarFrontCenter_TrajPointACCObj3_TrajPointACCObj3_Stopped_b_SetVt))
    {
        //update the signal value
        Msg_TrajPointACCObj3.TrajPointACCObj3_Stopped_b=getValue(this);
    }
}

on envVar E_pric_RadarFrontCenter_TrajPointACCObj3_TrajPointACCObj3_Stopped_b_SetVt
{
    if(getValue(E_pric_RadarFrontCenter_TrajPointACCObj3_TrajPointACCObj3_Stopped_b_SetVt))
    {
        //update the signal value
        Msg_TrajPointACCObj3.TrajPointACCObj3_Stopped_b=getvalue(E_pric_RadarFrontCenter_TrajPointACCObj3_TrajPointACCObj3_Stopped_b_Vt);
    }
    else
    {
        Msg_TrajPointACCObj3.TrajPointACCObj3_Stopped_b=getValue(E_pric_RadarFrontCenter_TrajPointACCObj3_TrajPointACCObj3_Stopped_b_Rv);
    }
}
 
on envVar E_pric_RadarFrontCenter_TrajPointACCObj3_TrajPointACCObj3_dVarYv_uw_Rv
{
    qword rawValue = 0ll;
    float rawValue_float = 0.0;
    float phyValue = 0.0;        

    //set the signal with updated raw value
    {
        rawValue = getvalue(this);
        if(chgEv_TrajPointACCObj3_TrajPointACCObj3_dVarYv_uw == 0)
        {
            //type conversion to float
            rawValue_float = rawValue;        
            // raw to physical conversion
            phyValue = ((rawValue_float *0.00195313)+(0));
            putValue(E_pric_RadarFrontCenter_TrajPointACCObj3_TrajPointACCObj3_dVarYv_uw_Pv, phyValue);
            chgEv_TrajPointACCObj3_TrajPointACCObj3_dVarYv_uw = 1;
        }
        else
        {
            chgEv_TrajPointACCObj3_TrajPointACCObj3_dVarYv_uw = 0;
        }    
        //update the signal value
        Msg_TrajPointACCObj3.TrajPointACCObj3_dVarYv_uw=rawValue;        
    }                                                                           
}

on envVar E_pric_RadarFrontCenter_TrajPointACCObj3_TrajPointACCObj3_dVarYv_uw_Pv
{
    qword rawValue = 0ll;
    float phyValue = 0.0;
    
    //update the raw value with physical value 
    {
        if(chgEv_TrajPointACCObj3_TrajPointACCObj3_dVarYv_uw == 0)
        {
            phyValue = getvalue(this);
            // physical to raw conversion
            rawValue = ((phyValue -(0))/0.00195313);
            putValue(E_pric_RadarFrontCenter_TrajPointACCObj3_TrajPointACCObj3_dVarYv_uw_Rv, rawValue);
            chgEv_TrajPointACCObj3_TrajPointACCObj3_dVarYv_uw = 1;  
        }
        else
        {
            chgEv_TrajPointACCObj3_TrajPointACCObj3_dVarYv_uw = 0;
        }
    }
}


 
on envVar E_pric_RadarFrontCenter_TrajPointACCObj3_TrajPointACCObj3_timestamp_Rv
{
    qword rawValue = 0ll;
    float rawValue_float = 0.0;
    float phyValue = 0.0;        

    //set the signal with updated raw value
    {
        rawValue = getvalue(this);
        if(chgEv_TrajPointACCObj3_TrajPointACCObj3_timestamp == 0)
        {
            //type conversion to float
            rawValue_float = rawValue;        
            // raw to physical conversion
            phyValue = ((rawValue_float *0.000488281)+(0));
            putValue(E_pric_RadarFrontCenter_TrajPointACCObj3_TrajPointACCObj3_timestamp_Pv, phyValue);
            chgEv_TrajPointACCObj3_TrajPointACCObj3_timestamp = 1;
        }
        else
        {
            chgEv_TrajPointACCObj3_TrajPointACCObj3_timestamp = 0;
        }    
        //update the signal value
        Msg_TrajPointACCObj3.TrajPointACCObj3_timestamp=rawValue;        
    }                                                                           
}

on envVar E_pric_RadarFrontCenter_TrajPointACCObj3_TrajPointACCObj3_timestamp_Pv
{
    qword rawValue = 0ll;
    float phyValue = 0.0;
    
    //update the raw value with physical value 
    {
        if(chgEv_TrajPointACCObj3_TrajPointACCObj3_timestamp == 0)
        {
            phyValue = getvalue(this);
            // physical to raw conversion
            rawValue = ((phyValue -(0))/0.000488281);
            putValue(E_pric_RadarFrontCenter_TrajPointACCObj3_TrajPointACCObj3_timestamp_Rv, rawValue);
            chgEv_TrajPointACCObj3_TrajPointACCObj3_timestamp = 1;  
        }
        else
        {
            chgEv_TrajPointACCObj3_TrajPointACCObj3_timestamp = 0;
        }
    }
}


 
on envVar E_pric_RadarFrontCenter_TrajPointACCObj2_tx
{
    if(getValue(this))
    {       
        
        //update the BZ Signal
        if(TrajPointACCObj2_TrajPointACCObj2_blockCtr_wrongvalctr == 0)
        {
            update_TrajPointACCObj2_TrajPointACCObj2_blockCtr_counter();
            Msg_TrajPointACCObj2.TrajPointACCObj2_blockCtr= TrajPointACCObj2_TrajPointACCObj2_blockCtr_counter;
        }
        else if(TrajPointACCObj2_TrajPointACCObj2_blockCtr_wrongvalctr > 0)
        {
             TrajPointACCObj2_TrajPointACCObj2_blockCtr_wrongvalctr--;
              // if counter becomes zero, update panel controller to zero
             if(TrajPointACCObj2_TrajPointACCObj2_blockCtr_wrongvalctr == 0)
             {
                 putValue(E_pric_RadarFrontCenter_TrajPointACCObj2_TrajPointACCObj2_blockCtr_wrongvalctr,0);
             }
        }
        else
        {
            //do nothing
        }        
        //update the BZ Signal
        if(TrajPointACCObj2_TrajPointACCObj2_MsgCtr_wrongvalctr == 0)
        {
            update_TrajPointACCObj2_TrajPointACCObj2_MsgCtr_counter();
            Msg_TrajPointACCObj2.TrajPointACCObj2_MsgCtr= TrajPointACCObj2_TrajPointACCObj2_MsgCtr_counter;
        }
        else if(TrajPointACCObj2_TrajPointACCObj2_MsgCtr_wrongvalctr > 0)
        {
             TrajPointACCObj2_TrajPointACCObj2_MsgCtr_wrongvalctr--;
              // if counter becomes zero, update panel controller to zero
             if(TrajPointACCObj2_TrajPointACCObj2_MsgCtr_wrongvalctr == 0)
             {
                 putValue(E_pric_RadarFrontCenter_TrajPointACCObj2_TrajPointACCObj2_MsgCtr_wrongvalctr,0);
             }
        }
        else
        {
            //do nothing
        }        
        //calculate the CRC checksum
        update_TrajPointACCObj2_ChkSum_Checksum();

        output(Msg_TrajPointACCObj2);        
    }
}

on envVar E_pric_RadarFrontCenter_TrajPointACCObj2_Range
{
    qword rawstatus = 0ll;
    qword rawValue = 0ll;    
    
    rawstatus = getvalue(this);    
    // set all the signals with min raw /max raw /init raw
    switch (rawstatus) 
    {
     case(0) :
        rawValue= 0;
        putValue(E_pric_RadarFrontCenter_TrajPointACCObj2_TrajPointACCObj2_timestamp_Rv, rawValue);
        rawValue= 0;
        putValue(E_pric_RadarFrontCenter_TrajPointACCObj2_TrajPointACCObj2_wExistProb_ub_Rv, rawValue);
        rawValue= 0;
        putValue(E_pric_RadarFrontCenter_TrajPointACCObj2_TrajPointACCObj2_Drive_b_Rv, rawValue);
        rawValue= -32768;
        putValue(E_pric_RadarFrontCenter_TrajPointACCObj2_TrajPointACCObj2_dxv_sw_Rv, rawValue);
        rawValue= 0;
        putValue(E_pric_RadarFrontCenter_TrajPointACCObj2_TrajPointACCObj2_InvDir_b_Rv, rawValue);
        rawValue= 0;
        putValue(E_pric_RadarFrontCenter_TrajPointACCObj2_TrajPointACCObj2_Stopped_b_Rv, rawValue);
        rawValue= 0;
        putValue(E_pric_RadarFrontCenter_TrajPointACCObj2_TrajPointACCObj2_Stand_b_Rv, rawValue);
        rawValue= -32768;
        putValue(E_pric_RadarFrontCenter_TrajPointACCObj2_TrajPointACCObj2_dyv_sw_Rv, rawValue);
        rawValue= 0;
        putValue(E_pric_RadarFrontCenter_TrajPointACCObj2_TrajPointACCObj2_dVarYv_uw_Rv, rawValue);
        rawValue= 0;
        putValue(E_pric_RadarFrontCenter_TrajPointACCObj2_TrajPointACCObj2_dVarXv_uw_Rv, rawValue);
        rawValue= 0;
        putValue(E_pric_RadarFrontCenter_TrajPointACCObj2_TrajPointACCObj2_TrajEnd_b_Rv, rawValue);
        rawValue= 0;
        putValue(E_pric_RadarFrontCenter_TrajPointACCObj2_TrajPointACCObj2_Valid_b_Rv, rawValue);
        break;
     case(1) :
        rawValue= 65536;
        putValue(E_pric_RadarFrontCenter_TrajPointACCObj2_TrajPointACCObj2_timestamp_Rv, rawValue);
        rawValue= 255;
        putValue(E_pric_RadarFrontCenter_TrajPointACCObj2_TrajPointACCObj2_wExistProb_ub_Rv, rawValue);
        rawValue= 1;
        putValue(E_pric_RadarFrontCenter_TrajPointACCObj2_TrajPointACCObj2_Drive_b_Rv, rawValue);
        rawValue= 32767;
        putValue(E_pric_RadarFrontCenter_TrajPointACCObj2_TrajPointACCObj2_dxv_sw_Rv, rawValue);
        rawValue= 1;
        putValue(E_pric_RadarFrontCenter_TrajPointACCObj2_TrajPointACCObj2_InvDir_b_Rv, rawValue);
        rawValue= 1;
        putValue(E_pric_RadarFrontCenter_TrajPointACCObj2_TrajPointACCObj2_Stopped_b_Rv, rawValue);
        rawValue= 1;
        putValue(E_pric_RadarFrontCenter_TrajPointACCObj2_TrajPointACCObj2_Stand_b_Rv, rawValue);
        rawValue= 32767;
        putValue(E_pric_RadarFrontCenter_TrajPointACCObj2_TrajPointACCObj2_dyv_sw_Rv, rawValue);
        rawValue= 65534;
        putValue(E_pric_RadarFrontCenter_TrajPointACCObj2_TrajPointACCObj2_dVarYv_uw_Rv, rawValue);
        rawValue= 65534;
        putValue(E_pric_RadarFrontCenter_TrajPointACCObj2_TrajPointACCObj2_dVarXv_uw_Rv, rawValue);
        rawValue= 1;
        putValue(E_pric_RadarFrontCenter_TrajPointACCObj2_TrajPointACCObj2_TrajEnd_b_Rv, rawValue);
        rawValue= 1;
        putValue(E_pric_RadarFrontCenter_TrajPointACCObj2_TrajPointACCObj2_Valid_b_Rv, rawValue);
        break;
     default :
        rawValue= 0;
        putValue(E_pric_RadarFrontCenter_TrajPointACCObj2_TrajPointACCObj2_timestamp_Rv, rawValue);
        rawValue= 0;
        putValue(E_pric_RadarFrontCenter_TrajPointACCObj2_TrajPointACCObj2_wExistProb_ub_Rv, rawValue);
        rawValue= 0;
        putValue(E_pric_RadarFrontCenter_TrajPointACCObj2_TrajPointACCObj2_Drive_b_Rv, rawValue);
        rawValue= -32768;
        putValue(E_pric_RadarFrontCenter_TrajPointACCObj2_TrajPointACCObj2_dxv_sw_Rv, rawValue);
        rawValue= 0;
        putValue(E_pric_RadarFrontCenter_TrajPointACCObj2_TrajPointACCObj2_InvDir_b_Rv, rawValue);
        rawValue= 0;
        putValue(E_pric_RadarFrontCenter_TrajPointACCObj2_TrajPointACCObj2_Stopped_b_Rv, rawValue);
        rawValue= 0;
        putValue(E_pric_RadarFrontCenter_TrajPointACCObj2_TrajPointACCObj2_Stand_b_Rv, rawValue);
        rawValue= -32768;
        putValue(E_pric_RadarFrontCenter_TrajPointACCObj2_TrajPointACCObj2_dyv_sw_Rv, rawValue);
        rawValue= 0;
        putValue(E_pric_RadarFrontCenter_TrajPointACCObj2_TrajPointACCObj2_dVarYv_uw_Rv, rawValue);
        rawValue= 0;
        putValue(E_pric_RadarFrontCenter_TrajPointACCObj2_TrajPointACCObj2_dVarXv_uw_Rv, rawValue);
        rawValue= 0;
        putValue(E_pric_RadarFrontCenter_TrajPointACCObj2_TrajPointACCObj2_TrajEnd_b_Rv, rawValue);
        rawValue= 0;
        putValue(E_pric_RadarFrontCenter_TrajPointACCObj2_TrajPointACCObj2_Valid_b_Rv, rawValue);
      break;
   }
}

on envVar E_pric_RadarFrontCenter_TrajPointACCObj2_Dlc
{
    if(getValue(E_pric_RadarFrontCenter_TrajPointACCObj2_enDlc))
    {
        Msg_TrajPointACCObj2.dlc =getValue(this);
    }
    else
    {
       Dbc_dlc = 16;
	   Msg_TrajPointACCObj2.dlc = Calc_Canfd_dlc(Dbc_dlc);
	   	
  }
}

on envVar E_pric_RadarFrontCenter_TrajPointACCObj2_enDlc
{
    //For Messages with DLC = 8, set wrong DLC to smaller than defined DLC
    //For Messages with DLC < 8 set wrong DLC to smaller/longer than defined DLC
    if(getValue(this))
    {
        Msg_TrajPointACCObj2.dlc =getValue(E_pric_RadarFrontCenter_TrajPointACCObj2_Dlc);
    }
    else
    {
       Dbc_dlc = 16;
	   Msg_TrajPointACCObj2.dlc = Calc_Canfd_dlc(Dbc_dlc);
			
    }
}

on envVar E_pric_RadarFrontCenter_TrajPointACCObj2_TrajPointACCObj2_CRC_wrongvalctr
{
    //update disturb count
    //disturb value range:(-1 = always send wrong value),( X>0 ,x is the number of Messages with wrong CHK sent)
    TrajPointACCObj2_TrajPointACCObj2_CRC_wrongvalctr =getValue(this);    
}
on envVar E_pric_RadarFrontCenter_TrajPointACCObj2_TrajPointACCObj2_MsgCtr_wrongvalctr
{
    //update disturb count
    //disturb value range:(-1 = always send wrong value),( X>0 ,x is the number of Messages with wrong CHK sent)
    TrajPointACCObj2_TrajPointACCObj2_MsgCtr_wrongvalctr =getValue(this);    
}
on envVar E_pric_RadarFrontCenter_TrajPointACCObj2_TrajPointACCObj2_blockCtr_wrongvalctr
{
    //update disturb count
    //disturb value range:(-1 = always send wrong value),( X>0 ,x is the number of Messages with wrong CHK sent)
    TrajPointACCObj2_TrajPointACCObj2_blockCtr_wrongvalctr =getValue(this);    
}

on envVar E_pric_RadarFrontCenter_TrajPointACCObj2_TrajPointACCObj2_timestamp_Rv
{
    qword rawValue = 0ll;
    float rawValue_float = 0.0;
    float phyValue = 0.0;        

    //set the signal with updated raw value
    {
        rawValue = getvalue(this);
        if(chgEv_TrajPointACCObj2_TrajPointACCObj2_timestamp == 0)
        {
            //type conversion to float
            rawValue_float = rawValue;        
            // raw to physical conversion
            phyValue = ((rawValue_float *0.000488281)+(0));
            putValue(E_pric_RadarFrontCenter_TrajPointACCObj2_TrajPointACCObj2_timestamp_Pv, phyValue);
            chgEv_TrajPointACCObj2_TrajPointACCObj2_timestamp = 1;
        }
        else
        {
            chgEv_TrajPointACCObj2_TrajPointACCObj2_timestamp = 0;
        }    
        //update the signal value
        Msg_TrajPointACCObj2.TrajPointACCObj2_timestamp=rawValue;        
    }                                                                           
}

on envVar E_pric_RadarFrontCenter_TrajPointACCObj2_TrajPointACCObj2_timestamp_Pv
{
    qword rawValue = 0ll;
    float phyValue = 0.0;
    
    //update the raw value with physical value 
    {
        if(chgEv_TrajPointACCObj2_TrajPointACCObj2_timestamp == 0)
        {
            phyValue = getvalue(this);
            // physical to raw conversion
            rawValue = ((phyValue -(0))/0.000488281);
            putValue(E_pric_RadarFrontCenter_TrajPointACCObj2_TrajPointACCObj2_timestamp_Rv, rawValue);
            chgEv_TrajPointACCObj2_TrajPointACCObj2_timestamp = 1;  
        }
        else
        {
            chgEv_TrajPointACCObj2_TrajPointACCObj2_timestamp = 0;
        }
    }
}


 
on envVar E_pric_RadarFrontCenter_TrajPointACCObj2_TrajPointACCObj2_wExistProb_ub_Rv
{
    qword rawValue = 0ll;
    float rawValue_float = 0.0;
    float phyValue = 0.0;        

    //set the signal with updated raw value
    {
        rawValue = getvalue(this);
        if(chgEv_TrajPointACCObj2_TrajPointACCObj2_wExistProb_ub == 0)
        {
            //type conversion to float
            rawValue_float = rawValue;        
            // raw to physical conversion
            phyValue = ((rawValue_float *0.00390625)+(0));
            putValue(E_pric_RadarFrontCenter_TrajPointACCObj2_TrajPointACCObj2_wExistProb_ub_Pv, phyValue);
            chgEv_TrajPointACCObj2_TrajPointACCObj2_wExistProb_ub = 1;
        }
        else
        {
            chgEv_TrajPointACCObj2_TrajPointACCObj2_wExistProb_ub = 0;
        }    
        //update the signal value
        Msg_TrajPointACCObj2.TrajPointACCObj2_wExistProb_ub=rawValue;        
    }                                                                           
}

on envVar E_pric_RadarFrontCenter_TrajPointACCObj2_TrajPointACCObj2_wExistProb_ub_Pv
{
    qword rawValue = 0ll;
    float phyValue = 0.0;
    
    //update the raw value with physical value 
    {
        if(chgEv_TrajPointACCObj2_TrajPointACCObj2_wExistProb_ub == 0)
        {
            phyValue = getvalue(this);
            // physical to raw conversion
            rawValue = ((phyValue -(0))/0.00390625);
            putValue(E_pric_RadarFrontCenter_TrajPointACCObj2_TrajPointACCObj2_wExistProb_ub_Rv, rawValue);
            chgEv_TrajPointACCObj2_TrajPointACCObj2_wExistProb_ub = 1;  
        }
        else
        {
            chgEv_TrajPointACCObj2_TrajPointACCObj2_wExistProb_ub = 0;
        }
    }
}


 
on envVar E_pric_RadarFrontCenter_TrajPointACCObj2_TrajPointACCObj2_Drive_b_Rv
{
    qword rawValue = 0ll;
    float rawValue_float = 0.0;
    float phyValue = 0.0;        

    //set the signal with updated raw value
    if(getValue(E_pric_RadarFrontCenter_TrajPointACCObj2_TrajPointACCObj2_Drive_b_SetVt)==0)
    {
        rawValue = getvalue(this);
        if(chgEv_TrajPointACCObj2_TrajPointACCObj2_Drive_b == 0)
        {
            //type conversion to float
            rawValue_float = rawValue;        
            // raw to physical conversion
            phyValue = ((rawValue_float *1)+(0));
            putValue(E_pric_RadarFrontCenter_TrajPointACCObj2_TrajPointACCObj2_Drive_b_Pv, phyValue);
            chgEv_TrajPointACCObj2_TrajPointACCObj2_Drive_b = 1;
        }
        else
        {
            chgEv_TrajPointACCObj2_TrajPointACCObj2_Drive_b = 0;
        }    
        //update the signal value
        Msg_TrajPointACCObj2.TrajPointACCObj2_Drive_b=rawValue;        
    }                                                                           
}

on envVar E_pric_RadarFrontCenter_TrajPointACCObj2_TrajPointACCObj2_Drive_b_Pv
{
    qword rawValue = 0ll;
    float phyValue = 0.0;
    
    //update the raw value with physical value 
    if(getValue(E_pric_RadarFrontCenter_TrajPointACCObj2_TrajPointACCObj2_Drive_b_SetVt)==0)
    {
        if(chgEv_TrajPointACCObj2_TrajPointACCObj2_Drive_b == 0)
        {
            phyValue = getvalue(this);
            // physical to raw conversion
            rawValue = ((phyValue -(0))/1);
            putValue(E_pric_RadarFrontCenter_TrajPointACCObj2_TrajPointACCObj2_Drive_b_Rv, rawValue);
            chgEv_TrajPointACCObj2_TrajPointACCObj2_Drive_b = 1;  
        }
        else
        {
            chgEv_TrajPointACCObj2_TrajPointACCObj2_Drive_b = 0;
        }
    }
}

on envVar E_pric_RadarFrontCenter_TrajPointACCObj2_TrajPointACCObj2_Drive_b_Vt
{
    qword rawValue = 0ll;
    if(getValue(E_pric_RadarFrontCenter_TrajPointACCObj2_TrajPointACCObj2_Drive_b_SetVt))
    {
        //update the signal value
        Msg_TrajPointACCObj2.TrajPointACCObj2_Drive_b=getValue(this);
    }
}

on envVar E_pric_RadarFrontCenter_TrajPointACCObj2_TrajPointACCObj2_Drive_b_SetVt
{
    if(getValue(E_pric_RadarFrontCenter_TrajPointACCObj2_TrajPointACCObj2_Drive_b_SetVt))
    {
        //update the signal value
        Msg_TrajPointACCObj2.TrajPointACCObj2_Drive_b=getvalue(E_pric_RadarFrontCenter_TrajPointACCObj2_TrajPointACCObj2_Drive_b_Vt);
    }
    else
    {
        Msg_TrajPointACCObj2.TrajPointACCObj2_Drive_b=getValue(E_pric_RadarFrontCenter_TrajPointACCObj2_TrajPointACCObj2_Drive_b_Rv);
    }
}
 
on envVar E_pric_RadarFrontCenter_TrajPointACCObj2_TrajPointACCObj2_dxv_sw_Rv
{
    qword rawValue = 0ll;
    float rawValue_float = 0.0;
    float phyValue = 0.0;        

    //set the signal with updated raw value
    {
        rawValue = getvalue(this);
        if(chgEv_TrajPointACCObj2_TrajPointACCObj2_dxv_sw == 0)
        {
            //type conversion to float
            rawValue_float = rawValue;        
            // raw to physical conversion
            phyValue = ((rawValue_float *0.0078125)+(0));
            putValue(E_pric_RadarFrontCenter_TrajPointACCObj2_TrajPointACCObj2_dxv_sw_Pv, phyValue);
            chgEv_TrajPointACCObj2_TrajPointACCObj2_dxv_sw = 1;
        }
        else
        {
            chgEv_TrajPointACCObj2_TrajPointACCObj2_dxv_sw = 0;
        }    
        //update the signal value
        Msg_TrajPointACCObj2.TrajPointACCObj2_dxv_sw=rawValue;        
    }                                                                           
}

on envVar E_pric_RadarFrontCenter_TrajPointACCObj2_TrajPointACCObj2_dxv_sw_Pv
{
    qword rawValue = 0ll;
    float phyValue = 0.0;
    
    //update the raw value with physical value 
    {
        if(chgEv_TrajPointACCObj2_TrajPointACCObj2_dxv_sw == 0)
        {
            phyValue = getvalue(this);
            // physical to raw conversion
            rawValue = ((phyValue -(0))/0.0078125);
            putValue(E_pric_RadarFrontCenter_TrajPointACCObj2_TrajPointACCObj2_dxv_sw_Rv, rawValue);
            chgEv_TrajPointACCObj2_TrajPointACCObj2_dxv_sw = 1;  
        }
        else
        {
            chgEv_TrajPointACCObj2_TrajPointACCObj2_dxv_sw = 0;
        }
    }
}


 
on envVar E_pric_RadarFrontCenter_TrajPointACCObj2_TrajPointACCObj2_InvDir_b_Rv
{
    qword rawValue = 0ll;
    float rawValue_float = 0.0;
    float phyValue = 0.0;        

    //set the signal with updated raw value
    if(getValue(E_pric_RadarFrontCenter_TrajPointACCObj2_TrajPointACCObj2_InvDir_b_SetVt)==0)
    {
        rawValue = getvalue(this);
        if(chgEv_TrajPointACCObj2_TrajPointACCObj2_InvDir_b == 0)
        {
            //type conversion to float
            rawValue_float = rawValue;        
            // raw to physical conversion
            phyValue = ((rawValue_float *1)+(0));
            putValue(E_pric_RadarFrontCenter_TrajPointACCObj2_TrajPointACCObj2_InvDir_b_Pv, phyValue);
            chgEv_TrajPointACCObj2_TrajPointACCObj2_InvDir_b = 1;
        }
        else
        {
            chgEv_TrajPointACCObj2_TrajPointACCObj2_InvDir_b = 0;
        }    
        //update the signal value
        Msg_TrajPointACCObj2.TrajPointACCObj2_InvDir_b=rawValue;        
    }                                                                           
}

on envVar E_pric_RadarFrontCenter_TrajPointACCObj2_TrajPointACCObj2_InvDir_b_Pv
{
    qword rawValue = 0ll;
    float phyValue = 0.0;
    
    //update the raw value with physical value 
    if(getValue(E_pric_RadarFrontCenter_TrajPointACCObj2_TrajPointACCObj2_InvDir_b_SetVt)==0)
    {
        if(chgEv_TrajPointACCObj2_TrajPointACCObj2_InvDir_b == 0)
        {
            phyValue = getvalue(this);
            // physical to raw conversion
            rawValue = ((phyValue -(0))/1);
            putValue(E_pric_RadarFrontCenter_TrajPointACCObj2_TrajPointACCObj2_InvDir_b_Rv, rawValue);
            chgEv_TrajPointACCObj2_TrajPointACCObj2_InvDir_b = 1;  
        }
        else
        {
            chgEv_TrajPointACCObj2_TrajPointACCObj2_InvDir_b = 0;
        }
    }
}

on envVar E_pric_RadarFrontCenter_TrajPointACCObj2_TrajPointACCObj2_InvDir_b_Vt
{
    qword rawValue = 0ll;
    if(getValue(E_pric_RadarFrontCenter_TrajPointACCObj2_TrajPointACCObj2_InvDir_b_SetVt))
    {
        //update the signal value
        Msg_TrajPointACCObj2.TrajPointACCObj2_InvDir_b=getValue(this);
    }
}

on envVar E_pric_RadarFrontCenter_TrajPointACCObj2_TrajPointACCObj2_InvDir_b_SetVt
{
    if(getValue(E_pric_RadarFrontCenter_TrajPointACCObj2_TrajPointACCObj2_InvDir_b_SetVt))
    {
        //update the signal value
        Msg_TrajPointACCObj2.TrajPointACCObj2_InvDir_b=getvalue(E_pric_RadarFrontCenter_TrajPointACCObj2_TrajPointACCObj2_InvDir_b_Vt);
    }
    else
    {
        Msg_TrajPointACCObj2.TrajPointACCObj2_InvDir_b=getValue(E_pric_RadarFrontCenter_TrajPointACCObj2_TrajPointACCObj2_InvDir_b_Rv);
    }
}
 
on envVar E_pric_RadarFrontCenter_TrajPointACCObj2_TrajPointACCObj2_Stopped_b_Rv
{
    qword rawValue = 0ll;
    float rawValue_float = 0.0;
    float phyValue = 0.0;        

    //set the signal with updated raw value
    if(getValue(E_pric_RadarFrontCenter_TrajPointACCObj2_TrajPointACCObj2_Stopped_b_SetVt)==0)
    {
        rawValue = getvalue(this);
        if(chgEv_TrajPointACCObj2_TrajPointACCObj2_Stopped_b == 0)
        {
            //type conversion to float
            rawValue_float = rawValue;        
            // raw to physical conversion
            phyValue = ((rawValue_float *1)+(0));
            putValue(E_pric_RadarFrontCenter_TrajPointACCObj2_TrajPointACCObj2_Stopped_b_Pv, phyValue);
            chgEv_TrajPointACCObj2_TrajPointACCObj2_Stopped_b = 1;
        }
        else
        {
            chgEv_TrajPointACCObj2_TrajPointACCObj2_Stopped_b = 0;
        }    
        //update the signal value
        Msg_TrajPointACCObj2.TrajPointACCObj2_Stopped_b=rawValue;        
    }                                                                           
}

on envVar E_pric_RadarFrontCenter_TrajPointACCObj2_TrajPointACCObj2_Stopped_b_Pv
{
    qword rawValue = 0ll;
    float phyValue = 0.0;
    
    //update the raw value with physical value 
    if(getValue(E_pric_RadarFrontCenter_TrajPointACCObj2_TrajPointACCObj2_Stopped_b_SetVt)==0)
    {
        if(chgEv_TrajPointACCObj2_TrajPointACCObj2_Stopped_b == 0)
        {
            phyValue = getvalue(this);
            // physical to raw conversion
            rawValue = ((phyValue -(0))/1);
            putValue(E_pric_RadarFrontCenter_TrajPointACCObj2_TrajPointACCObj2_Stopped_b_Rv, rawValue);
            chgEv_TrajPointACCObj2_TrajPointACCObj2_Stopped_b = 1;  
        }
        else
        {
            chgEv_TrajPointACCObj2_TrajPointACCObj2_Stopped_b = 0;
        }
    }
}

on envVar E_pric_RadarFrontCenter_TrajPointACCObj2_TrajPointACCObj2_Stopped_b_Vt
{
    qword rawValue = 0ll;
    if(getValue(E_pric_RadarFrontCenter_TrajPointACCObj2_TrajPointACCObj2_Stopped_b_SetVt))
    {
        //update the signal value
        Msg_TrajPointACCObj2.TrajPointACCObj2_Stopped_b=getValue(this);
    }
}

on envVar E_pric_RadarFrontCenter_TrajPointACCObj2_TrajPointACCObj2_Stopped_b_SetVt
{
    if(getValue(E_pric_RadarFrontCenter_TrajPointACCObj2_TrajPointACCObj2_Stopped_b_SetVt))
    {
        //update the signal value
        Msg_TrajPointACCObj2.TrajPointACCObj2_Stopped_b=getvalue(E_pric_RadarFrontCenter_TrajPointACCObj2_TrajPointACCObj2_Stopped_b_Vt);
    }
    else
    {
        Msg_TrajPointACCObj2.TrajPointACCObj2_Stopped_b=getValue(E_pric_RadarFrontCenter_TrajPointACCObj2_TrajPointACCObj2_Stopped_b_Rv);
    }
}
 
on envVar E_pric_RadarFrontCenter_TrajPointACCObj2_TrajPointACCObj2_Stand_b_Rv
{
    qword rawValue = 0ll;
    float rawValue_float = 0.0;
    float phyValue = 0.0;        

    //set the signal with updated raw value
    if(getValue(E_pric_RadarFrontCenter_TrajPointACCObj2_TrajPointACCObj2_Stand_b_SetVt)==0)
    {
        rawValue = getvalue(this);
        if(chgEv_TrajPointACCObj2_TrajPointACCObj2_Stand_b == 0)
        {
            //type conversion to float
            rawValue_float = rawValue;        
            // raw to physical conversion
            phyValue = ((rawValue_float *1)+(0));
            putValue(E_pric_RadarFrontCenter_TrajPointACCObj2_TrajPointACCObj2_Stand_b_Pv, phyValue);
            chgEv_TrajPointACCObj2_TrajPointACCObj2_Stand_b = 1;
        }
        else
        {
            chgEv_TrajPointACCObj2_TrajPointACCObj2_Stand_b = 0;
        }    
        //update the signal value
        Msg_TrajPointACCObj2.TrajPointACCObj2_Stand_b=rawValue;        
    }                                                                           
}

on envVar E_pric_RadarFrontCenter_TrajPointACCObj2_TrajPointACCObj2_Stand_b_Pv
{
    qword rawValue = 0ll;
    float phyValue = 0.0;
    
    //update the raw value with physical value 
    if(getValue(E_pric_RadarFrontCenter_TrajPointACCObj2_TrajPointACCObj2_Stand_b_SetVt)==0)
    {
        if(chgEv_TrajPointACCObj2_TrajPointACCObj2_Stand_b == 0)
        {
            phyValue = getvalue(this);
            // physical to raw conversion
            rawValue = ((phyValue -(0))/1);
            putValue(E_pric_RadarFrontCenter_TrajPointACCObj2_TrajPointACCObj2_Stand_b_Rv, rawValue);
            chgEv_TrajPointACCObj2_TrajPointACCObj2_Stand_b = 1;  
        }
        else
        {
            chgEv_TrajPointACCObj2_TrajPointACCObj2_Stand_b = 0;
        }
    }
}

on envVar E_pric_RadarFrontCenter_TrajPointACCObj2_TrajPointACCObj2_Stand_b_Vt
{
    qword rawValue = 0ll;
    if(getValue(E_pric_RadarFrontCenter_TrajPointACCObj2_TrajPointACCObj2_Stand_b_SetVt))
    {
        //update the signal value
        Msg_TrajPointACCObj2.TrajPointACCObj2_Stand_b=getValue(this);
    }
}

on envVar E_pric_RadarFrontCenter_TrajPointACCObj2_TrajPointACCObj2_Stand_b_SetVt
{
    if(getValue(E_pric_RadarFrontCenter_TrajPointACCObj2_TrajPointACCObj2_Stand_b_SetVt))
    {
        //update the signal value
        Msg_TrajPointACCObj2.TrajPointACCObj2_Stand_b=getvalue(E_pric_RadarFrontCenter_TrajPointACCObj2_TrajPointACCObj2_Stand_b_Vt);
    }
    else
    {
        Msg_TrajPointACCObj2.TrajPointACCObj2_Stand_b=getValue(E_pric_RadarFrontCenter_TrajPointACCObj2_TrajPointACCObj2_Stand_b_Rv);
    }
}
 
on envVar E_pric_RadarFrontCenter_TrajPointACCObj2_TrajPointACCObj2_dyv_sw_Rv
{
    qword rawValue = 0ll;
    float rawValue_float = 0.0;
    float phyValue = 0.0;        

    //set the signal with updated raw value
    {
        rawValue = getvalue(this);
        if(chgEv_TrajPointACCObj2_TrajPointACCObj2_dyv_sw == 0)
        {
            //type conversion to float
            rawValue_float = rawValue;        
            // raw to physical conversion
            phyValue = ((rawValue_float *0.0078125)+(0));
            putValue(E_pric_RadarFrontCenter_TrajPointACCObj2_TrajPointACCObj2_dyv_sw_Pv, phyValue);
            chgEv_TrajPointACCObj2_TrajPointACCObj2_dyv_sw = 1;
        }
        else
        {
            chgEv_TrajPointACCObj2_TrajPointACCObj2_dyv_sw = 0;
        }    
        //update the signal value
        Msg_TrajPointACCObj2.TrajPointACCObj2_dyv_sw=rawValue;        
    }                                                                           
}

on envVar E_pric_RadarFrontCenter_TrajPointACCObj2_TrajPointACCObj2_dyv_sw_Pv
{
    qword rawValue = 0ll;
    float phyValue = 0.0;
    
    //update the raw value with physical value 
    {
        if(chgEv_TrajPointACCObj2_TrajPointACCObj2_dyv_sw == 0)
        {
            phyValue = getvalue(this);
            // physical to raw conversion
            rawValue = ((phyValue -(0))/0.0078125);
            putValue(E_pric_RadarFrontCenter_TrajPointACCObj2_TrajPointACCObj2_dyv_sw_Rv, rawValue);
            chgEv_TrajPointACCObj2_TrajPointACCObj2_dyv_sw = 1;  
        }
        else
        {
            chgEv_TrajPointACCObj2_TrajPointACCObj2_dyv_sw = 0;
        }
    }
}


 
on envVar E_pric_RadarFrontCenter_TrajPointACCObj2_TrajPointACCObj2_dVarYv_uw_Rv
{
    qword rawValue = 0ll;
    float rawValue_float = 0.0;
    float phyValue = 0.0;        

    //set the signal with updated raw value
    {
        rawValue = getvalue(this);
        if(chgEv_TrajPointACCObj2_TrajPointACCObj2_dVarYv_uw == 0)
        {
            //type conversion to float
            rawValue_float = rawValue;        
            // raw to physical conversion
            phyValue = ((rawValue_float *0.00195313)+(0));
            putValue(E_pric_RadarFrontCenter_TrajPointACCObj2_TrajPointACCObj2_dVarYv_uw_Pv, phyValue);
            chgEv_TrajPointACCObj2_TrajPointACCObj2_dVarYv_uw = 1;
        }
        else
        {
            chgEv_TrajPointACCObj2_TrajPointACCObj2_dVarYv_uw = 0;
        }    
        //update the signal value
        Msg_TrajPointACCObj2.TrajPointACCObj2_dVarYv_uw=rawValue;        
    }                                                                           
}

on envVar E_pric_RadarFrontCenter_TrajPointACCObj2_TrajPointACCObj2_dVarYv_uw_Pv
{
    qword rawValue = 0ll;
    float phyValue = 0.0;
    
    //update the raw value with physical value 
    {
        if(chgEv_TrajPointACCObj2_TrajPointACCObj2_dVarYv_uw == 0)
        {
            phyValue = getvalue(this);
            // physical to raw conversion
            rawValue = ((phyValue -(0))/0.00195313);
            putValue(E_pric_RadarFrontCenter_TrajPointACCObj2_TrajPointACCObj2_dVarYv_uw_Rv, rawValue);
            chgEv_TrajPointACCObj2_TrajPointACCObj2_dVarYv_uw = 1;  
        }
        else
        {
            chgEv_TrajPointACCObj2_TrajPointACCObj2_dVarYv_uw = 0;
        }
    }
}


 
on envVar E_pric_RadarFrontCenter_TrajPointACCObj2_TrajPointACCObj2_dVarXv_uw_Rv
{
    qword rawValue = 0ll;
    float rawValue_float = 0.0;
    float phyValue = 0.0;        

    //set the signal with updated raw value
    {
        rawValue = getvalue(this);
        if(chgEv_TrajPointACCObj2_TrajPointACCObj2_dVarXv_uw == 0)
        {
            //type conversion to float
            rawValue_float = rawValue;        
            // raw to physical conversion
            phyValue = ((rawValue_float *0.00195313)+(0));
            putValue(E_pric_RadarFrontCenter_TrajPointACCObj2_TrajPointACCObj2_dVarXv_uw_Pv, phyValue);
            chgEv_TrajPointACCObj2_TrajPointACCObj2_dVarXv_uw = 1;
        }
        else
        {
            chgEv_TrajPointACCObj2_TrajPointACCObj2_dVarXv_uw = 0;
        }    
        //update the signal value
        Msg_TrajPointACCObj2.TrajPointACCObj2_dVarXv_uw=rawValue;        
    }                                                                           
}

on envVar E_pric_RadarFrontCenter_TrajPointACCObj2_TrajPointACCObj2_dVarXv_uw_Pv
{
    qword rawValue = 0ll;
    float phyValue = 0.0;
    
    //update the raw value with physical value 
    {
        if(chgEv_TrajPointACCObj2_TrajPointACCObj2_dVarXv_uw == 0)
        {
            phyValue = getvalue(this);
            // physical to raw conversion
            rawValue = ((phyValue -(0))/0.00195313);
            putValue(E_pric_RadarFrontCenter_TrajPointACCObj2_TrajPointACCObj2_dVarXv_uw_Rv, rawValue);
            chgEv_TrajPointACCObj2_TrajPointACCObj2_dVarXv_uw = 1;  
        }
        else
        {
            chgEv_TrajPointACCObj2_TrajPointACCObj2_dVarXv_uw = 0;
        }
    }
}


 
on envVar E_pric_RadarFrontCenter_TrajPointACCObj2_TrajPointACCObj2_TrajEnd_b_Rv
{
    qword rawValue = 0ll;
    float rawValue_float = 0.0;
    float phyValue = 0.0;        

    //set the signal with updated raw value
    if(getValue(E_pric_RadarFrontCenter_TrajPointACCObj2_TrajPointACCObj2_TrajEnd_b_SetVt)==0)
    {
        rawValue = getvalue(this);
        if(chgEv_TrajPointACCObj2_TrajPointACCObj2_TrajEnd_b == 0)
        {
            //type conversion to float
            rawValue_float = rawValue;        
            // raw to physical conversion
            phyValue = ((rawValue_float *1)+(0));
            putValue(E_pric_RadarFrontCenter_TrajPointACCObj2_TrajPointACCObj2_TrajEnd_b_Pv, phyValue);
            chgEv_TrajPointACCObj2_TrajPointACCObj2_TrajEnd_b = 1;
        }
        else
        {
            chgEv_TrajPointACCObj2_TrajPointACCObj2_TrajEnd_b = 0;
        }    
        //update the signal value
        Msg_TrajPointACCObj2.TrajPointACCObj2_TrajEnd_b=rawValue;        
    }                                                                           
}

on envVar E_pric_RadarFrontCenter_TrajPointACCObj2_TrajPointACCObj2_TrajEnd_b_Pv
{
    qword rawValue = 0ll;
    float phyValue = 0.0;
    
    //update the raw value with physical value 
    if(getValue(E_pric_RadarFrontCenter_TrajPointACCObj2_TrajPointACCObj2_TrajEnd_b_SetVt)==0)
    {
        if(chgEv_TrajPointACCObj2_TrajPointACCObj2_TrajEnd_b == 0)
        {
            phyValue = getvalue(this);
            // physical to raw conversion
            rawValue = ((phyValue -(0))/1);
            putValue(E_pric_RadarFrontCenter_TrajPointACCObj2_TrajPointACCObj2_TrajEnd_b_Rv, rawValue);
            chgEv_TrajPointACCObj2_TrajPointACCObj2_TrajEnd_b = 1;  
        }
        else
        {
            chgEv_TrajPointACCObj2_TrajPointACCObj2_TrajEnd_b = 0;
        }
    }
}

on envVar E_pric_RadarFrontCenter_TrajPointACCObj2_TrajPointACCObj2_TrajEnd_b_Vt
{
    qword rawValue = 0ll;
    if(getValue(E_pric_RadarFrontCenter_TrajPointACCObj2_TrajPointACCObj2_TrajEnd_b_SetVt))
    {
        //update the signal value
        Msg_TrajPointACCObj2.TrajPointACCObj2_TrajEnd_b=getValue(this);
    }
}

on envVar E_pric_RadarFrontCenter_TrajPointACCObj2_TrajPointACCObj2_TrajEnd_b_SetVt
{
    if(getValue(E_pric_RadarFrontCenter_TrajPointACCObj2_TrajPointACCObj2_TrajEnd_b_SetVt))
    {
        //update the signal value
        Msg_TrajPointACCObj2.TrajPointACCObj2_TrajEnd_b=getvalue(E_pric_RadarFrontCenter_TrajPointACCObj2_TrajPointACCObj2_TrajEnd_b_Vt);
    }
    else
    {
        Msg_TrajPointACCObj2.TrajPointACCObj2_TrajEnd_b=getValue(E_pric_RadarFrontCenter_TrajPointACCObj2_TrajPointACCObj2_TrajEnd_b_Rv);
    }
}
 
on envVar E_pric_RadarFrontCenter_TrajPointACCObj2_TrajPointACCObj2_Valid_b_Rv
{
    qword rawValue = 0ll;
    float rawValue_float = 0.0;
    float phyValue = 0.0;        

    //set the signal with updated raw value
    if(getValue(E_pric_RadarFrontCenter_TrajPointACCObj2_TrajPointACCObj2_Valid_b_SetVt)==0)
    {
        rawValue = getvalue(this);
        if(chgEv_TrajPointACCObj2_TrajPointACCObj2_Valid_b == 0)
        {
            //type conversion to float
            rawValue_float = rawValue;        
            // raw to physical conversion
            phyValue = ((rawValue_float *1)+(0));
            putValue(E_pric_RadarFrontCenter_TrajPointACCObj2_TrajPointACCObj2_Valid_b_Pv, phyValue);
            chgEv_TrajPointACCObj2_TrajPointACCObj2_Valid_b = 1;
        }
        else
        {
            chgEv_TrajPointACCObj2_TrajPointACCObj2_Valid_b = 0;
        }    
        //update the signal value
        Msg_TrajPointACCObj2.TrajPointACCObj2_Valid_b=rawValue;        
    }                                                                           
}

on envVar E_pric_RadarFrontCenter_TrajPointACCObj2_TrajPointACCObj2_Valid_b_Pv
{
    qword rawValue = 0ll;
    float phyValue = 0.0;
    
    //update the raw value with physical value 
    if(getValue(E_pric_RadarFrontCenter_TrajPointACCObj2_TrajPointACCObj2_Valid_b_SetVt)==0)
    {
        if(chgEv_TrajPointACCObj2_TrajPointACCObj2_Valid_b == 0)
        {
            phyValue = getvalue(this);
            // physical to raw conversion
            rawValue = ((phyValue -(0))/1);
            putValue(E_pric_RadarFrontCenter_TrajPointACCObj2_TrajPointACCObj2_Valid_b_Rv, rawValue);
            chgEv_TrajPointACCObj2_TrajPointACCObj2_Valid_b = 1;  
        }
        else
        {
            chgEv_TrajPointACCObj2_TrajPointACCObj2_Valid_b = 0;
        }
    }
}

on envVar E_pric_RadarFrontCenter_TrajPointACCObj2_TrajPointACCObj2_Valid_b_Vt
{
    qword rawValue = 0ll;
    if(getValue(E_pric_RadarFrontCenter_TrajPointACCObj2_TrajPointACCObj2_Valid_b_SetVt))
    {
        //update the signal value
        Msg_TrajPointACCObj2.TrajPointACCObj2_Valid_b=getValue(this);
    }
}

on envVar E_pric_RadarFrontCenter_TrajPointACCObj2_TrajPointACCObj2_Valid_b_SetVt
{
    if(getValue(E_pric_RadarFrontCenter_TrajPointACCObj2_TrajPointACCObj2_Valid_b_SetVt))
    {
        //update the signal value
        Msg_TrajPointACCObj2.TrajPointACCObj2_Valid_b=getvalue(E_pric_RadarFrontCenter_TrajPointACCObj2_TrajPointACCObj2_Valid_b_Vt);
    }
    else
    {
        Msg_TrajPointACCObj2.TrajPointACCObj2_Valid_b=getValue(E_pric_RadarFrontCenter_TrajPointACCObj2_TrajPointACCObj2_Valid_b_Rv);
    }
}
 
on envVar E_pric_RadarFrontCenter_TrajPointACCObj1_tx
{
    if(getValue(this))
    {       
        
        //update the BZ Signal
        if(TrajPointACCObj1_TrajPointACCObj1_blockCtr_wrongvalctr == 0)
        {
            update_TrajPointACCObj1_TrajPointACCObj1_blockCtr_counter();
            Msg_TrajPointACCObj1.TrajPointACCObj1_blockCtr= TrajPointACCObj1_TrajPointACCObj1_blockCtr_counter;
        }
        else if(TrajPointACCObj1_TrajPointACCObj1_blockCtr_wrongvalctr > 0)
        {
             TrajPointACCObj1_TrajPointACCObj1_blockCtr_wrongvalctr--;
              // if counter becomes zero, update panel controller to zero
             if(TrajPointACCObj1_TrajPointACCObj1_blockCtr_wrongvalctr == 0)
             {
                 putValue(E_pric_RadarFrontCenter_TrajPointACCObj1_TrajPointACCObj1_blockCtr_wrongvalctr,0);
             }
        }
        else
        {
            //do nothing
        }        
        //update the BZ Signal
        if(TrajPointACCObj1_TrajPointACCObj1_MsgCtr_wrongvalctr == 0)
        {
            update_TrajPointACCObj1_TrajPointACCObj1_MsgCtr_counter();
            Msg_TrajPointACCObj1.TrajPointACCObj1_MsgCtr= TrajPointACCObj1_TrajPointACCObj1_MsgCtr_counter;
        }
        else if(TrajPointACCObj1_TrajPointACCObj1_MsgCtr_wrongvalctr > 0)
        {
             TrajPointACCObj1_TrajPointACCObj1_MsgCtr_wrongvalctr--;
              // if counter becomes zero, update panel controller to zero
             if(TrajPointACCObj1_TrajPointACCObj1_MsgCtr_wrongvalctr == 0)
             {
                 putValue(E_pric_RadarFrontCenter_TrajPointACCObj1_TrajPointACCObj1_MsgCtr_wrongvalctr,0);
             }
        }
        else
        {
            //do nothing
        }        
        //calculate the CRC checksum
        update_TrajPointACCObj1_ChkSum_Checksum();

        output(Msg_TrajPointACCObj1);        
    }
}

on envVar E_pric_RadarFrontCenter_TrajPointACCObj1_Range
{
    qword rawstatus = 0ll;
    qword rawValue = 0ll;    
    
    rawstatus = getvalue(this);    
    // set all the signals with min raw /max raw /init raw
    switch (rawstatus) 
    {
     case(0) :
        rawValue= 0;
        putValue(E_pric_RadarFrontCenter_TrajPointACCObj1_TrajPointACCObj1_Stopped_b_Rv, rawValue);
        rawValue= -32768;
        putValue(E_pric_RadarFrontCenter_TrajPointACCObj1_TrajPointACCObj1_dyv_sw_Rv, rawValue);
        rawValue= 0;
        putValue(E_pric_RadarFrontCenter_TrajPointACCObj1_TrajPointACCObj1_Stand_b_Rv, rawValue);
        rawValue= 0;
        putValue(E_pric_RadarFrontCenter_TrajPointACCObj1_TrajPointACCObj1_Drive_b_Rv, rawValue);
        rawValue= 0;
        putValue(E_pric_RadarFrontCenter_TrajPointACCObj1_TrajPointACCObj1_InvDir_b_Rv, rawValue);
        rawValue= -32768;
        putValue(E_pric_RadarFrontCenter_TrajPointACCObj1_TrajPointACCObj1_dxv_sw_Rv, rawValue);
        rawValue= 0;
        putValue(E_pric_RadarFrontCenter_TrajPointACCObj1_TrajPointACCObj1_dVarXv_uw_Rv, rawValue);
        rawValue= 0;
        putValue(E_pric_RadarFrontCenter_TrajPointACCObj1_TrajPointACCObj1_Valid_b_Rv, rawValue);
        rawValue= 0;
        putValue(E_pric_RadarFrontCenter_TrajPointACCObj1_TrajPointACCObj1_dVarYv_uw_Rv, rawValue);
        rawValue= 0;
        putValue(E_pric_RadarFrontCenter_TrajPointACCObj1_TrajPointACCObj1_wExistProb_ub_Rv, rawValue);
        rawValue= 0;
        putValue(E_pric_RadarFrontCenter_TrajPointACCObj1_TrajPointACCObj1_TrajEnd_b_Rv, rawValue);
        rawValue= 0;
        putValue(E_pric_RadarFrontCenter_TrajPointACCObj1_TrajPointACCObj1_timestamp_Rv, rawValue);
        break;
     case(1) :
        rawValue= 1;
        putValue(E_pric_RadarFrontCenter_TrajPointACCObj1_TrajPointACCObj1_Stopped_b_Rv, rawValue);
        rawValue= 32767;
        putValue(E_pric_RadarFrontCenter_TrajPointACCObj1_TrajPointACCObj1_dyv_sw_Rv, rawValue);
        rawValue= 1;
        putValue(E_pric_RadarFrontCenter_TrajPointACCObj1_TrajPointACCObj1_Stand_b_Rv, rawValue);
        rawValue= 1;
        putValue(E_pric_RadarFrontCenter_TrajPointACCObj1_TrajPointACCObj1_Drive_b_Rv, rawValue);
        rawValue= 1;
        putValue(E_pric_RadarFrontCenter_TrajPointACCObj1_TrajPointACCObj1_InvDir_b_Rv, rawValue);
        rawValue= 32767;
        putValue(E_pric_RadarFrontCenter_TrajPointACCObj1_TrajPointACCObj1_dxv_sw_Rv, rawValue);
        rawValue= 65534;
        putValue(E_pric_RadarFrontCenter_TrajPointACCObj1_TrajPointACCObj1_dVarXv_uw_Rv, rawValue);
        rawValue= 1;
        putValue(E_pric_RadarFrontCenter_TrajPointACCObj1_TrajPointACCObj1_Valid_b_Rv, rawValue);
        rawValue= 65534;
        putValue(E_pric_RadarFrontCenter_TrajPointACCObj1_TrajPointACCObj1_dVarYv_uw_Rv, rawValue);
        rawValue= 255;
        putValue(E_pric_RadarFrontCenter_TrajPointACCObj1_TrajPointACCObj1_wExistProb_ub_Rv, rawValue);
        rawValue= 1;
        putValue(E_pric_RadarFrontCenter_TrajPointACCObj1_TrajPointACCObj1_TrajEnd_b_Rv, rawValue);
        rawValue= 65536;
        putValue(E_pric_RadarFrontCenter_TrajPointACCObj1_TrajPointACCObj1_timestamp_Rv, rawValue);
        break;
     default :
        rawValue= 0;
        putValue(E_pric_RadarFrontCenter_TrajPointACCObj1_TrajPointACCObj1_Stopped_b_Rv, rawValue);
        rawValue= -32768;
        putValue(E_pric_RadarFrontCenter_TrajPointACCObj1_TrajPointACCObj1_dyv_sw_Rv, rawValue);
        rawValue= 0;
        putValue(E_pric_RadarFrontCenter_TrajPointACCObj1_TrajPointACCObj1_Stand_b_Rv, rawValue);
        rawValue= 0;
        putValue(E_pric_RadarFrontCenter_TrajPointACCObj1_TrajPointACCObj1_Drive_b_Rv, rawValue);
        rawValue= 0;
        putValue(E_pric_RadarFrontCenter_TrajPointACCObj1_TrajPointACCObj1_InvDir_b_Rv, rawValue);
        rawValue= -32768;
        putValue(E_pric_RadarFrontCenter_TrajPointACCObj1_TrajPointACCObj1_dxv_sw_Rv, rawValue);
        rawValue= 0;
        putValue(E_pric_RadarFrontCenter_TrajPointACCObj1_TrajPointACCObj1_dVarXv_uw_Rv, rawValue);
        rawValue= 0;
        putValue(E_pric_RadarFrontCenter_TrajPointACCObj1_TrajPointACCObj1_Valid_b_Rv, rawValue);
        rawValue= 0;
        putValue(E_pric_RadarFrontCenter_TrajPointACCObj1_TrajPointACCObj1_dVarYv_uw_Rv, rawValue);
        rawValue= 0;
        putValue(E_pric_RadarFrontCenter_TrajPointACCObj1_TrajPointACCObj1_wExistProb_ub_Rv, rawValue);
        rawValue= 0;
        putValue(E_pric_RadarFrontCenter_TrajPointACCObj1_TrajPointACCObj1_TrajEnd_b_Rv, rawValue);
        rawValue= 0;
        putValue(E_pric_RadarFrontCenter_TrajPointACCObj1_TrajPointACCObj1_timestamp_Rv, rawValue);
      break;
   }
}

on envVar E_pric_RadarFrontCenter_TrajPointACCObj1_Dlc
{
    if(getValue(E_pric_RadarFrontCenter_TrajPointACCObj1_enDlc))
    {
        Msg_TrajPointACCObj1.dlc =getValue(this);
    }
    else
    {
       Dbc_dlc = 16;
	   Msg_TrajPointACCObj1.dlc = Calc_Canfd_dlc(Dbc_dlc);
	   	
  }
}

on envVar E_pric_RadarFrontCenter_TrajPointACCObj1_enDlc
{
    //For Messages with DLC = 8, set wrong DLC to smaller than defined DLC
    //For Messages with DLC < 8 set wrong DLC to smaller/longer than defined DLC
    if(getValue(this))
    {
        Msg_TrajPointACCObj1.dlc =getValue(E_pric_RadarFrontCenter_TrajPointACCObj1_Dlc);
    }
    else
    {
       Dbc_dlc = 16;
	   Msg_TrajPointACCObj1.dlc = Calc_Canfd_dlc(Dbc_dlc);
			
    }
}

on envVar E_pric_RadarFrontCenter_TrajPointACCObj1_TrajPointACCObj1_CRC_wrongvalctr
{
    //update disturb count
    //disturb value range:(-1 = always send wrong value),( X>0 ,x is the number of Messages with wrong CHK sent)
    TrajPointACCObj1_TrajPointACCObj1_CRC_wrongvalctr =getValue(this);    
}
on envVar E_pric_RadarFrontCenter_TrajPointACCObj1_TrajPointACCObj1_MsgCtr_wrongvalctr
{
    //update disturb count
    //disturb value range:(-1 = always send wrong value),( X>0 ,x is the number of Messages with wrong CHK sent)
    TrajPointACCObj1_TrajPointACCObj1_MsgCtr_wrongvalctr =getValue(this);    
}
on envVar E_pric_RadarFrontCenter_TrajPointACCObj1_TrajPointACCObj1_blockCtr_wrongvalctr
{
    //update disturb count
    //disturb value range:(-1 = always send wrong value),( X>0 ,x is the number of Messages with wrong CHK sent)
    TrajPointACCObj1_TrajPointACCObj1_blockCtr_wrongvalctr =getValue(this);    
}

on envVar E_pric_RadarFrontCenter_TrajPointACCObj1_TrajPointACCObj1_Stopped_b_Rv
{
    qword rawValue = 0ll;
    float rawValue_float = 0.0;
    float phyValue = 0.0;        

    //set the signal with updated raw value
    if(getValue(E_pric_RadarFrontCenter_TrajPointACCObj1_TrajPointACCObj1_Stopped_b_SetVt)==0)
    {
        rawValue = getvalue(this);
        if(chgEv_TrajPointACCObj1_TrajPointACCObj1_Stopped_b == 0)
        {
            //type conversion to float
            rawValue_float = rawValue;        
            // raw to physical conversion
            phyValue = ((rawValue_float *1)+(0));
            putValue(E_pric_RadarFrontCenter_TrajPointACCObj1_TrajPointACCObj1_Stopped_b_Pv, phyValue);
            chgEv_TrajPointACCObj1_TrajPointACCObj1_Stopped_b = 1;
        }
        else
        {
            chgEv_TrajPointACCObj1_TrajPointACCObj1_Stopped_b = 0;
        }    
        //update the signal value
        Msg_TrajPointACCObj1.TrajPointACCObj1_Stopped_b=rawValue;        
    }                                                                           
}

on envVar E_pric_RadarFrontCenter_TrajPointACCObj1_TrajPointACCObj1_Stopped_b_Pv
{
    qword rawValue = 0ll;
    float phyValue = 0.0;
    
    //update the raw value with physical value 
    if(getValue(E_pric_RadarFrontCenter_TrajPointACCObj1_TrajPointACCObj1_Stopped_b_SetVt)==0)
    {
        if(chgEv_TrajPointACCObj1_TrajPointACCObj1_Stopped_b == 0)
        {
            phyValue = getvalue(this);
            // physical to raw conversion
            rawValue = ((phyValue -(0))/1);
            putValue(E_pric_RadarFrontCenter_TrajPointACCObj1_TrajPointACCObj1_Stopped_b_Rv, rawValue);
            chgEv_TrajPointACCObj1_TrajPointACCObj1_Stopped_b = 1;  
        }
        else
        {
            chgEv_TrajPointACCObj1_TrajPointACCObj1_Stopped_b = 0;
        }
    }
}

on envVar E_pric_RadarFrontCenter_TrajPointACCObj1_TrajPointACCObj1_Stopped_b_Vt
{
    qword rawValue = 0ll;
    if(getValue(E_pric_RadarFrontCenter_TrajPointACCObj1_TrajPointACCObj1_Stopped_b_SetVt))
    {
        //update the signal value
        Msg_TrajPointACCObj1.TrajPointACCObj1_Stopped_b=getValue(this);
    }
}

on envVar E_pric_RadarFrontCenter_TrajPointACCObj1_TrajPointACCObj1_Stopped_b_SetVt
{
    if(getValue(E_pric_RadarFrontCenter_TrajPointACCObj1_TrajPointACCObj1_Stopped_b_SetVt))
    {
        //update the signal value
        Msg_TrajPointACCObj1.TrajPointACCObj1_Stopped_b=getvalue(E_pric_RadarFrontCenter_TrajPointACCObj1_TrajPointACCObj1_Stopped_b_Vt);
    }
    else
    {
        Msg_TrajPointACCObj1.TrajPointACCObj1_Stopped_b=getValue(E_pric_RadarFrontCenter_TrajPointACCObj1_TrajPointACCObj1_Stopped_b_Rv);
    }
}
 
on envVar E_pric_RadarFrontCenter_TrajPointACCObj1_TrajPointACCObj1_dyv_sw_Rv
{
    qword rawValue = 0ll;
    float rawValue_float = 0.0;
    float phyValue = 0.0;        

    //set the signal with updated raw value
    {
        rawValue = getvalue(this);
        if(chgEv_TrajPointACCObj1_TrajPointACCObj1_dyv_sw == 0)
        {
            //type conversion to float
            rawValue_float = rawValue;        
            // raw to physical conversion
            phyValue = ((rawValue_float *0.0078125)+(0));
            putValue(E_pric_RadarFrontCenter_TrajPointACCObj1_TrajPointACCObj1_dyv_sw_Pv, phyValue);
            chgEv_TrajPointACCObj1_TrajPointACCObj1_dyv_sw = 1;
        }
        else
        {
            chgEv_TrajPointACCObj1_TrajPointACCObj1_dyv_sw = 0;
        }    
        //update the signal value
        Msg_TrajPointACCObj1.TrajPointACCObj1_dyv_sw=rawValue;        
    }                                                                           
}

on envVar E_pric_RadarFrontCenter_TrajPointACCObj1_TrajPointACCObj1_dyv_sw_Pv
{
    qword rawValue = 0ll;
    float phyValue = 0.0;
    
    //update the raw value with physical value 
    {
        if(chgEv_TrajPointACCObj1_TrajPointACCObj1_dyv_sw == 0)
        {
            phyValue = getvalue(this);
            // physical to raw conversion
            rawValue = ((phyValue -(0))/0.0078125);
            putValue(E_pric_RadarFrontCenter_TrajPointACCObj1_TrajPointACCObj1_dyv_sw_Rv, rawValue);
            chgEv_TrajPointACCObj1_TrajPointACCObj1_dyv_sw = 1;  
        }
        else
        {
            chgEv_TrajPointACCObj1_TrajPointACCObj1_dyv_sw = 0;
        }
    }
}


 
on envVar E_pric_RadarFrontCenter_TrajPointACCObj1_TrajPointACCObj1_Stand_b_Rv
{
    qword rawValue = 0ll;
    float rawValue_float = 0.0;
    float phyValue = 0.0;        

    //set the signal with updated raw value
    if(getValue(E_pric_RadarFrontCenter_TrajPointACCObj1_TrajPointACCObj1_Stand_b_SetVt)==0)
    {
        rawValue = getvalue(this);
        if(chgEv_TrajPointACCObj1_TrajPointACCObj1_Stand_b == 0)
        {
            //type conversion to float
            rawValue_float = rawValue;        
            // raw to physical conversion
            phyValue = ((rawValue_float *1)+(0));
            putValue(E_pric_RadarFrontCenter_TrajPointACCObj1_TrajPointACCObj1_Stand_b_Pv, phyValue);
            chgEv_TrajPointACCObj1_TrajPointACCObj1_Stand_b = 1;
        }
        else
        {
            chgEv_TrajPointACCObj1_TrajPointACCObj1_Stand_b = 0;
        }    
        //update the signal value
        Msg_TrajPointACCObj1.TrajPointACCObj1_Stand_b=rawValue;        
    }                                                                           
}

on envVar E_pric_RadarFrontCenter_TrajPointACCObj1_TrajPointACCObj1_Stand_b_Pv
{
    qword rawValue = 0ll;
    float phyValue = 0.0;
    
    //update the raw value with physical value 
    if(getValue(E_pric_RadarFrontCenter_TrajPointACCObj1_TrajPointACCObj1_Stand_b_SetVt)==0)
    {
        if(chgEv_TrajPointACCObj1_TrajPointACCObj1_Stand_b == 0)
        {
            phyValue = getvalue(this);
            // physical to raw conversion
            rawValue = ((phyValue -(0))/1);
            putValue(E_pric_RadarFrontCenter_TrajPointACCObj1_TrajPointACCObj1_Stand_b_Rv, rawValue);
            chgEv_TrajPointACCObj1_TrajPointACCObj1_Stand_b = 1;  
        }
        else
        {
            chgEv_TrajPointACCObj1_TrajPointACCObj1_Stand_b = 0;
        }
    }
}

on envVar E_pric_RadarFrontCenter_TrajPointACCObj1_TrajPointACCObj1_Stand_b_Vt
{
    qword rawValue = 0ll;
    if(getValue(E_pric_RadarFrontCenter_TrajPointACCObj1_TrajPointACCObj1_Stand_b_SetVt))
    {
        //update the signal value
        Msg_TrajPointACCObj1.TrajPointACCObj1_Stand_b=getValue(this);
    }
}

on envVar E_pric_RadarFrontCenter_TrajPointACCObj1_TrajPointACCObj1_Stand_b_SetVt
{
    if(getValue(E_pric_RadarFrontCenter_TrajPointACCObj1_TrajPointACCObj1_Stand_b_SetVt))
    {
        //update the signal value
        Msg_TrajPointACCObj1.TrajPointACCObj1_Stand_b=getvalue(E_pric_RadarFrontCenter_TrajPointACCObj1_TrajPointACCObj1_Stand_b_Vt);
    }
    else
    {
        Msg_TrajPointACCObj1.TrajPointACCObj1_Stand_b=getValue(E_pric_RadarFrontCenter_TrajPointACCObj1_TrajPointACCObj1_Stand_b_Rv);
    }
}
 
on envVar E_pric_RadarFrontCenter_TrajPointACCObj1_TrajPointACCObj1_Drive_b_Rv
{
    qword rawValue = 0ll;
    float rawValue_float = 0.0;
    float phyValue = 0.0;        

    //set the signal with updated raw value
    if(getValue(E_pric_RadarFrontCenter_TrajPointACCObj1_TrajPointACCObj1_Drive_b_SetVt)==0)
    {
        rawValue = getvalue(this);
        if(chgEv_TrajPointACCObj1_TrajPointACCObj1_Drive_b == 0)
        {
            //type conversion to float
            rawValue_float = rawValue;        
            // raw to physical conversion
            phyValue = ((rawValue_float *1)+(0));
            putValue(E_pric_RadarFrontCenter_TrajPointACCObj1_TrajPointACCObj1_Drive_b_Pv, phyValue);
            chgEv_TrajPointACCObj1_TrajPointACCObj1_Drive_b = 1;
        }
        else
        {
            chgEv_TrajPointACCObj1_TrajPointACCObj1_Drive_b = 0;
        }    
        //update the signal value
        Msg_TrajPointACCObj1.TrajPointACCObj1_Drive_b=rawValue;        
    }                                                                           
}

on envVar E_pric_RadarFrontCenter_TrajPointACCObj1_TrajPointACCObj1_Drive_b_Pv
{
    qword rawValue = 0ll;
    float phyValue = 0.0;
    
    //update the raw value with physical value 
    if(getValue(E_pric_RadarFrontCenter_TrajPointACCObj1_TrajPointACCObj1_Drive_b_SetVt)==0)
    {
        if(chgEv_TrajPointACCObj1_TrajPointACCObj1_Drive_b == 0)
        {
            phyValue = getvalue(this);
            // physical to raw conversion
            rawValue = ((phyValue -(0))/1);
            putValue(E_pric_RadarFrontCenter_TrajPointACCObj1_TrajPointACCObj1_Drive_b_Rv, rawValue);
            chgEv_TrajPointACCObj1_TrajPointACCObj1_Drive_b = 1;  
        }
        else
        {
            chgEv_TrajPointACCObj1_TrajPointACCObj1_Drive_b = 0;
        }
    }
}

on envVar E_pric_RadarFrontCenter_TrajPointACCObj1_TrajPointACCObj1_Drive_b_Vt
{
    qword rawValue = 0ll;
    if(getValue(E_pric_RadarFrontCenter_TrajPointACCObj1_TrajPointACCObj1_Drive_b_SetVt))
    {
        //update the signal value
        Msg_TrajPointACCObj1.TrajPointACCObj1_Drive_b=getValue(this);
    }
}

on envVar E_pric_RadarFrontCenter_TrajPointACCObj1_TrajPointACCObj1_Drive_b_SetVt
{
    if(getValue(E_pric_RadarFrontCenter_TrajPointACCObj1_TrajPointACCObj1_Drive_b_SetVt))
    {
        //update the signal value
        Msg_TrajPointACCObj1.TrajPointACCObj1_Drive_b=getvalue(E_pric_RadarFrontCenter_TrajPointACCObj1_TrajPointACCObj1_Drive_b_Vt);
    }
    else
    {
        Msg_TrajPointACCObj1.TrajPointACCObj1_Drive_b=getValue(E_pric_RadarFrontCenter_TrajPointACCObj1_TrajPointACCObj1_Drive_b_Rv);
    }
}
 
on envVar E_pric_RadarFrontCenter_TrajPointACCObj1_TrajPointACCObj1_InvDir_b_Rv
{
    qword rawValue = 0ll;
    float rawValue_float = 0.0;
    float phyValue = 0.0;        

    //set the signal with updated raw value
    if(getValue(E_pric_RadarFrontCenter_TrajPointACCObj1_TrajPointACCObj1_InvDir_b_SetVt)==0)
    {
        rawValue = getvalue(this);
        if(chgEv_TrajPointACCObj1_TrajPointACCObj1_InvDir_b == 0)
        {
            //type conversion to float
            rawValue_float = rawValue;        
            // raw to physical conversion
            phyValue = ((rawValue_float *1)+(0));
            putValue(E_pric_RadarFrontCenter_TrajPointACCObj1_TrajPointACCObj1_InvDir_b_Pv, phyValue);
            chgEv_TrajPointACCObj1_TrajPointACCObj1_InvDir_b = 1;
        }
        else
        {
            chgEv_TrajPointACCObj1_TrajPointACCObj1_InvDir_b = 0;
        }    
        //update the signal value
        Msg_TrajPointACCObj1.TrajPointACCObj1_InvDir_b=rawValue;        
    }                                                                           
}

on envVar E_pric_RadarFrontCenter_TrajPointACCObj1_TrajPointACCObj1_InvDir_b_Pv
{
    qword rawValue = 0ll;
    float phyValue = 0.0;
    
    //update the raw value with physical value 
    if(getValue(E_pric_RadarFrontCenter_TrajPointACCObj1_TrajPointACCObj1_InvDir_b_SetVt)==0)
    {
        if(chgEv_TrajPointACCObj1_TrajPointACCObj1_InvDir_b == 0)
        {
            phyValue = getvalue(this);
            // physical to raw conversion
            rawValue = ((phyValue -(0))/1);
            putValue(E_pric_RadarFrontCenter_TrajPointACCObj1_TrajPointACCObj1_InvDir_b_Rv, rawValue);
            chgEv_TrajPointACCObj1_TrajPointACCObj1_InvDir_b = 1;  
        }
        else
        {
            chgEv_TrajPointACCObj1_TrajPointACCObj1_InvDir_b = 0;
        }
    }
}

on envVar E_pric_RadarFrontCenter_TrajPointACCObj1_TrajPointACCObj1_InvDir_b_Vt
{
    qword rawValue = 0ll;
    if(getValue(E_pric_RadarFrontCenter_TrajPointACCObj1_TrajPointACCObj1_InvDir_b_SetVt))
    {
        //update the signal value
        Msg_TrajPointACCObj1.TrajPointACCObj1_InvDir_b=getValue(this);
    }
}

on envVar E_pric_RadarFrontCenter_TrajPointACCObj1_TrajPointACCObj1_InvDir_b_SetVt
{
    if(getValue(E_pric_RadarFrontCenter_TrajPointACCObj1_TrajPointACCObj1_InvDir_b_SetVt))
    {
        //update the signal value
        Msg_TrajPointACCObj1.TrajPointACCObj1_InvDir_b=getvalue(E_pric_RadarFrontCenter_TrajPointACCObj1_TrajPointACCObj1_InvDir_b_Vt);
    }
    else
    {
        Msg_TrajPointACCObj1.TrajPointACCObj1_InvDir_b=getValue(E_pric_RadarFrontCenter_TrajPointACCObj1_TrajPointACCObj1_InvDir_b_Rv);
    }
}
 
on envVar E_pric_RadarFrontCenter_TrajPointACCObj1_TrajPointACCObj1_dxv_sw_Rv
{
    qword rawValue = 0ll;
    float rawValue_float = 0.0;
    float phyValue = 0.0;        

    //set the signal with updated raw value
    {
        rawValue = getvalue(this);
        if(chgEv_TrajPointACCObj1_TrajPointACCObj1_dxv_sw == 0)
        {
            //type conversion to float
            rawValue_float = rawValue;        
            // raw to physical conversion
            phyValue = ((rawValue_float *0.0078125)+(0));
            putValue(E_pric_RadarFrontCenter_TrajPointACCObj1_TrajPointACCObj1_dxv_sw_Pv, phyValue);
            chgEv_TrajPointACCObj1_TrajPointACCObj1_dxv_sw = 1;
        }
        else
        {
            chgEv_TrajPointACCObj1_TrajPointACCObj1_dxv_sw = 0;
        }    
        //update the signal value
        Msg_TrajPointACCObj1.TrajPointACCObj1_dxv_sw=rawValue;        
    }                                                                           
}

on envVar E_pric_RadarFrontCenter_TrajPointACCObj1_TrajPointACCObj1_dxv_sw_Pv
{
    qword rawValue = 0ll;
    float phyValue = 0.0;
    
    //update the raw value with physical value 
    {
        if(chgEv_TrajPointACCObj1_TrajPointACCObj1_dxv_sw == 0)
        {
            phyValue = getvalue(this);
            // physical to raw conversion
            rawValue = ((phyValue -(0))/0.0078125);
            putValue(E_pric_RadarFrontCenter_TrajPointACCObj1_TrajPointACCObj1_dxv_sw_Rv, rawValue);
            chgEv_TrajPointACCObj1_TrajPointACCObj1_dxv_sw = 1;  
        }
        else
        {
            chgEv_TrajPointACCObj1_TrajPointACCObj1_dxv_sw = 0;
        }
    }
}


 
on envVar E_pric_RadarFrontCenter_TrajPointACCObj1_TrajPointACCObj1_dVarXv_uw_Rv
{
    qword rawValue = 0ll;
    float rawValue_float = 0.0;
    float phyValue = 0.0;        

    //set the signal with updated raw value
    {
        rawValue = getvalue(this);
        if(chgEv_TrajPointACCObj1_TrajPointACCObj1_dVarXv_uw == 0)
        {
            //type conversion to float
            rawValue_float = rawValue;        
            // raw to physical conversion
            phyValue = ((rawValue_float *0.00195313)+(0));
            putValue(E_pric_RadarFrontCenter_TrajPointACCObj1_TrajPointACCObj1_dVarXv_uw_Pv, phyValue);
            chgEv_TrajPointACCObj1_TrajPointACCObj1_dVarXv_uw = 1;
        }
        else
        {
            chgEv_TrajPointACCObj1_TrajPointACCObj1_dVarXv_uw = 0;
        }    
        //update the signal value
        Msg_TrajPointACCObj1.TrajPointACCObj1_dVarXv_uw=rawValue;        
    }                                                                           
}

on envVar E_pric_RadarFrontCenter_TrajPointACCObj1_TrajPointACCObj1_dVarXv_uw_Pv
{
    qword rawValue = 0ll;
    float phyValue = 0.0;
    
    //update the raw value with physical value 
    {
        if(chgEv_TrajPointACCObj1_TrajPointACCObj1_dVarXv_uw == 0)
        {
            phyValue = getvalue(this);
            // physical to raw conversion
            rawValue = ((phyValue -(0))/0.00195313);
            putValue(E_pric_RadarFrontCenter_TrajPointACCObj1_TrajPointACCObj1_dVarXv_uw_Rv, rawValue);
            chgEv_TrajPointACCObj1_TrajPointACCObj1_dVarXv_uw = 1;  
        }
        else
        {
            chgEv_TrajPointACCObj1_TrajPointACCObj1_dVarXv_uw = 0;
        }
    }
}


 
on envVar E_pric_RadarFrontCenter_TrajPointACCObj1_TrajPointACCObj1_Valid_b_Rv
{
    qword rawValue = 0ll;
    float rawValue_float = 0.0;
    float phyValue = 0.0;        

    //set the signal with updated raw value
    if(getValue(E_pric_RadarFrontCenter_TrajPointACCObj1_TrajPointACCObj1_Valid_b_SetVt)==0)
    {
        rawValue = getvalue(this);
        if(chgEv_TrajPointACCObj1_TrajPointACCObj1_Valid_b == 0)
        {
            //type conversion to float
            rawValue_float = rawValue;        
            // raw to physical conversion
            phyValue = ((rawValue_float *1)+(0));
            putValue(E_pric_RadarFrontCenter_TrajPointACCObj1_TrajPointACCObj1_Valid_b_Pv, phyValue);
            chgEv_TrajPointACCObj1_TrajPointACCObj1_Valid_b = 1;
        }
        else
        {
            chgEv_TrajPointACCObj1_TrajPointACCObj1_Valid_b = 0;
        }    
        //update the signal value
        Msg_TrajPointACCObj1.TrajPointACCObj1_Valid_b=rawValue;        
    }                                                                           
}

on envVar E_pric_RadarFrontCenter_TrajPointACCObj1_TrajPointACCObj1_Valid_b_Pv
{
    qword rawValue = 0ll;
    float phyValue = 0.0;
    
    //update the raw value with physical value 
    if(getValue(E_pric_RadarFrontCenter_TrajPointACCObj1_TrajPointACCObj1_Valid_b_SetVt)==0)
    {
        if(chgEv_TrajPointACCObj1_TrajPointACCObj1_Valid_b == 0)
        {
            phyValue = getvalue(this);
            // physical to raw conversion
            rawValue = ((phyValue -(0))/1);
            putValue(E_pric_RadarFrontCenter_TrajPointACCObj1_TrajPointACCObj1_Valid_b_Rv, rawValue);
            chgEv_TrajPointACCObj1_TrajPointACCObj1_Valid_b = 1;  
        }
        else
        {
            chgEv_TrajPointACCObj1_TrajPointACCObj1_Valid_b = 0;
        }
    }
}

on envVar E_pric_RadarFrontCenter_TrajPointACCObj1_TrajPointACCObj1_Valid_b_Vt
{
    qword rawValue = 0ll;
    if(getValue(E_pric_RadarFrontCenter_TrajPointACCObj1_TrajPointACCObj1_Valid_b_SetVt))
    {
        //update the signal value
        Msg_TrajPointACCObj1.TrajPointACCObj1_Valid_b=getValue(this);
    }
}

on envVar E_pric_RadarFrontCenter_TrajPointACCObj1_TrajPointACCObj1_Valid_b_SetVt
{
    if(getValue(E_pric_RadarFrontCenter_TrajPointACCObj1_TrajPointACCObj1_Valid_b_SetVt))
    {
        //update the signal value
        Msg_TrajPointACCObj1.TrajPointACCObj1_Valid_b=getvalue(E_pric_RadarFrontCenter_TrajPointACCObj1_TrajPointACCObj1_Valid_b_Vt);
    }
    else
    {
        Msg_TrajPointACCObj1.TrajPointACCObj1_Valid_b=getValue(E_pric_RadarFrontCenter_TrajPointACCObj1_TrajPointACCObj1_Valid_b_Rv);
    }
}
 
on envVar E_pric_RadarFrontCenter_TrajPointACCObj1_TrajPointACCObj1_dVarYv_uw_Rv
{
    qword rawValue = 0ll;
    float rawValue_float = 0.0;
    float phyValue = 0.0;        

    //set the signal with updated raw value
    {
        rawValue = getvalue(this);
        if(chgEv_TrajPointACCObj1_TrajPointACCObj1_dVarYv_uw == 0)
        {
            //type conversion to float
            rawValue_float = rawValue;        
            // raw to physical conversion
            phyValue = ((rawValue_float *0.00195313)+(0));
            putValue(E_pric_RadarFrontCenter_TrajPointACCObj1_TrajPointACCObj1_dVarYv_uw_Pv, phyValue);
            chgEv_TrajPointACCObj1_TrajPointACCObj1_dVarYv_uw = 1;
        }
        else
        {
            chgEv_TrajPointACCObj1_TrajPointACCObj1_dVarYv_uw = 0;
        }    
        //update the signal value
        Msg_TrajPointACCObj1.TrajPointACCObj1_dVarYv_uw=rawValue;        
    }                                                                           
}

on envVar E_pric_RadarFrontCenter_TrajPointACCObj1_TrajPointACCObj1_dVarYv_uw_Pv
{
    qword rawValue = 0ll;
    float phyValue = 0.0;
    
    //update the raw value with physical value 
    {
        if(chgEv_TrajPointACCObj1_TrajPointACCObj1_dVarYv_uw == 0)
        {
            phyValue = getvalue(this);
            // physical to raw conversion
            rawValue = ((phyValue -(0))/0.00195313);
            putValue(E_pric_RadarFrontCenter_TrajPointACCObj1_TrajPointACCObj1_dVarYv_uw_Rv, rawValue);
            chgEv_TrajPointACCObj1_TrajPointACCObj1_dVarYv_uw = 1;  
        }
        else
        {
            chgEv_TrajPointACCObj1_TrajPointACCObj1_dVarYv_uw = 0;
        }
    }
}


 
on envVar E_pric_RadarFrontCenter_TrajPointACCObj1_TrajPointACCObj1_wExistProb_ub_Rv
{
    qword rawValue = 0ll;
    float rawValue_float = 0.0;
    float phyValue = 0.0;        

    //set the signal with updated raw value
    {
        rawValue = getvalue(this);
        if(chgEv_TrajPointACCObj1_TrajPointACCObj1_wExistProb_ub == 0)
        {
            //type conversion to float
            rawValue_float = rawValue;        
            // raw to physical conversion
            phyValue = ((rawValue_float *0.00390625)+(0));
            putValue(E_pric_RadarFrontCenter_TrajPointACCObj1_TrajPointACCObj1_wExistProb_ub_Pv, phyValue);
            chgEv_TrajPointACCObj1_TrajPointACCObj1_wExistProb_ub = 1;
        }
        else
        {
            chgEv_TrajPointACCObj1_TrajPointACCObj1_wExistProb_ub = 0;
        }    
        //update the signal value
        Msg_TrajPointACCObj1.TrajPointACCObj1_wExistProb_ub=rawValue;        
    }                                                                           
}

on envVar E_pric_RadarFrontCenter_TrajPointACCObj1_TrajPointACCObj1_wExistProb_ub_Pv
{
    qword rawValue = 0ll;
    float phyValue = 0.0;
    
    //update the raw value with physical value 
    {
        if(chgEv_TrajPointACCObj1_TrajPointACCObj1_wExistProb_ub == 0)
        {
            phyValue = getvalue(this);
            // physical to raw conversion
            rawValue = ((phyValue -(0))/0.00390625);
            putValue(E_pric_RadarFrontCenter_TrajPointACCObj1_TrajPointACCObj1_wExistProb_ub_Rv, rawValue);
            chgEv_TrajPointACCObj1_TrajPointACCObj1_wExistProb_ub = 1;  
        }
        else
        {
            chgEv_TrajPointACCObj1_TrajPointACCObj1_wExistProb_ub = 0;
        }
    }
}


 
on envVar E_pric_RadarFrontCenter_TrajPointACCObj1_TrajPointACCObj1_TrajEnd_b_Rv
{
    qword rawValue = 0ll;
    float rawValue_float = 0.0;
    float phyValue = 0.0;        

    //set the signal with updated raw value
    if(getValue(E_pric_RadarFrontCenter_TrajPointACCObj1_TrajPointACCObj1_TrajEnd_b_SetVt)==0)
    {
        rawValue = getvalue(this);
        if(chgEv_TrajPointACCObj1_TrajPointACCObj1_TrajEnd_b == 0)
        {
            //type conversion to float
            rawValue_float = rawValue;        
            // raw to physical conversion
            phyValue = ((rawValue_float *1)+(0));
            putValue(E_pric_RadarFrontCenter_TrajPointACCObj1_TrajPointACCObj1_TrajEnd_b_Pv, phyValue);
            chgEv_TrajPointACCObj1_TrajPointACCObj1_TrajEnd_b = 1;
        }
        else
        {
            chgEv_TrajPointACCObj1_TrajPointACCObj1_TrajEnd_b = 0;
        }    
        //update the signal value
        Msg_TrajPointACCObj1.TrajPointACCObj1_TrajEnd_b=rawValue;        
    }                                                                           
}

on envVar E_pric_RadarFrontCenter_TrajPointACCObj1_TrajPointACCObj1_TrajEnd_b_Pv
{
    qword rawValue = 0ll;
    float phyValue = 0.0;
    
    //update the raw value with physical value 
    if(getValue(E_pric_RadarFrontCenter_TrajPointACCObj1_TrajPointACCObj1_TrajEnd_b_SetVt)==0)
    {
        if(chgEv_TrajPointACCObj1_TrajPointACCObj1_TrajEnd_b == 0)
        {
            phyValue = getvalue(this);
            // physical to raw conversion
            rawValue = ((phyValue -(0))/1);
            putValue(E_pric_RadarFrontCenter_TrajPointACCObj1_TrajPointACCObj1_TrajEnd_b_Rv, rawValue);
            chgEv_TrajPointACCObj1_TrajPointACCObj1_TrajEnd_b = 1;  
        }
        else
        {
            chgEv_TrajPointACCObj1_TrajPointACCObj1_TrajEnd_b = 0;
        }
    }
}

on envVar E_pric_RadarFrontCenter_TrajPointACCObj1_TrajPointACCObj1_TrajEnd_b_Vt
{
    qword rawValue = 0ll;
    if(getValue(E_pric_RadarFrontCenter_TrajPointACCObj1_TrajPointACCObj1_TrajEnd_b_SetVt))
    {
        //update the signal value
        Msg_TrajPointACCObj1.TrajPointACCObj1_TrajEnd_b=getValue(this);
    }
}

on envVar E_pric_RadarFrontCenter_TrajPointACCObj1_TrajPointACCObj1_TrajEnd_b_SetVt
{
    if(getValue(E_pric_RadarFrontCenter_TrajPointACCObj1_TrajPointACCObj1_TrajEnd_b_SetVt))
    {
        //update the signal value
        Msg_TrajPointACCObj1.TrajPointACCObj1_TrajEnd_b=getvalue(E_pric_RadarFrontCenter_TrajPointACCObj1_TrajPointACCObj1_TrajEnd_b_Vt);
    }
    else
    {
        Msg_TrajPointACCObj1.TrajPointACCObj1_TrajEnd_b=getValue(E_pric_RadarFrontCenter_TrajPointACCObj1_TrajPointACCObj1_TrajEnd_b_Rv);
    }
}
 
on envVar E_pric_RadarFrontCenter_TrajPointACCObj1_TrajPointACCObj1_timestamp_Rv
{
    qword rawValue = 0ll;
    float rawValue_float = 0.0;
    float phyValue = 0.0;        

    //set the signal with updated raw value
    {
        rawValue = getvalue(this);
        if(chgEv_TrajPointACCObj1_TrajPointACCObj1_timestamp == 0)
        {
            //type conversion to float
            rawValue_float = rawValue;        
            // raw to physical conversion
            phyValue = ((rawValue_float *0.000488281)+(0));
            putValue(E_pric_RadarFrontCenter_TrajPointACCObj1_TrajPointACCObj1_timestamp_Pv, phyValue);
            chgEv_TrajPointACCObj1_TrajPointACCObj1_timestamp = 1;
        }
        else
        {
            chgEv_TrajPointACCObj1_TrajPointACCObj1_timestamp = 0;
        }    
        //update the signal value
        Msg_TrajPointACCObj1.TrajPointACCObj1_timestamp=rawValue;        
    }                                                                           
}

on envVar E_pric_RadarFrontCenter_TrajPointACCObj1_TrajPointACCObj1_timestamp_Pv
{
    qword rawValue = 0ll;
    float phyValue = 0.0;
    
    //update the raw value with physical value 
    {
        if(chgEv_TrajPointACCObj1_TrajPointACCObj1_timestamp == 0)
        {
            phyValue = getvalue(this);
            // physical to raw conversion
            rawValue = ((phyValue -(0))/0.000488281);
            putValue(E_pric_RadarFrontCenter_TrajPointACCObj1_TrajPointACCObj1_timestamp_Rv, rawValue);
            chgEv_TrajPointACCObj1_TrajPointACCObj1_timestamp = 1;  
        }
        else
        {
            chgEv_TrajPointACCObj1_TrajPointACCObj1_timestamp = 0;
        }
    }
}


 
on envVar E_pric_RadarFrontCenter_TrajPointACCObj0_tx
{
    if(getValue(this))
    {       
        
        //update the BZ Signal
        if(TrajPointACCObj0_TrajPointACCObj0_blockCtr_wrongvalctr == 0)
        {
            update_TrajPointACCObj0_TrajPointACCObj0_blockCtr_counter();
            Msg_TrajPointACCObj0.TrajPointACCObj0_blockCtr= TrajPointACCObj0_TrajPointACCObj0_blockCtr_counter;
        }
        else if(TrajPointACCObj0_TrajPointACCObj0_blockCtr_wrongvalctr > 0)
        {
             TrajPointACCObj0_TrajPointACCObj0_blockCtr_wrongvalctr--;
              // if counter becomes zero, update panel controller to zero
             if(TrajPointACCObj0_TrajPointACCObj0_blockCtr_wrongvalctr == 0)
             {
                 putValue(E_pric_RadarFrontCenter_TrajPointACCObj0_TrajPointACCObj0_blockCtr_wrongvalctr,0);
             }
        }
        else
        {
            //do nothing
        }        
        //update the BZ Signal
        if(TrajPointACCObj0_TrajPointACCObj0_MsgCtr_wrongvalctr == 0)
        {
            update_TrajPointACCObj0_TrajPointACCObj0_MsgCtr_counter();
            Msg_TrajPointACCObj0.TrajPointACCObj0_MsgCtr= TrajPointACCObj0_TrajPointACCObj0_MsgCtr_counter;
        }
        else if(TrajPointACCObj0_TrajPointACCObj0_MsgCtr_wrongvalctr > 0)
        {
             TrajPointACCObj0_TrajPointACCObj0_MsgCtr_wrongvalctr--;
              // if counter becomes zero, update panel controller to zero
             if(TrajPointACCObj0_TrajPointACCObj0_MsgCtr_wrongvalctr == 0)
             {
                 putValue(E_pric_RadarFrontCenter_TrajPointACCObj0_TrajPointACCObj0_MsgCtr_wrongvalctr,0);
             }
        }
        else
        {
            //do nothing
        }        
        //calculate the CRC checksum
        update_TrajPointACCObj0_ChkSum_Checksum();

        output(Msg_TrajPointACCObj0);        
    }
}

on envVar E_pric_RadarFrontCenter_TrajPointACCObj0_Range
{
    qword rawstatus = 0ll;
    qword rawValue = 0ll;    
    
    rawstatus = getvalue(this);    
    // set all the signals with min raw /max raw /init raw
    switch (rawstatus) 
    {
     case(0) :
        rawValue= 0;
        putValue(E_pric_RadarFrontCenter_TrajPointACCObj0_TrajPointACCObj0_timestamp_Rv, rawValue);
        rawValue= 0;
        putValue(E_pric_RadarFrontCenter_TrajPointACCObj0_TrajPointACCObj0_InvDir_b_Rv, rawValue);
        rawValue= 0;
        putValue(E_pric_RadarFrontCenter_TrajPointACCObj0_TrajPointACCObj0_Drive_b_Rv, rawValue);
        rawValue= 0;
        putValue(E_pric_RadarFrontCenter_TrajPointACCObj0_TrajPointACCObj0_TrajEnd_b_Rv, rawValue);
        rawValue= -32768;
        putValue(E_pric_RadarFrontCenter_TrajPointACCObj0_TrajPointACCObj0_dyv_sw_Rv, rawValue);
        rawValue= 0;
        putValue(E_pric_RadarFrontCenter_TrajPointACCObj0_TrajPointACCObj0_dVarYv_uw_Rv, rawValue);
        rawValue= 0;
        putValue(E_pric_RadarFrontCenter_TrajPointACCObj0_TrajPointACCObj0_Valid_b_Rv, rawValue);
        rawValue= 0;
        putValue(E_pric_RadarFrontCenter_TrajPointACCObj0_TrajPointACCObj0_wExistProb_ub_Rv, rawValue);
        rawValue= 0;
        putValue(E_pric_RadarFrontCenter_TrajPointACCObj0_TrajPointACCObj0_Stopped_b_Rv, rawValue);
        rawValue= 0;
        putValue(E_pric_RadarFrontCenter_TrajPointACCObj0_TrajPointACCObj0_Stand_b_Rv, rawValue);
        rawValue= -32768;
        putValue(E_pric_RadarFrontCenter_TrajPointACCObj0_TrajPointACCObj0_dxv_sw_Rv, rawValue);
        rawValue= 0;
        putValue(E_pric_RadarFrontCenter_TrajPointACCObj0_TrajPointACCObj0_dVarXv_uw_Rv, rawValue);
        break;
     case(1) :
        rawValue= 65536;
        putValue(E_pric_RadarFrontCenter_TrajPointACCObj0_TrajPointACCObj0_timestamp_Rv, rawValue);
        rawValue= 1;
        putValue(E_pric_RadarFrontCenter_TrajPointACCObj0_TrajPointACCObj0_InvDir_b_Rv, rawValue);
        rawValue= 1;
        putValue(E_pric_RadarFrontCenter_TrajPointACCObj0_TrajPointACCObj0_Drive_b_Rv, rawValue);
        rawValue= 1;
        putValue(E_pric_RadarFrontCenter_TrajPointACCObj0_TrajPointACCObj0_TrajEnd_b_Rv, rawValue);
        rawValue= 32767;
        putValue(E_pric_RadarFrontCenter_TrajPointACCObj0_TrajPointACCObj0_dyv_sw_Rv, rawValue);
        rawValue= 65534;
        putValue(E_pric_RadarFrontCenter_TrajPointACCObj0_TrajPointACCObj0_dVarYv_uw_Rv, rawValue);
        rawValue= 1;
        putValue(E_pric_RadarFrontCenter_TrajPointACCObj0_TrajPointACCObj0_Valid_b_Rv, rawValue);
        rawValue= 255;
        putValue(E_pric_RadarFrontCenter_TrajPointACCObj0_TrajPointACCObj0_wExistProb_ub_Rv, rawValue);
        rawValue= 1;
        putValue(E_pric_RadarFrontCenter_TrajPointACCObj0_TrajPointACCObj0_Stopped_b_Rv, rawValue);
        rawValue= 1;
        putValue(E_pric_RadarFrontCenter_TrajPointACCObj0_TrajPointACCObj0_Stand_b_Rv, rawValue);
        rawValue= 32767;
        putValue(E_pric_RadarFrontCenter_TrajPointACCObj0_TrajPointACCObj0_dxv_sw_Rv, rawValue);
        rawValue= 65534;
        putValue(E_pric_RadarFrontCenter_TrajPointACCObj0_TrajPointACCObj0_dVarXv_uw_Rv, rawValue);
        break;
     default :
        rawValue= 0;
        putValue(E_pric_RadarFrontCenter_TrajPointACCObj0_TrajPointACCObj0_timestamp_Rv, rawValue);
        rawValue= 0;
        putValue(E_pric_RadarFrontCenter_TrajPointACCObj0_TrajPointACCObj0_InvDir_b_Rv, rawValue);
        rawValue= 0;
        putValue(E_pric_RadarFrontCenter_TrajPointACCObj0_TrajPointACCObj0_Drive_b_Rv, rawValue);
        rawValue= 0;
        putValue(E_pric_RadarFrontCenter_TrajPointACCObj0_TrajPointACCObj0_TrajEnd_b_Rv, rawValue);
        rawValue= -32768;
        putValue(E_pric_RadarFrontCenter_TrajPointACCObj0_TrajPointACCObj0_dyv_sw_Rv, rawValue);
        rawValue= 0;
        putValue(E_pric_RadarFrontCenter_TrajPointACCObj0_TrajPointACCObj0_dVarYv_uw_Rv, rawValue);
        rawValue= 0;
        putValue(E_pric_RadarFrontCenter_TrajPointACCObj0_TrajPointACCObj0_Valid_b_Rv, rawValue);
        rawValue= 0;
        putValue(E_pric_RadarFrontCenter_TrajPointACCObj0_TrajPointACCObj0_wExistProb_ub_Rv, rawValue);
        rawValue= 0;
        putValue(E_pric_RadarFrontCenter_TrajPointACCObj0_TrajPointACCObj0_Stopped_b_Rv, rawValue);
        rawValue= 0;
        putValue(E_pric_RadarFrontCenter_TrajPointACCObj0_TrajPointACCObj0_Stand_b_Rv, rawValue);
        rawValue= -32768;
        putValue(E_pric_RadarFrontCenter_TrajPointACCObj0_TrajPointACCObj0_dxv_sw_Rv, rawValue);
        rawValue= 0;
        putValue(E_pric_RadarFrontCenter_TrajPointACCObj0_TrajPointACCObj0_dVarXv_uw_Rv, rawValue);
      break;
   }
}

on envVar E_pric_RadarFrontCenter_TrajPointACCObj0_Dlc
{
    if(getValue(E_pric_RadarFrontCenter_TrajPointACCObj0_enDlc))
    {
        Msg_TrajPointACCObj0.dlc =getValue(this);
    }
    else
    {
       Dbc_dlc = 16;
	   Msg_TrajPointACCObj0.dlc = Calc_Canfd_dlc(Dbc_dlc);
	   	
  }
}

on envVar E_pric_RadarFrontCenter_TrajPointACCObj0_enDlc
{
    //For Messages with DLC = 8, set wrong DLC to smaller than defined DLC
    //For Messages with DLC < 8 set wrong DLC to smaller/longer than defined DLC
    if(getValue(this))
    {
        Msg_TrajPointACCObj0.dlc =getValue(E_pric_RadarFrontCenter_TrajPointACCObj0_Dlc);
    }
    else
    {
       Dbc_dlc = 16;
	   Msg_TrajPointACCObj0.dlc = Calc_Canfd_dlc(Dbc_dlc);
			
    }
}

on envVar E_pric_RadarFrontCenter_TrajPointACCObj0_TrajPointACCObj0_CRC_wrongvalctr
{
    //update disturb count
    //disturb value range:(-1 = always send wrong value),( X>0 ,x is the number of Messages with wrong CHK sent)
    TrajPointACCObj0_TrajPointACCObj0_CRC_wrongvalctr =getValue(this);    
}
on envVar E_pric_RadarFrontCenter_TrajPointACCObj0_TrajPointACCObj0_MsgCtr_wrongvalctr
{
    //update disturb count
    //disturb value range:(-1 = always send wrong value),( X>0 ,x is the number of Messages with wrong CHK sent)
    TrajPointACCObj0_TrajPointACCObj0_MsgCtr_wrongvalctr =getValue(this);    
}
on envVar E_pric_RadarFrontCenter_TrajPointACCObj0_TrajPointACCObj0_blockCtr_wrongvalctr
{
    //update disturb count
    //disturb value range:(-1 = always send wrong value),( X>0 ,x is the number of Messages with wrong CHK sent)
    TrajPointACCObj0_TrajPointACCObj0_blockCtr_wrongvalctr =getValue(this);    
}

on envVar E_pric_RadarFrontCenter_TrajPointACCObj0_TrajPointACCObj0_timestamp_Rv
{
    qword rawValue = 0ll;
    float rawValue_float = 0.0;
    float phyValue = 0.0;        

    //set the signal with updated raw value
    {
        rawValue = getvalue(this);
        if(chgEv_TrajPointACCObj0_TrajPointACCObj0_timestamp == 0)
        {
            //type conversion to float
            rawValue_float = rawValue;        
            // raw to physical conversion
            phyValue = ((rawValue_float *0.000488281)+(0));
            putValue(E_pric_RadarFrontCenter_TrajPointACCObj0_TrajPointACCObj0_timestamp_Pv, phyValue);
            chgEv_TrajPointACCObj0_TrajPointACCObj0_timestamp = 1;
        }
        else
        {
            chgEv_TrajPointACCObj0_TrajPointACCObj0_timestamp = 0;
        }    
        //update the signal value
        Msg_TrajPointACCObj0.TrajPointACCObj0_timestamp=rawValue;        
    }                                                                           
}

on envVar E_pric_RadarFrontCenter_TrajPointACCObj0_TrajPointACCObj0_timestamp_Pv
{
    qword rawValue = 0ll;
    float phyValue = 0.0;
    
    //update the raw value with physical value 
    {
        if(chgEv_TrajPointACCObj0_TrajPointACCObj0_timestamp == 0)
        {
            phyValue = getvalue(this);
            // physical to raw conversion
            rawValue = ((phyValue -(0))/0.000488281);
            putValue(E_pric_RadarFrontCenter_TrajPointACCObj0_TrajPointACCObj0_timestamp_Rv, rawValue);
            chgEv_TrajPointACCObj0_TrajPointACCObj0_timestamp = 1;  
        }
        else
        {
            chgEv_TrajPointACCObj0_TrajPointACCObj0_timestamp = 0;
        }
    }
}


 
on envVar E_pric_RadarFrontCenter_TrajPointACCObj0_TrajPointACCObj0_InvDir_b_Rv
{
    qword rawValue = 0ll;
    float rawValue_float = 0.0;
    float phyValue = 0.0;        

    //set the signal with updated raw value
    if(getValue(E_pric_RadarFrontCenter_TrajPointACCObj0_TrajPointACCObj0_InvDir_b_SetVt)==0)
    {
        rawValue = getvalue(this);
        if(chgEv_TrajPointACCObj0_TrajPointACCObj0_InvDir_b == 0)
        {
            //type conversion to float
            rawValue_float = rawValue;        
            // raw to physical conversion
            phyValue = ((rawValue_float *1)+(0));
            putValue(E_pric_RadarFrontCenter_TrajPointACCObj0_TrajPointACCObj0_InvDir_b_Pv, phyValue);
            chgEv_TrajPointACCObj0_TrajPointACCObj0_InvDir_b = 1;
        }
        else
        {
            chgEv_TrajPointACCObj0_TrajPointACCObj0_InvDir_b = 0;
        }    
        //update the signal value
        Msg_TrajPointACCObj0.TrajPointACCObj0_InvDir_b=rawValue;        
    }                                                                           
}

on envVar E_pric_RadarFrontCenter_TrajPointACCObj0_TrajPointACCObj0_InvDir_b_Pv
{
    qword rawValue = 0ll;
    float phyValue = 0.0;
    
    //update the raw value with physical value 
    if(getValue(E_pric_RadarFrontCenter_TrajPointACCObj0_TrajPointACCObj0_InvDir_b_SetVt)==0)
    {
        if(chgEv_TrajPointACCObj0_TrajPointACCObj0_InvDir_b == 0)
        {
            phyValue = getvalue(this);
            // physical to raw conversion
            rawValue = ((phyValue -(0))/1);
            putValue(E_pric_RadarFrontCenter_TrajPointACCObj0_TrajPointACCObj0_InvDir_b_Rv, rawValue);
            chgEv_TrajPointACCObj0_TrajPointACCObj0_InvDir_b = 1;  
        }
        else
        {
            chgEv_TrajPointACCObj0_TrajPointACCObj0_InvDir_b = 0;
        }
    }
}

on envVar E_pric_RadarFrontCenter_TrajPointACCObj0_TrajPointACCObj0_InvDir_b_Vt
{
    qword rawValue = 0ll;
    if(getValue(E_pric_RadarFrontCenter_TrajPointACCObj0_TrajPointACCObj0_InvDir_b_SetVt))
    {
        //update the signal value
        Msg_TrajPointACCObj0.TrajPointACCObj0_InvDir_b=getValue(this);
    }
}

on envVar E_pric_RadarFrontCenter_TrajPointACCObj0_TrajPointACCObj0_InvDir_b_SetVt
{
    if(getValue(E_pric_RadarFrontCenter_TrajPointACCObj0_TrajPointACCObj0_InvDir_b_SetVt))
    {
        //update the signal value
        Msg_TrajPointACCObj0.TrajPointACCObj0_InvDir_b=getvalue(E_pric_RadarFrontCenter_TrajPointACCObj0_TrajPointACCObj0_InvDir_b_Vt);
    }
    else
    {
        Msg_TrajPointACCObj0.TrajPointACCObj0_InvDir_b=getValue(E_pric_RadarFrontCenter_TrajPointACCObj0_TrajPointACCObj0_InvDir_b_Rv);
    }
}
 
on envVar E_pric_RadarFrontCenter_TrajPointACCObj0_TrajPointACCObj0_Drive_b_Rv
{
    qword rawValue = 0ll;
    float rawValue_float = 0.0;
    float phyValue = 0.0;        

    //set the signal with updated raw value
    if(getValue(E_pric_RadarFrontCenter_TrajPointACCObj0_TrajPointACCObj0_Drive_b_SetVt)==0)
    {
        rawValue = getvalue(this);
        if(chgEv_TrajPointACCObj0_TrajPointACCObj0_Drive_b == 0)
        {
            //type conversion to float
            rawValue_float = rawValue;        
            // raw to physical conversion
            phyValue = ((rawValue_float *1)+(0));
            putValue(E_pric_RadarFrontCenter_TrajPointACCObj0_TrajPointACCObj0_Drive_b_Pv, phyValue);
            chgEv_TrajPointACCObj0_TrajPointACCObj0_Drive_b = 1;
        }
        else
        {
            chgEv_TrajPointACCObj0_TrajPointACCObj0_Drive_b = 0;
        }    
        //update the signal value
        Msg_TrajPointACCObj0.TrajPointACCObj0_Drive_b=rawValue;        
    }                                                                           
}

on envVar E_pric_RadarFrontCenter_TrajPointACCObj0_TrajPointACCObj0_Drive_b_Pv
{
    qword rawValue = 0ll;
    float phyValue = 0.0;
    
    //update the raw value with physical value 
    if(getValue(E_pric_RadarFrontCenter_TrajPointACCObj0_TrajPointACCObj0_Drive_b_SetVt)==0)
    {
        if(chgEv_TrajPointACCObj0_TrajPointACCObj0_Drive_b == 0)
        {
            phyValue = getvalue(this);
            // physical to raw conversion
            rawValue = ((phyValue -(0))/1);
            putValue(E_pric_RadarFrontCenter_TrajPointACCObj0_TrajPointACCObj0_Drive_b_Rv, rawValue);
            chgEv_TrajPointACCObj0_TrajPointACCObj0_Drive_b = 1;  
        }
        else
        {
            chgEv_TrajPointACCObj0_TrajPointACCObj0_Drive_b = 0;
        }
    }
}

on envVar E_pric_RadarFrontCenter_TrajPointACCObj0_TrajPointACCObj0_Drive_b_Vt
{
    qword rawValue = 0ll;
    if(getValue(E_pric_RadarFrontCenter_TrajPointACCObj0_TrajPointACCObj0_Drive_b_SetVt))
    {
        //update the signal value
        Msg_TrajPointACCObj0.TrajPointACCObj0_Drive_b=getValue(this);
    }
}

on envVar E_pric_RadarFrontCenter_TrajPointACCObj0_TrajPointACCObj0_Drive_b_SetVt
{
    if(getValue(E_pric_RadarFrontCenter_TrajPointACCObj0_TrajPointACCObj0_Drive_b_SetVt))
    {
        //update the signal value
        Msg_TrajPointACCObj0.TrajPointACCObj0_Drive_b=getvalue(E_pric_RadarFrontCenter_TrajPointACCObj0_TrajPointACCObj0_Drive_b_Vt);
    }
    else
    {
        Msg_TrajPointACCObj0.TrajPointACCObj0_Drive_b=getValue(E_pric_RadarFrontCenter_TrajPointACCObj0_TrajPointACCObj0_Drive_b_Rv);
    }
}
 
on envVar E_pric_RadarFrontCenter_TrajPointACCObj0_TrajPointACCObj0_TrajEnd_b_Rv
{
    qword rawValue = 0ll;
    float rawValue_float = 0.0;
    float phyValue = 0.0;        

    //set the signal with updated raw value
    if(getValue(E_pric_RadarFrontCenter_TrajPointACCObj0_TrajPointACCObj0_TrajEnd_b_SetVt)==0)
    {
        rawValue = getvalue(this);
        if(chgEv_TrajPointACCObj0_TrajPointACCObj0_TrajEnd_b == 0)
        {
            //type conversion to float
            rawValue_float = rawValue;        
            // raw to physical conversion
            phyValue = ((rawValue_float *1)+(0));
            putValue(E_pric_RadarFrontCenter_TrajPointACCObj0_TrajPointACCObj0_TrajEnd_b_Pv, phyValue);
            chgEv_TrajPointACCObj0_TrajPointACCObj0_TrajEnd_b = 1;
        }
        else
        {
            chgEv_TrajPointACCObj0_TrajPointACCObj0_TrajEnd_b = 0;
        }    
        //update the signal value
        Msg_TrajPointACCObj0.TrajPointACCObj0_TrajEnd_b=rawValue;        
    }                                                                           
}

on envVar E_pric_RadarFrontCenter_TrajPointACCObj0_TrajPointACCObj0_TrajEnd_b_Pv
{
    qword rawValue = 0ll;
    float phyValue = 0.0;
    
    //update the raw value with physical value 
    if(getValue(E_pric_RadarFrontCenter_TrajPointACCObj0_TrajPointACCObj0_TrajEnd_b_SetVt)==0)
    {
        if(chgEv_TrajPointACCObj0_TrajPointACCObj0_TrajEnd_b == 0)
        {
            phyValue = getvalue(this);
            // physical to raw conversion
            rawValue = ((phyValue -(0))/1);
            putValue(E_pric_RadarFrontCenter_TrajPointACCObj0_TrajPointACCObj0_TrajEnd_b_Rv, rawValue);
            chgEv_TrajPointACCObj0_TrajPointACCObj0_TrajEnd_b = 1;  
        }
        else
        {
            chgEv_TrajPointACCObj0_TrajPointACCObj0_TrajEnd_b = 0;
        }
    }
}

on envVar E_pric_RadarFrontCenter_TrajPointACCObj0_TrajPointACCObj0_TrajEnd_b_Vt
{
    qword rawValue = 0ll;
    if(getValue(E_pric_RadarFrontCenter_TrajPointACCObj0_TrajPointACCObj0_TrajEnd_b_SetVt))
    {
        //update the signal value
        Msg_TrajPointACCObj0.TrajPointACCObj0_TrajEnd_b=getValue(this);
    }
}

on envVar E_pric_RadarFrontCenter_TrajPointACCObj0_TrajPointACCObj0_TrajEnd_b_SetVt
{
    if(getValue(E_pric_RadarFrontCenter_TrajPointACCObj0_TrajPointACCObj0_TrajEnd_b_SetVt))
    {
        //update the signal value
        Msg_TrajPointACCObj0.TrajPointACCObj0_TrajEnd_b=getvalue(E_pric_RadarFrontCenter_TrajPointACCObj0_TrajPointACCObj0_TrajEnd_b_Vt);
    }
    else
    {
        Msg_TrajPointACCObj0.TrajPointACCObj0_TrajEnd_b=getValue(E_pric_RadarFrontCenter_TrajPointACCObj0_TrajPointACCObj0_TrajEnd_b_Rv);
    }
}
 
on envVar E_pric_RadarFrontCenter_TrajPointACCObj0_TrajPointACCObj0_dyv_sw_Rv
{
    qword rawValue = 0ll;
    float rawValue_float = 0.0;
    float phyValue = 0.0;        

    //set the signal with updated raw value
    {
        rawValue = getvalue(this);
        if(chgEv_TrajPointACCObj0_TrajPointACCObj0_dyv_sw == 0)
        {
            //type conversion to float
            rawValue_float = rawValue;        
            // raw to physical conversion
            phyValue = ((rawValue_float *0.0078125)+(0));
            putValue(E_pric_RadarFrontCenter_TrajPointACCObj0_TrajPointACCObj0_dyv_sw_Pv, phyValue);
            chgEv_TrajPointACCObj0_TrajPointACCObj0_dyv_sw = 1;
        }
        else
        {
            chgEv_TrajPointACCObj0_TrajPointACCObj0_dyv_sw = 0;
        }    
        //update the signal value
        Msg_TrajPointACCObj0.TrajPointACCObj0_dyv_sw=rawValue;        
    }                                                                           
}

on envVar E_pric_RadarFrontCenter_TrajPointACCObj0_TrajPointACCObj0_dyv_sw_Pv
{
    qword rawValue = 0ll;
    float phyValue = 0.0;
    
    //update the raw value with physical value 
    {
        if(chgEv_TrajPointACCObj0_TrajPointACCObj0_dyv_sw == 0)
        {
            phyValue = getvalue(this);
            // physical to raw conversion
            rawValue = ((phyValue -(0))/0.0078125);
            putValue(E_pric_RadarFrontCenter_TrajPointACCObj0_TrajPointACCObj0_dyv_sw_Rv, rawValue);
            chgEv_TrajPointACCObj0_TrajPointACCObj0_dyv_sw = 1;  
        }
        else
        {
            chgEv_TrajPointACCObj0_TrajPointACCObj0_dyv_sw = 0;
        }
    }
}


 
on envVar E_pric_RadarFrontCenter_TrajPointACCObj0_TrajPointACCObj0_dVarYv_uw_Rv
{
    qword rawValue = 0ll;
    float rawValue_float = 0.0;
    float phyValue = 0.0;        

    //set the signal with updated raw value
    {
        rawValue = getvalue(this);
        if(chgEv_TrajPointACCObj0_TrajPointACCObj0_dVarYv_uw == 0)
        {
            //type conversion to float
            rawValue_float = rawValue;        
            // raw to physical conversion
            phyValue = ((rawValue_float *0.00195313)+(0));
            putValue(E_pric_RadarFrontCenter_TrajPointACCObj0_TrajPointACCObj0_dVarYv_uw_Pv, phyValue);
            chgEv_TrajPointACCObj0_TrajPointACCObj0_dVarYv_uw = 1;
        }
        else
        {
            chgEv_TrajPointACCObj0_TrajPointACCObj0_dVarYv_uw = 0;
        }    
        //update the signal value
        Msg_TrajPointACCObj0.TrajPointACCObj0_dVarYv_uw=rawValue;        
    }                                                                           
}

on envVar E_pric_RadarFrontCenter_TrajPointACCObj0_TrajPointACCObj0_dVarYv_uw_Pv
{
    qword rawValue = 0ll;
    float phyValue = 0.0;
    
    //update the raw value with physical value 
    {
        if(chgEv_TrajPointACCObj0_TrajPointACCObj0_dVarYv_uw == 0)
        {
            phyValue = getvalue(this);
            // physical to raw conversion
            rawValue = ((phyValue -(0))/0.00195313);
            putValue(E_pric_RadarFrontCenter_TrajPointACCObj0_TrajPointACCObj0_dVarYv_uw_Rv, rawValue);
            chgEv_TrajPointACCObj0_TrajPointACCObj0_dVarYv_uw = 1;  
        }
        else
        {
            chgEv_TrajPointACCObj0_TrajPointACCObj0_dVarYv_uw = 0;
        }
    }
}


 
on envVar E_pric_RadarFrontCenter_TrajPointACCObj0_TrajPointACCObj0_Valid_b_Rv
{
    qword rawValue = 0ll;
    float rawValue_float = 0.0;
    float phyValue = 0.0;        

    //set the signal with updated raw value
    if(getValue(E_pric_RadarFrontCenter_TrajPointACCObj0_TrajPointACCObj0_Valid_b_SetVt)==0)
    {
        rawValue = getvalue(this);
        if(chgEv_TrajPointACCObj0_TrajPointACCObj0_Valid_b == 0)
        {
            //type conversion to float
            rawValue_float = rawValue;        
            // raw to physical conversion
            phyValue = ((rawValue_float *1)+(0));
            putValue(E_pric_RadarFrontCenter_TrajPointACCObj0_TrajPointACCObj0_Valid_b_Pv, phyValue);
            chgEv_TrajPointACCObj0_TrajPointACCObj0_Valid_b = 1;
        }
        else
        {
            chgEv_TrajPointACCObj0_TrajPointACCObj0_Valid_b = 0;
        }    
        //update the signal value
        Msg_TrajPointACCObj0.TrajPointACCObj0_Valid_b=rawValue;        
    }                                                                           
}

on envVar E_pric_RadarFrontCenter_TrajPointACCObj0_TrajPointACCObj0_Valid_b_Pv
{
    qword rawValue = 0ll;
    float phyValue = 0.0;
    
    //update the raw value with physical value 
    if(getValue(E_pric_RadarFrontCenter_TrajPointACCObj0_TrajPointACCObj0_Valid_b_SetVt)==0)
    {
        if(chgEv_TrajPointACCObj0_TrajPointACCObj0_Valid_b == 0)
        {
            phyValue = getvalue(this);
            // physical to raw conversion
            rawValue = ((phyValue -(0))/1);
            putValue(E_pric_RadarFrontCenter_TrajPointACCObj0_TrajPointACCObj0_Valid_b_Rv, rawValue);
            chgEv_TrajPointACCObj0_TrajPointACCObj0_Valid_b = 1;  
        }
        else
        {
            chgEv_TrajPointACCObj0_TrajPointACCObj0_Valid_b = 0;
        }
    }
}

on envVar E_pric_RadarFrontCenter_TrajPointACCObj0_TrajPointACCObj0_Valid_b_Vt
{
    qword rawValue = 0ll;
    if(getValue(E_pric_RadarFrontCenter_TrajPointACCObj0_TrajPointACCObj0_Valid_b_SetVt))
    {
        //update the signal value
        Msg_TrajPointACCObj0.TrajPointACCObj0_Valid_b=getValue(this);
    }
}

on envVar E_pric_RadarFrontCenter_TrajPointACCObj0_TrajPointACCObj0_Valid_b_SetVt
{
    if(getValue(E_pric_RadarFrontCenter_TrajPointACCObj0_TrajPointACCObj0_Valid_b_SetVt))
    {
        //update the signal value
        Msg_TrajPointACCObj0.TrajPointACCObj0_Valid_b=getvalue(E_pric_RadarFrontCenter_TrajPointACCObj0_TrajPointACCObj0_Valid_b_Vt);
    }
    else
    {
        Msg_TrajPointACCObj0.TrajPointACCObj0_Valid_b=getValue(E_pric_RadarFrontCenter_TrajPointACCObj0_TrajPointACCObj0_Valid_b_Rv);
    }
}
 
on envVar E_pric_RadarFrontCenter_TrajPointACCObj0_TrajPointACCObj0_wExistProb_ub_Rv
{
    qword rawValue = 0ll;
    float rawValue_float = 0.0;
    float phyValue = 0.0;        

    //set the signal with updated raw value
    {
        rawValue = getvalue(this);
        if(chgEv_TrajPointACCObj0_TrajPointACCObj0_wExistProb_ub == 0)
        {
            //type conversion to float
            rawValue_float = rawValue;        
            // raw to physical conversion
            phyValue = ((rawValue_float *0.00390625)+(0));
            putValue(E_pric_RadarFrontCenter_TrajPointACCObj0_TrajPointACCObj0_wExistProb_ub_Pv, phyValue);
            chgEv_TrajPointACCObj0_TrajPointACCObj0_wExistProb_ub = 1;
        }
        else
        {
            chgEv_TrajPointACCObj0_TrajPointACCObj0_wExistProb_ub = 0;
        }    
        //update the signal value
        Msg_TrajPointACCObj0.TrajPointACCObj0_wExistProb_ub=rawValue;        
    }                                                                           
}

on envVar E_pric_RadarFrontCenter_TrajPointACCObj0_TrajPointACCObj0_wExistProb_ub_Pv
{
    qword rawValue = 0ll;
    float phyValue = 0.0;
    
    //update the raw value with physical value 
    {
        if(chgEv_TrajPointACCObj0_TrajPointACCObj0_wExistProb_ub == 0)
        {
            phyValue = getvalue(this);
            // physical to raw conversion
            rawValue = ((phyValue -(0))/0.00390625);
            putValue(E_pric_RadarFrontCenter_TrajPointACCObj0_TrajPointACCObj0_wExistProb_ub_Rv, rawValue);
            chgEv_TrajPointACCObj0_TrajPointACCObj0_wExistProb_ub = 1;  
        }
        else
        {
            chgEv_TrajPointACCObj0_TrajPointACCObj0_wExistProb_ub = 0;
        }
    }
}


 
on envVar E_pric_RadarFrontCenter_TrajPointACCObj0_TrajPointACCObj0_Stopped_b_Rv
{
    qword rawValue = 0ll;
    float rawValue_float = 0.0;
    float phyValue = 0.0;        

    //set the signal with updated raw value
    if(getValue(E_pric_RadarFrontCenter_TrajPointACCObj0_TrajPointACCObj0_Stopped_b_SetVt)==0)
    {
        rawValue = getvalue(this);
        if(chgEv_TrajPointACCObj0_TrajPointACCObj0_Stopped_b == 0)
        {
            //type conversion to float
            rawValue_float = rawValue;        
            // raw to physical conversion
            phyValue = ((rawValue_float *1)+(0));
            putValue(E_pric_RadarFrontCenter_TrajPointACCObj0_TrajPointACCObj0_Stopped_b_Pv, phyValue);
            chgEv_TrajPointACCObj0_TrajPointACCObj0_Stopped_b = 1;
        }
        else
        {
            chgEv_TrajPointACCObj0_TrajPointACCObj0_Stopped_b = 0;
        }    
        //update the signal value
        Msg_TrajPointACCObj0.TrajPointACCObj0_Stopped_b=rawValue;        
    }                                                                           
}

on envVar E_pric_RadarFrontCenter_TrajPointACCObj0_TrajPointACCObj0_Stopped_b_Pv
{
    qword rawValue = 0ll;
    float phyValue = 0.0;
    
    //update the raw value with physical value 
    if(getValue(E_pric_RadarFrontCenter_TrajPointACCObj0_TrajPointACCObj0_Stopped_b_SetVt)==0)
    {
        if(chgEv_TrajPointACCObj0_TrajPointACCObj0_Stopped_b == 0)
        {
            phyValue = getvalue(this);
            // physical to raw conversion
            rawValue = ((phyValue -(0))/1);
            putValue(E_pric_RadarFrontCenter_TrajPointACCObj0_TrajPointACCObj0_Stopped_b_Rv, rawValue);
            chgEv_TrajPointACCObj0_TrajPointACCObj0_Stopped_b = 1;  
        }
        else
        {
            chgEv_TrajPointACCObj0_TrajPointACCObj0_Stopped_b = 0;
        }
    }
}

on envVar E_pric_RadarFrontCenter_TrajPointACCObj0_TrajPointACCObj0_Stopped_b_Vt
{
    qword rawValue = 0ll;
    if(getValue(E_pric_RadarFrontCenter_TrajPointACCObj0_TrajPointACCObj0_Stopped_b_SetVt))
    {
        //update the signal value
        Msg_TrajPointACCObj0.TrajPointACCObj0_Stopped_b=getValue(this);
    }
}

on envVar E_pric_RadarFrontCenter_TrajPointACCObj0_TrajPointACCObj0_Stopped_b_SetVt
{
    if(getValue(E_pric_RadarFrontCenter_TrajPointACCObj0_TrajPointACCObj0_Stopped_b_SetVt))
    {
        //update the signal value
        Msg_TrajPointACCObj0.TrajPointACCObj0_Stopped_b=getvalue(E_pric_RadarFrontCenter_TrajPointACCObj0_TrajPointACCObj0_Stopped_b_Vt);
    }
    else
    {
        Msg_TrajPointACCObj0.TrajPointACCObj0_Stopped_b=getValue(E_pric_RadarFrontCenter_TrajPointACCObj0_TrajPointACCObj0_Stopped_b_Rv);
    }
}
 
on envVar E_pric_RadarFrontCenter_TrajPointACCObj0_TrajPointACCObj0_Stand_b_Rv
{
    qword rawValue = 0ll;
    float rawValue_float = 0.0;
    float phyValue = 0.0;        

    //set the signal with updated raw value
    if(getValue(E_pric_RadarFrontCenter_TrajPointACCObj0_TrajPointACCObj0_Stand_b_SetVt)==0)
    {
        rawValue = getvalue(this);
        if(chgEv_TrajPointACCObj0_TrajPointACCObj0_Stand_b == 0)
        {
            //type conversion to float
            rawValue_float = rawValue;        
            // raw to physical conversion
            phyValue = ((rawValue_float *1)+(0));
            putValue(E_pric_RadarFrontCenter_TrajPointACCObj0_TrajPointACCObj0_Stand_b_Pv, phyValue);
            chgEv_TrajPointACCObj0_TrajPointACCObj0_Stand_b = 1;
        }
        else
        {
            chgEv_TrajPointACCObj0_TrajPointACCObj0_Stand_b = 0;
        }    
        //update the signal value
        Msg_TrajPointACCObj0.TrajPointACCObj0_Stand_b=rawValue;        
    }                                                                           
}

on envVar E_pric_RadarFrontCenter_TrajPointACCObj0_TrajPointACCObj0_Stand_b_Pv
{
    qword rawValue = 0ll;
    float phyValue = 0.0;
    
    //update the raw value with physical value 
    if(getValue(E_pric_RadarFrontCenter_TrajPointACCObj0_TrajPointACCObj0_Stand_b_SetVt)==0)
    {
        if(chgEv_TrajPointACCObj0_TrajPointACCObj0_Stand_b == 0)
        {
            phyValue = getvalue(this);
            // physical to raw conversion
            rawValue = ((phyValue -(0))/1);
            putValue(E_pric_RadarFrontCenter_TrajPointACCObj0_TrajPointACCObj0_Stand_b_Rv, rawValue);
            chgEv_TrajPointACCObj0_TrajPointACCObj0_Stand_b = 1;  
        }
        else
        {
            chgEv_TrajPointACCObj0_TrajPointACCObj0_Stand_b = 0;
        }
    }
}

on envVar E_pric_RadarFrontCenter_TrajPointACCObj0_TrajPointACCObj0_Stand_b_Vt
{
    qword rawValue = 0ll;
    if(getValue(E_pric_RadarFrontCenter_TrajPointACCObj0_TrajPointACCObj0_Stand_b_SetVt))
    {
        //update the signal value
        Msg_TrajPointACCObj0.TrajPointACCObj0_Stand_b=getValue(this);
    }
}

on envVar E_pric_RadarFrontCenter_TrajPointACCObj0_TrajPointACCObj0_Stand_b_SetVt
{
    if(getValue(E_pric_RadarFrontCenter_TrajPointACCObj0_TrajPointACCObj0_Stand_b_SetVt))
    {
        //update the signal value
        Msg_TrajPointACCObj0.TrajPointACCObj0_Stand_b=getvalue(E_pric_RadarFrontCenter_TrajPointACCObj0_TrajPointACCObj0_Stand_b_Vt);
    }
    else
    {
        Msg_TrajPointACCObj0.TrajPointACCObj0_Stand_b=getValue(E_pric_RadarFrontCenter_TrajPointACCObj0_TrajPointACCObj0_Stand_b_Rv);
    }
}
 
on envVar E_pric_RadarFrontCenter_TrajPointACCObj0_TrajPointACCObj0_dxv_sw_Rv
{
    qword rawValue = 0ll;
    float rawValue_float = 0.0;
    float phyValue = 0.0;        

    //set the signal with updated raw value
    {
        rawValue = getvalue(this);
        if(chgEv_TrajPointACCObj0_TrajPointACCObj0_dxv_sw == 0)
        {
            //type conversion to float
            rawValue_float = rawValue;        
            // raw to physical conversion
            phyValue = ((rawValue_float *0.0078125)+(0));
            putValue(E_pric_RadarFrontCenter_TrajPointACCObj0_TrajPointACCObj0_dxv_sw_Pv, phyValue);
            chgEv_TrajPointACCObj0_TrajPointACCObj0_dxv_sw = 1;
        }
        else
        {
            chgEv_TrajPointACCObj0_TrajPointACCObj0_dxv_sw = 0;
        }    
        //update the signal value
        Msg_TrajPointACCObj0.TrajPointACCObj0_dxv_sw=rawValue;        
    }                                                                           
}

on envVar E_pric_RadarFrontCenter_TrajPointACCObj0_TrajPointACCObj0_dxv_sw_Pv
{
    qword rawValue = 0ll;
    float phyValue = 0.0;
    
    //update the raw value with physical value 
    {
        if(chgEv_TrajPointACCObj0_TrajPointACCObj0_dxv_sw == 0)
        {
            phyValue = getvalue(this);
            // physical to raw conversion
            rawValue = ((phyValue -(0))/0.0078125);
            putValue(E_pric_RadarFrontCenter_TrajPointACCObj0_TrajPointACCObj0_dxv_sw_Rv, rawValue);
            chgEv_TrajPointACCObj0_TrajPointACCObj0_dxv_sw = 1;  
        }
        else
        {
            chgEv_TrajPointACCObj0_TrajPointACCObj0_dxv_sw = 0;
        }
    }
}


 
on envVar E_pric_RadarFrontCenter_TrajPointACCObj0_TrajPointACCObj0_dVarXv_uw_Rv
{
    qword rawValue = 0ll;
    float rawValue_float = 0.0;
    float phyValue = 0.0;        

    //set the signal with updated raw value
    {
        rawValue = getvalue(this);
        if(chgEv_TrajPointACCObj0_TrajPointACCObj0_dVarXv_uw == 0)
        {
            //type conversion to float
            rawValue_float = rawValue;        
            // raw to physical conversion
            phyValue = ((rawValue_float *0.00195313)+(0));
            putValue(E_pric_RadarFrontCenter_TrajPointACCObj0_TrajPointACCObj0_dVarXv_uw_Pv, phyValue);
            chgEv_TrajPointACCObj0_TrajPointACCObj0_dVarXv_uw = 1;
        }
        else
        {
            chgEv_TrajPointACCObj0_TrajPointACCObj0_dVarXv_uw = 0;
        }    
        //update the signal value
        Msg_TrajPointACCObj0.TrajPointACCObj0_dVarXv_uw=rawValue;        
    }                                                                           
}

on envVar E_pric_RadarFrontCenter_TrajPointACCObj0_TrajPointACCObj0_dVarXv_uw_Pv
{
    qword rawValue = 0ll;
    float phyValue = 0.0;
    
    //update the raw value with physical value 
    {
        if(chgEv_TrajPointACCObj0_TrajPointACCObj0_dVarXv_uw == 0)
        {
            phyValue = getvalue(this);
            // physical to raw conversion
            rawValue = ((phyValue -(0))/0.00195313);
            putValue(E_pric_RadarFrontCenter_TrajPointACCObj0_TrajPointACCObj0_dVarXv_uw_Rv, rawValue);
            chgEv_TrajPointACCObj0_TrajPointACCObj0_dVarXv_uw = 1;  
        }
        else
        {
            chgEv_TrajPointACCObj0_TrajPointACCObj0_dVarXv_uw = 0;
        }
    }
}


 
on envVar E_pric_RadarFrontCenter_ACCObjInfo_tx
{
    if(getValue(this))
    {       
        
        //update the BZ Signal
        if(ACCObjInfo_ACCObjInfo_MsgCtr_wrongvalctr == 0)
        {
            update_ACCObjInfo_ACCObjInfo_MsgCtr_counter();
            Msg_ACCObjInfo.ACCObjInfo_MsgCtr= ACCObjInfo_ACCObjInfo_MsgCtr_counter;
        }
        else if(ACCObjInfo_ACCObjInfo_MsgCtr_wrongvalctr > 0)
        {
             ACCObjInfo_ACCObjInfo_MsgCtr_wrongvalctr--;
              // if counter becomes zero, update panel controller to zero
             if(ACCObjInfo_ACCObjInfo_MsgCtr_wrongvalctr == 0)
             {
                 putValue(E_pric_RadarFrontCenter_ACCObjInfo_ACCObjInfo_MsgCtr_wrongvalctr,0);
             }
        }
        else
        {
            //do nothing
        }        
        //update the BZ Signal
        if(ACCObjInfo_ACCObjInfo_blockCtr_wrongvalctr == 0)
        {
            update_ACCObjInfo_ACCObjInfo_blockCtr_counter();
            Msg_ACCObjInfo.ACCObjInfo_blockCtr= ACCObjInfo_ACCObjInfo_blockCtr_counter;
        }
        else if(ACCObjInfo_ACCObjInfo_blockCtr_wrongvalctr > 0)
        {
             ACCObjInfo_ACCObjInfo_blockCtr_wrongvalctr--;
              // if counter becomes zero, update panel controller to zero
             if(ACCObjInfo_ACCObjInfo_blockCtr_wrongvalctr == 0)
             {
                 putValue(E_pric_RadarFrontCenter_ACCObjInfo_ACCObjInfo_blockCtr_wrongvalctr,0);
             }
        }
        else
        {
            //do nothing
        }        
        //calculate the CRC checksum
        update_ACCObjInfo_ChkSum_Checksum();

        output(Msg_ACCObjInfo);        
    }
}

on envVar E_pric_RadarFrontCenter_ACCObjInfo_Range
{
    qword rawstatus = 0ll;
    qword rawValue = 0ll;    
    
    rawstatus = getvalue(this);    
    // set all the signals with min raw /max raw /init raw
    switch (rawstatus) 
    {
     case(0) :
        rawValue= -32768;
        putValue(E_pric_RadarFrontCenter_ACCObjInfo_ACCObjInfo_dxv_sw_Rv, rawValue);
        rawValue= 0;
        putValue(E_pric_RadarFrontCenter_ACCObjInfo_ACCObjInfo_Handle_ub_Rv, rawValue);
        rawValue= 0;
        putValue(E_pric_RadarFrontCenter_ACCObjInfo_ACCObjInfo_RFF_ub_Rv, rawValue);
        rawValue= -32768;
        putValue(E_pric_RadarFrontCenter_ACCObjInfo_ACCObjInfo_vxv_sw_Rv, rawValue);
        rawValue= -32768;
        putValue(E_pric_RadarFrontCenter_ACCObjInfo_ACCObjInfo_dWidth_sw_Rv, rawValue);
        rawValue= -32768;
        putValue(E_pric_RadarFrontCenter_ACCObjInfo_ACCObjInfo_dyv_sw_Rv, rawValue);
        rawValue= 0;
        putValue(E_pric_RadarFrontCenter_ACCObjInfo_ACCObjInfo_timestamp_Rv, rawValue);
        break;
     case(1) :
        rawValue= 32767;
        putValue(E_pric_RadarFrontCenter_ACCObjInfo_ACCObjInfo_dxv_sw_Rv, rawValue);
        rawValue= 255;
        putValue(E_pric_RadarFrontCenter_ACCObjInfo_ACCObjInfo_Handle_ub_Rv, rawValue);
        rawValue= 255;
        putValue(E_pric_RadarFrontCenter_ACCObjInfo_ACCObjInfo_RFF_ub_Rv, rawValue);
        rawValue= 32767;
        putValue(E_pric_RadarFrontCenter_ACCObjInfo_ACCObjInfo_vxv_sw_Rv, rawValue);
        rawValue= 32767;
        putValue(E_pric_RadarFrontCenter_ACCObjInfo_ACCObjInfo_dWidth_sw_Rv, rawValue);
        rawValue= 32767;
        putValue(E_pric_RadarFrontCenter_ACCObjInfo_ACCObjInfo_dyv_sw_Rv, rawValue);
        rawValue= 4294964216;
        putValue(E_pric_RadarFrontCenter_ACCObjInfo_ACCObjInfo_timestamp_Rv, rawValue);
        break;
     default :
        rawValue= -32768;
        putValue(E_pric_RadarFrontCenter_ACCObjInfo_ACCObjInfo_dxv_sw_Rv, rawValue);
        rawValue= 0;
        putValue(E_pric_RadarFrontCenter_ACCObjInfo_ACCObjInfo_Handle_ub_Rv, rawValue);
        rawValue= 0;
        putValue(E_pric_RadarFrontCenter_ACCObjInfo_ACCObjInfo_RFF_ub_Rv, rawValue);
        rawValue= -32768;
        putValue(E_pric_RadarFrontCenter_ACCObjInfo_ACCObjInfo_vxv_sw_Rv, rawValue);
        rawValue= -32768;
        putValue(E_pric_RadarFrontCenter_ACCObjInfo_ACCObjInfo_dWidth_sw_Rv, rawValue);
        rawValue= -32768;
        putValue(E_pric_RadarFrontCenter_ACCObjInfo_ACCObjInfo_dyv_sw_Rv, rawValue);
        rawValue= 0;
        putValue(E_pric_RadarFrontCenter_ACCObjInfo_ACCObjInfo_timestamp_Rv, rawValue);
      break;
   }
}

on envVar E_pric_RadarFrontCenter_ACCObjInfo_Dlc
{
    if(getValue(E_pric_RadarFrontCenter_ACCObjInfo_enDlc))
    {
        Msg_ACCObjInfo.dlc =getValue(this);
    }
    else
    {
       Dbc_dlc = 16;
	   Msg_ACCObjInfo.dlc = Calc_Canfd_dlc(Dbc_dlc);
	   	
  }
}

on envVar E_pric_RadarFrontCenter_ACCObjInfo_enDlc
{
    //For Messages with DLC = 8, set wrong DLC to smaller than defined DLC
    //For Messages with DLC < 8 set wrong DLC to smaller/longer than defined DLC
    if(getValue(this))
    {
        Msg_ACCObjInfo.dlc =getValue(E_pric_RadarFrontCenter_ACCObjInfo_Dlc);
    }
    else
    {
       Dbc_dlc = 16;
	   Msg_ACCObjInfo.dlc = Calc_Canfd_dlc(Dbc_dlc);
			
    }
}

on envVar E_pric_RadarFrontCenter_ACCObjInfo_ACCObjInfo_CRC_wrongvalctr
{
    //update disturb count
    //disturb value range:(-1 = always send wrong value),( X>0 ,x is the number of Messages with wrong CHK sent)
    ACCObjInfo_ACCObjInfo_CRC_wrongvalctr =getValue(this);    
}
on envVar E_pric_RadarFrontCenter_ACCObjInfo_ACCObjInfo_MsgCtr_wrongvalctr
{
    //update disturb count
    //disturb value range:(-1 = always send wrong value),( X>0 ,x is the number of Messages with wrong CHK sent)
    ACCObjInfo_ACCObjInfo_MsgCtr_wrongvalctr =getValue(this);    
}
on envVar E_pric_RadarFrontCenter_ACCObjInfo_ACCObjInfo_blockCtr_wrongvalctr
{
    //update disturb count
    //disturb value range:(-1 = always send wrong value),( X>0 ,x is the number of Messages with wrong CHK sent)
    ACCObjInfo_ACCObjInfo_blockCtr_wrongvalctr =getValue(this);    
}

on envVar E_pric_RadarFrontCenter_ACCObjInfo_ACCObjInfo_dxv_sw_Rv
{
    qword rawValue = 0ll;
    float rawValue_float = 0.0;
    float phyValue = 0.0;        

    //set the signal with updated raw value
    {
        rawValue = getvalue(this);
        if(chgEv_ACCObjInfo_ACCObjInfo_dxv_sw == 0)
        {
            //type conversion to float
            rawValue_float = rawValue;        
            // raw to physical conversion
            phyValue = ((rawValue_float *0.0078125)+(0));
            putValue(E_pric_RadarFrontCenter_ACCObjInfo_ACCObjInfo_dxv_sw_Pv, phyValue);
            chgEv_ACCObjInfo_ACCObjInfo_dxv_sw = 1;
        }
        else
        {
            chgEv_ACCObjInfo_ACCObjInfo_dxv_sw = 0;
        }    
        //update the signal value
        Msg_ACCObjInfo.ACCObjInfo_dxv_sw=rawValue;        
    }                                                                           
}

on envVar E_pric_RadarFrontCenter_ACCObjInfo_ACCObjInfo_dxv_sw_Pv
{
    qword rawValue = 0ll;
    float phyValue = 0.0;
    
    //update the raw value with physical value 
    {
        if(chgEv_ACCObjInfo_ACCObjInfo_dxv_sw == 0)
        {
            phyValue = getvalue(this);
            // physical to raw conversion
            rawValue = ((phyValue -(0))/0.0078125);
            putValue(E_pric_RadarFrontCenter_ACCObjInfo_ACCObjInfo_dxv_sw_Rv, rawValue);
            chgEv_ACCObjInfo_ACCObjInfo_dxv_sw = 1;  
        }
        else
        {
            chgEv_ACCObjInfo_ACCObjInfo_dxv_sw = 0;
        }
    }
}


 
on envVar E_pric_RadarFrontCenter_ACCObjInfo_ACCObjInfo_Handle_ub_Rv
{
    qword rawValue = 0ll;
    float rawValue_float = 0.0;
    float phyValue = 0.0;        

    //set the signal with updated raw value
    if(getValue(E_pric_RadarFrontCenter_ACCObjInfo_ACCObjInfo_Handle_ub_SetVt)==0)
    {
        rawValue = getvalue(this);
        if(chgEv_ACCObjInfo_ACCObjInfo_Handle_ub == 0)
        {
            //type conversion to float
            rawValue_float = rawValue;        
            // raw to physical conversion
            phyValue = ((rawValue_float *1)+(0));
            putValue(E_pric_RadarFrontCenter_ACCObjInfo_ACCObjInfo_Handle_ub_Pv, phyValue);
            chgEv_ACCObjInfo_ACCObjInfo_Handle_ub = 1;
        }
        else
        {
            chgEv_ACCObjInfo_ACCObjInfo_Handle_ub = 0;
        }    
        //update the signal value
        Msg_ACCObjInfo.ACCObjInfo_Handle_ub=rawValue;        
    }                                                                           
}

on envVar E_pric_RadarFrontCenter_ACCObjInfo_ACCObjInfo_Handle_ub_Pv
{
    qword rawValue = 0ll;
    float phyValue = 0.0;
    
    //update the raw value with physical value 
    if(getValue(E_pric_RadarFrontCenter_ACCObjInfo_ACCObjInfo_Handle_ub_SetVt)==0)
    {
        if(chgEv_ACCObjInfo_ACCObjInfo_Handle_ub == 0)
        {
            phyValue = getvalue(this);
            // physical to raw conversion
            rawValue = ((phyValue -(0))/1);
            putValue(E_pric_RadarFrontCenter_ACCObjInfo_ACCObjInfo_Handle_ub_Rv, rawValue);
            chgEv_ACCObjInfo_ACCObjInfo_Handle_ub = 1;  
        }
        else
        {
            chgEv_ACCObjInfo_ACCObjInfo_Handle_ub = 0;
        }
    }
}

on envVar E_pric_RadarFrontCenter_ACCObjInfo_ACCObjInfo_Handle_ub_Vt
{
    qword rawValue = 0ll;
    if(getValue(E_pric_RadarFrontCenter_ACCObjInfo_ACCObjInfo_Handle_ub_SetVt))
    {
        //update the signal value
        Msg_ACCObjInfo.ACCObjInfo_Handle_ub=getValue(this);
    }
}

on envVar E_pric_RadarFrontCenter_ACCObjInfo_ACCObjInfo_Handle_ub_SetVt
{
    if(getValue(E_pric_RadarFrontCenter_ACCObjInfo_ACCObjInfo_Handle_ub_SetVt))
    {
        //update the signal value
        Msg_ACCObjInfo.ACCObjInfo_Handle_ub=getvalue(E_pric_RadarFrontCenter_ACCObjInfo_ACCObjInfo_Handle_ub_Vt);
    }
    else
    {
        Msg_ACCObjInfo.ACCObjInfo_Handle_ub=getValue(E_pric_RadarFrontCenter_ACCObjInfo_ACCObjInfo_Handle_ub_Rv);
    }
}
 
on envVar E_pric_RadarFrontCenter_ACCObjInfo_ACCObjInfo_RFF_ub_Rv
{
    qword rawValue = 0ll;
    float rawValue_float = 0.0;
    float phyValue = 0.0;        

    //set the signal with updated raw value
    if(getValue(E_pric_RadarFrontCenter_ACCObjInfo_ACCObjInfo_RFF_ub_SetVt)==0)
    {
        rawValue = getvalue(this);
        if(chgEv_ACCObjInfo_ACCObjInfo_RFF_ub == 0)
        {
            //type conversion to float
            rawValue_float = rawValue;        
            // raw to physical conversion
            phyValue = ((rawValue_float *1)+(0));
            putValue(E_pric_RadarFrontCenter_ACCObjInfo_ACCObjInfo_RFF_ub_Pv, phyValue);
            chgEv_ACCObjInfo_ACCObjInfo_RFF_ub = 1;
        }
        else
        {
            chgEv_ACCObjInfo_ACCObjInfo_RFF_ub = 0;
        }    
        //update the signal value
        Msg_ACCObjInfo.ACCObjInfo_RFF_ub=rawValue;        
    }                                                                           
}

on envVar E_pric_RadarFrontCenter_ACCObjInfo_ACCObjInfo_RFF_ub_Pv
{
    qword rawValue = 0ll;
    float phyValue = 0.0;
    
    //update the raw value with physical value 
    if(getValue(E_pric_RadarFrontCenter_ACCObjInfo_ACCObjInfo_RFF_ub_SetVt)==0)
    {
        if(chgEv_ACCObjInfo_ACCObjInfo_RFF_ub == 0)
        {
            phyValue = getvalue(this);
            // physical to raw conversion
            rawValue = ((phyValue -(0))/1);
            putValue(E_pric_RadarFrontCenter_ACCObjInfo_ACCObjInfo_RFF_ub_Rv, rawValue);
            chgEv_ACCObjInfo_ACCObjInfo_RFF_ub = 1;  
        }
        else
        {
            chgEv_ACCObjInfo_ACCObjInfo_RFF_ub = 0;
        }
    }
}

on envVar E_pric_RadarFrontCenter_ACCObjInfo_ACCObjInfo_RFF_ub_Vt
{
    qword rawValue = 0ll;
    if(getValue(E_pric_RadarFrontCenter_ACCObjInfo_ACCObjInfo_RFF_ub_SetVt))
    {
        //update the signal value
        Msg_ACCObjInfo.ACCObjInfo_RFF_ub=getValue(this);
    }
}

on envVar E_pric_RadarFrontCenter_ACCObjInfo_ACCObjInfo_RFF_ub_SetVt
{
    if(getValue(E_pric_RadarFrontCenter_ACCObjInfo_ACCObjInfo_RFF_ub_SetVt))
    {
        //update the signal value
        Msg_ACCObjInfo.ACCObjInfo_RFF_ub=getvalue(E_pric_RadarFrontCenter_ACCObjInfo_ACCObjInfo_RFF_ub_Vt);
    }
    else
    {
        Msg_ACCObjInfo.ACCObjInfo_RFF_ub=getValue(E_pric_RadarFrontCenter_ACCObjInfo_ACCObjInfo_RFF_ub_Rv);
    }
}
 
on envVar E_pric_RadarFrontCenter_ACCObjInfo_ACCObjInfo_vxv_sw_Rv
{
    qword rawValue = 0ll;
    float rawValue_float = 0.0;
    float phyValue = 0.0;        

    //set the signal with updated raw value
    {
        rawValue = getvalue(this);
        if(chgEv_ACCObjInfo_ACCObjInfo_vxv_sw == 0)
        {
            //type conversion to float
            rawValue_float = rawValue;        
            // raw to physical conversion
            phyValue = ((rawValue_float *0.00390625)+(0));
            putValue(E_pric_RadarFrontCenter_ACCObjInfo_ACCObjInfo_vxv_sw_Pv, phyValue);
            chgEv_ACCObjInfo_ACCObjInfo_vxv_sw = 1;
        }
        else
        {
            chgEv_ACCObjInfo_ACCObjInfo_vxv_sw = 0;
        }    
        //update the signal value
        Msg_ACCObjInfo.ACCObjInfo_vxv_sw=rawValue;        
    }                                                                           
}

on envVar E_pric_RadarFrontCenter_ACCObjInfo_ACCObjInfo_vxv_sw_Pv
{
    qword rawValue = 0ll;
    float phyValue = 0.0;
    
    //update the raw value with physical value 
    {
        if(chgEv_ACCObjInfo_ACCObjInfo_vxv_sw == 0)
        {
            phyValue = getvalue(this);
            // physical to raw conversion
            rawValue = ((phyValue -(0))/0.00390625);
            putValue(E_pric_RadarFrontCenter_ACCObjInfo_ACCObjInfo_vxv_sw_Rv, rawValue);
            chgEv_ACCObjInfo_ACCObjInfo_vxv_sw = 1;  
        }
        else
        {
            chgEv_ACCObjInfo_ACCObjInfo_vxv_sw = 0;
        }
    }
}


 
on envVar E_pric_RadarFrontCenter_ACCObjInfo_ACCObjInfo_dWidth_sw_Rv
{
    qword rawValue = 0ll;
    float rawValue_float = 0.0;
    float phyValue = 0.0;        

    //set the signal with updated raw value
    {
        rawValue = getvalue(this);
        if(chgEv_ACCObjInfo_ACCObjInfo_dWidth_sw == 0)
        {
            //type conversion to float
            rawValue_float = rawValue;        
            // raw to physical conversion
            phyValue = ((rawValue_float *0.0078125)+(0));
            putValue(E_pric_RadarFrontCenter_ACCObjInfo_ACCObjInfo_dWidth_sw_Pv, phyValue);
            chgEv_ACCObjInfo_ACCObjInfo_dWidth_sw = 1;
        }
        else
        {
            chgEv_ACCObjInfo_ACCObjInfo_dWidth_sw = 0;
        }    
        //update the signal value
        Msg_ACCObjInfo.ACCObjInfo_dWidth_sw=rawValue;        
    }                                                                           
}

on envVar E_pric_RadarFrontCenter_ACCObjInfo_ACCObjInfo_dWidth_sw_Pv
{
    qword rawValue = 0ll;
    float phyValue = 0.0;
    
    //update the raw value with physical value 
    {
        if(chgEv_ACCObjInfo_ACCObjInfo_dWidth_sw == 0)
        {
            phyValue = getvalue(this);
            // physical to raw conversion
            rawValue = ((phyValue -(0))/0.0078125);
            putValue(E_pric_RadarFrontCenter_ACCObjInfo_ACCObjInfo_dWidth_sw_Rv, rawValue);
            chgEv_ACCObjInfo_ACCObjInfo_dWidth_sw = 1;  
        }
        else
        {
            chgEv_ACCObjInfo_ACCObjInfo_dWidth_sw = 0;
        }
    }
}


 
on envVar E_pric_RadarFrontCenter_ACCObjInfo_ACCObjInfo_dyv_sw_Rv
{
    qword rawValue = 0ll;
    float rawValue_float = 0.0;
    float phyValue = 0.0;        

    //set the signal with updated raw value
    {
        rawValue = getvalue(this);
        if(chgEv_ACCObjInfo_ACCObjInfo_dyv_sw == 0)
        {
            //type conversion to float
            rawValue_float = rawValue;        
            // raw to physical conversion
            phyValue = ((rawValue_float *0.0078125)+(0));
            putValue(E_pric_RadarFrontCenter_ACCObjInfo_ACCObjInfo_dyv_sw_Pv, phyValue);
            chgEv_ACCObjInfo_ACCObjInfo_dyv_sw = 1;
        }
        else
        {
            chgEv_ACCObjInfo_ACCObjInfo_dyv_sw = 0;
        }    
        //update the signal value
        Msg_ACCObjInfo.ACCObjInfo_dyv_sw=rawValue;        
    }                                                                           
}

on envVar E_pric_RadarFrontCenter_ACCObjInfo_ACCObjInfo_dyv_sw_Pv
{
    qword rawValue = 0ll;
    float phyValue = 0.0;
    
    //update the raw value with physical value 
    {
        if(chgEv_ACCObjInfo_ACCObjInfo_dyv_sw == 0)
        {
            phyValue = getvalue(this);
            // physical to raw conversion
            rawValue = ((phyValue -(0))/0.0078125);
            putValue(E_pric_RadarFrontCenter_ACCObjInfo_ACCObjInfo_dyv_sw_Rv, rawValue);
            chgEv_ACCObjInfo_ACCObjInfo_dyv_sw = 1;  
        }
        else
        {
            chgEv_ACCObjInfo_ACCObjInfo_dyv_sw = 0;
        }
    }
}


 
on envVar E_pric_RadarFrontCenter_ACCObjInfo_ACCObjInfo_timestamp_Rv
{
    qword rawValue = 0ll;
    float rawValue_float = 0.0;
    float phyValue = 0.0;        

    //set the signal with updated raw value
    {
        rawValue = getvalue(this);
        if(chgEv_ACCObjInfo_ACCObjInfo_timestamp == 0)
        {
            //type conversion to float
            rawValue_float = rawValue;        
            // raw to physical conversion
            phyValue = ((rawValue_float *1.52588e-005)+(0));
            putValue(E_pric_RadarFrontCenter_ACCObjInfo_ACCObjInfo_timestamp_Pv, phyValue);
            chgEv_ACCObjInfo_ACCObjInfo_timestamp = 1;
        }
        else
        {
            chgEv_ACCObjInfo_ACCObjInfo_timestamp = 0;
        }    
        //update the signal value
        Msg_ACCObjInfo.ACCObjInfo_timestamp=rawValue;        
    }                                                                           
}

on envVar E_pric_RadarFrontCenter_ACCObjInfo_ACCObjInfo_timestamp_Pv
{
    qword rawValue = 0ll;
    float phyValue = 0.0;
    
    //update the raw value with physical value 
    {
        if(chgEv_ACCObjInfo_ACCObjInfo_timestamp == 0)
        {
            phyValue = getvalue(this);
            // physical to raw conversion
            rawValue = ((phyValue -(0))/1.52588e-005);
            putValue(E_pric_RadarFrontCenter_ACCObjInfo_ACCObjInfo_timestamp_Rv, rawValue);
            chgEv_ACCObjInfo_ACCObjInfo_timestamp = 1;  
        }
        else
        {
            chgEv_ACCObjInfo_ACCObjInfo_timestamp = 0;
        }
    }
}


 
on envVar E_pric_RadarFrontCenter_TIPLLaneInfo0_tx
{
    if(getValue(this))
    {       
        
        //update the BZ Signal
        if(TIPLLaneInfo0_TIPLLaneInfo0_MsgCtr_wrongvalctr == 0)
        {
            update_TIPLLaneInfo0_TIPLLaneInfo0_MsgCtr_counter();
            Msg_TIPLLaneInfo0.TIPLLaneInfo0_MsgCtr= TIPLLaneInfo0_TIPLLaneInfo0_MsgCtr_counter;
        }
        else if(TIPLLaneInfo0_TIPLLaneInfo0_MsgCtr_wrongvalctr > 0)
        {
             TIPLLaneInfo0_TIPLLaneInfo0_MsgCtr_wrongvalctr--;
              // if counter becomes zero, update panel controller to zero
             if(TIPLLaneInfo0_TIPLLaneInfo0_MsgCtr_wrongvalctr == 0)
             {
                 putValue(E_pric_RadarFrontCenter_TIPLLaneInfo0_TIPLLaneInfo0_MsgCtr_wrongvalctr,0);
             }
        }
        else
        {
            //do nothing
        }        
        //update the BZ Signal
        if(TIPLLaneInfo0_TIPLLaneInfo0_blockCtr_wrongvalctr == 0)
        {
            update_TIPLLaneInfo0_TIPLLaneInfo0_blockCtr_counter();
            Msg_TIPLLaneInfo0.TIPLLaneInfo0_blockCtr= TIPLLaneInfo0_TIPLLaneInfo0_blockCtr_counter;
        }
        else if(TIPLLaneInfo0_TIPLLaneInfo0_blockCtr_wrongvalctr > 0)
        {
             TIPLLaneInfo0_TIPLLaneInfo0_blockCtr_wrongvalctr--;
              // if counter becomes zero, update panel controller to zero
             if(TIPLLaneInfo0_TIPLLaneInfo0_blockCtr_wrongvalctr == 0)
             {
                 putValue(E_pric_RadarFrontCenter_TIPLLaneInfo0_TIPLLaneInfo0_blockCtr_wrongvalctr,0);
             }
        }
        else
        {
            //do nothing
        }        
        //calculate the CRC checksum
        update_TIPLLaneInfo0_ChkSum_Checksum();

        output(Msg_TIPLLaneInfo0);        
    }
}

on envVar E_pric_RadarFrontCenter_TIPLLaneInfo0_Range
{
    qword rawstatus = 0ll;
    qword rawValue = 0ll;    
    
    rawstatus = getvalue(this);    
    // set all the signals with min raw /max raw /init raw
    switch (rawstatus) 
    {
     case(0) :
        rawValue= 0;
        putValue(E_pric_RadarFrontCenter_TIPLLaneInfo0_TIPLLaneInfo0_prob1Lane_ub_Rv, rawValue);
        rawValue= -32768;
        putValue(E_pric_RadarFrontCenter_TIPLLaneInfo0_TIPLLaneInfo0_dUpperLimitLane_sw_Rv, rawValue);
        rawValue= -32768;
        putValue(E_pric_RadarFrontCenter_TIPLLaneInfo0_TIPLLaneInfo0_dLowerLimitLane_sw_Rv, rawValue);
        rawValue= -32768;
        putValue(E_pric_RadarFrontCenter_TIPLLaneInfo0_TIPLLaneInfo0_dRightBorder_sw_Rv, rawValue);
        rawValue= -32768;
        putValue(E_pric_RadarFrontCenter_TIPLLaneInfo0_TIPLLaneInfo0_dLeftBorder_sw_Rv, rawValue);
        break;
     case(1) :
        rawValue= 255;
        putValue(E_pric_RadarFrontCenter_TIPLLaneInfo0_TIPLLaneInfo0_prob1Lane_ub_Rv, rawValue);
        rawValue= 32767;
        putValue(E_pric_RadarFrontCenter_TIPLLaneInfo0_TIPLLaneInfo0_dUpperLimitLane_sw_Rv, rawValue);
        rawValue= 32767;
        putValue(E_pric_RadarFrontCenter_TIPLLaneInfo0_TIPLLaneInfo0_dLowerLimitLane_sw_Rv, rawValue);
        rawValue= 32767;
        putValue(E_pric_RadarFrontCenter_TIPLLaneInfo0_TIPLLaneInfo0_dRightBorder_sw_Rv, rawValue);
        rawValue= 32767;
        putValue(E_pric_RadarFrontCenter_TIPLLaneInfo0_TIPLLaneInfo0_dLeftBorder_sw_Rv, rawValue);
        break;
     default :
        rawValue= 0;
        putValue(E_pric_RadarFrontCenter_TIPLLaneInfo0_TIPLLaneInfo0_prob1Lane_ub_Rv, rawValue);
        rawValue= -32768;
        putValue(E_pric_RadarFrontCenter_TIPLLaneInfo0_TIPLLaneInfo0_dUpperLimitLane_sw_Rv, rawValue);
        rawValue= -32768;
        putValue(E_pric_RadarFrontCenter_TIPLLaneInfo0_TIPLLaneInfo0_dLowerLimitLane_sw_Rv, rawValue);
        rawValue= -32768;
        putValue(E_pric_RadarFrontCenter_TIPLLaneInfo0_TIPLLaneInfo0_dRightBorder_sw_Rv, rawValue);
        rawValue= -32768;
        putValue(E_pric_RadarFrontCenter_TIPLLaneInfo0_TIPLLaneInfo0_dLeftBorder_sw_Rv, rawValue);
      break;
   }
}

on envVar E_pric_RadarFrontCenter_TIPLLaneInfo0_Dlc
{
    if(getValue(E_pric_RadarFrontCenter_TIPLLaneInfo0_enDlc))
    {
        Msg_TIPLLaneInfo0.dlc =getValue(this);
    }
    else
    {
       Dbc_dlc = 12;
	   Msg_TIPLLaneInfo0.dlc = Calc_Canfd_dlc(Dbc_dlc);
	   	
  }
}

on envVar E_pric_RadarFrontCenter_TIPLLaneInfo0_enDlc
{
    //For Messages with DLC = 8, set wrong DLC to smaller than defined DLC
    //For Messages with DLC < 8 set wrong DLC to smaller/longer than defined DLC
    if(getValue(this))
    {
        Msg_TIPLLaneInfo0.dlc =getValue(E_pric_RadarFrontCenter_TIPLLaneInfo0_Dlc);
    }
    else
    {
       Dbc_dlc = 12;
	   Msg_TIPLLaneInfo0.dlc = Calc_Canfd_dlc(Dbc_dlc);
			
    }
}

on envVar E_pric_RadarFrontCenter_TIPLLaneInfo0_TIPLLaneInfo0_CRC_wrongvalctr
{
    //update disturb count
    //disturb value range:(-1 = always send wrong value),( X>0 ,x is the number of Messages with wrong CHK sent)
    TIPLLaneInfo0_TIPLLaneInfo0_CRC_wrongvalctr =getValue(this);    
}
on envVar E_pric_RadarFrontCenter_TIPLLaneInfo0_TIPLLaneInfo0_MsgCtr_wrongvalctr
{
    //update disturb count
    //disturb value range:(-1 = always send wrong value),( X>0 ,x is the number of Messages with wrong CHK sent)
    TIPLLaneInfo0_TIPLLaneInfo0_MsgCtr_wrongvalctr =getValue(this);    
}
on envVar E_pric_RadarFrontCenter_TIPLLaneInfo0_TIPLLaneInfo0_blockCtr_wrongvalctr
{
    //update disturb count
    //disturb value range:(-1 = always send wrong value),( X>0 ,x is the number of Messages with wrong CHK sent)
    TIPLLaneInfo0_TIPLLaneInfo0_blockCtr_wrongvalctr =getValue(this);    
}

on envVar E_pric_RadarFrontCenter_TIPLLaneInfo0_TIPLLaneInfo0_prob1Lane_ub_Rv
{
    qword rawValue = 0ll;
    float rawValue_float = 0.0;
    float phyValue = 0.0;        

    //set the signal with updated raw value
    {
        rawValue = getvalue(this);
        if(chgEv_TIPLLaneInfo0_TIPLLaneInfo0_prob1Lane_ub == 0)
        {
            //type conversion to float
            rawValue_float = rawValue;        
            // raw to physical conversion
            phyValue = ((rawValue_float *0.0078125)+(0));
            putValue(E_pric_RadarFrontCenter_TIPLLaneInfo0_TIPLLaneInfo0_prob1Lane_ub_Pv, phyValue);
            chgEv_TIPLLaneInfo0_TIPLLaneInfo0_prob1Lane_ub = 1;
        }
        else
        {
            chgEv_TIPLLaneInfo0_TIPLLaneInfo0_prob1Lane_ub = 0;
        }    
        //update the signal value
        Msg_TIPLLaneInfo0.TIPLLaneInfo0_prob1Lane_ub=rawValue;        
    }                                                                           
}

on envVar E_pric_RadarFrontCenter_TIPLLaneInfo0_TIPLLaneInfo0_prob1Lane_ub_Pv
{
    qword rawValue = 0ll;
    float phyValue = 0.0;
    
    //update the raw value with physical value 
    {
        if(chgEv_TIPLLaneInfo0_TIPLLaneInfo0_prob1Lane_ub == 0)
        {
            phyValue = getvalue(this);
            // physical to raw conversion
            rawValue = ((phyValue -(0))/0.0078125);
            putValue(E_pric_RadarFrontCenter_TIPLLaneInfo0_TIPLLaneInfo0_prob1Lane_ub_Rv, rawValue);
            chgEv_TIPLLaneInfo0_TIPLLaneInfo0_prob1Lane_ub = 1;  
        }
        else
        {
            chgEv_TIPLLaneInfo0_TIPLLaneInfo0_prob1Lane_ub = 0;
        }
    }
}


 
on envVar E_pric_RadarFrontCenter_TIPLLaneInfo0_TIPLLaneInfo0_dUpperLimitLane_sw_Rv
{
    qword rawValue = 0ll;
    float rawValue_float = 0.0;
    float phyValue = 0.0;        

    //set the signal with updated raw value
    {
        rawValue = getvalue(this);
        if(chgEv_TIPLLaneInfo0_TIPLLaneInfo0_dUpperLimitLane_sw == 0)
        {
            //type conversion to float
            rawValue_float = rawValue;        
            // raw to physical conversion
            phyValue = ((rawValue_float *0.0078125)+(0));
            putValue(E_pric_RadarFrontCenter_TIPLLaneInfo0_TIPLLaneInfo0_dUpperLimitLane_sw_Pv, phyValue);
            chgEv_TIPLLaneInfo0_TIPLLaneInfo0_dUpperLimitLane_sw = 1;
        }
        else
        {
            chgEv_TIPLLaneInfo0_TIPLLaneInfo0_dUpperLimitLane_sw = 0;
        }    
        //update the signal value
        Msg_TIPLLaneInfo0.TIPLLaneInfo0_dUpperLimitLane_sw=rawValue;        
    }                                                                           
}

on envVar E_pric_RadarFrontCenter_TIPLLaneInfo0_TIPLLaneInfo0_dUpperLimitLane_sw_Pv
{
    qword rawValue = 0ll;
    float phyValue = 0.0;
    
    //update the raw value with physical value 
    {
        if(chgEv_TIPLLaneInfo0_TIPLLaneInfo0_dUpperLimitLane_sw == 0)
        {
            phyValue = getvalue(this);
            // physical to raw conversion
            rawValue = ((phyValue -(0))/0.0078125);
            putValue(E_pric_RadarFrontCenter_TIPLLaneInfo0_TIPLLaneInfo0_dUpperLimitLane_sw_Rv, rawValue);
            chgEv_TIPLLaneInfo0_TIPLLaneInfo0_dUpperLimitLane_sw = 1;  
        }
        else
        {
            chgEv_TIPLLaneInfo0_TIPLLaneInfo0_dUpperLimitLane_sw = 0;
        }
    }
}


 
on envVar E_pric_RadarFrontCenter_TIPLLaneInfo0_TIPLLaneInfo0_dLowerLimitLane_sw_Rv
{
    qword rawValue = 0ll;
    float rawValue_float = 0.0;
    float phyValue = 0.0;        

    //set the signal with updated raw value
    {
        rawValue = getvalue(this);
        if(chgEv_TIPLLaneInfo0_TIPLLaneInfo0_dLowerLimitLane_sw == 0)
        {
            //type conversion to float
            rawValue_float = rawValue;        
            // raw to physical conversion
            phyValue = ((rawValue_float *0.0078125)+(0));
            putValue(E_pric_RadarFrontCenter_TIPLLaneInfo0_TIPLLaneInfo0_dLowerLimitLane_sw_Pv, phyValue);
            chgEv_TIPLLaneInfo0_TIPLLaneInfo0_dLowerLimitLane_sw = 1;
        }
        else
        {
            chgEv_TIPLLaneInfo0_TIPLLaneInfo0_dLowerLimitLane_sw = 0;
        }    
        //update the signal value
        Msg_TIPLLaneInfo0.TIPLLaneInfo0_dLowerLimitLane_sw=rawValue;        
    }                                                                           
}

on envVar E_pric_RadarFrontCenter_TIPLLaneInfo0_TIPLLaneInfo0_dLowerLimitLane_sw_Pv
{
    qword rawValue = 0ll;
    float phyValue = 0.0;
    
    //update the raw value with physical value 
    {
        if(chgEv_TIPLLaneInfo0_TIPLLaneInfo0_dLowerLimitLane_sw == 0)
        {
            phyValue = getvalue(this);
            // physical to raw conversion
            rawValue = ((phyValue -(0))/0.0078125);
            putValue(E_pric_RadarFrontCenter_TIPLLaneInfo0_TIPLLaneInfo0_dLowerLimitLane_sw_Rv, rawValue);
            chgEv_TIPLLaneInfo0_TIPLLaneInfo0_dLowerLimitLane_sw = 1;  
        }
        else
        {
            chgEv_TIPLLaneInfo0_TIPLLaneInfo0_dLowerLimitLane_sw = 0;
        }
    }
}


 
on envVar E_pric_RadarFrontCenter_TIPLLaneInfo0_TIPLLaneInfo0_dRightBorder_sw_Rv
{
    qword rawValue = 0ll;
    float rawValue_float = 0.0;
    float phyValue = 0.0;        

    //set the signal with updated raw value
    {
        rawValue = getvalue(this);
        if(chgEv_TIPLLaneInfo0_TIPLLaneInfo0_dRightBorder_sw == 0)
        {
            //type conversion to float
            rawValue_float = rawValue;        
            // raw to physical conversion
            phyValue = ((rawValue_float *0.0078125)+(0));
            putValue(E_pric_RadarFrontCenter_TIPLLaneInfo0_TIPLLaneInfo0_dRightBorder_sw_Pv, phyValue);
            chgEv_TIPLLaneInfo0_TIPLLaneInfo0_dRightBorder_sw = 1;
        }
        else
        {
            chgEv_TIPLLaneInfo0_TIPLLaneInfo0_dRightBorder_sw = 0;
        }    
        //update the signal value
        Msg_TIPLLaneInfo0.TIPLLaneInfo0_dRightBorder_sw=rawValue;        
    }                                                                           
}

on envVar E_pric_RadarFrontCenter_TIPLLaneInfo0_TIPLLaneInfo0_dRightBorder_sw_Pv
{
    qword rawValue = 0ll;
    float phyValue = 0.0;
    
    //update the raw value with physical value 
    {
        if(chgEv_TIPLLaneInfo0_TIPLLaneInfo0_dRightBorder_sw == 0)
        {
            phyValue = getvalue(this);
            // physical to raw conversion
            rawValue = ((phyValue -(0))/0.0078125);
            putValue(E_pric_RadarFrontCenter_TIPLLaneInfo0_TIPLLaneInfo0_dRightBorder_sw_Rv, rawValue);
            chgEv_TIPLLaneInfo0_TIPLLaneInfo0_dRightBorder_sw = 1;  
        }
        else
        {
            chgEv_TIPLLaneInfo0_TIPLLaneInfo0_dRightBorder_sw = 0;
        }
    }
}


 
on envVar E_pric_RadarFrontCenter_TIPLLaneInfo0_TIPLLaneInfo0_dLeftBorder_sw_Rv
{
    qword rawValue = 0ll;
    float rawValue_float = 0.0;
    float phyValue = 0.0;        

    //set the signal with updated raw value
    {
        rawValue = getvalue(this);
        if(chgEv_TIPLLaneInfo0_TIPLLaneInfo0_dLeftBorder_sw == 0)
        {
            //type conversion to float
            rawValue_float = rawValue;        
            // raw to physical conversion
            phyValue = ((rawValue_float *0.0078125)+(0));
            putValue(E_pric_RadarFrontCenter_TIPLLaneInfo0_TIPLLaneInfo0_dLeftBorder_sw_Pv, phyValue);
            chgEv_TIPLLaneInfo0_TIPLLaneInfo0_dLeftBorder_sw = 1;
        }
        else
        {
            chgEv_TIPLLaneInfo0_TIPLLaneInfo0_dLeftBorder_sw = 0;
        }    
        //update the signal value
        Msg_TIPLLaneInfo0.TIPLLaneInfo0_dLeftBorder_sw=rawValue;        
    }                                                                           
}

on envVar E_pric_RadarFrontCenter_TIPLLaneInfo0_TIPLLaneInfo0_dLeftBorder_sw_Pv
{
    qword rawValue = 0ll;
    float phyValue = 0.0;
    
    //update the raw value with physical value 
    {
        if(chgEv_TIPLLaneInfo0_TIPLLaneInfo0_dLeftBorder_sw == 0)
        {
            phyValue = getvalue(this);
            // physical to raw conversion
            rawValue = ((phyValue -(0))/0.0078125);
            putValue(E_pric_RadarFrontCenter_TIPLLaneInfo0_TIPLLaneInfo0_dLeftBorder_sw_Rv, rawValue);
            chgEv_TIPLLaneInfo0_TIPLLaneInfo0_dLeftBorder_sw = 1;  
        }
        else
        {
            chgEv_TIPLLaneInfo0_TIPLLaneInfo0_dLeftBorder_sw = 0;
        }
    }
}


 
on envVar E_pric_RadarFrontCenter_TIPLLaneInfo1_tx
{
    if(getValue(this))
    {       
        
        //update the BZ Signal
        if(TIPLLaneInfo1_TIPLLaneInfo1_MsgCtr_wrongvalctr == 0)
        {
            update_TIPLLaneInfo1_TIPLLaneInfo1_MsgCtr_counter();
            Msg_TIPLLaneInfo1.TIPLLaneInfo1_MsgCtr= TIPLLaneInfo1_TIPLLaneInfo1_MsgCtr_counter;
        }
        else if(TIPLLaneInfo1_TIPLLaneInfo1_MsgCtr_wrongvalctr > 0)
        {
             TIPLLaneInfo1_TIPLLaneInfo1_MsgCtr_wrongvalctr--;
              // if counter becomes zero, update panel controller to zero
             if(TIPLLaneInfo1_TIPLLaneInfo1_MsgCtr_wrongvalctr == 0)
             {
                 putValue(E_pric_RadarFrontCenter_TIPLLaneInfo1_TIPLLaneInfo1_MsgCtr_wrongvalctr,0);
             }
        }
        else
        {
            //do nothing
        }        
        //update the BZ Signal
        if(TIPLLaneInfo1_TIPLLaneInfo1_blockCtr_wrongvalctr == 0)
        {
            update_TIPLLaneInfo1_TIPLLaneInfo1_blockCtr_counter();
            Msg_TIPLLaneInfo1.TIPLLaneInfo1_blockCtr= TIPLLaneInfo1_TIPLLaneInfo1_blockCtr_counter;
        }
        else if(TIPLLaneInfo1_TIPLLaneInfo1_blockCtr_wrongvalctr > 0)
        {
             TIPLLaneInfo1_TIPLLaneInfo1_blockCtr_wrongvalctr--;
              // if counter becomes zero, update panel controller to zero
             if(TIPLLaneInfo1_TIPLLaneInfo1_blockCtr_wrongvalctr == 0)
             {
                 putValue(E_pric_RadarFrontCenter_TIPLLaneInfo1_TIPLLaneInfo1_blockCtr_wrongvalctr,0);
             }
        }
        else
        {
            //do nothing
        }        
        //calculate the CRC checksum
        update_TIPLLaneInfo1_ChkSum_Checksum();

        output(Msg_TIPLLaneInfo1);        
    }
}

on envVar E_pric_RadarFrontCenter_TIPLLaneInfo1_Range
{
    qword rawstatus = 0ll;
    qword rawValue = 0ll;    
    
    rawstatus = getvalue(this);    
    // set all the signals with min raw /max raw /init raw
    switch (rawstatus) 
    {
     case(0) :
        rawValue= -32768;
        putValue(E_pric_RadarFrontCenter_TIPLLaneInfo1_TIPLLaneInfo1_dRightBorder_sw_Rv, rawValue);
        rawValue= -32768;
        putValue(E_pric_RadarFrontCenter_TIPLLaneInfo1_TIPLLaneInfo1_dUpperLimitLane_sw_Rv, rawValue);
        rawValue= -32768;
        putValue(E_pric_RadarFrontCenter_TIPLLaneInfo1_TIPLLaneInfo1_dLowerLimitLane_sw_Rv, rawValue);
        rawValue= -32768;
        putValue(E_pric_RadarFrontCenter_TIPLLaneInfo1_TIPLLaneInfo1_dLeftBorder_sw_Rv, rawValue);
        rawValue= 0;
        putValue(E_pric_RadarFrontCenter_TIPLLaneInfo1_TIPLLaneInfo1_prob1Lane_ub_Rv, rawValue);
        break;
     case(1) :
        rawValue= 32767;
        putValue(E_pric_RadarFrontCenter_TIPLLaneInfo1_TIPLLaneInfo1_dRightBorder_sw_Rv, rawValue);
        rawValue= 32767;
        putValue(E_pric_RadarFrontCenter_TIPLLaneInfo1_TIPLLaneInfo1_dUpperLimitLane_sw_Rv, rawValue);
        rawValue= 32767;
        putValue(E_pric_RadarFrontCenter_TIPLLaneInfo1_TIPLLaneInfo1_dLowerLimitLane_sw_Rv, rawValue);
        rawValue= 32767;
        putValue(E_pric_RadarFrontCenter_TIPLLaneInfo1_TIPLLaneInfo1_dLeftBorder_sw_Rv, rawValue);
        rawValue= 255;
        putValue(E_pric_RadarFrontCenter_TIPLLaneInfo1_TIPLLaneInfo1_prob1Lane_ub_Rv, rawValue);
        break;
     default :
        rawValue= -32768;
        putValue(E_pric_RadarFrontCenter_TIPLLaneInfo1_TIPLLaneInfo1_dRightBorder_sw_Rv, rawValue);
        rawValue= -32768;
        putValue(E_pric_RadarFrontCenter_TIPLLaneInfo1_TIPLLaneInfo1_dUpperLimitLane_sw_Rv, rawValue);
        rawValue= -32768;
        putValue(E_pric_RadarFrontCenter_TIPLLaneInfo1_TIPLLaneInfo1_dLowerLimitLane_sw_Rv, rawValue);
        rawValue= -32768;
        putValue(E_pric_RadarFrontCenter_TIPLLaneInfo1_TIPLLaneInfo1_dLeftBorder_sw_Rv, rawValue);
        rawValue= 0;
        putValue(E_pric_RadarFrontCenter_TIPLLaneInfo1_TIPLLaneInfo1_prob1Lane_ub_Rv, rawValue);
      break;
   }
}

on envVar E_pric_RadarFrontCenter_TIPLLaneInfo1_Dlc
{
    if(getValue(E_pric_RadarFrontCenter_TIPLLaneInfo1_enDlc))
    {
        Msg_TIPLLaneInfo1.dlc =getValue(this);
    }
    else
    {
       Dbc_dlc = 12;
	   Msg_TIPLLaneInfo1.dlc = Calc_Canfd_dlc(Dbc_dlc);
	   	
  }
}

on envVar E_pric_RadarFrontCenter_TIPLLaneInfo1_enDlc
{
    //For Messages with DLC = 8, set wrong DLC to smaller than defined DLC
    //For Messages with DLC < 8 set wrong DLC to smaller/longer than defined DLC
    if(getValue(this))
    {
        Msg_TIPLLaneInfo1.dlc =getValue(E_pric_RadarFrontCenter_TIPLLaneInfo1_Dlc);
    }
    else
    {
       Dbc_dlc = 12;
	   Msg_TIPLLaneInfo1.dlc = Calc_Canfd_dlc(Dbc_dlc);
			
    }
}

on envVar E_pric_RadarFrontCenter_TIPLLaneInfo1_TIPLLaneInfo1_CRC_wrongvalctr
{
    //update disturb count
    //disturb value range:(-1 = always send wrong value),( X>0 ,x is the number of Messages with wrong CHK sent)
    TIPLLaneInfo1_TIPLLaneInfo1_CRC_wrongvalctr =getValue(this);    
}
on envVar E_pric_RadarFrontCenter_TIPLLaneInfo1_TIPLLaneInfo1_MsgCtr_wrongvalctr
{
    //update disturb count
    //disturb value range:(-1 = always send wrong value),( X>0 ,x is the number of Messages with wrong CHK sent)
    TIPLLaneInfo1_TIPLLaneInfo1_MsgCtr_wrongvalctr =getValue(this);    
}
on envVar E_pric_RadarFrontCenter_TIPLLaneInfo1_TIPLLaneInfo1_blockCtr_wrongvalctr
{
    //update disturb count
    //disturb value range:(-1 = always send wrong value),( X>0 ,x is the number of Messages with wrong CHK sent)
    TIPLLaneInfo1_TIPLLaneInfo1_blockCtr_wrongvalctr =getValue(this);    
}

on envVar E_pric_RadarFrontCenter_TIPLLaneInfo1_TIPLLaneInfo1_dRightBorder_sw_Rv
{
    qword rawValue = 0ll;
    float rawValue_float = 0.0;
    float phyValue = 0.0;        

    //set the signal with updated raw value
    {
        rawValue = getvalue(this);
        if(chgEv_TIPLLaneInfo1_TIPLLaneInfo1_dRightBorder_sw == 0)
        {
            //type conversion to float
            rawValue_float = rawValue;        
            // raw to physical conversion
            phyValue = ((rawValue_float *0.0078125)+(0));
            putValue(E_pric_RadarFrontCenter_TIPLLaneInfo1_TIPLLaneInfo1_dRightBorder_sw_Pv, phyValue);
            chgEv_TIPLLaneInfo1_TIPLLaneInfo1_dRightBorder_sw = 1;
        }
        else
        {
            chgEv_TIPLLaneInfo1_TIPLLaneInfo1_dRightBorder_sw = 0;
        }    
        //update the signal value
        Msg_TIPLLaneInfo1.TIPLLaneInfo1_dRightBorder_sw=rawValue;        
    }                                                                           
}

on envVar E_pric_RadarFrontCenter_TIPLLaneInfo1_TIPLLaneInfo1_dRightBorder_sw_Pv
{
    qword rawValue = 0ll;
    float phyValue = 0.0;
    
    //update the raw value with physical value 
    {
        if(chgEv_TIPLLaneInfo1_TIPLLaneInfo1_dRightBorder_sw == 0)
        {
            phyValue = getvalue(this);
            // physical to raw conversion
            rawValue = ((phyValue -(0))/0.0078125);
            putValue(E_pric_RadarFrontCenter_TIPLLaneInfo1_TIPLLaneInfo1_dRightBorder_sw_Rv, rawValue);
            chgEv_TIPLLaneInfo1_TIPLLaneInfo1_dRightBorder_sw = 1;  
        }
        else
        {
            chgEv_TIPLLaneInfo1_TIPLLaneInfo1_dRightBorder_sw = 0;
        }
    }
}


 
on envVar E_pric_RadarFrontCenter_TIPLLaneInfo1_TIPLLaneInfo1_dUpperLimitLane_sw_Rv
{
    qword rawValue = 0ll;
    float rawValue_float = 0.0;
    float phyValue = 0.0;        

    //set the signal with updated raw value
    {
        rawValue = getvalue(this);
        if(chgEv_TIPLLaneInfo1_TIPLLaneInfo1_dUpperLimitLane_sw == 0)
        {
            //type conversion to float
            rawValue_float = rawValue;        
            // raw to physical conversion
            phyValue = ((rawValue_float *0.0078125)+(0));
            putValue(E_pric_RadarFrontCenter_TIPLLaneInfo1_TIPLLaneInfo1_dUpperLimitLane_sw_Pv, phyValue);
            chgEv_TIPLLaneInfo1_TIPLLaneInfo1_dUpperLimitLane_sw = 1;
        }
        else
        {
            chgEv_TIPLLaneInfo1_TIPLLaneInfo1_dUpperLimitLane_sw = 0;
        }    
        //update the signal value
        Msg_TIPLLaneInfo1.TIPLLaneInfo1_dUpperLimitLane_sw=rawValue;        
    }                                                                           
}

on envVar E_pric_RadarFrontCenter_TIPLLaneInfo1_TIPLLaneInfo1_dUpperLimitLane_sw_Pv
{
    qword rawValue = 0ll;
    float phyValue = 0.0;
    
    //update the raw value with physical value 
    {
        if(chgEv_TIPLLaneInfo1_TIPLLaneInfo1_dUpperLimitLane_sw == 0)
        {
            phyValue = getvalue(this);
            // physical to raw conversion
            rawValue = ((phyValue -(0))/0.0078125);
            putValue(E_pric_RadarFrontCenter_TIPLLaneInfo1_TIPLLaneInfo1_dUpperLimitLane_sw_Rv, rawValue);
            chgEv_TIPLLaneInfo1_TIPLLaneInfo1_dUpperLimitLane_sw = 1;  
        }
        else
        {
            chgEv_TIPLLaneInfo1_TIPLLaneInfo1_dUpperLimitLane_sw = 0;
        }
    }
}


 
on envVar E_pric_RadarFrontCenter_TIPLLaneInfo1_TIPLLaneInfo1_dLowerLimitLane_sw_Rv
{
    qword rawValue = 0ll;
    float rawValue_float = 0.0;
    float phyValue = 0.0;        

    //set the signal with updated raw value
    {
        rawValue = getvalue(this);
        if(chgEv_TIPLLaneInfo1_TIPLLaneInfo1_dLowerLimitLane_sw == 0)
        {
            //type conversion to float
            rawValue_float = rawValue;        
            // raw to physical conversion
            phyValue = ((rawValue_float *0.0078125)+(0));
            putValue(E_pric_RadarFrontCenter_TIPLLaneInfo1_TIPLLaneInfo1_dLowerLimitLane_sw_Pv, phyValue);
            chgEv_TIPLLaneInfo1_TIPLLaneInfo1_dLowerLimitLane_sw = 1;
        }
        else
        {
            chgEv_TIPLLaneInfo1_TIPLLaneInfo1_dLowerLimitLane_sw = 0;
        }    
        //update the signal value
        Msg_TIPLLaneInfo1.TIPLLaneInfo1_dLowerLimitLane_sw=rawValue;        
    }                                                                           
}

on envVar E_pric_RadarFrontCenter_TIPLLaneInfo1_TIPLLaneInfo1_dLowerLimitLane_sw_Pv
{
    qword rawValue = 0ll;
    float phyValue = 0.0;
    
    //update the raw value with physical value 
    {
        if(chgEv_TIPLLaneInfo1_TIPLLaneInfo1_dLowerLimitLane_sw == 0)
        {
            phyValue = getvalue(this);
            // physical to raw conversion
            rawValue = ((phyValue -(0))/0.0078125);
            putValue(E_pric_RadarFrontCenter_TIPLLaneInfo1_TIPLLaneInfo1_dLowerLimitLane_sw_Rv, rawValue);
            chgEv_TIPLLaneInfo1_TIPLLaneInfo1_dLowerLimitLane_sw = 1;  
        }
        else
        {
            chgEv_TIPLLaneInfo1_TIPLLaneInfo1_dLowerLimitLane_sw = 0;
        }
    }
}


 
on envVar E_pric_RadarFrontCenter_TIPLLaneInfo1_TIPLLaneInfo1_dLeftBorder_sw_Rv
{
    qword rawValue = 0ll;
    float rawValue_float = 0.0;
    float phyValue = 0.0;        

    //set the signal with updated raw value
    {
        rawValue = getvalue(this);
        if(chgEv_TIPLLaneInfo1_TIPLLaneInfo1_dLeftBorder_sw == 0)
        {
            //type conversion to float
            rawValue_float = rawValue;        
            // raw to physical conversion
            phyValue = ((rawValue_float *0.0078125)+(0));
            putValue(E_pric_RadarFrontCenter_TIPLLaneInfo1_TIPLLaneInfo1_dLeftBorder_sw_Pv, phyValue);
            chgEv_TIPLLaneInfo1_TIPLLaneInfo1_dLeftBorder_sw = 1;
        }
        else
        {
            chgEv_TIPLLaneInfo1_TIPLLaneInfo1_dLeftBorder_sw = 0;
        }    
        //update the signal value
        Msg_TIPLLaneInfo1.TIPLLaneInfo1_dLeftBorder_sw=rawValue;        
    }                                                                           
}

on envVar E_pric_RadarFrontCenter_TIPLLaneInfo1_TIPLLaneInfo1_dLeftBorder_sw_Pv
{
    qword rawValue = 0ll;
    float phyValue = 0.0;
    
    //update the raw value with physical value 
    {
        if(chgEv_TIPLLaneInfo1_TIPLLaneInfo1_dLeftBorder_sw == 0)
        {
            phyValue = getvalue(this);
            // physical to raw conversion
            rawValue = ((phyValue -(0))/0.0078125);
            putValue(E_pric_RadarFrontCenter_TIPLLaneInfo1_TIPLLaneInfo1_dLeftBorder_sw_Rv, rawValue);
            chgEv_TIPLLaneInfo1_TIPLLaneInfo1_dLeftBorder_sw = 1;  
        }
        else
        {
            chgEv_TIPLLaneInfo1_TIPLLaneInfo1_dLeftBorder_sw = 0;
        }
    }
}


 
on envVar E_pric_RadarFrontCenter_TIPLLaneInfo1_TIPLLaneInfo1_prob1Lane_ub_Rv
{
    qword rawValue = 0ll;
    float rawValue_float = 0.0;
    float phyValue = 0.0;        

    //set the signal with updated raw value
    {
        rawValue = getvalue(this);
        if(chgEv_TIPLLaneInfo1_TIPLLaneInfo1_prob1Lane_ub == 0)
        {
            //type conversion to float
            rawValue_float = rawValue;        
            // raw to physical conversion
            phyValue = ((rawValue_float *0.0078125)+(0));
            putValue(E_pric_RadarFrontCenter_TIPLLaneInfo1_TIPLLaneInfo1_prob1Lane_ub_Pv, phyValue);
            chgEv_TIPLLaneInfo1_TIPLLaneInfo1_prob1Lane_ub = 1;
        }
        else
        {
            chgEv_TIPLLaneInfo1_TIPLLaneInfo1_prob1Lane_ub = 0;
        }    
        //update the signal value
        Msg_TIPLLaneInfo1.TIPLLaneInfo1_prob1Lane_ub=rawValue;        
    }                                                                           
}

on envVar E_pric_RadarFrontCenter_TIPLLaneInfo1_TIPLLaneInfo1_prob1Lane_ub_Pv
{
    qword rawValue = 0ll;
    float phyValue = 0.0;
    
    //update the raw value with physical value 
    {
        if(chgEv_TIPLLaneInfo1_TIPLLaneInfo1_prob1Lane_ub == 0)
        {
            phyValue = getvalue(this);
            // physical to raw conversion
            rawValue = ((phyValue -(0))/0.0078125);
            putValue(E_pric_RadarFrontCenter_TIPLLaneInfo1_TIPLLaneInfo1_prob1Lane_ub_Rv, rawValue);
            chgEv_TIPLLaneInfo1_TIPLLaneInfo1_prob1Lane_ub = 1;  
        }
        else
        {
            chgEv_TIPLLaneInfo1_TIPLLaneInfo1_prob1Lane_ub = 0;
        }
    }
}


 
on envVar E_pric_RadarFrontCenter_TIPLLaneInfo2_tx
{
    if(getValue(this))
    {       
        
        //update the BZ Signal
        if(TIPLLaneInfo2_TIPLLaneInfo2_blockCtr_wrongvalctr == 0)
        {
            update_TIPLLaneInfo2_TIPLLaneInfo2_blockCtr_counter();
            Msg_TIPLLaneInfo2.TIPLLaneInfo2_blockCtr= TIPLLaneInfo2_TIPLLaneInfo2_blockCtr_counter;
        }
        else if(TIPLLaneInfo2_TIPLLaneInfo2_blockCtr_wrongvalctr > 0)
        {
             TIPLLaneInfo2_TIPLLaneInfo2_blockCtr_wrongvalctr--;
              // if counter becomes zero, update panel controller to zero
             if(TIPLLaneInfo2_TIPLLaneInfo2_blockCtr_wrongvalctr == 0)
             {
                 putValue(E_pric_RadarFrontCenter_TIPLLaneInfo2_TIPLLaneInfo2_blockCtr_wrongvalctr,0);
             }
        }
        else
        {
            //do nothing
        }        
        //update the BZ Signal
        if(TIPLLaneInfo2_TIPLLaneInfo2_MsgCtr_wrongvalctr == 0)
        {
            update_TIPLLaneInfo2_TIPLLaneInfo2_MsgCtr_counter();
            Msg_TIPLLaneInfo2.TIPLLaneInfo2_MsgCtr= TIPLLaneInfo2_TIPLLaneInfo2_MsgCtr_counter;
        }
        else if(TIPLLaneInfo2_TIPLLaneInfo2_MsgCtr_wrongvalctr > 0)
        {
             TIPLLaneInfo2_TIPLLaneInfo2_MsgCtr_wrongvalctr--;
              // if counter becomes zero, update panel controller to zero
             if(TIPLLaneInfo2_TIPLLaneInfo2_MsgCtr_wrongvalctr == 0)
             {
                 putValue(E_pric_RadarFrontCenter_TIPLLaneInfo2_TIPLLaneInfo2_MsgCtr_wrongvalctr,0);
             }
        }
        else
        {
            //do nothing
        }        
        //calculate the CRC checksum
        update_TIPLLaneInfo2_ChkSum_Checksum();

        output(Msg_TIPLLaneInfo2);        
    }
}

on envVar E_pric_RadarFrontCenter_TIPLLaneInfo2_Range
{
    qword rawstatus = 0ll;
    qword rawValue = 0ll;    
    
    rawstatus = getvalue(this);    
    // set all the signals with min raw /max raw /init raw
    switch (rawstatus) 
    {
     case(0) :
        rawValue= 0;
        putValue(E_pric_RadarFrontCenter_TIPLLaneInfo2_TIPLLaneInfo2_prob1Lane_ub_Rv, rawValue);
        rawValue= -32768;
        putValue(E_pric_RadarFrontCenter_TIPLLaneInfo2_TIPLLaneInfo2_dUpperLimitLane_sw_Rv, rawValue);
        rawValue= -32768;
        putValue(E_pric_RadarFrontCenter_TIPLLaneInfo2_TIPLLaneInfo2_dLeftBorder_sw_Rv, rawValue);
        rawValue= -32768;
        putValue(E_pric_RadarFrontCenter_TIPLLaneInfo2_TIPLLaneInfo2_dRightBorder_sw_Rv, rawValue);
        rawValue= -32768;
        putValue(E_pric_RadarFrontCenter_TIPLLaneInfo2_TIPLLaneInfo2_dLowerLimitLane_sw_Rv, rawValue);
        break;
     case(1) :
        rawValue= 255;
        putValue(E_pric_RadarFrontCenter_TIPLLaneInfo2_TIPLLaneInfo2_prob1Lane_ub_Rv, rawValue);
        rawValue= 32767;
        putValue(E_pric_RadarFrontCenter_TIPLLaneInfo2_TIPLLaneInfo2_dUpperLimitLane_sw_Rv, rawValue);
        rawValue= 32767;
        putValue(E_pric_RadarFrontCenter_TIPLLaneInfo2_TIPLLaneInfo2_dLeftBorder_sw_Rv, rawValue);
        rawValue= 32767;
        putValue(E_pric_RadarFrontCenter_TIPLLaneInfo2_TIPLLaneInfo2_dRightBorder_sw_Rv, rawValue);
        rawValue= 32767;
        putValue(E_pric_RadarFrontCenter_TIPLLaneInfo2_TIPLLaneInfo2_dLowerLimitLane_sw_Rv, rawValue);
        break;
     default :
        rawValue= 0;
        putValue(E_pric_RadarFrontCenter_TIPLLaneInfo2_TIPLLaneInfo2_prob1Lane_ub_Rv, rawValue);
        rawValue= -32768;
        putValue(E_pric_RadarFrontCenter_TIPLLaneInfo2_TIPLLaneInfo2_dUpperLimitLane_sw_Rv, rawValue);
        rawValue= -32768;
        putValue(E_pric_RadarFrontCenter_TIPLLaneInfo2_TIPLLaneInfo2_dLeftBorder_sw_Rv, rawValue);
        rawValue= -32768;
        putValue(E_pric_RadarFrontCenter_TIPLLaneInfo2_TIPLLaneInfo2_dRightBorder_sw_Rv, rawValue);
        rawValue= -32768;
        putValue(E_pric_RadarFrontCenter_TIPLLaneInfo2_TIPLLaneInfo2_dLowerLimitLane_sw_Rv, rawValue);
      break;
   }
}

on envVar E_pric_RadarFrontCenter_TIPLLaneInfo2_Dlc
{
    if(getValue(E_pric_RadarFrontCenter_TIPLLaneInfo2_enDlc))
    {
        Msg_TIPLLaneInfo2.dlc =getValue(this);
    }
    else
    {
       Dbc_dlc = 12;
	   Msg_TIPLLaneInfo2.dlc = Calc_Canfd_dlc(Dbc_dlc);
	   	
  }
}

on envVar E_pric_RadarFrontCenter_TIPLLaneInfo2_enDlc
{
    //For Messages with DLC = 8, set wrong DLC to smaller than defined DLC
    //For Messages with DLC < 8 set wrong DLC to smaller/longer than defined DLC
    if(getValue(this))
    {
        Msg_TIPLLaneInfo2.dlc =getValue(E_pric_RadarFrontCenter_TIPLLaneInfo2_Dlc);
    }
    else
    {
       Dbc_dlc = 12;
	   Msg_TIPLLaneInfo2.dlc = Calc_Canfd_dlc(Dbc_dlc);
			
    }
}

on envVar E_pric_RadarFrontCenter_TIPLLaneInfo2_TIPLLaneInfo2_CRC_wrongvalctr
{
    //update disturb count
    //disturb value range:(-1 = always send wrong value),( X>0 ,x is the number of Messages with wrong CHK sent)
    TIPLLaneInfo2_TIPLLaneInfo2_CRC_wrongvalctr =getValue(this);    
}
on envVar E_pric_RadarFrontCenter_TIPLLaneInfo2_TIPLLaneInfo2_MsgCtr_wrongvalctr
{
    //update disturb count
    //disturb value range:(-1 = always send wrong value),( X>0 ,x is the number of Messages with wrong CHK sent)
    TIPLLaneInfo2_TIPLLaneInfo2_MsgCtr_wrongvalctr =getValue(this);    
}
on envVar E_pric_RadarFrontCenter_TIPLLaneInfo2_TIPLLaneInfo2_blockCtr_wrongvalctr
{
    //update disturb count
    //disturb value range:(-1 = always send wrong value),( X>0 ,x is the number of Messages with wrong CHK sent)
    TIPLLaneInfo2_TIPLLaneInfo2_blockCtr_wrongvalctr =getValue(this);    
}

on envVar E_pric_RadarFrontCenter_TIPLLaneInfo2_TIPLLaneInfo2_prob1Lane_ub_Rv
{
    qword rawValue = 0ll;
    float rawValue_float = 0.0;
    float phyValue = 0.0;        

    //set the signal with updated raw value
    {
        rawValue = getvalue(this);
        if(chgEv_TIPLLaneInfo2_TIPLLaneInfo2_prob1Lane_ub == 0)
        {
            //type conversion to float
            rawValue_float = rawValue;        
            // raw to physical conversion
            phyValue = ((rawValue_float *0.0078125)+(0));
            putValue(E_pric_RadarFrontCenter_TIPLLaneInfo2_TIPLLaneInfo2_prob1Lane_ub_Pv, phyValue);
            chgEv_TIPLLaneInfo2_TIPLLaneInfo2_prob1Lane_ub = 1;
        }
        else
        {
            chgEv_TIPLLaneInfo2_TIPLLaneInfo2_prob1Lane_ub = 0;
        }    
        //update the signal value
        Msg_TIPLLaneInfo2.TIPLLaneInfo2_prob1Lane_ub=rawValue;        
    }                                                                           
}

on envVar E_pric_RadarFrontCenter_TIPLLaneInfo2_TIPLLaneInfo2_prob1Lane_ub_Pv
{
    qword rawValue = 0ll;
    float phyValue = 0.0;
    
    //update the raw value with physical value 
    {
        if(chgEv_TIPLLaneInfo2_TIPLLaneInfo2_prob1Lane_ub == 0)
        {
            phyValue = getvalue(this);
            // physical to raw conversion
            rawValue = ((phyValue -(0))/0.0078125);
            putValue(E_pric_RadarFrontCenter_TIPLLaneInfo2_TIPLLaneInfo2_prob1Lane_ub_Rv, rawValue);
            chgEv_TIPLLaneInfo2_TIPLLaneInfo2_prob1Lane_ub = 1;  
        }
        else
        {
            chgEv_TIPLLaneInfo2_TIPLLaneInfo2_prob1Lane_ub = 0;
        }
    }
}


 
on envVar E_pric_RadarFrontCenter_TIPLLaneInfo2_TIPLLaneInfo2_dUpperLimitLane_sw_Rv
{
    qword rawValue = 0ll;
    float rawValue_float = 0.0;
    float phyValue = 0.0;        

    //set the signal with updated raw value
    {
        rawValue = getvalue(this);
        if(chgEv_TIPLLaneInfo2_TIPLLaneInfo2_dUpperLimitLane_sw == 0)
        {
            //type conversion to float
            rawValue_float = rawValue;        
            // raw to physical conversion
            phyValue = ((rawValue_float *0.0078125)+(0));
            putValue(E_pric_RadarFrontCenter_TIPLLaneInfo2_TIPLLaneInfo2_dUpperLimitLane_sw_Pv, phyValue);
            chgEv_TIPLLaneInfo2_TIPLLaneInfo2_dUpperLimitLane_sw = 1;
        }
        else
        {
            chgEv_TIPLLaneInfo2_TIPLLaneInfo2_dUpperLimitLane_sw = 0;
        }    
        //update the signal value
        Msg_TIPLLaneInfo2.TIPLLaneInfo2_dUpperLimitLane_sw=rawValue;        
    }                                                                           
}

on envVar E_pric_RadarFrontCenter_TIPLLaneInfo2_TIPLLaneInfo2_dUpperLimitLane_sw_Pv
{
    qword rawValue = 0ll;
    float phyValue = 0.0;
    
    //update the raw value with physical value 
    {
        if(chgEv_TIPLLaneInfo2_TIPLLaneInfo2_dUpperLimitLane_sw == 0)
        {
            phyValue = getvalue(this);
            // physical to raw conversion
            rawValue = ((phyValue -(0))/0.0078125);
            putValue(E_pric_RadarFrontCenter_TIPLLaneInfo2_TIPLLaneInfo2_dUpperLimitLane_sw_Rv, rawValue);
            chgEv_TIPLLaneInfo2_TIPLLaneInfo2_dUpperLimitLane_sw = 1;  
        }
        else
        {
            chgEv_TIPLLaneInfo2_TIPLLaneInfo2_dUpperLimitLane_sw = 0;
        }
    }
}


 
on envVar E_pric_RadarFrontCenter_TIPLLaneInfo2_TIPLLaneInfo2_dLeftBorder_sw_Rv
{
    qword rawValue = 0ll;
    float rawValue_float = 0.0;
    float phyValue = 0.0;        

    //set the signal with updated raw value
    {
        rawValue = getvalue(this);
        if(chgEv_TIPLLaneInfo2_TIPLLaneInfo2_dLeftBorder_sw == 0)
        {
            //type conversion to float
            rawValue_float = rawValue;        
            // raw to physical conversion
            phyValue = ((rawValue_float *0.0078125)+(0));
            putValue(E_pric_RadarFrontCenter_TIPLLaneInfo2_TIPLLaneInfo2_dLeftBorder_sw_Pv, phyValue);
            chgEv_TIPLLaneInfo2_TIPLLaneInfo2_dLeftBorder_sw = 1;
        }
        else
        {
            chgEv_TIPLLaneInfo2_TIPLLaneInfo2_dLeftBorder_sw = 0;
        }    
        //update the signal value
        Msg_TIPLLaneInfo2.TIPLLaneInfo2_dLeftBorder_sw=rawValue;        
    }                                                                           
}

on envVar E_pric_RadarFrontCenter_TIPLLaneInfo2_TIPLLaneInfo2_dLeftBorder_sw_Pv
{
    qword rawValue = 0ll;
    float phyValue = 0.0;
    
    //update the raw value with physical value 
    {
        if(chgEv_TIPLLaneInfo2_TIPLLaneInfo2_dLeftBorder_sw == 0)
        {
            phyValue = getvalue(this);
            // physical to raw conversion
            rawValue = ((phyValue -(0))/0.0078125);
            putValue(E_pric_RadarFrontCenter_TIPLLaneInfo2_TIPLLaneInfo2_dLeftBorder_sw_Rv, rawValue);
            chgEv_TIPLLaneInfo2_TIPLLaneInfo2_dLeftBorder_sw = 1;  
        }
        else
        {
            chgEv_TIPLLaneInfo2_TIPLLaneInfo2_dLeftBorder_sw = 0;
        }
    }
}


 
on envVar E_pric_RadarFrontCenter_TIPLLaneInfo2_TIPLLaneInfo2_dRightBorder_sw_Rv
{
    qword rawValue = 0ll;
    float rawValue_float = 0.0;
    float phyValue = 0.0;        

    //set the signal with updated raw value
    {
        rawValue = getvalue(this);
        if(chgEv_TIPLLaneInfo2_TIPLLaneInfo2_dRightBorder_sw == 0)
        {
            //type conversion to float
            rawValue_float = rawValue;        
            // raw to physical conversion
            phyValue = ((rawValue_float *0.0078125)+(0));
            putValue(E_pric_RadarFrontCenter_TIPLLaneInfo2_TIPLLaneInfo2_dRightBorder_sw_Pv, phyValue);
            chgEv_TIPLLaneInfo2_TIPLLaneInfo2_dRightBorder_sw = 1;
        }
        else
        {
            chgEv_TIPLLaneInfo2_TIPLLaneInfo2_dRightBorder_sw = 0;
        }    
        //update the signal value
        Msg_TIPLLaneInfo2.TIPLLaneInfo2_dRightBorder_sw=rawValue;        
    }                                                                           
}

on envVar E_pric_RadarFrontCenter_TIPLLaneInfo2_TIPLLaneInfo2_dRightBorder_sw_Pv
{
    qword rawValue = 0ll;
    float phyValue = 0.0;
    
    //update the raw value with physical value 
    {
        if(chgEv_TIPLLaneInfo2_TIPLLaneInfo2_dRightBorder_sw == 0)
        {
            phyValue = getvalue(this);
            // physical to raw conversion
            rawValue = ((phyValue -(0))/0.0078125);
            putValue(E_pric_RadarFrontCenter_TIPLLaneInfo2_TIPLLaneInfo2_dRightBorder_sw_Rv, rawValue);
            chgEv_TIPLLaneInfo2_TIPLLaneInfo2_dRightBorder_sw = 1;  
        }
        else
        {
            chgEv_TIPLLaneInfo2_TIPLLaneInfo2_dRightBorder_sw = 0;
        }
    }
}


 
on envVar E_pric_RadarFrontCenter_TIPLLaneInfo2_TIPLLaneInfo2_dLowerLimitLane_sw_Rv
{
    qword rawValue = 0ll;
    float rawValue_float = 0.0;
    float phyValue = 0.0;        

    //set the signal with updated raw value
    {
        rawValue = getvalue(this);
        if(chgEv_TIPLLaneInfo2_TIPLLaneInfo2_dLowerLimitLane_sw == 0)
        {
            //type conversion to float
            rawValue_float = rawValue;        
            // raw to physical conversion
            phyValue = ((rawValue_float *0.0078125)+(0));
            putValue(E_pric_RadarFrontCenter_TIPLLaneInfo2_TIPLLaneInfo2_dLowerLimitLane_sw_Pv, phyValue);
            chgEv_TIPLLaneInfo2_TIPLLaneInfo2_dLowerLimitLane_sw = 1;
        }
        else
        {
            chgEv_TIPLLaneInfo2_TIPLLaneInfo2_dLowerLimitLane_sw = 0;
        }    
        //update the signal value
        Msg_TIPLLaneInfo2.TIPLLaneInfo2_dLowerLimitLane_sw=rawValue;        
    }                                                                           
}

on envVar E_pric_RadarFrontCenter_TIPLLaneInfo2_TIPLLaneInfo2_dLowerLimitLane_sw_Pv
{
    qword rawValue = 0ll;
    float phyValue = 0.0;
    
    //update the raw value with physical value 
    {
        if(chgEv_TIPLLaneInfo2_TIPLLaneInfo2_dLowerLimitLane_sw == 0)
        {
            phyValue = getvalue(this);
            // physical to raw conversion
            rawValue = ((phyValue -(0))/0.0078125);
            putValue(E_pric_RadarFrontCenter_TIPLLaneInfo2_TIPLLaneInfo2_dLowerLimitLane_sw_Rv, rawValue);
            chgEv_TIPLLaneInfo2_TIPLLaneInfo2_dLowerLimitLane_sw = 1;  
        }
        else
        {
            chgEv_TIPLLaneInfo2_TIPLLaneInfo2_dLowerLimitLane_sw = 0;
        }
    }
}


 
on envVar E_pric_RadarFrontCenter_TIPLLaneInfo3_tx
{
    if(getValue(this))
    {       
        
        //update the BZ Signal
        if(TIPLLaneInfo3_TIPLLaneInfo3_MsgCtr_wrongvalctr == 0)
        {
            update_TIPLLaneInfo3_TIPLLaneInfo3_MsgCtr_counter();
            Msg_TIPLLaneInfo3.TIPLLaneInfo3_MsgCtr= TIPLLaneInfo3_TIPLLaneInfo3_MsgCtr_counter;
        }
        else if(TIPLLaneInfo3_TIPLLaneInfo3_MsgCtr_wrongvalctr > 0)
        {
             TIPLLaneInfo3_TIPLLaneInfo3_MsgCtr_wrongvalctr--;
              // if counter becomes zero, update panel controller to zero
             if(TIPLLaneInfo3_TIPLLaneInfo3_MsgCtr_wrongvalctr == 0)
             {
                 putValue(E_pric_RadarFrontCenter_TIPLLaneInfo3_TIPLLaneInfo3_MsgCtr_wrongvalctr,0);
             }
        }
        else
        {
            //do nothing
        }        
        //update the BZ Signal
        if(TIPLLaneInfo3_TIPLLaneInfo3_blockCtr_wrongvalctr == 0)
        {
            update_TIPLLaneInfo3_TIPLLaneInfo3_blockCtr_counter();
            Msg_TIPLLaneInfo3.TIPLLaneInfo3_blockCtr= TIPLLaneInfo3_TIPLLaneInfo3_blockCtr_counter;
        }
        else if(TIPLLaneInfo3_TIPLLaneInfo3_blockCtr_wrongvalctr > 0)
        {
             TIPLLaneInfo3_TIPLLaneInfo3_blockCtr_wrongvalctr--;
              // if counter becomes zero, update panel controller to zero
             if(TIPLLaneInfo3_TIPLLaneInfo3_blockCtr_wrongvalctr == 0)
             {
                 putValue(E_pric_RadarFrontCenter_TIPLLaneInfo3_TIPLLaneInfo3_blockCtr_wrongvalctr,0);
             }
        }
        else
        {
            //do nothing
        }        
        //calculate the CRC checksum
        update_TIPLLaneInfo3_ChkSum_Checksum();

        output(Msg_TIPLLaneInfo3);        
    }
}

on envVar E_pric_RadarFrontCenter_TIPLLaneInfo3_Range
{
    qword rawstatus = 0ll;
    qword rawValue = 0ll;    
    
    rawstatus = getvalue(this);    
    // set all the signals with min raw /max raw /init raw
    switch (rawstatus) 
    {
     case(0) :
        rawValue= -32768;
        putValue(E_pric_RadarFrontCenter_TIPLLaneInfo3_TIPLLaneInfo3_dLowerLimitLane_sw_Rv, rawValue);
        rawValue= -32768;
        putValue(E_pric_RadarFrontCenter_TIPLLaneInfo3_TIPLLaneInfo3_dRightBorder_sw_Rv, rawValue);
        rawValue= -32768;
        putValue(E_pric_RadarFrontCenter_TIPLLaneInfo3_TIPLLaneInfo3_dUpperLimitLane_sw_Rv, rawValue);
        rawValue= -32768;
        putValue(E_pric_RadarFrontCenter_TIPLLaneInfo3_TIPLLaneInfo3_dLeftBorder_sw_Rv, rawValue);
        rawValue= 0;
        putValue(E_pric_RadarFrontCenter_TIPLLaneInfo3_TIPLLaneInfo3_prob1Lane_ub_Rv, rawValue);
        break;
     case(1) :
        rawValue= 32767;
        putValue(E_pric_RadarFrontCenter_TIPLLaneInfo3_TIPLLaneInfo3_dLowerLimitLane_sw_Rv, rawValue);
        rawValue= 32767;
        putValue(E_pric_RadarFrontCenter_TIPLLaneInfo3_TIPLLaneInfo3_dRightBorder_sw_Rv, rawValue);
        rawValue= 32767;
        putValue(E_pric_RadarFrontCenter_TIPLLaneInfo3_TIPLLaneInfo3_dUpperLimitLane_sw_Rv, rawValue);
        rawValue= 32767;
        putValue(E_pric_RadarFrontCenter_TIPLLaneInfo3_TIPLLaneInfo3_dLeftBorder_sw_Rv, rawValue);
        rawValue= 255;
        putValue(E_pric_RadarFrontCenter_TIPLLaneInfo3_TIPLLaneInfo3_prob1Lane_ub_Rv, rawValue);
        break;
     default :
        rawValue= -32768;
        putValue(E_pric_RadarFrontCenter_TIPLLaneInfo3_TIPLLaneInfo3_dLowerLimitLane_sw_Rv, rawValue);
        rawValue= -32768;
        putValue(E_pric_RadarFrontCenter_TIPLLaneInfo3_TIPLLaneInfo3_dRightBorder_sw_Rv, rawValue);
        rawValue= -32768;
        putValue(E_pric_RadarFrontCenter_TIPLLaneInfo3_TIPLLaneInfo3_dUpperLimitLane_sw_Rv, rawValue);
        rawValue= -32768;
        putValue(E_pric_RadarFrontCenter_TIPLLaneInfo3_TIPLLaneInfo3_dLeftBorder_sw_Rv, rawValue);
        rawValue= 0;
        putValue(E_pric_RadarFrontCenter_TIPLLaneInfo3_TIPLLaneInfo3_prob1Lane_ub_Rv, rawValue);
      break;
   }
}

on envVar E_pric_RadarFrontCenter_TIPLLaneInfo3_Dlc
{
    if(getValue(E_pric_RadarFrontCenter_TIPLLaneInfo3_enDlc))
    {
        Msg_TIPLLaneInfo3.dlc =getValue(this);
    }
    else
    {
       Dbc_dlc = 12;
	   Msg_TIPLLaneInfo3.dlc = Calc_Canfd_dlc(Dbc_dlc);
	   	
  }
}

on envVar E_pric_RadarFrontCenter_TIPLLaneInfo3_enDlc
{
    //For Messages with DLC = 8, set wrong DLC to smaller than defined DLC
    //For Messages with DLC < 8 set wrong DLC to smaller/longer than defined DLC
    if(getValue(this))
    {
        Msg_TIPLLaneInfo3.dlc =getValue(E_pric_RadarFrontCenter_TIPLLaneInfo3_Dlc);
    }
    else
    {
       Dbc_dlc = 12;
	   Msg_TIPLLaneInfo3.dlc = Calc_Canfd_dlc(Dbc_dlc);
			
    }
}

on envVar E_pric_RadarFrontCenter_TIPLLaneInfo3_TIPLLaneInfo3_CRC_wrongvalctr
{
    //update disturb count
    //disturb value range:(-1 = always send wrong value),( X>0 ,x is the number of Messages with wrong CHK sent)
    TIPLLaneInfo3_TIPLLaneInfo3_CRC_wrongvalctr =getValue(this);    
}
on envVar E_pric_RadarFrontCenter_TIPLLaneInfo3_TIPLLaneInfo3_MsgCtr_wrongvalctr
{
    //update disturb count
    //disturb value range:(-1 = always send wrong value),( X>0 ,x is the number of Messages with wrong CHK sent)
    TIPLLaneInfo3_TIPLLaneInfo3_MsgCtr_wrongvalctr =getValue(this);    
}
on envVar E_pric_RadarFrontCenter_TIPLLaneInfo3_TIPLLaneInfo3_blockCtr_wrongvalctr
{
    //update disturb count
    //disturb value range:(-1 = always send wrong value),( X>0 ,x is the number of Messages with wrong CHK sent)
    TIPLLaneInfo3_TIPLLaneInfo3_blockCtr_wrongvalctr =getValue(this);    
}

on envVar E_pric_RadarFrontCenter_TIPLLaneInfo3_TIPLLaneInfo3_dLowerLimitLane_sw_Rv
{
    qword rawValue = 0ll;
    float rawValue_float = 0.0;
    float phyValue = 0.0;        

    //set the signal with updated raw value
    {
        rawValue = getvalue(this);
        if(chgEv_TIPLLaneInfo3_TIPLLaneInfo3_dLowerLimitLane_sw == 0)
        {
            //type conversion to float
            rawValue_float = rawValue;        
            // raw to physical conversion
            phyValue = ((rawValue_float *0.0078125)+(0));
            putValue(E_pric_RadarFrontCenter_TIPLLaneInfo3_TIPLLaneInfo3_dLowerLimitLane_sw_Pv, phyValue);
            chgEv_TIPLLaneInfo3_TIPLLaneInfo3_dLowerLimitLane_sw = 1;
        }
        else
        {
            chgEv_TIPLLaneInfo3_TIPLLaneInfo3_dLowerLimitLane_sw = 0;
        }    
        //update the signal value
        Msg_TIPLLaneInfo3.TIPLLaneInfo3_dLowerLimitLane_sw=rawValue;        
    }                                                                           
}

on envVar E_pric_RadarFrontCenter_TIPLLaneInfo3_TIPLLaneInfo3_dLowerLimitLane_sw_Pv
{
    qword rawValue = 0ll;
    float phyValue = 0.0;
    
    //update the raw value with physical value 
    {
        if(chgEv_TIPLLaneInfo3_TIPLLaneInfo3_dLowerLimitLane_sw == 0)
        {
            phyValue = getvalue(this);
            // physical to raw conversion
            rawValue = ((phyValue -(0))/0.0078125);
            putValue(E_pric_RadarFrontCenter_TIPLLaneInfo3_TIPLLaneInfo3_dLowerLimitLane_sw_Rv, rawValue);
            chgEv_TIPLLaneInfo3_TIPLLaneInfo3_dLowerLimitLane_sw = 1;  
        }
        else
        {
            chgEv_TIPLLaneInfo3_TIPLLaneInfo3_dLowerLimitLane_sw = 0;
        }
    }
}


 
on envVar E_pric_RadarFrontCenter_TIPLLaneInfo3_TIPLLaneInfo3_dRightBorder_sw_Rv
{
    qword rawValue = 0ll;
    float rawValue_float = 0.0;
    float phyValue = 0.0;        

    //set the signal with updated raw value
    {
        rawValue = getvalue(this);
        if(chgEv_TIPLLaneInfo3_TIPLLaneInfo3_dRightBorder_sw == 0)
        {
            //type conversion to float
            rawValue_float = rawValue;        
            // raw to physical conversion
            phyValue = ((rawValue_float *0.0078125)+(0));
            putValue(E_pric_RadarFrontCenter_TIPLLaneInfo3_TIPLLaneInfo3_dRightBorder_sw_Pv, phyValue);
            chgEv_TIPLLaneInfo3_TIPLLaneInfo3_dRightBorder_sw = 1;
        }
        else
        {
            chgEv_TIPLLaneInfo3_TIPLLaneInfo3_dRightBorder_sw = 0;
        }    
        //update the signal value
        Msg_TIPLLaneInfo3.TIPLLaneInfo3_dRightBorder_sw=rawValue;        
    }                                                                           
}

on envVar E_pric_RadarFrontCenter_TIPLLaneInfo3_TIPLLaneInfo3_dRightBorder_sw_Pv
{
    qword rawValue = 0ll;
    float phyValue = 0.0;
    
    //update the raw value with physical value 
    {
        if(chgEv_TIPLLaneInfo3_TIPLLaneInfo3_dRightBorder_sw == 0)
        {
            phyValue = getvalue(this);
            // physical to raw conversion
            rawValue = ((phyValue -(0))/0.0078125);
            putValue(E_pric_RadarFrontCenter_TIPLLaneInfo3_TIPLLaneInfo3_dRightBorder_sw_Rv, rawValue);
            chgEv_TIPLLaneInfo3_TIPLLaneInfo3_dRightBorder_sw = 1;  
        }
        else
        {
            chgEv_TIPLLaneInfo3_TIPLLaneInfo3_dRightBorder_sw = 0;
        }
    }
}


 
on envVar E_pric_RadarFrontCenter_TIPLLaneInfo3_TIPLLaneInfo3_dUpperLimitLane_sw_Rv
{
    qword rawValue = 0ll;
    float rawValue_float = 0.0;
    float phyValue = 0.0;        

    //set the signal with updated raw value
    {
        rawValue = getvalue(this);
        if(chgEv_TIPLLaneInfo3_TIPLLaneInfo3_dUpperLimitLane_sw == 0)
        {
            //type conversion to float
            rawValue_float = rawValue;        
            // raw to physical conversion
            phyValue = ((rawValue_float *0.0078125)+(0));
            putValue(E_pric_RadarFrontCenter_TIPLLaneInfo3_TIPLLaneInfo3_dUpperLimitLane_sw_Pv, phyValue);
            chgEv_TIPLLaneInfo3_TIPLLaneInfo3_dUpperLimitLane_sw = 1;
        }
        else
        {
            chgEv_TIPLLaneInfo3_TIPLLaneInfo3_dUpperLimitLane_sw = 0;
        }    
        //update the signal value
        Msg_TIPLLaneInfo3.TIPLLaneInfo3_dUpperLimitLane_sw=rawValue;        
    }                                                                           
}

on envVar E_pric_RadarFrontCenter_TIPLLaneInfo3_TIPLLaneInfo3_dUpperLimitLane_sw_Pv
{
    qword rawValue = 0ll;
    float phyValue = 0.0;
    
    //update the raw value with physical value 
    {
        if(chgEv_TIPLLaneInfo3_TIPLLaneInfo3_dUpperLimitLane_sw == 0)
        {
            phyValue = getvalue(this);
            // physical to raw conversion
            rawValue = ((phyValue -(0))/0.0078125);
            putValue(E_pric_RadarFrontCenter_TIPLLaneInfo3_TIPLLaneInfo3_dUpperLimitLane_sw_Rv, rawValue);
            chgEv_TIPLLaneInfo3_TIPLLaneInfo3_dUpperLimitLane_sw = 1;  
        }
        else
        {
            chgEv_TIPLLaneInfo3_TIPLLaneInfo3_dUpperLimitLane_sw = 0;
        }
    }
}


 
on envVar E_pric_RadarFrontCenter_TIPLLaneInfo3_TIPLLaneInfo3_dLeftBorder_sw_Rv
{
    qword rawValue = 0ll;
    float rawValue_float = 0.0;
    float phyValue = 0.0;        

    //set the signal with updated raw value
    {
        rawValue = getvalue(this);
        if(chgEv_TIPLLaneInfo3_TIPLLaneInfo3_dLeftBorder_sw == 0)
        {
            //type conversion to float
            rawValue_float = rawValue;        
            // raw to physical conversion
            phyValue = ((rawValue_float *0.0078125)+(0));
            putValue(E_pric_RadarFrontCenter_TIPLLaneInfo3_TIPLLaneInfo3_dLeftBorder_sw_Pv, phyValue);
            chgEv_TIPLLaneInfo3_TIPLLaneInfo3_dLeftBorder_sw = 1;
        }
        else
        {
            chgEv_TIPLLaneInfo3_TIPLLaneInfo3_dLeftBorder_sw = 0;
        }    
        //update the signal value
        Msg_TIPLLaneInfo3.TIPLLaneInfo3_dLeftBorder_sw=rawValue;        
    }                                                                           
}

on envVar E_pric_RadarFrontCenter_TIPLLaneInfo3_TIPLLaneInfo3_dLeftBorder_sw_Pv
{
    qword rawValue = 0ll;
    float phyValue = 0.0;
    
    //update the raw value with physical value 
    {
        if(chgEv_TIPLLaneInfo3_TIPLLaneInfo3_dLeftBorder_sw == 0)
        {
            phyValue = getvalue(this);
            // physical to raw conversion
            rawValue = ((phyValue -(0))/0.0078125);
            putValue(E_pric_RadarFrontCenter_TIPLLaneInfo3_TIPLLaneInfo3_dLeftBorder_sw_Rv, rawValue);
            chgEv_TIPLLaneInfo3_TIPLLaneInfo3_dLeftBorder_sw = 1;  
        }
        else
        {
            chgEv_TIPLLaneInfo3_TIPLLaneInfo3_dLeftBorder_sw = 0;
        }
    }
}


 
on envVar E_pric_RadarFrontCenter_TIPLLaneInfo3_TIPLLaneInfo3_prob1Lane_ub_Rv
{
    qword rawValue = 0ll;
    float rawValue_float = 0.0;
    float phyValue = 0.0;        

    //set the signal with updated raw value
    {
        rawValue = getvalue(this);
        if(chgEv_TIPLLaneInfo3_TIPLLaneInfo3_prob1Lane_ub == 0)
        {
            //type conversion to float
            rawValue_float = rawValue;        
            // raw to physical conversion
            phyValue = ((rawValue_float *0.0078125)+(0));
            putValue(E_pric_RadarFrontCenter_TIPLLaneInfo3_TIPLLaneInfo3_prob1Lane_ub_Pv, phyValue);
            chgEv_TIPLLaneInfo3_TIPLLaneInfo3_prob1Lane_ub = 1;
        }
        else
        {
            chgEv_TIPLLaneInfo3_TIPLLaneInfo3_prob1Lane_ub = 0;
        }    
        //update the signal value
        Msg_TIPLLaneInfo3.TIPLLaneInfo3_prob1Lane_ub=rawValue;        
    }                                                                           
}

on envVar E_pric_RadarFrontCenter_TIPLLaneInfo3_TIPLLaneInfo3_prob1Lane_ub_Pv
{
    qword rawValue = 0ll;
    float phyValue = 0.0;
    
    //update the raw value with physical value 
    {
        if(chgEv_TIPLLaneInfo3_TIPLLaneInfo3_prob1Lane_ub == 0)
        {
            phyValue = getvalue(this);
            // physical to raw conversion
            rawValue = ((phyValue -(0))/0.0078125);
            putValue(E_pric_RadarFrontCenter_TIPLLaneInfo3_TIPLLaneInfo3_prob1Lane_ub_Rv, rawValue);
            chgEv_TIPLLaneInfo3_TIPLLaneInfo3_prob1Lane_ub = 1;  
        }
        else
        {
            chgEv_TIPLLaneInfo3_TIPLLaneInfo3_prob1Lane_ub = 0;
        }
    }
}


 
on envVar E_pric_RadarFrontCenter_TIPLCourseInfo1_tx
{
    if(getValue(this))
    {       
        
        //update the BZ Signal
        if(TIPLCourseInfo1_TIPLCourseInfo1_MsgCtr_wrongvalctr == 0)
        {
            update_TIPLCourseInfo1_TIPLCourseInfo1_MsgCtr_counter();
            Msg_TIPLCourseInfo1.TIPLCourseInfo1_MsgCtr= TIPLCourseInfo1_TIPLCourseInfo1_MsgCtr_counter;
        }
        else if(TIPLCourseInfo1_TIPLCourseInfo1_MsgCtr_wrongvalctr > 0)
        {
             TIPLCourseInfo1_TIPLCourseInfo1_MsgCtr_wrongvalctr--;
              // if counter becomes zero, update panel controller to zero
             if(TIPLCourseInfo1_TIPLCourseInfo1_MsgCtr_wrongvalctr == 0)
             {
                 putValue(E_pric_RadarFrontCenter_TIPLCourseInfo1_TIPLCourseInfo1_MsgCtr_wrongvalctr,0);
             }
        }
        else
        {
            //do nothing
        }        
        //update the BZ Signal
        if(TIPLCourseInfo1_TIPLCourseInfo1_blockCtr_wrongvalctr == 0)
        {
            update_TIPLCourseInfo1_TIPLCourseInfo1_blockCtr_counter();
            Msg_TIPLCourseInfo1.TIPLCourseInfo1_blockCtr= TIPLCourseInfo1_TIPLCourseInfo1_blockCtr_counter;
        }
        else if(TIPLCourseInfo1_TIPLCourseInfo1_blockCtr_wrongvalctr > 0)
        {
             TIPLCourseInfo1_TIPLCourseInfo1_blockCtr_wrongvalctr--;
              // if counter becomes zero, update panel controller to zero
             if(TIPLCourseInfo1_TIPLCourseInfo1_blockCtr_wrongvalctr == 0)
             {
                 putValue(E_pric_RadarFrontCenter_TIPLCourseInfo1_TIPLCourseInfo1_blockCtr_wrongvalctr,0);
             }
        }
        else
        {
            //do nothing
        }        
        //calculate the CRC checksum
        update_TIPLCourseInfo1_ChkSum_Checksum();

        output(Msg_TIPLCourseInfo1);        
    }
}

on envVar E_pric_RadarFrontCenter_TIPLCourseInfo1_Range
{
    qword rawstatus = 0ll;
    qword rawValue = 0ll;    
    
    rawstatus = getvalue(this);    
    // set all the signals with min raw /max raw /init raw
    switch (rawstatus) 
    {
     case(0) :
        rawValue= -32767;
        putValue(E_pric_RadarFrontCenter_TIPLCourseInfo1_TIPLCourseInfo1_a1polynomCoef_sw_Rv, rawValue);
        rawValue= -32768;
        putValue(E_pric_RadarFrontCenter_TIPLCourseInfo1_TIPLCourseInfo1_a0polynomCoef_sw_Rv, rawValue);
        rawValue= 0;
        putValue(E_pric_RadarFrontCenter_TIPLCourseInfo1_TIPLCourseInfo1_qCourseConform_Rv, rawValue);
        rawValue= -32768;
        putValue(E_pric_RadarFrontCenter_TIPLCourseInfo1_TIPLCourseInfo1_dLowerLimit_sw_Rv, rawValue);
        rawValue= -32767;
        putValue(E_pric_RadarFrontCenter_TIPLCourseInfo1_TIPLCourseInfo1_a2polynomCoef_sw_Rv, rawValue);
        rawValue= -32768;
        putValue(E_pric_RadarFrontCenter_TIPLCourseInfo1_TIPLCourseInfo1_dUpperLimit_sw_Rv, rawValue);
        break;
     case(1) :
        rawValue= 32766;
        putValue(E_pric_RadarFrontCenter_TIPLCourseInfo1_TIPLCourseInfo1_a1polynomCoef_sw_Rv, rawValue);
        rawValue= 32767;
        putValue(E_pric_RadarFrontCenter_TIPLCourseInfo1_TIPLCourseInfo1_a0polynomCoef_sw_Rv, rawValue);
        rawValue= 255;
        putValue(E_pric_RadarFrontCenter_TIPLCourseInfo1_TIPLCourseInfo1_qCourseConform_Rv, rawValue);
        rawValue= 32767;
        putValue(E_pric_RadarFrontCenter_TIPLCourseInfo1_TIPLCourseInfo1_dLowerLimit_sw_Rv, rawValue);
        rawValue= 32766;
        putValue(E_pric_RadarFrontCenter_TIPLCourseInfo1_TIPLCourseInfo1_a2polynomCoef_sw_Rv, rawValue);
        rawValue= 32767;
        putValue(E_pric_RadarFrontCenter_TIPLCourseInfo1_TIPLCourseInfo1_dUpperLimit_sw_Rv, rawValue);
        break;
     default :
        rawValue= -32767;
        putValue(E_pric_RadarFrontCenter_TIPLCourseInfo1_TIPLCourseInfo1_a1polynomCoef_sw_Rv, rawValue);
        rawValue= -32768;
        putValue(E_pric_RadarFrontCenter_TIPLCourseInfo1_TIPLCourseInfo1_a0polynomCoef_sw_Rv, rawValue);
        rawValue= 0;
        putValue(E_pric_RadarFrontCenter_TIPLCourseInfo1_TIPLCourseInfo1_qCourseConform_Rv, rawValue);
        rawValue= -32768;
        putValue(E_pric_RadarFrontCenter_TIPLCourseInfo1_TIPLCourseInfo1_dLowerLimit_sw_Rv, rawValue);
        rawValue= -32767;
        putValue(E_pric_RadarFrontCenter_TIPLCourseInfo1_TIPLCourseInfo1_a2polynomCoef_sw_Rv, rawValue);
        rawValue= -32768;
        putValue(E_pric_RadarFrontCenter_TIPLCourseInfo1_TIPLCourseInfo1_dUpperLimit_sw_Rv, rawValue);
      break;
   }
}

on envVar E_pric_RadarFrontCenter_TIPLCourseInfo1_Dlc
{
    if(getValue(E_pric_RadarFrontCenter_TIPLCourseInfo1_enDlc))
    {
        Msg_TIPLCourseInfo1.dlc =getValue(this);
    }
    else
    {
       Dbc_dlc = 16;
	   Msg_TIPLCourseInfo1.dlc = Calc_Canfd_dlc(Dbc_dlc);
	   	
  }
}

on envVar E_pric_RadarFrontCenter_TIPLCourseInfo1_enDlc
{
    //For Messages with DLC = 8, set wrong DLC to smaller than defined DLC
    //For Messages with DLC < 8 set wrong DLC to smaller/longer than defined DLC
    if(getValue(this))
    {
        Msg_TIPLCourseInfo1.dlc =getValue(E_pric_RadarFrontCenter_TIPLCourseInfo1_Dlc);
    }
    else
    {
       Dbc_dlc = 16;
	   Msg_TIPLCourseInfo1.dlc = Calc_Canfd_dlc(Dbc_dlc);
			
    }
}

on envVar E_pric_RadarFrontCenter_TIPLCourseInfo1_TIPLCourseInfo1_CRC_wrongvalctr
{
    //update disturb count
    //disturb value range:(-1 = always send wrong value),( X>0 ,x is the number of Messages with wrong CHK sent)
    TIPLCourseInfo1_TIPLCourseInfo1_CRC_wrongvalctr =getValue(this);    
}
on envVar E_pric_RadarFrontCenter_TIPLCourseInfo1_TIPLCourseInfo1_MsgCtr_wrongvalctr
{
    //update disturb count
    //disturb value range:(-1 = always send wrong value),( X>0 ,x is the number of Messages with wrong CHK sent)
    TIPLCourseInfo1_TIPLCourseInfo1_MsgCtr_wrongvalctr =getValue(this);    
}
on envVar E_pric_RadarFrontCenter_TIPLCourseInfo1_TIPLCourseInfo1_blockCtr_wrongvalctr
{
    //update disturb count
    //disturb value range:(-1 = always send wrong value),( X>0 ,x is the number of Messages with wrong CHK sent)
    TIPLCourseInfo1_TIPLCourseInfo1_blockCtr_wrongvalctr =getValue(this);    
}

on envVar E_pric_RadarFrontCenter_TIPLCourseInfo1_TIPLCourseInfo1_a1polynomCoef_sw_Rv
{
    qword rawValue = 0ll;
    float rawValue_float = 0.0;
    float phyValue = 0.0;        

    //set the signal with updated raw value
    {
        rawValue = getvalue(this);
        if(chgEv_TIPLCourseInfo1_TIPLCourseInfo1_a1polynomCoef_sw == 0)
        {
            //type conversion to float
            rawValue_float = rawValue;        
            // raw to physical conversion
            phyValue = ((rawValue_float *0.000244141)+(0));
            putValue(E_pric_RadarFrontCenter_TIPLCourseInfo1_TIPLCourseInfo1_a1polynomCoef_sw_Pv, phyValue);
            chgEv_TIPLCourseInfo1_TIPLCourseInfo1_a1polynomCoef_sw = 1;
        }
        else
        {
            chgEv_TIPLCourseInfo1_TIPLCourseInfo1_a1polynomCoef_sw = 0;
        }    
        //update the signal value
        Msg_TIPLCourseInfo1.TIPLCourseInfo1_a1polynomCoef_sw=rawValue;        
    }                                                                           
}

on envVar E_pric_RadarFrontCenter_TIPLCourseInfo1_TIPLCourseInfo1_a1polynomCoef_sw_Pv
{
    qword rawValue = 0ll;
    float phyValue = 0.0;
    
    //update the raw value with physical value 
    {
        if(chgEv_TIPLCourseInfo1_TIPLCourseInfo1_a1polynomCoef_sw == 0)
        {
            phyValue = getvalue(this);
            // physical to raw conversion
            rawValue = ((phyValue -(0))/0.000244141);
            putValue(E_pric_RadarFrontCenter_TIPLCourseInfo1_TIPLCourseInfo1_a1polynomCoef_sw_Rv, rawValue);
            chgEv_TIPLCourseInfo1_TIPLCourseInfo1_a1polynomCoef_sw = 1;  
        }
        else
        {
            chgEv_TIPLCourseInfo1_TIPLCourseInfo1_a1polynomCoef_sw = 0;
        }
    }
}


 
on envVar E_pric_RadarFrontCenter_TIPLCourseInfo1_TIPLCourseInfo1_a0polynomCoef_sw_Rv
{
    qword rawValue = 0ll;
    float rawValue_float = 0.0;
    float phyValue = 0.0;        

    //set the signal with updated raw value
    {
        rawValue = getvalue(this);
        if(chgEv_TIPLCourseInfo1_TIPLCourseInfo1_a0polynomCoef_sw == 0)
        {
            //type conversion to float
            rawValue_float = rawValue;        
            // raw to physical conversion
            phyValue = ((rawValue_float *0.0078125)+(0));
            putValue(E_pric_RadarFrontCenter_TIPLCourseInfo1_TIPLCourseInfo1_a0polynomCoef_sw_Pv, phyValue);
            chgEv_TIPLCourseInfo1_TIPLCourseInfo1_a0polynomCoef_sw = 1;
        }
        else
        {
            chgEv_TIPLCourseInfo1_TIPLCourseInfo1_a0polynomCoef_sw = 0;
        }    
        //update the signal value
        Msg_TIPLCourseInfo1.TIPLCourseInfo1_a0polynomCoef_sw=rawValue;        
    }                                                                           
}

on envVar E_pric_RadarFrontCenter_TIPLCourseInfo1_TIPLCourseInfo1_a0polynomCoef_sw_Pv
{
    qword rawValue = 0ll;
    float phyValue = 0.0;
    
    //update the raw value with physical value 
    {
        if(chgEv_TIPLCourseInfo1_TIPLCourseInfo1_a0polynomCoef_sw == 0)
        {
            phyValue = getvalue(this);
            // physical to raw conversion
            rawValue = ((phyValue -(0))/0.0078125);
            putValue(E_pric_RadarFrontCenter_TIPLCourseInfo1_TIPLCourseInfo1_a0polynomCoef_sw_Rv, rawValue);
            chgEv_TIPLCourseInfo1_TIPLCourseInfo1_a0polynomCoef_sw = 1;  
        }
        else
        {
            chgEv_TIPLCourseInfo1_TIPLCourseInfo1_a0polynomCoef_sw = 0;
        }
    }
}


 
on envVar E_pric_RadarFrontCenter_TIPLCourseInfo1_TIPLCourseInfo1_qCourseConform_Rv
{
    qword rawValue = 0ll;
    float rawValue_float = 0.0;
    float phyValue = 0.0;        

    //set the signal with updated raw value
    {
        rawValue = getvalue(this);
        if(chgEv_TIPLCourseInfo1_TIPLCourseInfo1_qCourseConform == 0)
        {
            //type conversion to float
            rawValue_float = rawValue;        
            // raw to physical conversion
            phyValue = ((rawValue_float *0.00390625)+(0));
            putValue(E_pric_RadarFrontCenter_TIPLCourseInfo1_TIPLCourseInfo1_qCourseConform_Pv, phyValue);
            chgEv_TIPLCourseInfo1_TIPLCourseInfo1_qCourseConform = 1;
        }
        else
        {
            chgEv_TIPLCourseInfo1_TIPLCourseInfo1_qCourseConform = 0;
        }    
        //update the signal value
        Msg_TIPLCourseInfo1.TIPLCourseInfo1_qCourseConform=rawValue;        
    }                                                                           
}

on envVar E_pric_RadarFrontCenter_TIPLCourseInfo1_TIPLCourseInfo1_qCourseConform_Pv
{
    qword rawValue = 0ll;
    float phyValue = 0.0;
    
    //update the raw value with physical value 
    {
        if(chgEv_TIPLCourseInfo1_TIPLCourseInfo1_qCourseConform == 0)
        {
            phyValue = getvalue(this);
            // physical to raw conversion
            rawValue = ((phyValue -(0))/0.00390625);
            putValue(E_pric_RadarFrontCenter_TIPLCourseInfo1_TIPLCourseInfo1_qCourseConform_Rv, rawValue);
            chgEv_TIPLCourseInfo1_TIPLCourseInfo1_qCourseConform = 1;  
        }
        else
        {
            chgEv_TIPLCourseInfo1_TIPLCourseInfo1_qCourseConform = 0;
        }
    }
}


 
on envVar E_pric_RadarFrontCenter_TIPLCourseInfo1_TIPLCourseInfo1_dLowerLimit_sw_Rv
{
    qword rawValue = 0ll;
    float rawValue_float = 0.0;
    float phyValue = 0.0;        

    //set the signal with updated raw value
    {
        rawValue = getvalue(this);
        if(chgEv_TIPLCourseInfo1_TIPLCourseInfo1_dLowerLimit_sw == 0)
        {
            //type conversion to float
            rawValue_float = rawValue;        
            // raw to physical conversion
            phyValue = ((rawValue_float *0.0078125)+(0));
            putValue(E_pric_RadarFrontCenter_TIPLCourseInfo1_TIPLCourseInfo1_dLowerLimit_sw_Pv, phyValue);
            chgEv_TIPLCourseInfo1_TIPLCourseInfo1_dLowerLimit_sw = 1;
        }
        else
        {
            chgEv_TIPLCourseInfo1_TIPLCourseInfo1_dLowerLimit_sw = 0;
        }    
        //update the signal value
        Msg_TIPLCourseInfo1.TIPLCourseInfo1_dLowerLimit_sw=rawValue;        
    }                                                                           
}

on envVar E_pric_RadarFrontCenter_TIPLCourseInfo1_TIPLCourseInfo1_dLowerLimit_sw_Pv
{
    qword rawValue = 0ll;
    float phyValue = 0.0;
    
    //update the raw value with physical value 
    {
        if(chgEv_TIPLCourseInfo1_TIPLCourseInfo1_dLowerLimit_sw == 0)
        {
            phyValue = getvalue(this);
            // physical to raw conversion
            rawValue = ((phyValue -(0))/0.0078125);
            putValue(E_pric_RadarFrontCenter_TIPLCourseInfo1_TIPLCourseInfo1_dLowerLimit_sw_Rv, rawValue);
            chgEv_TIPLCourseInfo1_TIPLCourseInfo1_dLowerLimit_sw = 1;  
        }
        else
        {
            chgEv_TIPLCourseInfo1_TIPLCourseInfo1_dLowerLimit_sw = 0;
        }
    }
}


 
on envVar E_pric_RadarFrontCenter_TIPLCourseInfo1_TIPLCourseInfo1_a2polynomCoef_sw_Rv
{
    qword rawValue = 0ll;
    float rawValue_float = 0.0;
    float phyValue = 0.0;        

    //set the signal with updated raw value
    {
        rawValue = getvalue(this);
        if(chgEv_TIPLCourseInfo1_TIPLCourseInfo1_a2polynomCoef_sw == 0)
        {
            //type conversion to float
            rawValue_float = rawValue;        
            // raw to physical conversion
            phyValue = ((rawValue_float *1.90735e-006)+(0));
            putValue(E_pric_RadarFrontCenter_TIPLCourseInfo1_TIPLCourseInfo1_a2polynomCoef_sw_Pv, phyValue);
            chgEv_TIPLCourseInfo1_TIPLCourseInfo1_a2polynomCoef_sw = 1;
        }
        else
        {
            chgEv_TIPLCourseInfo1_TIPLCourseInfo1_a2polynomCoef_sw = 0;
        }    
        //update the signal value
        Msg_TIPLCourseInfo1.TIPLCourseInfo1_a2polynomCoef_sw=rawValue;        
    }                                                                           
}

on envVar E_pric_RadarFrontCenter_TIPLCourseInfo1_TIPLCourseInfo1_a2polynomCoef_sw_Pv
{
    qword rawValue = 0ll;
    float phyValue = 0.0;
    
    //update the raw value with physical value 
    {
        if(chgEv_TIPLCourseInfo1_TIPLCourseInfo1_a2polynomCoef_sw == 0)
        {
            phyValue = getvalue(this);
            // physical to raw conversion
            rawValue = ((phyValue -(0))/1.90735e-006);
            putValue(E_pric_RadarFrontCenter_TIPLCourseInfo1_TIPLCourseInfo1_a2polynomCoef_sw_Rv, rawValue);
            chgEv_TIPLCourseInfo1_TIPLCourseInfo1_a2polynomCoef_sw = 1;  
        }
        else
        {
            chgEv_TIPLCourseInfo1_TIPLCourseInfo1_a2polynomCoef_sw = 0;
        }
    }
}


 
on envVar E_pric_RadarFrontCenter_TIPLCourseInfo1_TIPLCourseInfo1_dUpperLimit_sw_Rv
{
    qword rawValue = 0ll;
    float rawValue_float = 0.0;
    float phyValue = 0.0;        

    //set the signal with updated raw value
    {
        rawValue = getvalue(this);
        if(chgEv_TIPLCourseInfo1_TIPLCourseInfo1_dUpperLimit_sw == 0)
        {
            //type conversion to float
            rawValue_float = rawValue;        
            // raw to physical conversion
            phyValue = ((rawValue_float *0.0078125)+(0));
            putValue(E_pric_RadarFrontCenter_TIPLCourseInfo1_TIPLCourseInfo1_dUpperLimit_sw_Pv, phyValue);
            chgEv_TIPLCourseInfo1_TIPLCourseInfo1_dUpperLimit_sw = 1;
        }
        else
        {
            chgEv_TIPLCourseInfo1_TIPLCourseInfo1_dUpperLimit_sw = 0;
        }    
        //update the signal value
        Msg_TIPLCourseInfo1.TIPLCourseInfo1_dUpperLimit_sw=rawValue;        
    }                                                                           
}

on envVar E_pric_RadarFrontCenter_TIPLCourseInfo1_TIPLCourseInfo1_dUpperLimit_sw_Pv
{
    qword rawValue = 0ll;
    float phyValue = 0.0;
    
    //update the raw value with physical value 
    {
        if(chgEv_TIPLCourseInfo1_TIPLCourseInfo1_dUpperLimit_sw == 0)
        {
            phyValue = getvalue(this);
            // physical to raw conversion
            rawValue = ((phyValue -(0))/0.0078125);
            putValue(E_pric_RadarFrontCenter_TIPLCourseInfo1_TIPLCourseInfo1_dUpperLimit_sw_Rv, rawValue);
            chgEv_TIPLCourseInfo1_TIPLCourseInfo1_dUpperLimit_sw = 1;  
        }
        else
        {
            chgEv_TIPLCourseInfo1_TIPLCourseInfo1_dUpperLimit_sw = 0;
        }
    }
}


 
on envVar E_pric_RadarFrontCenter_TIPLCourseInfo0_tx
{
    if(getValue(this))
    {       
        
        //update the BZ Signal
        if(TIPLCourseInfo0_TIPLCourseInfo0_MsgCtr_wrongvalctr == 0)
        {
            update_TIPLCourseInfo0_TIPLCourseInfo0_MsgCtr_counter();
            Msg_TIPLCourseInfo0.TIPLCourseInfo0_MsgCtr= TIPLCourseInfo0_TIPLCourseInfo0_MsgCtr_counter;
        }
        else if(TIPLCourseInfo0_TIPLCourseInfo0_MsgCtr_wrongvalctr > 0)
        {
             TIPLCourseInfo0_TIPLCourseInfo0_MsgCtr_wrongvalctr--;
              // if counter becomes zero, update panel controller to zero
             if(TIPLCourseInfo0_TIPLCourseInfo0_MsgCtr_wrongvalctr == 0)
             {
                 putValue(E_pric_RadarFrontCenter_TIPLCourseInfo0_TIPLCourseInfo0_MsgCtr_wrongvalctr,0);
             }
        }
        else
        {
            //do nothing
        }        
        //update the BZ Signal
        if(TIPLCourseInfo0_TIPLCourseInfo0_blockCtr_wrongvalctr == 0)
        {
            update_TIPLCourseInfo0_TIPLCourseInfo0_blockCtr_counter();
            Msg_TIPLCourseInfo0.TIPLCourseInfo0_blockCtr= TIPLCourseInfo0_TIPLCourseInfo0_blockCtr_counter;
        }
        else if(TIPLCourseInfo0_TIPLCourseInfo0_blockCtr_wrongvalctr > 0)
        {
             TIPLCourseInfo0_TIPLCourseInfo0_blockCtr_wrongvalctr--;
              // if counter becomes zero, update panel controller to zero
             if(TIPLCourseInfo0_TIPLCourseInfo0_blockCtr_wrongvalctr == 0)
             {
                 putValue(E_pric_RadarFrontCenter_TIPLCourseInfo0_TIPLCourseInfo0_blockCtr_wrongvalctr,0);
             }
        }
        else
        {
            //do nothing
        }        
        //calculate the CRC checksum
        update_TIPLCourseInfo0_ChkSum_Checksum();

        output(Msg_TIPLCourseInfo0);        
    }
}

on envVar E_pric_RadarFrontCenter_TIPLCourseInfo0_Range
{
    qword rawstatus = 0ll;
    qword rawValue = 0ll;    
    
    rawstatus = getvalue(this);    
    // set all the signals with min raw /max raw /init raw
    switch (rawstatus) 
    {
     case(0) :
        rawValue= 0;
        putValue(E_pric_RadarFrontCenter_TIPLCourseInfo0_TIPLCourseInfo0_qCourseConform_Rv, rawValue);
        rawValue= -32768;
        putValue(E_pric_RadarFrontCenter_TIPLCourseInfo0_TIPLCourseInfo0_a0polynomCoef_sw_Rv, rawValue);
        rawValue= -32767;
        putValue(E_pric_RadarFrontCenter_TIPLCourseInfo0_TIPLCourseInfo0_a2polynomCoef_sw_Rv, rawValue);
        rawValue= -32768;
        putValue(E_pric_RadarFrontCenter_TIPLCourseInfo0_TIPLCourseInfo0_dUpperLimit_sw_Rv, rawValue);
        rawValue= -32768;
        putValue(E_pric_RadarFrontCenter_TIPLCourseInfo0_TIPLCourseInfo0_dLowerLimit_sw_Rv, rawValue);
        rawValue= -32767;
        putValue(E_pric_RadarFrontCenter_TIPLCourseInfo0_TIPLCourseInfo0_a1polynomCoef_sw_Rv, rawValue);
        break;
     case(1) :
        rawValue= 255;
        putValue(E_pric_RadarFrontCenter_TIPLCourseInfo0_TIPLCourseInfo0_qCourseConform_Rv, rawValue);
        rawValue= 32767;
        putValue(E_pric_RadarFrontCenter_TIPLCourseInfo0_TIPLCourseInfo0_a0polynomCoef_sw_Rv, rawValue);
        rawValue= 32766;
        putValue(E_pric_RadarFrontCenter_TIPLCourseInfo0_TIPLCourseInfo0_a2polynomCoef_sw_Rv, rawValue);
        rawValue= 32767;
        putValue(E_pric_RadarFrontCenter_TIPLCourseInfo0_TIPLCourseInfo0_dUpperLimit_sw_Rv, rawValue);
        rawValue= 32767;
        putValue(E_pric_RadarFrontCenter_TIPLCourseInfo0_TIPLCourseInfo0_dLowerLimit_sw_Rv, rawValue);
        rawValue= 32766;
        putValue(E_pric_RadarFrontCenter_TIPLCourseInfo0_TIPLCourseInfo0_a1polynomCoef_sw_Rv, rawValue);
        break;
     default :
        rawValue= 0;
        putValue(E_pric_RadarFrontCenter_TIPLCourseInfo0_TIPLCourseInfo0_qCourseConform_Rv, rawValue);
        rawValue= -32768;
        putValue(E_pric_RadarFrontCenter_TIPLCourseInfo0_TIPLCourseInfo0_a0polynomCoef_sw_Rv, rawValue);
        rawValue= -32767;
        putValue(E_pric_RadarFrontCenter_TIPLCourseInfo0_TIPLCourseInfo0_a2polynomCoef_sw_Rv, rawValue);
        rawValue= -32768;
        putValue(E_pric_RadarFrontCenter_TIPLCourseInfo0_TIPLCourseInfo0_dUpperLimit_sw_Rv, rawValue);
        rawValue= -32768;
        putValue(E_pric_RadarFrontCenter_TIPLCourseInfo0_TIPLCourseInfo0_dLowerLimit_sw_Rv, rawValue);
        rawValue= -32767;
        putValue(E_pric_RadarFrontCenter_TIPLCourseInfo0_TIPLCourseInfo0_a1polynomCoef_sw_Rv, rawValue);
      break;
   }
}

on envVar E_pric_RadarFrontCenter_TIPLCourseInfo0_Dlc
{
    if(getValue(E_pric_RadarFrontCenter_TIPLCourseInfo0_enDlc))
    {
        Msg_TIPLCourseInfo0.dlc =getValue(this);
    }
    else
    {
       Dbc_dlc = 16;
	   Msg_TIPLCourseInfo0.dlc = Calc_Canfd_dlc(Dbc_dlc);
	   	
  }
}

on envVar E_pric_RadarFrontCenter_TIPLCourseInfo0_enDlc
{
    //For Messages with DLC = 8, set wrong DLC to smaller than defined DLC
    //For Messages with DLC < 8 set wrong DLC to smaller/longer than defined DLC
    if(getValue(this))
    {
        Msg_TIPLCourseInfo0.dlc =getValue(E_pric_RadarFrontCenter_TIPLCourseInfo0_Dlc);
    }
    else
    {
       Dbc_dlc = 16;
	   Msg_TIPLCourseInfo0.dlc = Calc_Canfd_dlc(Dbc_dlc);
			
    }
}

on envVar E_pric_RadarFrontCenter_TIPLCourseInfo0_TIPLCourseInfo0_CRC_wrongvalctr
{
    //update disturb count
    //disturb value range:(-1 = always send wrong value),( X>0 ,x is the number of Messages with wrong CHK sent)
    TIPLCourseInfo0_TIPLCourseInfo0_CRC_wrongvalctr =getValue(this);    
}
on envVar E_pric_RadarFrontCenter_TIPLCourseInfo0_TIPLCourseInfo0_MsgCtr_wrongvalctr
{
    //update disturb count
    //disturb value range:(-1 = always send wrong value),( X>0 ,x is the number of Messages with wrong CHK sent)
    TIPLCourseInfo0_TIPLCourseInfo0_MsgCtr_wrongvalctr =getValue(this);    
}
on envVar E_pric_RadarFrontCenter_TIPLCourseInfo0_TIPLCourseInfo0_blockCtr_wrongvalctr
{
    //update disturb count
    //disturb value range:(-1 = always send wrong value),( X>0 ,x is the number of Messages with wrong CHK sent)
    TIPLCourseInfo0_TIPLCourseInfo0_blockCtr_wrongvalctr =getValue(this);    
}

on envVar E_pric_RadarFrontCenter_TIPLCourseInfo0_TIPLCourseInfo0_qCourseConform_Rv
{
    qword rawValue = 0ll;
    float rawValue_float = 0.0;
    float phyValue = 0.0;        

    //set the signal with updated raw value
    {
        rawValue = getvalue(this);
        if(chgEv_TIPLCourseInfo0_TIPLCourseInfo0_qCourseConform == 0)
        {
            //type conversion to float
            rawValue_float = rawValue;        
            // raw to physical conversion
            phyValue = ((rawValue_float *0.00390625)+(0));
            putValue(E_pric_RadarFrontCenter_TIPLCourseInfo0_TIPLCourseInfo0_qCourseConform_Pv, phyValue);
            chgEv_TIPLCourseInfo0_TIPLCourseInfo0_qCourseConform = 1;
        }
        else
        {
            chgEv_TIPLCourseInfo0_TIPLCourseInfo0_qCourseConform = 0;
        }    
        //update the signal value
        Msg_TIPLCourseInfo0.TIPLCourseInfo0_qCourseConform=rawValue;        
    }                                                                           
}

on envVar E_pric_RadarFrontCenter_TIPLCourseInfo0_TIPLCourseInfo0_qCourseConform_Pv
{
    qword rawValue = 0ll;
    float phyValue = 0.0;
    
    //update the raw value with physical value 
    {
        if(chgEv_TIPLCourseInfo0_TIPLCourseInfo0_qCourseConform == 0)
        {
            phyValue = getvalue(this);
            // physical to raw conversion
            rawValue = ((phyValue -(0))/0.00390625);
            putValue(E_pric_RadarFrontCenter_TIPLCourseInfo0_TIPLCourseInfo0_qCourseConform_Rv, rawValue);
            chgEv_TIPLCourseInfo0_TIPLCourseInfo0_qCourseConform = 1;  
        }
        else
        {
            chgEv_TIPLCourseInfo0_TIPLCourseInfo0_qCourseConform = 0;
        }
    }
}


 
on envVar E_pric_RadarFrontCenter_TIPLCourseInfo0_TIPLCourseInfo0_a0polynomCoef_sw_Rv
{
    qword rawValue = 0ll;
    float rawValue_float = 0.0;
    float phyValue = 0.0;        

    //set the signal with updated raw value
    {
        rawValue = getvalue(this);
        if(chgEv_TIPLCourseInfo0_TIPLCourseInfo0_a0polynomCoef_sw == 0)
        {
            //type conversion to float
            rawValue_float = rawValue;        
            // raw to physical conversion
            phyValue = ((rawValue_float *0.0078125)+(0));
            putValue(E_pric_RadarFrontCenter_TIPLCourseInfo0_TIPLCourseInfo0_a0polynomCoef_sw_Pv, phyValue);
            chgEv_TIPLCourseInfo0_TIPLCourseInfo0_a0polynomCoef_sw = 1;
        }
        else
        {
            chgEv_TIPLCourseInfo0_TIPLCourseInfo0_a0polynomCoef_sw = 0;
        }    
        //update the signal value
        Msg_TIPLCourseInfo0.TIPLCourseInfo0_a0polynomCoef_sw=rawValue;        
    }                                                                           
}

on envVar E_pric_RadarFrontCenter_TIPLCourseInfo0_TIPLCourseInfo0_a0polynomCoef_sw_Pv
{
    qword rawValue = 0ll;
    float phyValue = 0.0;
    
    //update the raw value with physical value 
    {
        if(chgEv_TIPLCourseInfo0_TIPLCourseInfo0_a0polynomCoef_sw == 0)
        {
            phyValue = getvalue(this);
            // physical to raw conversion
            rawValue = ((phyValue -(0))/0.0078125);
            putValue(E_pric_RadarFrontCenter_TIPLCourseInfo0_TIPLCourseInfo0_a0polynomCoef_sw_Rv, rawValue);
            chgEv_TIPLCourseInfo0_TIPLCourseInfo0_a0polynomCoef_sw = 1;  
        }
        else
        {
            chgEv_TIPLCourseInfo0_TIPLCourseInfo0_a0polynomCoef_sw = 0;
        }
    }
}


 
on envVar E_pric_RadarFrontCenter_TIPLCourseInfo0_TIPLCourseInfo0_a2polynomCoef_sw_Rv
{
    qword rawValue = 0ll;
    float rawValue_float = 0.0;
    float phyValue = 0.0;        

    //set the signal with updated raw value
    {
        rawValue = getvalue(this);
        if(chgEv_TIPLCourseInfo0_TIPLCourseInfo0_a2polynomCoef_sw == 0)
        {
            //type conversion to float
            rawValue_float = rawValue;        
            // raw to physical conversion
            phyValue = ((rawValue_float *1.90735e-006)+(0));
            putValue(E_pric_RadarFrontCenter_TIPLCourseInfo0_TIPLCourseInfo0_a2polynomCoef_sw_Pv, phyValue);
            chgEv_TIPLCourseInfo0_TIPLCourseInfo0_a2polynomCoef_sw = 1;
        }
        else
        {
            chgEv_TIPLCourseInfo0_TIPLCourseInfo0_a2polynomCoef_sw = 0;
        }    
        //update the signal value
        Msg_TIPLCourseInfo0.TIPLCourseInfo0_a2polynomCoef_sw=rawValue;        
    }                                                                           
}

on envVar E_pric_RadarFrontCenter_TIPLCourseInfo0_TIPLCourseInfo0_a2polynomCoef_sw_Pv
{
    qword rawValue = 0ll;
    float phyValue = 0.0;
    
    //update the raw value with physical value 
    {
        if(chgEv_TIPLCourseInfo0_TIPLCourseInfo0_a2polynomCoef_sw == 0)
        {
            phyValue = getvalue(this);
            // physical to raw conversion
            rawValue = ((phyValue -(0))/1.90735e-006);
            putValue(E_pric_RadarFrontCenter_TIPLCourseInfo0_TIPLCourseInfo0_a2polynomCoef_sw_Rv, rawValue);
            chgEv_TIPLCourseInfo0_TIPLCourseInfo0_a2polynomCoef_sw = 1;  
        }
        else
        {
            chgEv_TIPLCourseInfo0_TIPLCourseInfo0_a2polynomCoef_sw = 0;
        }
    }
}


 
on envVar E_pric_RadarFrontCenter_TIPLCourseInfo0_TIPLCourseInfo0_dUpperLimit_sw_Rv
{
    qword rawValue = 0ll;
    float rawValue_float = 0.0;
    float phyValue = 0.0;        

    //set the signal with updated raw value
    {
        rawValue = getvalue(this);
        if(chgEv_TIPLCourseInfo0_TIPLCourseInfo0_dUpperLimit_sw == 0)
        {
            //type conversion to float
            rawValue_float = rawValue;        
            // raw to physical conversion
            phyValue = ((rawValue_float *0.0078125)+(0));
            putValue(E_pric_RadarFrontCenter_TIPLCourseInfo0_TIPLCourseInfo0_dUpperLimit_sw_Pv, phyValue);
            chgEv_TIPLCourseInfo0_TIPLCourseInfo0_dUpperLimit_sw = 1;
        }
        else
        {
            chgEv_TIPLCourseInfo0_TIPLCourseInfo0_dUpperLimit_sw = 0;
        }    
        //update the signal value
        Msg_TIPLCourseInfo0.TIPLCourseInfo0_dUpperLimit_sw=rawValue;        
    }                                                                           
}

on envVar E_pric_RadarFrontCenter_TIPLCourseInfo0_TIPLCourseInfo0_dUpperLimit_sw_Pv
{
    qword rawValue = 0ll;
    float phyValue = 0.0;
    
    //update the raw value with physical value 
    {
        if(chgEv_TIPLCourseInfo0_TIPLCourseInfo0_dUpperLimit_sw == 0)
        {
            phyValue = getvalue(this);
            // physical to raw conversion
            rawValue = ((phyValue -(0))/0.0078125);
            putValue(E_pric_RadarFrontCenter_TIPLCourseInfo0_TIPLCourseInfo0_dUpperLimit_sw_Rv, rawValue);
            chgEv_TIPLCourseInfo0_TIPLCourseInfo0_dUpperLimit_sw = 1;  
        }
        else
        {
            chgEv_TIPLCourseInfo0_TIPLCourseInfo0_dUpperLimit_sw = 0;
        }
    }
}


 
on envVar E_pric_RadarFrontCenter_TIPLCourseInfo0_TIPLCourseInfo0_dLowerLimit_sw_Rv
{
    qword rawValue = 0ll;
    float rawValue_float = 0.0;
    float phyValue = 0.0;        

    //set the signal with updated raw value
    {
        rawValue = getvalue(this);
        if(chgEv_TIPLCourseInfo0_TIPLCourseInfo0_dLowerLimit_sw == 0)
        {
            //type conversion to float
            rawValue_float = rawValue;        
            // raw to physical conversion
            phyValue = ((rawValue_float *0.0078125)+(0));
            putValue(E_pric_RadarFrontCenter_TIPLCourseInfo0_TIPLCourseInfo0_dLowerLimit_sw_Pv, phyValue);
            chgEv_TIPLCourseInfo0_TIPLCourseInfo0_dLowerLimit_sw = 1;
        }
        else
        {
            chgEv_TIPLCourseInfo0_TIPLCourseInfo0_dLowerLimit_sw = 0;
        }    
        //update the signal value
        Msg_TIPLCourseInfo0.TIPLCourseInfo0_dLowerLimit_sw=rawValue;        
    }                                                                           
}

on envVar E_pric_RadarFrontCenter_TIPLCourseInfo0_TIPLCourseInfo0_dLowerLimit_sw_Pv
{
    qword rawValue = 0ll;
    float phyValue = 0.0;
    
    //update the raw value with physical value 
    {
        if(chgEv_TIPLCourseInfo0_TIPLCourseInfo0_dLowerLimit_sw == 0)
        {
            phyValue = getvalue(this);
            // physical to raw conversion
            rawValue = ((phyValue -(0))/0.0078125);
            putValue(E_pric_RadarFrontCenter_TIPLCourseInfo0_TIPLCourseInfo0_dLowerLimit_sw_Rv, rawValue);
            chgEv_TIPLCourseInfo0_TIPLCourseInfo0_dLowerLimit_sw = 1;  
        }
        else
        {
            chgEv_TIPLCourseInfo0_TIPLCourseInfo0_dLowerLimit_sw = 0;
        }
    }
}


 
on envVar E_pric_RadarFrontCenter_TIPLCourseInfo0_TIPLCourseInfo0_a1polynomCoef_sw_Rv
{
    qword rawValue = 0ll;
    float rawValue_float = 0.0;
    float phyValue = 0.0;        

    //set the signal with updated raw value
    {
        rawValue = getvalue(this);
        if(chgEv_TIPLCourseInfo0_TIPLCourseInfo0_a1polynomCoef_sw == 0)
        {
            //type conversion to float
            rawValue_float = rawValue;        
            // raw to physical conversion
            phyValue = ((rawValue_float *0.000244141)+(0));
            putValue(E_pric_RadarFrontCenter_TIPLCourseInfo0_TIPLCourseInfo0_a1polynomCoef_sw_Pv, phyValue);
            chgEv_TIPLCourseInfo0_TIPLCourseInfo0_a1polynomCoef_sw = 1;
        }
        else
        {
            chgEv_TIPLCourseInfo0_TIPLCourseInfo0_a1polynomCoef_sw = 0;
        }    
        //update the signal value
        Msg_TIPLCourseInfo0.TIPLCourseInfo0_a1polynomCoef_sw=rawValue;        
    }                                                                           
}

on envVar E_pric_RadarFrontCenter_TIPLCourseInfo0_TIPLCourseInfo0_a1polynomCoef_sw_Pv
{
    qword rawValue = 0ll;
    float phyValue = 0.0;
    
    //update the raw value with physical value 
    {
        if(chgEv_TIPLCourseInfo0_TIPLCourseInfo0_a1polynomCoef_sw == 0)
        {
            phyValue = getvalue(this);
            // physical to raw conversion
            rawValue = ((phyValue -(0))/0.000244141);
            putValue(E_pric_RadarFrontCenter_TIPLCourseInfo0_TIPLCourseInfo0_a1polynomCoef_sw_Rv, rawValue);
            chgEv_TIPLCourseInfo0_TIPLCourseInfo0_a1polynomCoef_sw = 1;  
        }
        else
        {
            chgEv_TIPLCourseInfo0_TIPLCourseInfo0_a1polynomCoef_sw = 0;
        }
    }
}


 
on envVar E_pric_RadarFrontCenter_TIPLCourseInfo3_tx
{
    if(getValue(this))
    {       
        
        //update the BZ Signal
        if(TIPLCourseInfo3_TIPLCourseInfo3_blockCtr_wrongvalctr == 0)
        {
            update_TIPLCourseInfo3_TIPLCourseInfo3_blockCtr_counter();
            Msg_TIPLCourseInfo3.TIPLCourseInfo3_blockCtr= TIPLCourseInfo3_TIPLCourseInfo3_blockCtr_counter;
        }
        else if(TIPLCourseInfo3_TIPLCourseInfo3_blockCtr_wrongvalctr > 0)
        {
             TIPLCourseInfo3_TIPLCourseInfo3_blockCtr_wrongvalctr--;
              // if counter becomes zero, update panel controller to zero
             if(TIPLCourseInfo3_TIPLCourseInfo3_blockCtr_wrongvalctr == 0)
             {
                 putValue(E_pric_RadarFrontCenter_TIPLCourseInfo3_TIPLCourseInfo3_blockCtr_wrongvalctr,0);
             }
        }
        else
        {
            //do nothing
        }        
        //update the BZ Signal
        if(TIPLCourseInfo3_TIPLCourseInfo3_MsgCtr_wrongvalctr == 0)
        {
            update_TIPLCourseInfo3_TIPLCourseInfo3_MsgCtr_counter();
            Msg_TIPLCourseInfo3.TIPLCourseInfo3_MsgCtr= TIPLCourseInfo3_TIPLCourseInfo3_MsgCtr_counter;
        }
        else if(TIPLCourseInfo3_TIPLCourseInfo3_MsgCtr_wrongvalctr > 0)
        {
             TIPLCourseInfo3_TIPLCourseInfo3_MsgCtr_wrongvalctr--;
              // if counter becomes zero, update panel controller to zero
             if(TIPLCourseInfo3_TIPLCourseInfo3_MsgCtr_wrongvalctr == 0)
             {
                 putValue(E_pric_RadarFrontCenter_TIPLCourseInfo3_TIPLCourseInfo3_MsgCtr_wrongvalctr,0);
             }
        }
        else
        {
            //do nothing
        }        
        //calculate the CRC checksum
        update_TIPLCourseInfo3_ChkSum_Checksum();

        output(Msg_TIPLCourseInfo3);        
    }
}

on envVar E_pric_RadarFrontCenter_TIPLCourseInfo3_Range
{
    qword rawstatus = 0ll;
    qword rawValue = 0ll;    
    
    rawstatus = getvalue(this);    
    // set all the signals with min raw /max raw /init raw
    switch (rawstatus) 
    {
     case(0) :
        rawValue= -32767;
        putValue(E_pric_RadarFrontCenter_TIPLCourseInfo3_TIPLCourseInfo3_a1polynomCoef_sw_Rv, rawValue);
        rawValue= -32767;
        putValue(E_pric_RadarFrontCenter_TIPLCourseInfo3_TIPLCourseInfo3_a2polynomCoef_sw_Rv, rawValue);
        rawValue= 0;
        putValue(E_pric_RadarFrontCenter_TIPLCourseInfo3_TIPLCourseInfo3_qCourseConform_Rv, rawValue);
        rawValue= -32768;
        putValue(E_pric_RadarFrontCenter_TIPLCourseInfo3_TIPLCourseInfo3_dLowerLimit_sw_Rv, rawValue);
        rawValue= -32768;
        putValue(E_pric_RadarFrontCenter_TIPLCourseInfo3_TIPLCourseInfo3_dUpperLimit_sw_Rv, rawValue);
        rawValue= -32768;
        putValue(E_pric_RadarFrontCenter_TIPLCourseInfo3_TIPLCourseInfo3_a0polynomCoef_sw_Rv, rawValue);
        break;
     case(1) :
        rawValue= 32766;
        putValue(E_pric_RadarFrontCenter_TIPLCourseInfo3_TIPLCourseInfo3_a1polynomCoef_sw_Rv, rawValue);
        rawValue= 32766;
        putValue(E_pric_RadarFrontCenter_TIPLCourseInfo3_TIPLCourseInfo3_a2polynomCoef_sw_Rv, rawValue);
        rawValue= 255;
        putValue(E_pric_RadarFrontCenter_TIPLCourseInfo3_TIPLCourseInfo3_qCourseConform_Rv, rawValue);
        rawValue= 32767;
        putValue(E_pric_RadarFrontCenter_TIPLCourseInfo3_TIPLCourseInfo3_dLowerLimit_sw_Rv, rawValue);
        rawValue= 32767;
        putValue(E_pric_RadarFrontCenter_TIPLCourseInfo3_TIPLCourseInfo3_dUpperLimit_sw_Rv, rawValue);
        rawValue= 32767;
        putValue(E_pric_RadarFrontCenter_TIPLCourseInfo3_TIPLCourseInfo3_a0polynomCoef_sw_Rv, rawValue);
        break;
     default :
        rawValue= -32767;
        putValue(E_pric_RadarFrontCenter_TIPLCourseInfo3_TIPLCourseInfo3_a1polynomCoef_sw_Rv, rawValue);
        rawValue= -32767;
        putValue(E_pric_RadarFrontCenter_TIPLCourseInfo3_TIPLCourseInfo3_a2polynomCoef_sw_Rv, rawValue);
        rawValue= 0;
        putValue(E_pric_RadarFrontCenter_TIPLCourseInfo3_TIPLCourseInfo3_qCourseConform_Rv, rawValue);
        rawValue= -32768;
        putValue(E_pric_RadarFrontCenter_TIPLCourseInfo3_TIPLCourseInfo3_dLowerLimit_sw_Rv, rawValue);
        rawValue= -32768;
        putValue(E_pric_RadarFrontCenter_TIPLCourseInfo3_TIPLCourseInfo3_dUpperLimit_sw_Rv, rawValue);
        rawValue= -32768;
        putValue(E_pric_RadarFrontCenter_TIPLCourseInfo3_TIPLCourseInfo3_a0polynomCoef_sw_Rv, rawValue);
      break;
   }
}

on envVar E_pric_RadarFrontCenter_TIPLCourseInfo3_Dlc
{
    if(getValue(E_pric_RadarFrontCenter_TIPLCourseInfo3_enDlc))
    {
        Msg_TIPLCourseInfo3.dlc =getValue(this);
    }
    else
    {
       Dbc_dlc = 16;
	   Msg_TIPLCourseInfo3.dlc = Calc_Canfd_dlc(Dbc_dlc);
	   	
  }
}

on envVar E_pric_RadarFrontCenter_TIPLCourseInfo3_enDlc
{
    //For Messages with DLC = 8, set wrong DLC to smaller than defined DLC
    //For Messages with DLC < 8 set wrong DLC to smaller/longer than defined DLC
    if(getValue(this))
    {
        Msg_TIPLCourseInfo3.dlc =getValue(E_pric_RadarFrontCenter_TIPLCourseInfo3_Dlc);
    }
    else
    {
       Dbc_dlc = 16;
	   Msg_TIPLCourseInfo3.dlc = Calc_Canfd_dlc(Dbc_dlc);
			
    }
}

on envVar E_pric_RadarFrontCenter_TIPLCourseInfo3_TIPLCourseInfo3_CRC_wrongvalctr
{
    //update disturb count
    //disturb value range:(-1 = always send wrong value),( X>0 ,x is the number of Messages with wrong CHK sent)
    TIPLCourseInfo3_TIPLCourseInfo3_CRC_wrongvalctr =getValue(this);    
}
on envVar E_pric_RadarFrontCenter_TIPLCourseInfo3_TIPLCourseInfo3_MsgCtr_wrongvalctr
{
    //update disturb count
    //disturb value range:(-1 = always send wrong value),( X>0 ,x is the number of Messages with wrong CHK sent)
    TIPLCourseInfo3_TIPLCourseInfo3_MsgCtr_wrongvalctr =getValue(this);    
}
on envVar E_pric_RadarFrontCenter_TIPLCourseInfo3_TIPLCourseInfo3_blockCtr_wrongvalctr
{
    //update disturb count
    //disturb value range:(-1 = always send wrong value),( X>0 ,x is the number of Messages with wrong CHK sent)
    TIPLCourseInfo3_TIPLCourseInfo3_blockCtr_wrongvalctr =getValue(this);    
}

on envVar E_pric_RadarFrontCenter_TIPLCourseInfo3_TIPLCourseInfo3_a1polynomCoef_sw_Rv
{
    qword rawValue = 0ll;
    float rawValue_float = 0.0;
    float phyValue = 0.0;        

    //set the signal with updated raw value
    {
        rawValue = getvalue(this);
        if(chgEv_TIPLCourseInfo3_TIPLCourseInfo3_a1polynomCoef_sw == 0)
        {
            //type conversion to float
            rawValue_float = rawValue;        
            // raw to physical conversion
            phyValue = ((rawValue_float *0.000244141)+(0));
            putValue(E_pric_RadarFrontCenter_TIPLCourseInfo3_TIPLCourseInfo3_a1polynomCoef_sw_Pv, phyValue);
            chgEv_TIPLCourseInfo3_TIPLCourseInfo3_a1polynomCoef_sw = 1;
        }
        else
        {
            chgEv_TIPLCourseInfo3_TIPLCourseInfo3_a1polynomCoef_sw = 0;
        }    
        //update the signal value
        Msg_TIPLCourseInfo3.TIPLCourseInfo3_a1polynomCoef_sw=rawValue;        
    }                                                                           
}

on envVar E_pric_RadarFrontCenter_TIPLCourseInfo3_TIPLCourseInfo3_a1polynomCoef_sw_Pv
{
    qword rawValue = 0ll;
    float phyValue = 0.0;
    
    //update the raw value with physical value 
    {
        if(chgEv_TIPLCourseInfo3_TIPLCourseInfo3_a1polynomCoef_sw == 0)
        {
            phyValue = getvalue(this);
            // physical to raw conversion
            rawValue = ((phyValue -(0))/0.000244141);
            putValue(E_pric_RadarFrontCenter_TIPLCourseInfo3_TIPLCourseInfo3_a1polynomCoef_sw_Rv, rawValue);
            chgEv_TIPLCourseInfo3_TIPLCourseInfo3_a1polynomCoef_sw = 1;  
        }
        else
        {
            chgEv_TIPLCourseInfo3_TIPLCourseInfo3_a1polynomCoef_sw = 0;
        }
    }
}


 
on envVar E_pric_RadarFrontCenter_TIPLCourseInfo3_TIPLCourseInfo3_a2polynomCoef_sw_Rv
{
    qword rawValue = 0ll;
    float rawValue_float = 0.0;
    float phyValue = 0.0;        

    //set the signal with updated raw value
    {
        rawValue = getvalue(this);
        if(chgEv_TIPLCourseInfo3_TIPLCourseInfo3_a2polynomCoef_sw == 0)
        {
            //type conversion to float
            rawValue_float = rawValue;        
            // raw to physical conversion
            phyValue = ((rawValue_float *1.90735e-006)+(0));
            putValue(E_pric_RadarFrontCenter_TIPLCourseInfo3_TIPLCourseInfo3_a2polynomCoef_sw_Pv, phyValue);
            chgEv_TIPLCourseInfo3_TIPLCourseInfo3_a2polynomCoef_sw = 1;
        }
        else
        {
            chgEv_TIPLCourseInfo3_TIPLCourseInfo3_a2polynomCoef_sw = 0;
        }    
        //update the signal value
        Msg_TIPLCourseInfo3.TIPLCourseInfo3_a2polynomCoef_sw=rawValue;        
    }                                                                           
}

on envVar E_pric_RadarFrontCenter_TIPLCourseInfo3_TIPLCourseInfo3_a2polynomCoef_sw_Pv
{
    qword rawValue = 0ll;
    float phyValue = 0.0;
    
    //update the raw value with physical value 
    {
        if(chgEv_TIPLCourseInfo3_TIPLCourseInfo3_a2polynomCoef_sw == 0)
        {
            phyValue = getvalue(this);
            // physical to raw conversion
            rawValue = ((phyValue -(0))/1.90735e-006);
            putValue(E_pric_RadarFrontCenter_TIPLCourseInfo3_TIPLCourseInfo3_a2polynomCoef_sw_Rv, rawValue);
            chgEv_TIPLCourseInfo3_TIPLCourseInfo3_a2polynomCoef_sw = 1;  
        }
        else
        {
            chgEv_TIPLCourseInfo3_TIPLCourseInfo3_a2polynomCoef_sw = 0;
        }
    }
}


 
on envVar E_pric_RadarFrontCenter_TIPLCourseInfo3_TIPLCourseInfo3_qCourseConform_Rv
{
    qword rawValue = 0ll;
    float rawValue_float = 0.0;
    float phyValue = 0.0;        

    //set the signal with updated raw value
    {
        rawValue = getvalue(this);
        if(chgEv_TIPLCourseInfo3_TIPLCourseInfo3_qCourseConform == 0)
        {
            //type conversion to float
            rawValue_float = rawValue;        
            // raw to physical conversion
            phyValue = ((rawValue_float *0.00390625)+(0));
            putValue(E_pric_RadarFrontCenter_TIPLCourseInfo3_TIPLCourseInfo3_qCourseConform_Pv, phyValue);
            chgEv_TIPLCourseInfo3_TIPLCourseInfo3_qCourseConform = 1;
        }
        else
        {
            chgEv_TIPLCourseInfo3_TIPLCourseInfo3_qCourseConform = 0;
        }    
        //update the signal value
        Msg_TIPLCourseInfo3.TIPLCourseInfo3_qCourseConform=rawValue;        
    }                                                                           
}

on envVar E_pric_RadarFrontCenter_TIPLCourseInfo3_TIPLCourseInfo3_qCourseConform_Pv
{
    qword rawValue = 0ll;
    float phyValue = 0.0;
    
    //update the raw value with physical value 
    {
        if(chgEv_TIPLCourseInfo3_TIPLCourseInfo3_qCourseConform == 0)
        {
            phyValue = getvalue(this);
            // physical to raw conversion
            rawValue = ((phyValue -(0))/0.00390625);
            putValue(E_pric_RadarFrontCenter_TIPLCourseInfo3_TIPLCourseInfo3_qCourseConform_Rv, rawValue);
            chgEv_TIPLCourseInfo3_TIPLCourseInfo3_qCourseConform = 1;  
        }
        else
        {
            chgEv_TIPLCourseInfo3_TIPLCourseInfo3_qCourseConform = 0;
        }
    }
}


 
on envVar E_pric_RadarFrontCenter_TIPLCourseInfo3_TIPLCourseInfo3_dLowerLimit_sw_Rv
{
    qword rawValue = 0ll;
    float rawValue_float = 0.0;
    float phyValue = 0.0;        

    //set the signal with updated raw value
    {
        rawValue = getvalue(this);
        if(chgEv_TIPLCourseInfo3_TIPLCourseInfo3_dLowerLimit_sw == 0)
        {
            //type conversion to float
            rawValue_float = rawValue;        
            // raw to physical conversion
            phyValue = ((rawValue_float *0.0078125)+(0));
            putValue(E_pric_RadarFrontCenter_TIPLCourseInfo3_TIPLCourseInfo3_dLowerLimit_sw_Pv, phyValue);
            chgEv_TIPLCourseInfo3_TIPLCourseInfo3_dLowerLimit_sw = 1;
        }
        else
        {
            chgEv_TIPLCourseInfo3_TIPLCourseInfo3_dLowerLimit_sw = 0;
        }    
        //update the signal value
        Msg_TIPLCourseInfo3.TIPLCourseInfo3_dLowerLimit_sw=rawValue;        
    }                                                                           
}

on envVar E_pric_RadarFrontCenter_TIPLCourseInfo3_TIPLCourseInfo3_dLowerLimit_sw_Pv
{
    qword rawValue = 0ll;
    float phyValue = 0.0;
    
    //update the raw value with physical value 
    {
        if(chgEv_TIPLCourseInfo3_TIPLCourseInfo3_dLowerLimit_sw == 0)
        {
            phyValue = getvalue(this);
            // physical to raw conversion
            rawValue = ((phyValue -(0))/0.0078125);
            putValue(E_pric_RadarFrontCenter_TIPLCourseInfo3_TIPLCourseInfo3_dLowerLimit_sw_Rv, rawValue);
            chgEv_TIPLCourseInfo3_TIPLCourseInfo3_dLowerLimit_sw = 1;  
        }
        else
        {
            chgEv_TIPLCourseInfo3_TIPLCourseInfo3_dLowerLimit_sw = 0;
        }
    }
}


 
on envVar E_pric_RadarFrontCenter_TIPLCourseInfo3_TIPLCourseInfo3_dUpperLimit_sw_Rv
{
    qword rawValue = 0ll;
    float rawValue_float = 0.0;
    float phyValue = 0.0;        

    //set the signal with updated raw value
    {
        rawValue = getvalue(this);
        if(chgEv_TIPLCourseInfo3_TIPLCourseInfo3_dUpperLimit_sw == 0)
        {
            //type conversion to float
            rawValue_float = rawValue;        
            // raw to physical conversion
            phyValue = ((rawValue_float *0.0078125)+(0));
            putValue(E_pric_RadarFrontCenter_TIPLCourseInfo3_TIPLCourseInfo3_dUpperLimit_sw_Pv, phyValue);
            chgEv_TIPLCourseInfo3_TIPLCourseInfo3_dUpperLimit_sw = 1;
        }
        else
        {
            chgEv_TIPLCourseInfo3_TIPLCourseInfo3_dUpperLimit_sw = 0;
        }    
        //update the signal value
        Msg_TIPLCourseInfo3.TIPLCourseInfo3_dUpperLimit_sw=rawValue;        
    }                                                                           
}

on envVar E_pric_RadarFrontCenter_TIPLCourseInfo3_TIPLCourseInfo3_dUpperLimit_sw_Pv
{
    qword rawValue = 0ll;
    float phyValue = 0.0;
    
    //update the raw value with physical value 
    {
        if(chgEv_TIPLCourseInfo3_TIPLCourseInfo3_dUpperLimit_sw == 0)
        {
            phyValue = getvalue(this);
            // physical to raw conversion
            rawValue = ((phyValue -(0))/0.0078125);
            putValue(E_pric_RadarFrontCenter_TIPLCourseInfo3_TIPLCourseInfo3_dUpperLimit_sw_Rv, rawValue);
            chgEv_TIPLCourseInfo3_TIPLCourseInfo3_dUpperLimit_sw = 1;  
        }
        else
        {
            chgEv_TIPLCourseInfo3_TIPLCourseInfo3_dUpperLimit_sw = 0;
        }
    }
}


 
on envVar E_pric_RadarFrontCenter_TIPLCourseInfo3_TIPLCourseInfo3_a0polynomCoef_sw_Rv
{
    qword rawValue = 0ll;
    float rawValue_float = 0.0;
    float phyValue = 0.0;        

    //set the signal with updated raw value
    {
        rawValue = getvalue(this);
        if(chgEv_TIPLCourseInfo3_TIPLCourseInfo3_a0polynomCoef_sw == 0)
        {
            //type conversion to float
            rawValue_float = rawValue;        
            // raw to physical conversion
            phyValue = ((rawValue_float *0.0078125)+(0));
            putValue(E_pric_RadarFrontCenter_TIPLCourseInfo3_TIPLCourseInfo3_a0polynomCoef_sw_Pv, phyValue);
            chgEv_TIPLCourseInfo3_TIPLCourseInfo3_a0polynomCoef_sw = 1;
        }
        else
        {
            chgEv_TIPLCourseInfo3_TIPLCourseInfo3_a0polynomCoef_sw = 0;
        }    
        //update the signal value
        Msg_TIPLCourseInfo3.TIPLCourseInfo3_a0polynomCoef_sw=rawValue;        
    }                                                                           
}

on envVar E_pric_RadarFrontCenter_TIPLCourseInfo3_TIPLCourseInfo3_a0polynomCoef_sw_Pv
{
    qword rawValue = 0ll;
    float phyValue = 0.0;
    
    //update the raw value with physical value 
    {
        if(chgEv_TIPLCourseInfo3_TIPLCourseInfo3_a0polynomCoef_sw == 0)
        {
            phyValue = getvalue(this);
            // physical to raw conversion
            rawValue = ((phyValue -(0))/0.0078125);
            putValue(E_pric_RadarFrontCenter_TIPLCourseInfo3_TIPLCourseInfo3_a0polynomCoef_sw_Rv, rawValue);
            chgEv_TIPLCourseInfo3_TIPLCourseInfo3_a0polynomCoef_sw = 1;  
        }
        else
        {
            chgEv_TIPLCourseInfo3_TIPLCourseInfo3_a0polynomCoef_sw = 0;
        }
    }
}


 
on envVar E_pric_RadarFrontCenter_TIPLCourseInfo2_tx
{
    if(getValue(this))
    {       
        
        //update the BZ Signal
        if(TIPLCourseInfo2_TIPLCourseInfo2_blockCtr_wrongvalctr == 0)
        {
            update_TIPLCourseInfo2_TIPLCourseInfo2_blockCtr_counter();
            Msg_TIPLCourseInfo2.TIPLCourseInfo2_blockCtr= TIPLCourseInfo2_TIPLCourseInfo2_blockCtr_counter;
        }
        else if(TIPLCourseInfo2_TIPLCourseInfo2_blockCtr_wrongvalctr > 0)
        {
             TIPLCourseInfo2_TIPLCourseInfo2_blockCtr_wrongvalctr--;
              // if counter becomes zero, update panel controller to zero
             if(TIPLCourseInfo2_TIPLCourseInfo2_blockCtr_wrongvalctr == 0)
             {
                 putValue(E_pric_RadarFrontCenter_TIPLCourseInfo2_TIPLCourseInfo2_blockCtr_wrongvalctr,0);
             }
        }
        else
        {
            //do nothing
        }        
        //update the BZ Signal
        if(TIPLCourseInfo2_TIPLCourseInfo2_MsgCtr_wrongvalctr == 0)
        {
            update_TIPLCourseInfo2_TIPLCourseInfo2_MsgCtr_counter();
            Msg_TIPLCourseInfo2.TIPLCourseInfo2_MsgCtr= TIPLCourseInfo2_TIPLCourseInfo2_MsgCtr_counter;
        }
        else if(TIPLCourseInfo2_TIPLCourseInfo2_MsgCtr_wrongvalctr > 0)
        {
             TIPLCourseInfo2_TIPLCourseInfo2_MsgCtr_wrongvalctr--;
              // if counter becomes zero, update panel controller to zero
             if(TIPLCourseInfo2_TIPLCourseInfo2_MsgCtr_wrongvalctr == 0)
             {
                 putValue(E_pric_RadarFrontCenter_TIPLCourseInfo2_TIPLCourseInfo2_MsgCtr_wrongvalctr,0);
             }
        }
        else
        {
            //do nothing
        }        
        //calculate the CRC checksum
        update_TIPLCourseInfo2_ChkSum_Checksum();

        output(Msg_TIPLCourseInfo2);        
    }
}

on envVar E_pric_RadarFrontCenter_TIPLCourseInfo2_Range
{
    qword rawstatus = 0ll;
    qword rawValue = 0ll;    
    
    rawstatus = getvalue(this);    
    // set all the signals with min raw /max raw /init raw
    switch (rawstatus) 
    {
     case(0) :
        rawValue= -32768;
        putValue(E_pric_RadarFrontCenter_TIPLCourseInfo2_TIPLCourseInfo2_dLowerLimit_sw_Rv, rawValue);
        rawValue= 0;
        putValue(E_pric_RadarFrontCenter_TIPLCourseInfo2_TIPLCourseInfo2_qCourseConform_Rv, rawValue);
        rawValue= -32767;
        putValue(E_pric_RadarFrontCenter_TIPLCourseInfo2_TIPLCourseInfo2_a2polynomCoef_sw_Rv, rawValue);
        rawValue= -32768;
        putValue(E_pric_RadarFrontCenter_TIPLCourseInfo2_TIPLCourseInfo2_a0polynomCoef_sw_Rv, rawValue);
        rawValue= -32767;
        putValue(E_pric_RadarFrontCenter_TIPLCourseInfo2_TIPLCourseInfo2_a1polynomCoef_sw_Rv, rawValue);
        rawValue= -32768;
        putValue(E_pric_RadarFrontCenter_TIPLCourseInfo2_TIPLCourseInfo2_dUpperLimit_sw_Rv, rawValue);
        break;
     case(1) :
        rawValue= 32767;
        putValue(E_pric_RadarFrontCenter_TIPLCourseInfo2_TIPLCourseInfo2_dLowerLimit_sw_Rv, rawValue);
        rawValue= 255;
        putValue(E_pric_RadarFrontCenter_TIPLCourseInfo2_TIPLCourseInfo2_qCourseConform_Rv, rawValue);
        rawValue= 32766;
        putValue(E_pric_RadarFrontCenter_TIPLCourseInfo2_TIPLCourseInfo2_a2polynomCoef_sw_Rv, rawValue);
        rawValue= 32767;
        putValue(E_pric_RadarFrontCenter_TIPLCourseInfo2_TIPLCourseInfo2_a0polynomCoef_sw_Rv, rawValue);
        rawValue= 32766;
        putValue(E_pric_RadarFrontCenter_TIPLCourseInfo2_TIPLCourseInfo2_a1polynomCoef_sw_Rv, rawValue);
        rawValue= 32767;
        putValue(E_pric_RadarFrontCenter_TIPLCourseInfo2_TIPLCourseInfo2_dUpperLimit_sw_Rv, rawValue);
        break;
     default :
        rawValue= -32768;
        putValue(E_pric_RadarFrontCenter_TIPLCourseInfo2_TIPLCourseInfo2_dLowerLimit_sw_Rv, rawValue);
        rawValue= 0;
        putValue(E_pric_RadarFrontCenter_TIPLCourseInfo2_TIPLCourseInfo2_qCourseConform_Rv, rawValue);
        rawValue= -32767;
        putValue(E_pric_RadarFrontCenter_TIPLCourseInfo2_TIPLCourseInfo2_a2polynomCoef_sw_Rv, rawValue);
        rawValue= -32768;
        putValue(E_pric_RadarFrontCenter_TIPLCourseInfo2_TIPLCourseInfo2_a0polynomCoef_sw_Rv, rawValue);
        rawValue= -32767;
        putValue(E_pric_RadarFrontCenter_TIPLCourseInfo2_TIPLCourseInfo2_a1polynomCoef_sw_Rv, rawValue);
        rawValue= -32768;
        putValue(E_pric_RadarFrontCenter_TIPLCourseInfo2_TIPLCourseInfo2_dUpperLimit_sw_Rv, rawValue);
      break;
   }
}

on envVar E_pric_RadarFrontCenter_TIPLCourseInfo2_Dlc
{
    if(getValue(E_pric_RadarFrontCenter_TIPLCourseInfo2_enDlc))
    {
        Msg_TIPLCourseInfo2.dlc =getValue(this);
    }
    else
    {
       Dbc_dlc = 16;
	   Msg_TIPLCourseInfo2.dlc = Calc_Canfd_dlc(Dbc_dlc);
	   	
  }
}

on envVar E_pric_RadarFrontCenter_TIPLCourseInfo2_enDlc
{
    //For Messages with DLC = 8, set wrong DLC to smaller than defined DLC
    //For Messages with DLC < 8 set wrong DLC to smaller/longer than defined DLC
    if(getValue(this))
    {
        Msg_TIPLCourseInfo2.dlc =getValue(E_pric_RadarFrontCenter_TIPLCourseInfo2_Dlc);
    }
    else
    {
       Dbc_dlc = 16;
	   Msg_TIPLCourseInfo2.dlc = Calc_Canfd_dlc(Dbc_dlc);
			
    }
}

on envVar E_pric_RadarFrontCenter_TIPLCourseInfo2_TIPLCourseInfo2_CRC_wrongvalctr
{
    //update disturb count
    //disturb value range:(-1 = always send wrong value),( X>0 ,x is the number of Messages with wrong CHK sent)
    TIPLCourseInfo2_TIPLCourseInfo2_CRC_wrongvalctr =getValue(this);    
}
on envVar E_pric_RadarFrontCenter_TIPLCourseInfo2_TIPLCourseInfo2_MsgCtr_wrongvalctr
{
    //update disturb count
    //disturb value range:(-1 = always send wrong value),( X>0 ,x is the number of Messages with wrong CHK sent)
    TIPLCourseInfo2_TIPLCourseInfo2_MsgCtr_wrongvalctr =getValue(this);    
}
on envVar E_pric_RadarFrontCenter_TIPLCourseInfo2_TIPLCourseInfo2_blockCtr_wrongvalctr
{
    //update disturb count
    //disturb value range:(-1 = always send wrong value),( X>0 ,x is the number of Messages with wrong CHK sent)
    TIPLCourseInfo2_TIPLCourseInfo2_blockCtr_wrongvalctr =getValue(this);    
}

on envVar E_pric_RadarFrontCenter_TIPLCourseInfo2_TIPLCourseInfo2_dLowerLimit_sw_Rv
{
    qword rawValue = 0ll;
    float rawValue_float = 0.0;
    float phyValue = 0.0;        

    //set the signal with updated raw value
    {
        rawValue = getvalue(this);
        if(chgEv_TIPLCourseInfo2_TIPLCourseInfo2_dLowerLimit_sw == 0)
        {
            //type conversion to float
            rawValue_float = rawValue;        
            // raw to physical conversion
            phyValue = ((rawValue_float *0.0078125)+(0));
            putValue(E_pric_RadarFrontCenter_TIPLCourseInfo2_TIPLCourseInfo2_dLowerLimit_sw_Pv, phyValue);
            chgEv_TIPLCourseInfo2_TIPLCourseInfo2_dLowerLimit_sw = 1;
        }
        else
        {
            chgEv_TIPLCourseInfo2_TIPLCourseInfo2_dLowerLimit_sw = 0;
        }    
        //update the signal value
        Msg_TIPLCourseInfo2.TIPLCourseInfo2_dLowerLimit_sw=rawValue;        
    }                                                                           
}

on envVar E_pric_RadarFrontCenter_TIPLCourseInfo2_TIPLCourseInfo2_dLowerLimit_sw_Pv
{
    qword rawValue = 0ll;
    float phyValue = 0.0;
    
    //update the raw value with physical value 
    {
        if(chgEv_TIPLCourseInfo2_TIPLCourseInfo2_dLowerLimit_sw == 0)
        {
            phyValue = getvalue(this);
            // physical to raw conversion
            rawValue = ((phyValue -(0))/0.0078125);
            putValue(E_pric_RadarFrontCenter_TIPLCourseInfo2_TIPLCourseInfo2_dLowerLimit_sw_Rv, rawValue);
            chgEv_TIPLCourseInfo2_TIPLCourseInfo2_dLowerLimit_sw = 1;  
        }
        else
        {
            chgEv_TIPLCourseInfo2_TIPLCourseInfo2_dLowerLimit_sw = 0;
        }
    }
}


 
on envVar E_pric_RadarFrontCenter_TIPLCourseInfo2_TIPLCourseInfo2_qCourseConform_Rv
{
    qword rawValue = 0ll;
    float rawValue_float = 0.0;
    float phyValue = 0.0;        

    //set the signal with updated raw value
    {
        rawValue = getvalue(this);
        if(chgEv_TIPLCourseInfo2_TIPLCourseInfo2_qCourseConform == 0)
        {
            //type conversion to float
            rawValue_float = rawValue;        
            // raw to physical conversion
            phyValue = ((rawValue_float *0.00390625)+(0));
            putValue(E_pric_RadarFrontCenter_TIPLCourseInfo2_TIPLCourseInfo2_qCourseConform_Pv, phyValue);
            chgEv_TIPLCourseInfo2_TIPLCourseInfo2_qCourseConform = 1;
        }
        else
        {
            chgEv_TIPLCourseInfo2_TIPLCourseInfo2_qCourseConform = 0;
        }    
        //update the signal value
        Msg_TIPLCourseInfo2.TIPLCourseInfo2_qCourseConform=rawValue;        
    }                                                                           
}

on envVar E_pric_RadarFrontCenter_TIPLCourseInfo2_TIPLCourseInfo2_qCourseConform_Pv
{
    qword rawValue = 0ll;
    float phyValue = 0.0;
    
    //update the raw value with physical value 
    {
        if(chgEv_TIPLCourseInfo2_TIPLCourseInfo2_qCourseConform == 0)
        {
            phyValue = getvalue(this);
            // physical to raw conversion
            rawValue = ((phyValue -(0))/0.00390625);
            putValue(E_pric_RadarFrontCenter_TIPLCourseInfo2_TIPLCourseInfo2_qCourseConform_Rv, rawValue);
            chgEv_TIPLCourseInfo2_TIPLCourseInfo2_qCourseConform = 1;  
        }
        else
        {
            chgEv_TIPLCourseInfo2_TIPLCourseInfo2_qCourseConform = 0;
        }
    }
}


 
on envVar E_pric_RadarFrontCenter_TIPLCourseInfo2_TIPLCourseInfo2_a2polynomCoef_sw_Rv
{
    qword rawValue = 0ll;
    float rawValue_float = 0.0;
    float phyValue = 0.0;        

    //set the signal with updated raw value
    {
        rawValue = getvalue(this);
        if(chgEv_TIPLCourseInfo2_TIPLCourseInfo2_a2polynomCoef_sw == 0)
        {
            //type conversion to float
            rawValue_float = rawValue;        
            // raw to physical conversion
            phyValue = ((rawValue_float *1.90735e-006)+(0));
            putValue(E_pric_RadarFrontCenter_TIPLCourseInfo2_TIPLCourseInfo2_a2polynomCoef_sw_Pv, phyValue);
            chgEv_TIPLCourseInfo2_TIPLCourseInfo2_a2polynomCoef_sw = 1;
        }
        else
        {
            chgEv_TIPLCourseInfo2_TIPLCourseInfo2_a2polynomCoef_sw = 0;
        }    
        //update the signal value
        Msg_TIPLCourseInfo2.TIPLCourseInfo2_a2polynomCoef_sw=rawValue;        
    }                                                                           
}

on envVar E_pric_RadarFrontCenter_TIPLCourseInfo2_TIPLCourseInfo2_a2polynomCoef_sw_Pv
{
    qword rawValue = 0ll;
    float phyValue = 0.0;
    
    //update the raw value with physical value 
    {
        if(chgEv_TIPLCourseInfo2_TIPLCourseInfo2_a2polynomCoef_sw == 0)
        {
            phyValue = getvalue(this);
            // physical to raw conversion
            rawValue = ((phyValue -(0))/1.90735e-006);
            putValue(E_pric_RadarFrontCenter_TIPLCourseInfo2_TIPLCourseInfo2_a2polynomCoef_sw_Rv, rawValue);
            chgEv_TIPLCourseInfo2_TIPLCourseInfo2_a2polynomCoef_sw = 1;  
        }
        else
        {
            chgEv_TIPLCourseInfo2_TIPLCourseInfo2_a2polynomCoef_sw = 0;
        }
    }
}


 
on envVar E_pric_RadarFrontCenter_TIPLCourseInfo2_TIPLCourseInfo2_a0polynomCoef_sw_Rv
{
    qword rawValue = 0ll;
    float rawValue_float = 0.0;
    float phyValue = 0.0;        

    //set the signal with updated raw value
    {
        rawValue = getvalue(this);
        if(chgEv_TIPLCourseInfo2_TIPLCourseInfo2_a0polynomCoef_sw == 0)
        {
            //type conversion to float
            rawValue_float = rawValue;        
            // raw to physical conversion
            phyValue = ((rawValue_float *0.0078125)+(0));
            putValue(E_pric_RadarFrontCenter_TIPLCourseInfo2_TIPLCourseInfo2_a0polynomCoef_sw_Pv, phyValue);
            chgEv_TIPLCourseInfo2_TIPLCourseInfo2_a0polynomCoef_sw = 1;
        }
        else
        {
            chgEv_TIPLCourseInfo2_TIPLCourseInfo2_a0polynomCoef_sw = 0;
        }    
        //update the signal value
        Msg_TIPLCourseInfo2.TIPLCourseInfo2_a0polynomCoef_sw=rawValue;        
    }                                                                           
}

on envVar E_pric_RadarFrontCenter_TIPLCourseInfo2_TIPLCourseInfo2_a0polynomCoef_sw_Pv
{
    qword rawValue = 0ll;
    float phyValue = 0.0;
    
    //update the raw value with physical value 
    {
        if(chgEv_TIPLCourseInfo2_TIPLCourseInfo2_a0polynomCoef_sw == 0)
        {
            phyValue = getvalue(this);
            // physical to raw conversion
            rawValue = ((phyValue -(0))/0.0078125);
            putValue(E_pric_RadarFrontCenter_TIPLCourseInfo2_TIPLCourseInfo2_a0polynomCoef_sw_Rv, rawValue);
            chgEv_TIPLCourseInfo2_TIPLCourseInfo2_a0polynomCoef_sw = 1;  
        }
        else
        {
            chgEv_TIPLCourseInfo2_TIPLCourseInfo2_a0polynomCoef_sw = 0;
        }
    }
}


 
on envVar E_pric_RadarFrontCenter_TIPLCourseInfo2_TIPLCourseInfo2_a1polynomCoef_sw_Rv
{
    qword rawValue = 0ll;
    float rawValue_float = 0.0;
    float phyValue = 0.0;        

    //set the signal with updated raw value
    {
        rawValue = getvalue(this);
        if(chgEv_TIPLCourseInfo2_TIPLCourseInfo2_a1polynomCoef_sw == 0)
        {
            //type conversion to float
            rawValue_float = rawValue;        
            // raw to physical conversion
            phyValue = ((rawValue_float *0.000244141)+(0));
            putValue(E_pric_RadarFrontCenter_TIPLCourseInfo2_TIPLCourseInfo2_a1polynomCoef_sw_Pv, phyValue);
            chgEv_TIPLCourseInfo2_TIPLCourseInfo2_a1polynomCoef_sw = 1;
        }
        else
        {
            chgEv_TIPLCourseInfo2_TIPLCourseInfo2_a1polynomCoef_sw = 0;
        }    
        //update the signal value
        Msg_TIPLCourseInfo2.TIPLCourseInfo2_a1polynomCoef_sw=rawValue;        
    }                                                                           
}

on envVar E_pric_RadarFrontCenter_TIPLCourseInfo2_TIPLCourseInfo2_a1polynomCoef_sw_Pv
{
    qword rawValue = 0ll;
    float phyValue = 0.0;
    
    //update the raw value with physical value 
    {
        if(chgEv_TIPLCourseInfo2_TIPLCourseInfo2_a1polynomCoef_sw == 0)
        {
            phyValue = getvalue(this);
            // physical to raw conversion
            rawValue = ((phyValue -(0))/0.000244141);
            putValue(E_pric_RadarFrontCenter_TIPLCourseInfo2_TIPLCourseInfo2_a1polynomCoef_sw_Rv, rawValue);
            chgEv_TIPLCourseInfo2_TIPLCourseInfo2_a1polynomCoef_sw = 1;  
        }
        else
        {
            chgEv_TIPLCourseInfo2_TIPLCourseInfo2_a1polynomCoef_sw = 0;
        }
    }
}


 
on envVar E_pric_RadarFrontCenter_TIPLCourseInfo2_TIPLCourseInfo2_dUpperLimit_sw_Rv
{
    qword rawValue = 0ll;
    float rawValue_float = 0.0;
    float phyValue = 0.0;        

    //set the signal with updated raw value
    {
        rawValue = getvalue(this);
        if(chgEv_TIPLCourseInfo2_TIPLCourseInfo2_dUpperLimit_sw == 0)
        {
            //type conversion to float
            rawValue_float = rawValue;        
            // raw to physical conversion
            phyValue = ((rawValue_float *0.0078125)+(0));
            putValue(E_pric_RadarFrontCenter_TIPLCourseInfo2_TIPLCourseInfo2_dUpperLimit_sw_Pv, phyValue);
            chgEv_TIPLCourseInfo2_TIPLCourseInfo2_dUpperLimit_sw = 1;
        }
        else
        {
            chgEv_TIPLCourseInfo2_TIPLCourseInfo2_dUpperLimit_sw = 0;
        }    
        //update the signal value
        Msg_TIPLCourseInfo2.TIPLCourseInfo2_dUpperLimit_sw=rawValue;        
    }                                                                           
}

on envVar E_pric_RadarFrontCenter_TIPLCourseInfo2_TIPLCourseInfo2_dUpperLimit_sw_Pv
{
    qword rawValue = 0ll;
    float phyValue = 0.0;
    
    //update the raw value with physical value 
    {
        if(chgEv_TIPLCourseInfo2_TIPLCourseInfo2_dUpperLimit_sw == 0)
        {
            phyValue = getvalue(this);
            // physical to raw conversion
            rawValue = ((phyValue -(0))/0.0078125);
            putValue(E_pric_RadarFrontCenter_TIPLCourseInfo2_TIPLCourseInfo2_dUpperLimit_sw_Rv, rawValue);
            chgEv_TIPLCourseInfo2_TIPLCourseInfo2_dUpperLimit_sw = 1;  
        }
        else
        {
            chgEv_TIPLCourseInfo2_TIPLCourseInfo2_dUpperLimit_sw = 0;
        }
    }
}


 
on envVar E_pric_RadarFrontCenter_TIPLCourseInfo4_tx
{
    if(getValue(this))
    {       
        
        //update the BZ Signal
        if(TIPLCourseInfo4_TIPLCourseInfo4_blockCtr_wrongvalctr == 0)
        {
            update_TIPLCourseInfo4_TIPLCourseInfo4_blockCtr_counter();
            Msg_TIPLCourseInfo4.TIPLCourseInfo4_blockCtr= TIPLCourseInfo4_TIPLCourseInfo4_blockCtr_counter;
        }
        else if(TIPLCourseInfo4_TIPLCourseInfo4_blockCtr_wrongvalctr > 0)
        {
             TIPLCourseInfo4_TIPLCourseInfo4_blockCtr_wrongvalctr--;
              // if counter becomes zero, update panel controller to zero
             if(TIPLCourseInfo4_TIPLCourseInfo4_blockCtr_wrongvalctr == 0)
             {
                 putValue(E_pric_RadarFrontCenter_TIPLCourseInfo4_TIPLCourseInfo4_blockCtr_wrongvalctr,0);
             }
        }
        else
        {
            //do nothing
        }        
        //update the BZ Signal
        if(TIPLCourseInfo4_TIPLCourseInfo4_MsgCtr_wrongvalctr == 0)
        {
            update_TIPLCourseInfo4_TIPLCourseInfo4_MsgCtr_counter();
            Msg_TIPLCourseInfo4.TIPLCourseInfo4_MsgCtr= TIPLCourseInfo4_TIPLCourseInfo4_MsgCtr_counter;
        }
        else if(TIPLCourseInfo4_TIPLCourseInfo4_MsgCtr_wrongvalctr > 0)
        {
             TIPLCourseInfo4_TIPLCourseInfo4_MsgCtr_wrongvalctr--;
              // if counter becomes zero, update panel controller to zero
             if(TIPLCourseInfo4_TIPLCourseInfo4_MsgCtr_wrongvalctr == 0)
             {
                 putValue(E_pric_RadarFrontCenter_TIPLCourseInfo4_TIPLCourseInfo4_MsgCtr_wrongvalctr,0);
             }
        }
        else
        {
            //do nothing
        }        
        //calculate the CRC checksum
        update_TIPLCourseInfo4_ChkSum_Checksum();

        output(Msg_TIPLCourseInfo4);        
    }
}

on envVar E_pric_RadarFrontCenter_TIPLCourseInfo4_Range
{
    qword rawstatus = 0ll;
    qword rawValue = 0ll;    
    
    rawstatus = getvalue(this);    
    // set all the signals with min raw /max raw /init raw
    switch (rawstatus) 
    {
     case(0) :
        rawValue= -32767;
        putValue(E_pric_RadarFrontCenter_TIPLCourseInfo4_TIPLCourseInfo4_a2polynomCoef_sw_Rv, rawValue);
        rawValue= -32767;
        putValue(E_pric_RadarFrontCenter_TIPLCourseInfo4_TIPLCourseInfo4_a1polynomCoef_sw_Rv, rawValue);
        rawValue= -32768;
        putValue(E_pric_RadarFrontCenter_TIPLCourseInfo4_TIPLCourseInfo4_dUpperLimit_sw_Rv, rawValue);
        rawValue= 0;
        putValue(E_pric_RadarFrontCenter_TIPLCourseInfo4_TIPLCourseInfo4_qCourseConform_Rv, rawValue);
        rawValue= -32768;
        putValue(E_pric_RadarFrontCenter_TIPLCourseInfo4_TIPLCourseInfo4_dLowerLimit_sw_Rv, rawValue);
        rawValue= -32768;
        putValue(E_pric_RadarFrontCenter_TIPLCourseInfo4_TIPLCourseInfo4_a0polynomCoef_sw_Rv, rawValue);
        break;
     case(1) :
        rawValue= 32766;
        putValue(E_pric_RadarFrontCenter_TIPLCourseInfo4_TIPLCourseInfo4_a2polynomCoef_sw_Rv, rawValue);
        rawValue= 32766;
        putValue(E_pric_RadarFrontCenter_TIPLCourseInfo4_TIPLCourseInfo4_a1polynomCoef_sw_Rv, rawValue);
        rawValue= 32767;
        putValue(E_pric_RadarFrontCenter_TIPLCourseInfo4_TIPLCourseInfo4_dUpperLimit_sw_Rv, rawValue);
        rawValue= 255;
        putValue(E_pric_RadarFrontCenter_TIPLCourseInfo4_TIPLCourseInfo4_qCourseConform_Rv, rawValue);
        rawValue= 32767;
        putValue(E_pric_RadarFrontCenter_TIPLCourseInfo4_TIPLCourseInfo4_dLowerLimit_sw_Rv, rawValue);
        rawValue= 32767;
        putValue(E_pric_RadarFrontCenter_TIPLCourseInfo4_TIPLCourseInfo4_a0polynomCoef_sw_Rv, rawValue);
        break;
     default :
        rawValue= -32767;
        putValue(E_pric_RadarFrontCenter_TIPLCourseInfo4_TIPLCourseInfo4_a2polynomCoef_sw_Rv, rawValue);
        rawValue= -32767;
        putValue(E_pric_RadarFrontCenter_TIPLCourseInfo4_TIPLCourseInfo4_a1polynomCoef_sw_Rv, rawValue);
        rawValue= -32768;
        putValue(E_pric_RadarFrontCenter_TIPLCourseInfo4_TIPLCourseInfo4_dUpperLimit_sw_Rv, rawValue);
        rawValue= 0;
        putValue(E_pric_RadarFrontCenter_TIPLCourseInfo4_TIPLCourseInfo4_qCourseConform_Rv, rawValue);
        rawValue= -32768;
        putValue(E_pric_RadarFrontCenter_TIPLCourseInfo4_TIPLCourseInfo4_dLowerLimit_sw_Rv, rawValue);
        rawValue= -32768;
        putValue(E_pric_RadarFrontCenter_TIPLCourseInfo4_TIPLCourseInfo4_a0polynomCoef_sw_Rv, rawValue);
      break;
   }
}

on envVar E_pric_RadarFrontCenter_TIPLCourseInfo4_Dlc
{
    if(getValue(E_pric_RadarFrontCenter_TIPLCourseInfo4_enDlc))
    {
        Msg_TIPLCourseInfo4.dlc =getValue(this);
    }
    else
    {
       Dbc_dlc = 16;
	   Msg_TIPLCourseInfo4.dlc = Calc_Canfd_dlc(Dbc_dlc);
	   	
  }
}

on envVar E_pric_RadarFrontCenter_TIPLCourseInfo4_enDlc
{
    //For Messages with DLC = 8, set wrong DLC to smaller than defined DLC
    //For Messages with DLC < 8 set wrong DLC to smaller/longer than defined DLC
    if(getValue(this))
    {
        Msg_TIPLCourseInfo4.dlc =getValue(E_pric_RadarFrontCenter_TIPLCourseInfo4_Dlc);
    }
    else
    {
       Dbc_dlc = 16;
	   Msg_TIPLCourseInfo4.dlc = Calc_Canfd_dlc(Dbc_dlc);
			
    }
}

on envVar E_pric_RadarFrontCenter_TIPLCourseInfo4_TIPLCourseInfo4_CRC_wrongvalctr
{
    //update disturb count
    //disturb value range:(-1 = always send wrong value),( X>0 ,x is the number of Messages with wrong CHK sent)
    TIPLCourseInfo4_TIPLCourseInfo4_CRC_wrongvalctr =getValue(this);    
}
on envVar E_pric_RadarFrontCenter_TIPLCourseInfo4_TIPLCourseInfo4_MsgCtr_wrongvalctr
{
    //update disturb count
    //disturb value range:(-1 = always send wrong value),( X>0 ,x is the number of Messages with wrong CHK sent)
    TIPLCourseInfo4_TIPLCourseInfo4_MsgCtr_wrongvalctr =getValue(this);    
}
on envVar E_pric_RadarFrontCenter_TIPLCourseInfo4_TIPLCourseInfo4_blockCtr_wrongvalctr
{
    //update disturb count
    //disturb value range:(-1 = always send wrong value),( X>0 ,x is the number of Messages with wrong CHK sent)
    TIPLCourseInfo4_TIPLCourseInfo4_blockCtr_wrongvalctr =getValue(this);    
}

on envVar E_pric_RadarFrontCenter_TIPLCourseInfo4_TIPLCourseInfo4_a2polynomCoef_sw_Rv
{
    qword rawValue = 0ll;
    float rawValue_float = 0.0;
    float phyValue = 0.0;        

    //set the signal with updated raw value
    {
        rawValue = getvalue(this);
        if(chgEv_TIPLCourseInfo4_TIPLCourseInfo4_a2polynomCoef_sw == 0)
        {
            //type conversion to float
            rawValue_float = rawValue;        
            // raw to physical conversion
            phyValue = ((rawValue_float *1.90735e-006)+(0));
            putValue(E_pric_RadarFrontCenter_TIPLCourseInfo4_TIPLCourseInfo4_a2polynomCoef_sw_Pv, phyValue);
            chgEv_TIPLCourseInfo4_TIPLCourseInfo4_a2polynomCoef_sw = 1;
        }
        else
        {
            chgEv_TIPLCourseInfo4_TIPLCourseInfo4_a2polynomCoef_sw = 0;
        }    
        //update the signal value
        Msg_TIPLCourseInfo4.TIPLCourseInfo4_a2polynomCoef_sw=rawValue;        
    }                                                                           
}

on envVar E_pric_RadarFrontCenter_TIPLCourseInfo4_TIPLCourseInfo4_a2polynomCoef_sw_Pv
{
    qword rawValue = 0ll;
    float phyValue = 0.0;
    
    //update the raw value with physical value 
    {
        if(chgEv_TIPLCourseInfo4_TIPLCourseInfo4_a2polynomCoef_sw == 0)
        {
            phyValue = getvalue(this);
            // physical to raw conversion
            rawValue = ((phyValue -(0))/1.90735e-006);
            putValue(E_pric_RadarFrontCenter_TIPLCourseInfo4_TIPLCourseInfo4_a2polynomCoef_sw_Rv, rawValue);
            chgEv_TIPLCourseInfo4_TIPLCourseInfo4_a2polynomCoef_sw = 1;  
        }
        else
        {
            chgEv_TIPLCourseInfo4_TIPLCourseInfo4_a2polynomCoef_sw = 0;
        }
    }
}


 
on envVar E_pric_RadarFrontCenter_TIPLCourseInfo4_TIPLCourseInfo4_a1polynomCoef_sw_Rv
{
    qword rawValue = 0ll;
    float rawValue_float = 0.0;
    float phyValue = 0.0;        

    //set the signal with updated raw value
    {
        rawValue = getvalue(this);
        if(chgEv_TIPLCourseInfo4_TIPLCourseInfo4_a1polynomCoef_sw == 0)
        {
            //type conversion to float
            rawValue_float = rawValue;        
            // raw to physical conversion
            phyValue = ((rawValue_float *0.000244141)+(0));
            putValue(E_pric_RadarFrontCenter_TIPLCourseInfo4_TIPLCourseInfo4_a1polynomCoef_sw_Pv, phyValue);
            chgEv_TIPLCourseInfo4_TIPLCourseInfo4_a1polynomCoef_sw = 1;
        }
        else
        {
            chgEv_TIPLCourseInfo4_TIPLCourseInfo4_a1polynomCoef_sw = 0;
        }    
        //update the signal value
        Msg_TIPLCourseInfo4.TIPLCourseInfo4_a1polynomCoef_sw=rawValue;        
    }                                                                           
}

on envVar E_pric_RadarFrontCenter_TIPLCourseInfo4_TIPLCourseInfo4_a1polynomCoef_sw_Pv
{
    qword rawValue = 0ll;
    float phyValue = 0.0;
    
    //update the raw value with physical value 
    {
        if(chgEv_TIPLCourseInfo4_TIPLCourseInfo4_a1polynomCoef_sw == 0)
        {
            phyValue = getvalue(this);
            // physical to raw conversion
            rawValue = ((phyValue -(0))/0.000244141);
            putValue(E_pric_RadarFrontCenter_TIPLCourseInfo4_TIPLCourseInfo4_a1polynomCoef_sw_Rv, rawValue);
            chgEv_TIPLCourseInfo4_TIPLCourseInfo4_a1polynomCoef_sw = 1;  
        }
        else
        {
            chgEv_TIPLCourseInfo4_TIPLCourseInfo4_a1polynomCoef_sw = 0;
        }
    }
}


 
on envVar E_pric_RadarFrontCenter_TIPLCourseInfo4_TIPLCourseInfo4_dUpperLimit_sw_Rv
{
    qword rawValue = 0ll;
    float rawValue_float = 0.0;
    float phyValue = 0.0;        

    //set the signal with updated raw value
    {
        rawValue = getvalue(this);
        if(chgEv_TIPLCourseInfo4_TIPLCourseInfo4_dUpperLimit_sw == 0)
        {
            //type conversion to float
            rawValue_float = rawValue;        
            // raw to physical conversion
            phyValue = ((rawValue_float *0.0078125)+(0));
            putValue(E_pric_RadarFrontCenter_TIPLCourseInfo4_TIPLCourseInfo4_dUpperLimit_sw_Pv, phyValue);
            chgEv_TIPLCourseInfo4_TIPLCourseInfo4_dUpperLimit_sw = 1;
        }
        else
        {
            chgEv_TIPLCourseInfo4_TIPLCourseInfo4_dUpperLimit_sw = 0;
        }    
        //update the signal value
        Msg_TIPLCourseInfo4.TIPLCourseInfo4_dUpperLimit_sw=rawValue;        
    }                                                                           
}

on envVar E_pric_RadarFrontCenter_TIPLCourseInfo4_TIPLCourseInfo4_dUpperLimit_sw_Pv
{
    qword rawValue = 0ll;
    float phyValue = 0.0;
    
    //update the raw value with physical value 
    {
        if(chgEv_TIPLCourseInfo4_TIPLCourseInfo4_dUpperLimit_sw == 0)
        {
            phyValue = getvalue(this);
            // physical to raw conversion
            rawValue = ((phyValue -(0))/0.0078125);
            putValue(E_pric_RadarFrontCenter_TIPLCourseInfo4_TIPLCourseInfo4_dUpperLimit_sw_Rv, rawValue);
            chgEv_TIPLCourseInfo4_TIPLCourseInfo4_dUpperLimit_sw = 1;  
        }
        else
        {
            chgEv_TIPLCourseInfo4_TIPLCourseInfo4_dUpperLimit_sw = 0;
        }
    }
}


 
on envVar E_pric_RadarFrontCenter_TIPLCourseInfo4_TIPLCourseInfo4_qCourseConform_Rv
{
    qword rawValue = 0ll;
    float rawValue_float = 0.0;
    float phyValue = 0.0;        

    //set the signal with updated raw value
    {
        rawValue = getvalue(this);
        if(chgEv_TIPLCourseInfo4_TIPLCourseInfo4_qCourseConform == 0)
        {
            //type conversion to float
            rawValue_float = rawValue;        
            // raw to physical conversion
            phyValue = ((rawValue_float *0.00390625)+(0));
            putValue(E_pric_RadarFrontCenter_TIPLCourseInfo4_TIPLCourseInfo4_qCourseConform_Pv, phyValue);
            chgEv_TIPLCourseInfo4_TIPLCourseInfo4_qCourseConform = 1;
        }
        else
        {
            chgEv_TIPLCourseInfo4_TIPLCourseInfo4_qCourseConform = 0;
        }    
        //update the signal value
        Msg_TIPLCourseInfo4.TIPLCourseInfo4_qCourseConform=rawValue;        
    }                                                                           
}

on envVar E_pric_RadarFrontCenter_TIPLCourseInfo4_TIPLCourseInfo4_qCourseConform_Pv
{
    qword rawValue = 0ll;
    float phyValue = 0.0;
    
    //update the raw value with physical value 
    {
        if(chgEv_TIPLCourseInfo4_TIPLCourseInfo4_qCourseConform == 0)
        {
            phyValue = getvalue(this);
            // physical to raw conversion
            rawValue = ((phyValue -(0))/0.00390625);
            putValue(E_pric_RadarFrontCenter_TIPLCourseInfo4_TIPLCourseInfo4_qCourseConform_Rv, rawValue);
            chgEv_TIPLCourseInfo4_TIPLCourseInfo4_qCourseConform = 1;  
        }
        else
        {
            chgEv_TIPLCourseInfo4_TIPLCourseInfo4_qCourseConform = 0;
        }
    }
}


 
on envVar E_pric_RadarFrontCenter_TIPLCourseInfo4_TIPLCourseInfo4_dLowerLimit_sw_Rv
{
    qword rawValue = 0ll;
    float rawValue_float = 0.0;
    float phyValue = 0.0;        

    //set the signal with updated raw value
    {
        rawValue = getvalue(this);
        if(chgEv_TIPLCourseInfo4_TIPLCourseInfo4_dLowerLimit_sw == 0)
        {
            //type conversion to float
            rawValue_float = rawValue;        
            // raw to physical conversion
            phyValue = ((rawValue_float *0.0078125)+(0));
            putValue(E_pric_RadarFrontCenter_TIPLCourseInfo4_TIPLCourseInfo4_dLowerLimit_sw_Pv, phyValue);
            chgEv_TIPLCourseInfo4_TIPLCourseInfo4_dLowerLimit_sw = 1;
        }
        else
        {
            chgEv_TIPLCourseInfo4_TIPLCourseInfo4_dLowerLimit_sw = 0;
        }    
        //update the signal value
        Msg_TIPLCourseInfo4.TIPLCourseInfo4_dLowerLimit_sw=rawValue;        
    }                                                                           
}

on envVar E_pric_RadarFrontCenter_TIPLCourseInfo4_TIPLCourseInfo4_dLowerLimit_sw_Pv
{
    qword rawValue = 0ll;
    float phyValue = 0.0;
    
    //update the raw value with physical value 
    {
        if(chgEv_TIPLCourseInfo4_TIPLCourseInfo4_dLowerLimit_sw == 0)
        {
            phyValue = getvalue(this);
            // physical to raw conversion
            rawValue = ((phyValue -(0))/0.0078125);
            putValue(E_pric_RadarFrontCenter_TIPLCourseInfo4_TIPLCourseInfo4_dLowerLimit_sw_Rv, rawValue);
            chgEv_TIPLCourseInfo4_TIPLCourseInfo4_dLowerLimit_sw = 1;  
        }
        else
        {
            chgEv_TIPLCourseInfo4_TIPLCourseInfo4_dLowerLimit_sw = 0;
        }
    }
}


 
on envVar E_pric_RadarFrontCenter_TIPLCourseInfo4_TIPLCourseInfo4_a0polynomCoef_sw_Rv
{
    qword rawValue = 0ll;
    float rawValue_float = 0.0;
    float phyValue = 0.0;        

    //set the signal with updated raw value
    {
        rawValue = getvalue(this);
        if(chgEv_TIPLCourseInfo4_TIPLCourseInfo4_a0polynomCoef_sw == 0)
        {
            //type conversion to float
            rawValue_float = rawValue;        
            // raw to physical conversion
            phyValue = ((rawValue_float *0.0078125)+(0));
            putValue(E_pric_RadarFrontCenter_TIPLCourseInfo4_TIPLCourseInfo4_a0polynomCoef_sw_Pv, phyValue);
            chgEv_TIPLCourseInfo4_TIPLCourseInfo4_a0polynomCoef_sw = 1;
        }
        else
        {
            chgEv_TIPLCourseInfo4_TIPLCourseInfo4_a0polynomCoef_sw = 0;
        }    
        //update the signal value
        Msg_TIPLCourseInfo4.TIPLCourseInfo4_a0polynomCoef_sw=rawValue;        
    }                                                                           
}

on envVar E_pric_RadarFrontCenter_TIPLCourseInfo4_TIPLCourseInfo4_a0polynomCoef_sw_Pv
{
    qword rawValue = 0ll;
    float phyValue = 0.0;
    
    //update the raw value with physical value 
    {
        if(chgEv_TIPLCourseInfo4_TIPLCourseInfo4_a0polynomCoef_sw == 0)
        {
            phyValue = getvalue(this);
            // physical to raw conversion
            rawValue = ((phyValue -(0))/0.0078125);
            putValue(E_pric_RadarFrontCenter_TIPLCourseInfo4_TIPLCourseInfo4_a0polynomCoef_sw_Rv, rawValue);
            chgEv_TIPLCourseInfo4_TIPLCourseInfo4_a0polynomCoef_sw = 1;  
        }
        else
        {
            chgEv_TIPLCourseInfo4_TIPLCourseInfo4_a0polynomCoef_sw = 0;
        }
    }
}


 
/*@@envVar:E_pric_RadarFrontCenter_ACC_0x95_tx:*/
on envVar E_pric_RadarFrontCenter_ACC_0x95_tx
{
    if(getValue(this))
    {       
        
        //update the BZ Signal
        if(ACC_0x95_ACC_RollingCounter_0x95_wrongvalctr == 0)
        {
            update_ACC_0x95_ACC_RollingCounter_0x95_counter();
            Msg_ACC_0x95.ACC_RollingCounter_0x95= ACC_0x95_ACC_RollingCounter_0x95_counter;
        }
        else if(ACC_0x95_ACC_RollingCounter_0x95_wrongvalctr > 0)
        {
             ACC_0x95_ACC_RollingCounter_0x95_wrongvalctr--;
              // if counter becomes zero, update panel controller to zero
             if(ACC_0x95_ACC_RollingCounter_0x95_wrongvalctr == 0)
             {
                 putValue(E_pric_RadarFrontCenter_ACC_0x95_ACC_RollingCounter_0x95_wrongvalctr,0);
             }
        }
        else
        {
            //do nothing
        }        
        //calculate the CRC checksum
        update_ACC_0x95_ChkSum_Checksum();

        output(Msg_ACC_0x95);        
    }
}
/*@@end*/

/*@@envVar:E_pric_RadarFrontCenter_ACC_0x95_Range:*/
on envVar E_pric_RadarFrontCenter_ACC_0x95_Range
{
    qword rawstatus = 0ll;
    qword rawValue = 0ll;    
    
    rawstatus = getvalue(this);    
    // set all the signals with min raw /max raw /init raw
    switch (rawstatus) 
    {
     case(0) :
        rawValue= 0;
        putValue(E_pric_RadarFrontCenter_ACC_0x95_ACC_AEBActive_Rv, rawValue);
        break;
     case(1) :
        rawValue= 1;
        putValue(E_pric_RadarFrontCenter_ACC_0x95_ACC_AEBActive_Rv, rawValue);
        break;
     default :
        rawValue= 0;
        putValue(E_pric_RadarFrontCenter_ACC_0x95_ACC_AEBActive_Rv, rawValue);
      break;
   }
}
/*@@end*/

/*@@envVar:E_pric_RadarFrontCenter_ACC_0x95_Dlc:*/
on envVar E_pric_RadarFrontCenter_ACC_0x95_Dlc
{
    if(getValue(E_pric_RadarFrontCenter_ACC_0x95_enDlc))
    {
        Msg_ACC_0x95.dlc =getValue(this);
    }
    else
    {
       Dbc_dlc = 8;
	   Msg_ACC_0x95.dlc = Calc_Canfd_dlc(Dbc_dlc);
	   	
  }
}
/*@@end*/

/*@@envVar:E_pric_RadarFrontCenter_ACC_0x95_enDlc:*/
on envVar E_pric_RadarFrontCenter_ACC_0x95_enDlc
{
    //For Messages with DLC = 8, set wrong DLC to smaller than defined DLC
    //For Messages with DLC < 8 set wrong DLC to smaller/longer than defined DLC
    if(getValue(this))
    {
        Msg_ACC_0x95.dlc =getValue(E_pric_RadarFrontCenter_ACC_0x95_Dlc);
    }
    else
    {
       Dbc_dlc = 8;
	   Msg_ACC_0x95.dlc = Calc_Canfd_dlc(Dbc_dlc);
			
    }
}
/*@@end*/

/*@@envVar:E_pric_RadarFrontCenter_ACC_0x95_ACC_CRCCheck_0x95_wrongvalctr:*/
on envVar E_pric_RadarFrontCenter_ACC_0x95_ACC_CRCCheck_0x95_wrongvalctr
{
    //update disturb count
    //disturb value range:(-1 = always send wrong value),( X>0 ,x is the number of Messages with wrong CHK sent)
    ACC_0x95_ACC_CRCCheck_0x95_wrongvalctr =getValue(this);    
}
/*@@end*/
/*@@envVar:E_pric_RadarFrontCenter_ACC_0x95_ACC_RollingCounter_0x95_wrongvalctr:*/
on envVar E_pric_RadarFrontCenter_ACC_0x95_ACC_RollingCounter_0x95_wrongvalctr
{
    //update disturb count
    //disturb value range:(-1 = always send wrong value),( X>0 ,x is the number of Messages with wrong CHK sent)
    ACC_0x95_ACC_RollingCounter_0x95_wrongvalctr =getValue(this);    
}
/*@@end*/

/*@@envVar:E_pric_RadarFrontCenter_ACC_0x95_ACC_AEBActive_Rv:*/
on envVar E_pric_RadarFrontCenter_ACC_0x95_ACC_AEBActive_Rv
{
    qword rawValue = 0ll;
    float rawValue_float = 0.0;
    float phyValue = 0.0;        

    //set the signal with updated raw value
    if(getValue(E_pric_RadarFrontCenter_ACC_0x95_ACC_AEBActive_SetVt)==0)
    {
        rawValue = getvalue(this);
        if(chgEv_ACC_0x95_ACC_AEBActive == 0)
        {
            //type conversion to float
            rawValue_float = rawValue;        
            // raw to physical conversion
            phyValue = ((rawValue_float *1)+(0));
            putValue(E_pric_RadarFrontCenter_ACC_0x95_ACC_AEBActive_Pv, phyValue);
            chgEv_ACC_0x95_ACC_AEBActive = 1;
        }
        else
        {
            chgEv_ACC_0x95_ACC_AEBActive = 0;
        }    
        //update the signal value
        Msg_ACC_0x95.ACC_AEBActive=rawValue;        
    }                                                                           
}
/*@@end*/

/*@@envVar:E_pric_RadarFrontCenter_ACC_0x95_ACC_AEBActive_Pv:*/
on envVar E_pric_RadarFrontCenter_ACC_0x95_ACC_AEBActive_Pv
{
    qword rawValue = 0ll;
    float phyValue = 0.0;
    
    //update the raw value with physical value 
    if(getValue(E_pric_RadarFrontCenter_ACC_0x95_ACC_AEBActive_SetVt)==0)
    {
        if(chgEv_ACC_0x95_ACC_AEBActive == 0)
        {
            phyValue = getvalue(this);
            // physical to raw conversion
            rawValue = ((phyValue -(0))/1);
            putValue(E_pric_RadarFrontCenter_ACC_0x95_ACC_AEBActive_Rv, rawValue);
            chgEv_ACC_0x95_ACC_AEBActive = 1;  
        }
        else
        {
            chgEv_ACC_0x95_ACC_AEBActive = 0;
        }
    }
}
/*@@end*/

/*@@envVar:E_pric_RadarFrontCenter_ACC_0x95_ACC_AEBActive_Vt:*/
on envVar E_pric_RadarFrontCenter_ACC_0x95_ACC_AEBActive_Vt
{
    qword rawValue = 0ll;
    if(getValue(E_pric_RadarFrontCenter_ACC_0x95_ACC_AEBActive_SetVt))
    {
        //update the signal value
        Msg_ACC_0x95.ACC_AEBActive=getValue(this);
    }
}
/*@@end*/

/*@@envVar:E_pric_RadarFrontCenter_ACC_0x95_ACC_AEBActive_SetVt:*/
on envVar E_pric_RadarFrontCenter_ACC_0x95_ACC_AEBActive_SetVt
{
    if(getValue(E_pric_RadarFrontCenter_ACC_0x95_ACC_AEBActive_SetVt))
    {
        //update the signal value
        Msg_ACC_0x95.ACC_AEBActive=getvalue(E_pric_RadarFrontCenter_ACC_0x95_ACC_AEBActive_Vt);
    }
    else
    {
        Msg_ACC_0x95.ACC_AEBActive=getValue(E_pric_RadarFrontCenter_ACC_0x95_ACC_AEBActive_Rv);
    }
}
/*@@end*/
 
/*@@envVar:E_pric_RadarFrontCenter_TrajPointACCObj22_tx:*/
on envVar E_pric_RadarFrontCenter_TrajPointACCObj22_tx
{
    if(getValue(this))
    {       
        
        //update the BZ Signal
        if(TrajPointACCObj22_TrajPointACCObj22_MsgCtr_wrongvalctr == 0)
        {
            update_TrajPointACCObj22_TrajPointACCObj22_MsgCtr_counter();
            Msg_TrajPointACCObj22.TrajPointACCObj22_MsgCtr= TrajPointACCObj22_TrajPointACCObj22_MsgCtr_counter;
        }
        else if(TrajPointACCObj22_TrajPointACCObj22_MsgCtr_wrongvalctr > 0)
        {
             TrajPointACCObj22_TrajPointACCObj22_MsgCtr_wrongvalctr--;
              // if counter becomes zero, update panel controller to zero
             if(TrajPointACCObj22_TrajPointACCObj22_MsgCtr_wrongvalctr == 0)
             {
                 putValue(E_pric_RadarFrontCenter_TrajPointACCObj22_TrajPointACCObj22_MsgCtr_wrongvalctr,0);
             }
        }
        else
        {
            //do nothing
        }        
        //update the BZ Signal
        if(TrajPointACCObj22_TrajPointACCObj22_blockCtr_wrongvalctr == 0)
        {
            update_TrajPointACCObj22_TrajPointACCObj22_blockCtr_counter();
            Msg_TrajPointACCObj22.TrajPointACCObj22_blockCtr= TrajPointACCObj22_TrajPointACCObj22_blockCtr_counter;
        }
        else if(TrajPointACCObj22_TrajPointACCObj22_blockCtr_wrongvalctr > 0)
        {
             TrajPointACCObj22_TrajPointACCObj22_blockCtr_wrongvalctr--;
              // if counter becomes zero, update panel controller to zero
             if(TrajPointACCObj22_TrajPointACCObj22_blockCtr_wrongvalctr == 0)
             {
                 putValue(E_pric_RadarFrontCenter_TrajPointACCObj22_TrajPointACCObj22_blockCtr_wrongvalctr,0);
             }
        }
        else
        {
            //do nothing
        }        
        //calculate the CRC checksum
        update_TrajPointACCObj22_ChkSum_Checksum();

        output(Msg_TrajPointACCObj22);        
    }
}

on envVar E_pric_RadarFrontCenter_TrajPointACCObj22_Range
{
    qword rawstatus = 0ll;
    qword rawValue = 0ll;    
    
    rawstatus = getvalue(this);    
    // set all the signals with min raw /max raw /init raw
    switch (rawstatus) 
    {
     case(0) :
        rawValue= 0;
        putValue(E_pric_RadarFrontCenter_TrajPointACCObj22_TrajPointACCObj22_wExistProb_ub_Rv, rawValue);
        rawValue= 0;
        putValue(E_pric_RadarFrontCenter_TrajPointACCObj22_TrajPointACCObj22_InvDir_b_Rv, rawValue);
        rawValue= 0;
        putValue(E_pric_RadarFrontCenter_TrajPointACCObj22_TrajPointACCObj22_Stopped_b_Rv, rawValue);
        rawValue= 0;
        putValue(E_pric_RadarFrontCenter_TrajPointACCObj22_TrajPointACCObj22_Valid_b_Rv, rawValue);
        rawValue= 0;
        putValue(E_pric_RadarFrontCenter_TrajPointACCObj22_TrajPointACCObj22_TrajEnd_b_Rv, rawValue);
        rawValue= -32768;
        putValue(E_pric_RadarFrontCenter_TrajPointACCObj22_TrajPointACCObj22_dyv_sw_Rv, rawValue);
        rawValue= 0;
        putValue(E_pric_RadarFrontCenter_TrajPointACCObj22_TrajPointACCObj22_Drive_b_Rv, rawValue);
        rawValue= 0;
        putValue(E_pric_RadarFrontCenter_TrajPointACCObj22_TrajPointACCObj22_Stand_b_Rv, rawValue);
        rawValue= 0;
        putValue(E_pric_RadarFrontCenter_TrajPointACCObj22_TrajPointACCObj22_dVarXv_uw_Rv, rawValue);
        rawValue= 0;
        putValue(E_pric_RadarFrontCenter_TrajPointACCObj22_TrajPointACCObj22_timestamp_Rv, rawValue);
        rawValue= 0;
        putValue(E_pric_RadarFrontCenter_TrajPointACCObj22_TrajPointACCObj22_dVarYv_uw_Rv, rawValue);
        rawValue= -32768;
        putValue(E_pric_RadarFrontCenter_TrajPointACCObj22_TrajPointACCObj22_dxv_sw_Rv, rawValue);
        break;
     case(1) :
        rawValue= 255;
        putValue(E_pric_RadarFrontCenter_TrajPointACCObj22_TrajPointACCObj22_wExistProb_ub_Rv, rawValue);
        rawValue= 1;
        putValue(E_pric_RadarFrontCenter_TrajPointACCObj22_TrajPointACCObj22_InvDir_b_Rv, rawValue);
        rawValue= 1;
        putValue(E_pric_RadarFrontCenter_TrajPointACCObj22_TrajPointACCObj22_Stopped_b_Rv, rawValue);
        rawValue= 1;
        putValue(E_pric_RadarFrontCenter_TrajPointACCObj22_TrajPointACCObj22_Valid_b_Rv, rawValue);
        rawValue= 1;
        putValue(E_pric_RadarFrontCenter_TrajPointACCObj22_TrajPointACCObj22_TrajEnd_b_Rv, rawValue);
        rawValue= 32767;
        putValue(E_pric_RadarFrontCenter_TrajPointACCObj22_TrajPointACCObj22_dyv_sw_Rv, rawValue);
        rawValue= 1;
        putValue(E_pric_RadarFrontCenter_TrajPointACCObj22_TrajPointACCObj22_Drive_b_Rv, rawValue);
        rawValue= 1;
        putValue(E_pric_RadarFrontCenter_TrajPointACCObj22_TrajPointACCObj22_Stand_b_Rv, rawValue);
        rawValue= 65534;
        putValue(E_pric_RadarFrontCenter_TrajPointACCObj22_TrajPointACCObj22_dVarXv_uw_Rv, rawValue);
        rawValue= 65536;
        putValue(E_pric_RadarFrontCenter_TrajPointACCObj22_TrajPointACCObj22_timestamp_Rv, rawValue);
        rawValue= 65534;
        putValue(E_pric_RadarFrontCenter_TrajPointACCObj22_TrajPointACCObj22_dVarYv_uw_Rv, rawValue);
        rawValue= 32767;
        putValue(E_pric_RadarFrontCenter_TrajPointACCObj22_TrajPointACCObj22_dxv_sw_Rv, rawValue);
        break;
     default :
        rawValue= 0;
        putValue(E_pric_RadarFrontCenter_TrajPointACCObj22_TrajPointACCObj22_wExistProb_ub_Rv, rawValue);
        rawValue= 0;
        putValue(E_pric_RadarFrontCenter_TrajPointACCObj22_TrajPointACCObj22_InvDir_b_Rv, rawValue);
        rawValue= 0;
        putValue(E_pric_RadarFrontCenter_TrajPointACCObj22_TrajPointACCObj22_Stopped_b_Rv, rawValue);
        rawValue= 0;
        putValue(E_pric_RadarFrontCenter_TrajPointACCObj22_TrajPointACCObj22_Valid_b_Rv, rawValue);
        rawValue= 0;
        putValue(E_pric_RadarFrontCenter_TrajPointACCObj22_TrajPointACCObj22_TrajEnd_b_Rv, rawValue);
        rawValue= -32768;
        putValue(E_pric_RadarFrontCenter_TrajPointACCObj22_TrajPointACCObj22_dyv_sw_Rv, rawValue);
        rawValue= 0;
        putValue(E_pric_RadarFrontCenter_TrajPointACCObj22_TrajPointACCObj22_Drive_b_Rv, rawValue);
        rawValue= 0;
        putValue(E_pric_RadarFrontCenter_TrajPointACCObj22_TrajPointACCObj22_Stand_b_Rv, rawValue);
        rawValue= 0;
        putValue(E_pric_RadarFrontCenter_TrajPointACCObj22_TrajPointACCObj22_dVarXv_uw_Rv, rawValue);
        rawValue= 0;
        putValue(E_pric_RadarFrontCenter_TrajPointACCObj22_TrajPointACCObj22_timestamp_Rv, rawValue);
        rawValue= 0;
        putValue(E_pric_RadarFrontCenter_TrajPointACCObj22_TrajPointACCObj22_dVarYv_uw_Rv, rawValue);
        rawValue= -32768;
        putValue(E_pric_RadarFrontCenter_TrajPointACCObj22_TrajPointACCObj22_dxv_sw_Rv, rawValue);
      break;
   }
}

on envVar E_pric_RadarFrontCenter_TrajPointACCObj22_Dlc
{
    if(getValue(E_pric_RadarFrontCenter_TrajPointACCObj22_enDlc))
    {
        Msg_TrajPointACCObj22.dlc =getValue(this);
    }
    else
    {
       Dbc_dlc = 16;
	   Msg_TrajPointACCObj22.dlc = Calc_Canfd_dlc(Dbc_dlc);
	   	
  }
}

on envVar E_pric_RadarFrontCenter_TrajPointACCObj22_enDlc
{
    //For Messages with DLC = 8, set wrong DLC to smaller than defined DLC
    //For Messages with DLC < 8 set wrong DLC to smaller/longer than defined DLC
    if(getValue(this))
    {
        Msg_TrajPointACCObj22.dlc =getValue(E_pric_RadarFrontCenter_TrajPointACCObj22_Dlc);
    }
    else
    {
       Dbc_dlc = 16;
	   Msg_TrajPointACCObj22.dlc = Calc_Canfd_dlc(Dbc_dlc);
			
    }
}

on envVar E_pric_RadarFrontCenter_TrajPointACCObj22_TrajPointACCObj22_CRC_wrongvalctr
{
    //update disturb count
    //disturb value range:(-1 = always send wrong value),( X>0 ,x is the number of Messages with wrong CHK sent)
    TrajPointACCObj22_TrajPointACCObj22_CRC_wrongvalctr =getValue(this);    
}
on envVar E_pric_RadarFrontCenter_TrajPointACCObj22_TrajPointACCObj22_MsgCtr_wrongvalctr
{
    //update disturb count
    //disturb value range:(-1 = always send wrong value),( X>0 ,x is the number of Messages with wrong CHK sent)
    TrajPointACCObj22_TrajPointACCObj22_MsgCtr_wrongvalctr =getValue(this);    
}
on envVar E_pric_RadarFrontCenter_TrajPointACCObj22_TrajPointACCObj22_blockCtr_wrongvalctr
{
    //update disturb count
    //disturb value range:(-1 = always send wrong value),( X>0 ,x is the number of Messages with wrong CHK sent)
    TrajPointACCObj22_TrajPointACCObj22_blockCtr_wrongvalctr =getValue(this);    
}

on envVar E_pric_RadarFrontCenter_TrajPointACCObj22_TrajPointACCObj22_wExistProb_ub_Rv
{
    qword rawValue = 0ll;
    float rawValue_float = 0.0;
    float phyValue = 0.0;        

    //set the signal with updated raw value
    {
        rawValue = getvalue(this);
        if(chgEv_TrajPointACCObj22_TrajPointACCObj22_wExistProb_ub == 0)
        {
            //type conversion to float
            rawValue_float = rawValue;        
            // raw to physical conversion
            phyValue = ((rawValue_float *0.00390625)+(0));
            putValue(E_pric_RadarFrontCenter_TrajPointACCObj22_TrajPointACCObj22_wExistProb_ub_Pv, phyValue);
            chgEv_TrajPointACCObj22_TrajPointACCObj22_wExistProb_ub = 1;
        }
        else
        {
            chgEv_TrajPointACCObj22_TrajPointACCObj22_wExistProb_ub = 0;
        }    
        //update the signal value
        Msg_TrajPointACCObj22.TrajPointACCObj22_wExistProb_ub=rawValue;        
    }                                                                           
}

on envVar E_pric_RadarFrontCenter_TrajPointACCObj22_TrajPointACCObj22_wExistProb_ub_Pv
{
    qword rawValue = 0ll;
    float phyValue = 0.0;
    
    //update the raw value with physical value 
    {
        if(chgEv_TrajPointACCObj22_TrajPointACCObj22_wExistProb_ub == 0)
        {
            phyValue = getvalue(this);
            // physical to raw conversion
            rawValue = ((phyValue -(0))/0.00390625);
            putValue(E_pric_RadarFrontCenter_TrajPointACCObj22_TrajPointACCObj22_wExistProb_ub_Rv, rawValue);
            chgEv_TrajPointACCObj22_TrajPointACCObj22_wExistProb_ub = 1;  
        }
        else
        {
            chgEv_TrajPointACCObj22_TrajPointACCObj22_wExistProb_ub = 0;
        }
    }
}


 
on envVar E_pric_RadarFrontCenter_TrajPointACCObj22_TrajPointACCObj22_InvDir_b_Rv
{
    qword rawValue = 0ll;
    float rawValue_float = 0.0;
    float phyValue = 0.0;        

    //set the signal with updated raw value
    if(getValue(E_pric_RadarFrontCenter_TrajPointACCObj22_TrajPointACCObj22_InvDir_b_SetVt)==0)
    {
        rawValue = getvalue(this);
        if(chgEv_TrajPointACCObj22_TrajPointACCObj22_InvDir_b == 0)
        {
            //type conversion to float
            rawValue_float = rawValue;        
            // raw to physical conversion
            phyValue = ((rawValue_float *1)+(0));
            putValue(E_pric_RadarFrontCenter_TrajPointACCObj22_TrajPointACCObj22_InvDir_b_Pv, phyValue);
            chgEv_TrajPointACCObj22_TrajPointACCObj22_InvDir_b = 1;
        }
        else
        {
            chgEv_TrajPointACCObj22_TrajPointACCObj22_InvDir_b = 0;
        }    
        //update the signal value
        Msg_TrajPointACCObj22.TrajPointACCObj22_InvDir_b=rawValue;        
    }                                                                           
}

on envVar E_pric_RadarFrontCenter_TrajPointACCObj22_TrajPointACCObj22_InvDir_b_Pv
{
    qword rawValue = 0ll;
    float phyValue = 0.0;
    
    //update the raw value with physical value 
    if(getValue(E_pric_RadarFrontCenter_TrajPointACCObj22_TrajPointACCObj22_InvDir_b_SetVt)==0)
    {
        if(chgEv_TrajPointACCObj22_TrajPointACCObj22_InvDir_b == 0)
        {
            phyValue = getvalue(this);
            // physical to raw conversion
            rawValue = ((phyValue -(0))/1);
            putValue(E_pric_RadarFrontCenter_TrajPointACCObj22_TrajPointACCObj22_InvDir_b_Rv, rawValue);
            chgEv_TrajPointACCObj22_TrajPointACCObj22_InvDir_b = 1;  
        }
        else
        {
            chgEv_TrajPointACCObj22_TrajPointACCObj22_InvDir_b = 0;
        }
    }
}

on envVar E_pric_RadarFrontCenter_TrajPointACCObj22_TrajPointACCObj22_InvDir_b_Vt
{
    qword rawValue = 0ll;
    if(getValue(E_pric_RadarFrontCenter_TrajPointACCObj22_TrajPointACCObj22_InvDir_b_SetVt))
    {
        //update the signal value
        Msg_TrajPointACCObj22.TrajPointACCObj22_InvDir_b=getValue(this);
    }
}

on envVar E_pric_RadarFrontCenter_TrajPointACCObj22_TrajPointACCObj22_InvDir_b_SetVt
{
    if(getValue(E_pric_RadarFrontCenter_TrajPointACCObj22_TrajPointACCObj22_InvDir_b_SetVt))
    {
        //update the signal value
        Msg_TrajPointACCObj22.TrajPointACCObj22_InvDir_b=getvalue(E_pric_RadarFrontCenter_TrajPointACCObj22_TrajPointACCObj22_InvDir_b_Vt);
    }
    else
    {
        Msg_TrajPointACCObj22.TrajPointACCObj22_InvDir_b=getValue(E_pric_RadarFrontCenter_TrajPointACCObj22_TrajPointACCObj22_InvDir_b_Rv);
    }
}
 
on envVar E_pric_RadarFrontCenter_TrajPointACCObj22_TrajPointACCObj22_Stopped_b_Rv
{
    qword rawValue = 0ll;
    float rawValue_float = 0.0;
    float phyValue = 0.0;        

    //set the signal with updated raw value
    if(getValue(E_pric_RadarFrontCenter_TrajPointACCObj22_TrajPointACCObj22_Stopped_b_SetVt)==0)
    {
        rawValue = getvalue(this);
        if(chgEv_TrajPointACCObj22_TrajPointACCObj22_Stopped_b == 0)
        {
            //type conversion to float
            rawValue_float = rawValue;        
            // raw to physical conversion
            phyValue = ((rawValue_float *1)+(0));
            putValue(E_pric_RadarFrontCenter_TrajPointACCObj22_TrajPointACCObj22_Stopped_b_Pv, phyValue);
            chgEv_TrajPointACCObj22_TrajPointACCObj22_Stopped_b = 1;
        }
        else
        {
            chgEv_TrajPointACCObj22_TrajPointACCObj22_Stopped_b = 0;
        }    
        //update the signal value
        Msg_TrajPointACCObj22.TrajPointACCObj22_Stopped_b=rawValue;        
    }                                                                           
}

on envVar E_pric_RadarFrontCenter_TrajPointACCObj22_TrajPointACCObj22_Stopped_b_Pv
{
    qword rawValue = 0ll;
    float phyValue = 0.0;
    
    //update the raw value with physical value 
    if(getValue(E_pric_RadarFrontCenter_TrajPointACCObj22_TrajPointACCObj22_Stopped_b_SetVt)==0)
    {
        if(chgEv_TrajPointACCObj22_TrajPointACCObj22_Stopped_b == 0)
        {
            phyValue = getvalue(this);
            // physical to raw conversion
            rawValue = ((phyValue -(0))/1);
            putValue(E_pric_RadarFrontCenter_TrajPointACCObj22_TrajPointACCObj22_Stopped_b_Rv, rawValue);
            chgEv_TrajPointACCObj22_TrajPointACCObj22_Stopped_b = 1;  
        }
        else
        {
            chgEv_TrajPointACCObj22_TrajPointACCObj22_Stopped_b = 0;
        }
    }
}

on envVar E_pric_RadarFrontCenter_TrajPointACCObj22_TrajPointACCObj22_Stopped_b_Vt
{
    qword rawValue = 0ll;
    if(getValue(E_pric_RadarFrontCenter_TrajPointACCObj22_TrajPointACCObj22_Stopped_b_SetVt))
    {
        //update the signal value
        Msg_TrajPointACCObj22.TrajPointACCObj22_Stopped_b=getValue(this);
    }
}

on envVar E_pric_RadarFrontCenter_TrajPointACCObj22_TrajPointACCObj22_Stopped_b_SetVt
{
    if(getValue(E_pric_RadarFrontCenter_TrajPointACCObj22_TrajPointACCObj22_Stopped_b_SetVt))
    {
        //update the signal value
        Msg_TrajPointACCObj22.TrajPointACCObj22_Stopped_b=getvalue(E_pric_RadarFrontCenter_TrajPointACCObj22_TrajPointACCObj22_Stopped_b_Vt);
    }
    else
    {
        Msg_TrajPointACCObj22.TrajPointACCObj22_Stopped_b=getValue(E_pric_RadarFrontCenter_TrajPointACCObj22_TrajPointACCObj22_Stopped_b_Rv);
    }
}
 
on envVar E_pric_RadarFrontCenter_TrajPointACCObj22_TrajPointACCObj22_Valid_b_Rv
{
    qword rawValue = 0ll;
    float rawValue_float = 0.0;
    float phyValue = 0.0;        

    //set the signal with updated raw value
    if(getValue(E_pric_RadarFrontCenter_TrajPointACCObj22_TrajPointACCObj22_Valid_b_SetVt)==0)
    {
        rawValue = getvalue(this);
        if(chgEv_TrajPointACCObj22_TrajPointACCObj22_Valid_b == 0)
        {
            //type conversion to float
            rawValue_float = rawValue;        
            // raw to physical conversion
            phyValue = ((rawValue_float *1)+(0));
            putValue(E_pric_RadarFrontCenter_TrajPointACCObj22_TrajPointACCObj22_Valid_b_Pv, phyValue);
            chgEv_TrajPointACCObj22_TrajPointACCObj22_Valid_b = 1;
        }
        else
        {
            chgEv_TrajPointACCObj22_TrajPointACCObj22_Valid_b = 0;
        }    
        //update the signal value
        Msg_TrajPointACCObj22.TrajPointACCObj22_Valid_b=rawValue;        
    }                                                                           
}

on envVar E_pric_RadarFrontCenter_TrajPointACCObj22_TrajPointACCObj22_Valid_b_Pv
{
    qword rawValue = 0ll;
    float phyValue = 0.0;
    
    //update the raw value with physical value 
    if(getValue(E_pric_RadarFrontCenter_TrajPointACCObj22_TrajPointACCObj22_Valid_b_SetVt)==0)
    {
        if(chgEv_TrajPointACCObj22_TrajPointACCObj22_Valid_b == 0)
        {
            phyValue = getvalue(this);
            // physical to raw conversion
            rawValue = ((phyValue -(0))/1);
            putValue(E_pric_RadarFrontCenter_TrajPointACCObj22_TrajPointACCObj22_Valid_b_Rv, rawValue);
            chgEv_TrajPointACCObj22_TrajPointACCObj22_Valid_b = 1;  
        }
        else
        {
            chgEv_TrajPointACCObj22_TrajPointACCObj22_Valid_b = 0;
        }
    }
}

on envVar E_pric_RadarFrontCenter_TrajPointACCObj22_TrajPointACCObj22_Valid_b_Vt
{
    qword rawValue = 0ll;
    if(getValue(E_pric_RadarFrontCenter_TrajPointACCObj22_TrajPointACCObj22_Valid_b_SetVt))
    {
        //update the signal value
        Msg_TrajPointACCObj22.TrajPointACCObj22_Valid_b=getValue(this);
    }
}

on envVar E_pric_RadarFrontCenter_TrajPointACCObj22_TrajPointACCObj22_Valid_b_SetVt
{
    if(getValue(E_pric_RadarFrontCenter_TrajPointACCObj22_TrajPointACCObj22_Valid_b_SetVt))
    {
        //update the signal value
        Msg_TrajPointACCObj22.TrajPointACCObj22_Valid_b=getvalue(E_pric_RadarFrontCenter_TrajPointACCObj22_TrajPointACCObj22_Valid_b_Vt);
    }
    else
    {
        Msg_TrajPointACCObj22.TrajPointACCObj22_Valid_b=getValue(E_pric_RadarFrontCenter_TrajPointACCObj22_TrajPointACCObj22_Valid_b_Rv);
    }
}
 
on envVar E_pric_RadarFrontCenter_TrajPointACCObj22_TrajPointACCObj22_TrajEnd_b_Rv
{
    qword rawValue = 0ll;
    float rawValue_float = 0.0;
    float phyValue = 0.0;        

    //set the signal with updated raw value
    if(getValue(E_pric_RadarFrontCenter_TrajPointACCObj22_TrajPointACCObj22_TrajEnd_b_SetVt)==0)
    {
        rawValue = getvalue(this);
        if(chgEv_TrajPointACCObj22_TrajPointACCObj22_TrajEnd_b == 0)
        {
            //type conversion to float
            rawValue_float = rawValue;        
            // raw to physical conversion
            phyValue = ((rawValue_float *1)+(0));
            putValue(E_pric_RadarFrontCenter_TrajPointACCObj22_TrajPointACCObj22_TrajEnd_b_Pv, phyValue);
            chgEv_TrajPointACCObj22_TrajPointACCObj22_TrajEnd_b = 1;
        }
        else
        {
            chgEv_TrajPointACCObj22_TrajPointACCObj22_TrajEnd_b = 0;
        }    
        //update the signal value
        Msg_TrajPointACCObj22.TrajPointACCObj22_TrajEnd_b=rawValue;        
    }                                                                           
}

on envVar E_pric_RadarFrontCenter_TrajPointACCObj22_TrajPointACCObj22_TrajEnd_b_Pv
{
    qword rawValue = 0ll;
    float phyValue = 0.0;
    
    //update the raw value with physical value 
    if(getValue(E_pric_RadarFrontCenter_TrajPointACCObj22_TrajPointACCObj22_TrajEnd_b_SetVt)==0)
    {
        if(chgEv_TrajPointACCObj22_TrajPointACCObj22_TrajEnd_b == 0)
        {
            phyValue = getvalue(this);
            // physical to raw conversion
            rawValue = ((phyValue -(0))/1);
            putValue(E_pric_RadarFrontCenter_TrajPointACCObj22_TrajPointACCObj22_TrajEnd_b_Rv, rawValue);
            chgEv_TrajPointACCObj22_TrajPointACCObj22_TrajEnd_b = 1;  
        }
        else
        {
            chgEv_TrajPointACCObj22_TrajPointACCObj22_TrajEnd_b = 0;
        }
    }
}

on envVar E_pric_RadarFrontCenter_TrajPointACCObj22_TrajPointACCObj22_TrajEnd_b_Vt
{
    qword rawValue = 0ll;
    if(getValue(E_pric_RadarFrontCenter_TrajPointACCObj22_TrajPointACCObj22_TrajEnd_b_SetVt))
    {
        //update the signal value
        Msg_TrajPointACCObj22.TrajPointACCObj22_TrajEnd_b=getValue(this);
    }
}

on envVar E_pric_RadarFrontCenter_TrajPointACCObj22_TrajPointACCObj22_TrajEnd_b_SetVt
{
    if(getValue(E_pric_RadarFrontCenter_TrajPointACCObj22_TrajPointACCObj22_TrajEnd_b_SetVt))
    {
        //update the signal value
        Msg_TrajPointACCObj22.TrajPointACCObj22_TrajEnd_b=getvalue(E_pric_RadarFrontCenter_TrajPointACCObj22_TrajPointACCObj22_TrajEnd_b_Vt);
    }
    else
    {
        Msg_TrajPointACCObj22.TrajPointACCObj22_TrajEnd_b=getValue(E_pric_RadarFrontCenter_TrajPointACCObj22_TrajPointACCObj22_TrajEnd_b_Rv);
    }
}
 
on envVar E_pric_RadarFrontCenter_TrajPointACCObj22_TrajPointACCObj22_dyv_sw_Rv
{
    qword rawValue = 0ll;
    float rawValue_float = 0.0;
    float phyValue = 0.0;        

    //set the signal with updated raw value
    {
        rawValue = getvalue(this);
        if(chgEv_TrajPointACCObj22_TrajPointACCObj22_dyv_sw == 0)
        {
            //type conversion to float
            rawValue_float = rawValue;        
            // raw to physical conversion
            phyValue = ((rawValue_float *0.0078125)+(0));
            putValue(E_pric_RadarFrontCenter_TrajPointACCObj22_TrajPointACCObj22_dyv_sw_Pv, phyValue);
            chgEv_TrajPointACCObj22_TrajPointACCObj22_dyv_sw = 1;
        }
        else
        {
            chgEv_TrajPointACCObj22_TrajPointACCObj22_dyv_sw = 0;
        }    
        //update the signal value
        Msg_TrajPointACCObj22.TrajPointACCObj22_dyv_sw=rawValue;        
    }                                                                           
}

on envVar E_pric_RadarFrontCenter_TrajPointACCObj22_TrajPointACCObj22_dyv_sw_Pv
{
    qword rawValue = 0ll;
    float phyValue = 0.0;
    
    //update the raw value with physical value 
    {
        if(chgEv_TrajPointACCObj22_TrajPointACCObj22_dyv_sw == 0)
        {
            phyValue = getvalue(this);
            // physical to raw conversion
            rawValue = ((phyValue -(0))/0.0078125);
            putValue(E_pric_RadarFrontCenter_TrajPointACCObj22_TrajPointACCObj22_dyv_sw_Rv, rawValue);
            chgEv_TrajPointACCObj22_TrajPointACCObj22_dyv_sw = 1;  
        }
        else
        {
            chgEv_TrajPointACCObj22_TrajPointACCObj22_dyv_sw = 0;
        }
    }
}


 
on envVar E_pric_RadarFrontCenter_TrajPointACCObj22_TrajPointACCObj22_Drive_b_Rv
{
    qword rawValue = 0ll;
    float rawValue_float = 0.0;
    float phyValue = 0.0;        

    //set the signal with updated raw value
    if(getValue(E_pric_RadarFrontCenter_TrajPointACCObj22_TrajPointACCObj22_Drive_b_SetVt)==0)
    {
        rawValue = getvalue(this);
        if(chgEv_TrajPointACCObj22_TrajPointACCObj22_Drive_b == 0)
        {
            //type conversion to float
            rawValue_float = rawValue;        
            // raw to physical conversion
            phyValue = ((rawValue_float *1)+(0));
            putValue(E_pric_RadarFrontCenter_TrajPointACCObj22_TrajPointACCObj22_Drive_b_Pv, phyValue);
            chgEv_TrajPointACCObj22_TrajPointACCObj22_Drive_b = 1;
        }
        else
        {
            chgEv_TrajPointACCObj22_TrajPointACCObj22_Drive_b = 0;
        }    
        //update the signal value
        Msg_TrajPointACCObj22.TrajPointACCObj22_Drive_b=rawValue;        
    }                                                                           
}

on envVar E_pric_RadarFrontCenter_TrajPointACCObj22_TrajPointACCObj22_Drive_b_Pv
{
    qword rawValue = 0ll;
    float phyValue = 0.0;
    
    //update the raw value with physical value 
    if(getValue(E_pric_RadarFrontCenter_TrajPointACCObj22_TrajPointACCObj22_Drive_b_SetVt)==0)
    {
        if(chgEv_TrajPointACCObj22_TrajPointACCObj22_Drive_b == 0)
        {
            phyValue = getvalue(this);
            // physical to raw conversion
            rawValue = ((phyValue -(0))/1);
            putValue(E_pric_RadarFrontCenter_TrajPointACCObj22_TrajPointACCObj22_Drive_b_Rv, rawValue);
            chgEv_TrajPointACCObj22_TrajPointACCObj22_Drive_b = 1;  
        }
        else
        {
            chgEv_TrajPointACCObj22_TrajPointACCObj22_Drive_b = 0;
        }
    }
}

on envVar E_pric_RadarFrontCenter_TrajPointACCObj22_TrajPointACCObj22_Drive_b_Vt
{
    qword rawValue = 0ll;
    if(getValue(E_pric_RadarFrontCenter_TrajPointACCObj22_TrajPointACCObj22_Drive_b_SetVt))
    {
        //update the signal value
        Msg_TrajPointACCObj22.TrajPointACCObj22_Drive_b=getValue(this);
    }
}

on envVar E_pric_RadarFrontCenter_TrajPointACCObj22_TrajPointACCObj22_Drive_b_SetVt
{
    if(getValue(E_pric_RadarFrontCenter_TrajPointACCObj22_TrajPointACCObj22_Drive_b_SetVt))
    {
        //update the signal value
        Msg_TrajPointACCObj22.TrajPointACCObj22_Drive_b=getvalue(E_pric_RadarFrontCenter_TrajPointACCObj22_TrajPointACCObj22_Drive_b_Vt);
    }
    else
    {
        Msg_TrajPointACCObj22.TrajPointACCObj22_Drive_b=getValue(E_pric_RadarFrontCenter_TrajPointACCObj22_TrajPointACCObj22_Drive_b_Rv);
    }
}
 
on envVar E_pric_RadarFrontCenter_TrajPointACCObj22_TrajPointACCObj22_Stand_b_Rv
{
    qword rawValue = 0ll;
    float rawValue_float = 0.0;
    float phyValue = 0.0;        

    //set the signal with updated raw value
    if(getValue(E_pric_RadarFrontCenter_TrajPointACCObj22_TrajPointACCObj22_Stand_b_SetVt)==0)
    {
        rawValue = getvalue(this);
        if(chgEv_TrajPointACCObj22_TrajPointACCObj22_Stand_b == 0)
        {
            //type conversion to float
            rawValue_float = rawValue;        
            // raw to physical conversion
            phyValue = ((rawValue_float *1)+(0));
            putValue(E_pric_RadarFrontCenter_TrajPointACCObj22_TrajPointACCObj22_Stand_b_Pv, phyValue);
            chgEv_TrajPointACCObj22_TrajPointACCObj22_Stand_b = 1;
        }
        else
        {
            chgEv_TrajPointACCObj22_TrajPointACCObj22_Stand_b = 0;
        }    
        //update the signal value
        Msg_TrajPointACCObj22.TrajPointACCObj22_Stand_b=rawValue;        
    }                                                                           
}

on envVar E_pric_RadarFrontCenter_TrajPointACCObj22_TrajPointACCObj22_Stand_b_Pv
{
    qword rawValue = 0ll;
    float phyValue = 0.0;
    
    //update the raw value with physical value 
    if(getValue(E_pric_RadarFrontCenter_TrajPointACCObj22_TrajPointACCObj22_Stand_b_SetVt)==0)
    {
        if(chgEv_TrajPointACCObj22_TrajPointACCObj22_Stand_b == 0)
        {
            phyValue = getvalue(this);
            // physical to raw conversion
            rawValue = ((phyValue -(0))/1);
            putValue(E_pric_RadarFrontCenter_TrajPointACCObj22_TrajPointACCObj22_Stand_b_Rv, rawValue);
            chgEv_TrajPointACCObj22_TrajPointACCObj22_Stand_b = 1;  
        }
        else
        {
            chgEv_TrajPointACCObj22_TrajPointACCObj22_Stand_b = 0;
        }
    }
}

on envVar E_pric_RadarFrontCenter_TrajPointACCObj22_TrajPointACCObj22_Stand_b_Vt
{
    qword rawValue = 0ll;
    if(getValue(E_pric_RadarFrontCenter_TrajPointACCObj22_TrajPointACCObj22_Stand_b_SetVt))
    {
        //update the signal value
        Msg_TrajPointACCObj22.TrajPointACCObj22_Stand_b=getValue(this);
    }
}

on envVar E_pric_RadarFrontCenter_TrajPointACCObj22_TrajPointACCObj22_Stand_b_SetVt
{
    if(getValue(E_pric_RadarFrontCenter_TrajPointACCObj22_TrajPointACCObj22_Stand_b_SetVt))
    {
        //update the signal value
        Msg_TrajPointACCObj22.TrajPointACCObj22_Stand_b=getvalue(E_pric_RadarFrontCenter_TrajPointACCObj22_TrajPointACCObj22_Stand_b_Vt);
    }
    else
    {
        Msg_TrajPointACCObj22.TrajPointACCObj22_Stand_b=getValue(E_pric_RadarFrontCenter_TrajPointACCObj22_TrajPointACCObj22_Stand_b_Rv);
    }
}
 
on envVar E_pric_RadarFrontCenter_TrajPointACCObj22_TrajPointACCObj22_dVarXv_uw_Rv
{
    qword rawValue = 0ll;
    float rawValue_float = 0.0;
    float phyValue = 0.0;        

    //set the signal with updated raw value
    {
        rawValue = getvalue(this);
        if(chgEv_TrajPointACCObj22_TrajPointACCObj22_dVarXv_uw == 0)
        {
            //type conversion to float
            rawValue_float = rawValue;        
            // raw to physical conversion
            phyValue = ((rawValue_float *0.00195313)+(0));
            putValue(E_pric_RadarFrontCenter_TrajPointACCObj22_TrajPointACCObj22_dVarXv_uw_Pv, phyValue);
            chgEv_TrajPointACCObj22_TrajPointACCObj22_dVarXv_uw = 1;
        }
        else
        {
            chgEv_TrajPointACCObj22_TrajPointACCObj22_dVarXv_uw = 0;
        }    
        //update the signal value
        Msg_TrajPointACCObj22.TrajPointACCObj22_dVarXv_uw=rawValue;        
    }                                                                           
}

on envVar E_pric_RadarFrontCenter_TrajPointACCObj22_TrajPointACCObj22_dVarXv_uw_Pv
{
    qword rawValue = 0ll;
    float phyValue = 0.0;
    
    //update the raw value with physical value 
    {
        if(chgEv_TrajPointACCObj22_TrajPointACCObj22_dVarXv_uw == 0)
        {
            phyValue = getvalue(this);
            // physical to raw conversion
            rawValue = ((phyValue -(0))/0.00195313);
            putValue(E_pric_RadarFrontCenter_TrajPointACCObj22_TrajPointACCObj22_dVarXv_uw_Rv, rawValue);
            chgEv_TrajPointACCObj22_TrajPointACCObj22_dVarXv_uw = 1;  
        }
        else
        {
            chgEv_TrajPointACCObj22_TrajPointACCObj22_dVarXv_uw = 0;
        }
    }
}


 
on envVar E_pric_RadarFrontCenter_TrajPointACCObj22_TrajPointACCObj22_timestamp_Rv
{
    qword rawValue = 0ll;
    float rawValue_float = 0.0;
    float phyValue = 0.0;        

    //set the signal with updated raw value
    {
        rawValue = getvalue(this);
        if(chgEv_TrajPointACCObj22_TrajPointACCObj22_timestamp == 0)
        {
            //type conversion to float
            rawValue_float = rawValue;        
            // raw to physical conversion
            phyValue = ((rawValue_float *0.000488281)+(0));
            putValue(E_pric_RadarFrontCenter_TrajPointACCObj22_TrajPointACCObj22_timestamp_Pv, phyValue);
            chgEv_TrajPointACCObj22_TrajPointACCObj22_timestamp = 1;
        }
        else
        {
            chgEv_TrajPointACCObj22_TrajPointACCObj22_timestamp = 0;
        }    
        //update the signal value
        Msg_TrajPointACCObj22.TrajPointACCObj22_timestamp=rawValue;        
    }                                                                           
}

on envVar E_pric_RadarFrontCenter_TrajPointACCObj22_TrajPointACCObj22_timestamp_Pv
{
    qword rawValue = 0ll;
    float phyValue = 0.0;
    
    //update the raw value with physical value 
    {
        if(chgEv_TrajPointACCObj22_TrajPointACCObj22_timestamp == 0)
        {
            phyValue = getvalue(this);
            // physical to raw conversion
            rawValue = ((phyValue -(0))/0.000488281);
            putValue(E_pric_RadarFrontCenter_TrajPointACCObj22_TrajPointACCObj22_timestamp_Rv, rawValue);
            chgEv_TrajPointACCObj22_TrajPointACCObj22_timestamp = 1;  
        }
        else
        {
            chgEv_TrajPointACCObj22_TrajPointACCObj22_timestamp = 0;
        }
    }
}


 
on envVar E_pric_RadarFrontCenter_TrajPointACCObj22_TrajPointACCObj22_dVarYv_uw_Rv
{
    qword rawValue = 0ll;
    float rawValue_float = 0.0;
    float phyValue = 0.0;        

    //set the signal with updated raw value
    {
        rawValue = getvalue(this);
        if(chgEv_TrajPointACCObj22_TrajPointACCObj22_dVarYv_uw == 0)
        {
            //type conversion to float
            rawValue_float = rawValue;        
            // raw to physical conversion
            phyValue = ((rawValue_float *0.00195313)+(0));
            putValue(E_pric_RadarFrontCenter_TrajPointACCObj22_TrajPointACCObj22_dVarYv_uw_Pv, phyValue);
            chgEv_TrajPointACCObj22_TrajPointACCObj22_dVarYv_uw = 1;
        }
        else
        {
            chgEv_TrajPointACCObj22_TrajPointACCObj22_dVarYv_uw = 0;
        }    
        //update the signal value
        Msg_TrajPointACCObj22.TrajPointACCObj22_dVarYv_uw=rawValue;        
    }                                                                           
}

on envVar E_pric_RadarFrontCenter_TrajPointACCObj22_TrajPointACCObj22_dVarYv_uw_Pv
{
    qword rawValue = 0ll;
    float phyValue = 0.0;
    
    //update the raw value with physical value 
    {
        if(chgEv_TrajPointACCObj22_TrajPointACCObj22_dVarYv_uw == 0)
        {
            phyValue = getvalue(this);
            // physical to raw conversion
            rawValue = ((phyValue -(0))/0.00195313);
            putValue(E_pric_RadarFrontCenter_TrajPointACCObj22_TrajPointACCObj22_dVarYv_uw_Rv, rawValue);
            chgEv_TrajPointACCObj22_TrajPointACCObj22_dVarYv_uw = 1;  
        }
        else
        {
            chgEv_TrajPointACCObj22_TrajPointACCObj22_dVarYv_uw = 0;
        }
    }
}


 
on envVar E_pric_RadarFrontCenter_TrajPointACCObj22_TrajPointACCObj22_dxv_sw_Rv
{
    qword rawValue = 0ll;
    float rawValue_float = 0.0;
    float phyValue = 0.0;        

    //set the signal with updated raw value
    {
        rawValue = getvalue(this);
        if(chgEv_TrajPointACCObj22_TrajPointACCObj22_dxv_sw == 0)
        {
            //type conversion to float
            rawValue_float = rawValue;        
            // raw to physical conversion
            phyValue = ((rawValue_float *0.0078125)+(0));
            putValue(E_pric_RadarFrontCenter_TrajPointACCObj22_TrajPointACCObj22_dxv_sw_Pv, phyValue);
            chgEv_TrajPointACCObj22_TrajPointACCObj22_dxv_sw = 1;
        }
        else
        {
            chgEv_TrajPointACCObj22_TrajPointACCObj22_dxv_sw = 0;
        }    
        //update the signal value
        Msg_TrajPointACCObj22.TrajPointACCObj22_dxv_sw=rawValue;        
    }                                                                           
}

on envVar E_pric_RadarFrontCenter_TrajPointACCObj22_TrajPointACCObj22_dxv_sw_Pv
{
    qword rawValue = 0ll;
    float phyValue = 0.0;
    
    //update the raw value with physical value 
    {
        if(chgEv_TrajPointACCObj22_TrajPointACCObj22_dxv_sw == 0)
        {
            phyValue = getvalue(this);
            // physical to raw conversion
            rawValue = ((phyValue -(0))/0.0078125);
            putValue(E_pric_RadarFrontCenter_TrajPointACCObj22_TrajPointACCObj22_dxv_sw_Rv, rawValue);
            chgEv_TrajPointACCObj22_TrajPointACCObj22_dxv_sw = 1;  
        }
        else
        {
            chgEv_TrajPointACCObj22_TrajPointACCObj22_dxv_sw = 0;
        }
    }
}


 
on envVar E_pric_RadarFrontCenter_TrajPointACCObj23_tx
{
    if(getValue(this))
    {       
        
        //update the BZ Signal
        if(TrajPointACCObj23_TrajPointACCObj23_blockCtr_wrongvalctr == 0)
        {
            update_TrajPointACCObj23_TrajPointACCObj23_blockCtr_counter();
            Msg_TrajPointACCObj23.TrajPointACCObj23_blockCtr= TrajPointACCObj23_TrajPointACCObj23_blockCtr_counter;
        }
        else if(TrajPointACCObj23_TrajPointACCObj23_blockCtr_wrongvalctr > 0)
        {
             TrajPointACCObj23_TrajPointACCObj23_blockCtr_wrongvalctr--;
              // if counter becomes zero, update panel controller to zero
             if(TrajPointACCObj23_TrajPointACCObj23_blockCtr_wrongvalctr == 0)
             {
                 putValue(E_pric_RadarFrontCenter_TrajPointACCObj23_TrajPointACCObj23_blockCtr_wrongvalctr,0);
             }
        }
        else
        {
            //do nothing
        }        
        //update the BZ Signal
        if(TrajPointACCObj23_TrajPointACCObj23_MsgCtr_wrongvalctr == 0)
        {
            update_TrajPointACCObj23_TrajPointACCObj23_MsgCtr_counter();
            Msg_TrajPointACCObj23.TrajPointACCObj23_MsgCtr= TrajPointACCObj23_TrajPointACCObj23_MsgCtr_counter;
        }
        else if(TrajPointACCObj23_TrajPointACCObj23_MsgCtr_wrongvalctr > 0)
        {
             TrajPointACCObj23_TrajPointACCObj23_MsgCtr_wrongvalctr--;
              // if counter becomes zero, update panel controller to zero
             if(TrajPointACCObj23_TrajPointACCObj23_MsgCtr_wrongvalctr == 0)
             {
                 putValue(E_pric_RadarFrontCenter_TrajPointACCObj23_TrajPointACCObj23_MsgCtr_wrongvalctr,0);
             }
        }
        else
        {
            //do nothing
        }        
        //calculate the CRC checksum
        update_TrajPointACCObj23_ChkSum_Checksum();

        output(Msg_TrajPointACCObj23);        
    }
}

on envVar E_pric_RadarFrontCenter_TrajPointACCObj23_Range
{
    qword rawstatus = 0ll;
    qword rawValue = 0ll;    
    
    rawstatus = getvalue(this);    
    // set all the signals with min raw /max raw /init raw
    switch (rawstatus) 
    {
     case(0) :
        rawValue= 0;
        putValue(E_pric_RadarFrontCenter_TrajPointACCObj23_TrajPointACCObj23_Stopped_b_Rv, rawValue);
        rawValue= 0;
        putValue(E_pric_RadarFrontCenter_TrajPointACCObj23_TrajPointACCObj23_InvDir_b_Rv, rawValue);
        rawValue= 0;
        putValue(E_pric_RadarFrontCenter_TrajPointACCObj23_TrajPointACCObj23_Valid_b_Rv, rawValue);
        rawValue= 0;
        putValue(E_pric_RadarFrontCenter_TrajPointACCObj23_TrajPointACCObj23_Stand_b_Rv, rawValue);
        rawValue= 0;
        putValue(E_pric_RadarFrontCenter_TrajPointACCObj23_TrajPointACCObj23_dVarYv_uw_Rv, rawValue);
        rawValue= -32768;
        putValue(E_pric_RadarFrontCenter_TrajPointACCObj23_TrajPointACCObj23_dyv_sw_Rv, rawValue);
        rawValue= 0;
        putValue(E_pric_RadarFrontCenter_TrajPointACCObj23_TrajPointACCObj23_TrajEnd_b_Rv, rawValue);
        rawValue= 0;
        putValue(E_pric_RadarFrontCenter_TrajPointACCObj23_TrajPointACCObj23_dVarXv_uw_Rv, rawValue);
        rawValue= 0;
        putValue(E_pric_RadarFrontCenter_TrajPointACCObj23_TrajPointACCObj23_wExistProb_ub_Rv, rawValue);
        rawValue= -32768;
        putValue(E_pric_RadarFrontCenter_TrajPointACCObj23_TrajPointACCObj23_dxv_sw_Rv, rawValue);
        rawValue= 0;
        putValue(E_pric_RadarFrontCenter_TrajPointACCObj23_TrajPointACCObj23_timestamp_Rv, rawValue);
        rawValue= 0;
        putValue(E_pric_RadarFrontCenter_TrajPointACCObj23_TrajPointACCObj23_Drive_b_Rv, rawValue);
        break;
     case(1) :
        rawValue= 1;
        putValue(E_pric_RadarFrontCenter_TrajPointACCObj23_TrajPointACCObj23_Stopped_b_Rv, rawValue);
        rawValue= 1;
        putValue(E_pric_RadarFrontCenter_TrajPointACCObj23_TrajPointACCObj23_InvDir_b_Rv, rawValue);
        rawValue= 1;
        putValue(E_pric_RadarFrontCenter_TrajPointACCObj23_TrajPointACCObj23_Valid_b_Rv, rawValue);
        rawValue= 1;
        putValue(E_pric_RadarFrontCenter_TrajPointACCObj23_TrajPointACCObj23_Stand_b_Rv, rawValue);
        rawValue= 65534;
        putValue(E_pric_RadarFrontCenter_TrajPointACCObj23_TrajPointACCObj23_dVarYv_uw_Rv, rawValue);
        rawValue= 32767;
        putValue(E_pric_RadarFrontCenter_TrajPointACCObj23_TrajPointACCObj23_dyv_sw_Rv, rawValue);
        rawValue= 1;
        putValue(E_pric_RadarFrontCenter_TrajPointACCObj23_TrajPointACCObj23_TrajEnd_b_Rv, rawValue);
        rawValue= 65534;
        putValue(E_pric_RadarFrontCenter_TrajPointACCObj23_TrajPointACCObj23_dVarXv_uw_Rv, rawValue);
        rawValue= 255;
        putValue(E_pric_RadarFrontCenter_TrajPointACCObj23_TrajPointACCObj23_wExistProb_ub_Rv, rawValue);
        rawValue= 32767;
        putValue(E_pric_RadarFrontCenter_TrajPointACCObj23_TrajPointACCObj23_dxv_sw_Rv, rawValue);
        rawValue= 65536;
        putValue(E_pric_RadarFrontCenter_TrajPointACCObj23_TrajPointACCObj23_timestamp_Rv, rawValue);
        rawValue= 1;
        putValue(E_pric_RadarFrontCenter_TrajPointACCObj23_TrajPointACCObj23_Drive_b_Rv, rawValue);
        break;
     default :
        rawValue= 0;
        putValue(E_pric_RadarFrontCenter_TrajPointACCObj23_TrajPointACCObj23_Stopped_b_Rv, rawValue);
        rawValue= 0;
        putValue(E_pric_RadarFrontCenter_TrajPointACCObj23_TrajPointACCObj23_InvDir_b_Rv, rawValue);
        rawValue= 0;
        putValue(E_pric_RadarFrontCenter_TrajPointACCObj23_TrajPointACCObj23_Valid_b_Rv, rawValue);
        rawValue= 0;
        putValue(E_pric_RadarFrontCenter_TrajPointACCObj23_TrajPointACCObj23_Stand_b_Rv, rawValue);
        rawValue= 0;
        putValue(E_pric_RadarFrontCenter_TrajPointACCObj23_TrajPointACCObj23_dVarYv_uw_Rv, rawValue);
        rawValue= -32768;
        putValue(E_pric_RadarFrontCenter_TrajPointACCObj23_TrajPointACCObj23_dyv_sw_Rv, rawValue);
        rawValue= 0;
        putValue(E_pric_RadarFrontCenter_TrajPointACCObj23_TrajPointACCObj23_TrajEnd_b_Rv, rawValue);
        rawValue= 0;
        putValue(E_pric_RadarFrontCenter_TrajPointACCObj23_TrajPointACCObj23_dVarXv_uw_Rv, rawValue);
        rawValue= 0;
        putValue(E_pric_RadarFrontCenter_TrajPointACCObj23_TrajPointACCObj23_wExistProb_ub_Rv, rawValue);
        rawValue= -32768;
        putValue(E_pric_RadarFrontCenter_TrajPointACCObj23_TrajPointACCObj23_dxv_sw_Rv, rawValue);
        rawValue= 0;
        putValue(E_pric_RadarFrontCenter_TrajPointACCObj23_TrajPointACCObj23_timestamp_Rv, rawValue);
        rawValue= 0;
        putValue(E_pric_RadarFrontCenter_TrajPointACCObj23_TrajPointACCObj23_Drive_b_Rv, rawValue);
      break;
   }
}

on envVar E_pric_RadarFrontCenter_TrajPointACCObj23_Dlc
{
    if(getValue(E_pric_RadarFrontCenter_TrajPointACCObj23_enDlc))
    {
        Msg_TrajPointACCObj23.dlc =getValue(this);
    }
    else
    {
       Dbc_dlc = 16;
	   Msg_TrajPointACCObj23.dlc = Calc_Canfd_dlc(Dbc_dlc);
	   	
  }
}

on envVar E_pric_RadarFrontCenter_TrajPointACCObj23_enDlc
{
    //For Messages with DLC = 8, set wrong DLC to smaller than defined DLC
    //For Messages with DLC < 8 set wrong DLC to smaller/longer than defined DLC
    if(getValue(this))
    {
        Msg_TrajPointACCObj23.dlc =getValue(E_pric_RadarFrontCenter_TrajPointACCObj23_Dlc);
    }
    else
    {
       Dbc_dlc = 16;
	   Msg_TrajPointACCObj23.dlc = Calc_Canfd_dlc(Dbc_dlc);
			
    }
}

on envVar E_pric_RadarFrontCenter_TrajPointACCObj23_TrajPointACCObj23_CRC_wrongvalctr
{
    //update disturb count
    //disturb value range:(-1 = always send wrong value),( X>0 ,x is the number of Messages with wrong CHK sent)
    TrajPointACCObj23_TrajPointACCObj23_CRC_wrongvalctr =getValue(this);    
}
on envVar E_pric_RadarFrontCenter_TrajPointACCObj23_TrajPointACCObj23_MsgCtr_wrongvalctr
{
    //update disturb count
    //disturb value range:(-1 = always send wrong value),( X>0 ,x is the number of Messages with wrong CHK sent)
    TrajPointACCObj23_TrajPointACCObj23_MsgCtr_wrongvalctr =getValue(this);    
}
on envVar E_pric_RadarFrontCenter_TrajPointACCObj23_TrajPointACCObj23_blockCtr_wrongvalctr
{
    //update disturb count
    //disturb value range:(-1 = always send wrong value),( X>0 ,x is the number of Messages with wrong CHK sent)
    TrajPointACCObj23_TrajPointACCObj23_blockCtr_wrongvalctr =getValue(this);    
}

on envVar E_pric_RadarFrontCenter_TrajPointACCObj23_TrajPointACCObj23_Stopped_b_Rv
{
    qword rawValue = 0ll;
    float rawValue_float = 0.0;
    float phyValue = 0.0;        

    //set the signal with updated raw value
    if(getValue(E_pric_RadarFrontCenter_TrajPointACCObj23_TrajPointACCObj23_Stopped_b_SetVt)==0)
    {
        rawValue = getvalue(this);
        if(chgEv_TrajPointACCObj23_TrajPointACCObj23_Stopped_b == 0)
        {
            //type conversion to float
            rawValue_float = rawValue;        
            // raw to physical conversion
            phyValue = ((rawValue_float *1)+(0));
            putValue(E_pric_RadarFrontCenter_TrajPointACCObj23_TrajPointACCObj23_Stopped_b_Pv, phyValue);
            chgEv_TrajPointACCObj23_TrajPointACCObj23_Stopped_b = 1;
        }
        else
        {
            chgEv_TrajPointACCObj23_TrajPointACCObj23_Stopped_b = 0;
        }    
        //update the signal value
        Msg_TrajPointACCObj23.TrajPointACCObj23_Stopped_b=rawValue;        
    }                                                                           
}

on envVar E_pric_RadarFrontCenter_TrajPointACCObj23_TrajPointACCObj23_Stopped_b_Pv
{
    qword rawValue = 0ll;
    float phyValue = 0.0;
    
    //update the raw value with physical value 
    if(getValue(E_pric_RadarFrontCenter_TrajPointACCObj23_TrajPointACCObj23_Stopped_b_SetVt)==0)
    {
        if(chgEv_TrajPointACCObj23_TrajPointACCObj23_Stopped_b == 0)
        {
            phyValue = getvalue(this);
            // physical to raw conversion
            rawValue = ((phyValue -(0))/1);
            putValue(E_pric_RadarFrontCenter_TrajPointACCObj23_TrajPointACCObj23_Stopped_b_Rv, rawValue);
            chgEv_TrajPointACCObj23_TrajPointACCObj23_Stopped_b = 1;  
        }
        else
        {
            chgEv_TrajPointACCObj23_TrajPointACCObj23_Stopped_b = 0;
        }
    }
}

on envVar E_pric_RadarFrontCenter_TrajPointACCObj23_TrajPointACCObj23_Stopped_b_Vt
{
    qword rawValue = 0ll;
    if(getValue(E_pric_RadarFrontCenter_TrajPointACCObj23_TrajPointACCObj23_Stopped_b_SetVt))
    {
        //update the signal value
        Msg_TrajPointACCObj23.TrajPointACCObj23_Stopped_b=getValue(this);
    }
}

on envVar E_pric_RadarFrontCenter_TrajPointACCObj23_TrajPointACCObj23_Stopped_b_SetVt
{
    if(getValue(E_pric_RadarFrontCenter_TrajPointACCObj23_TrajPointACCObj23_Stopped_b_SetVt))
    {
        //update the signal value
        Msg_TrajPointACCObj23.TrajPointACCObj23_Stopped_b=getvalue(E_pric_RadarFrontCenter_TrajPointACCObj23_TrajPointACCObj23_Stopped_b_Vt);
    }
    else
    {
        Msg_TrajPointACCObj23.TrajPointACCObj23_Stopped_b=getValue(E_pric_RadarFrontCenter_TrajPointACCObj23_TrajPointACCObj23_Stopped_b_Rv);
    }
}
 
on envVar E_pric_RadarFrontCenter_TrajPointACCObj23_TrajPointACCObj23_InvDir_b_Rv
{
    qword rawValue = 0ll;
    float rawValue_float = 0.0;
    float phyValue = 0.0;        

    //set the signal with updated raw value
    if(getValue(E_pric_RadarFrontCenter_TrajPointACCObj23_TrajPointACCObj23_InvDir_b_SetVt)==0)
    {
        rawValue = getvalue(this);
        if(chgEv_TrajPointACCObj23_TrajPointACCObj23_InvDir_b == 0)
        {
            //type conversion to float
            rawValue_float = rawValue;        
            // raw to physical conversion
            phyValue = ((rawValue_float *1)+(0));
            putValue(E_pric_RadarFrontCenter_TrajPointACCObj23_TrajPointACCObj23_InvDir_b_Pv, phyValue);
            chgEv_TrajPointACCObj23_TrajPointACCObj23_InvDir_b = 1;
        }
        else
        {
            chgEv_TrajPointACCObj23_TrajPointACCObj23_InvDir_b = 0;
        }    
        //update the signal value
        Msg_TrajPointACCObj23.TrajPointACCObj23_InvDir_b=rawValue;        
    }                                                                           
}

on envVar E_pric_RadarFrontCenter_TrajPointACCObj23_TrajPointACCObj23_InvDir_b_Pv
{
    qword rawValue = 0ll;
    float phyValue = 0.0;
    
    //update the raw value with physical value 
    if(getValue(E_pric_RadarFrontCenter_TrajPointACCObj23_TrajPointACCObj23_InvDir_b_SetVt)==0)
    {
        if(chgEv_TrajPointACCObj23_TrajPointACCObj23_InvDir_b == 0)
        {
            phyValue = getvalue(this);
            // physical to raw conversion
            rawValue = ((phyValue -(0))/1);
            putValue(E_pric_RadarFrontCenter_TrajPointACCObj23_TrajPointACCObj23_InvDir_b_Rv, rawValue);
            chgEv_TrajPointACCObj23_TrajPointACCObj23_InvDir_b = 1;  
        }
        else
        {
            chgEv_TrajPointACCObj23_TrajPointACCObj23_InvDir_b = 0;
        }
    }
}

on envVar E_pric_RadarFrontCenter_TrajPointACCObj23_TrajPointACCObj23_InvDir_b_Vt
{
    qword rawValue = 0ll;
    if(getValue(E_pric_RadarFrontCenter_TrajPointACCObj23_TrajPointACCObj23_InvDir_b_SetVt))
    {
        //update the signal value
        Msg_TrajPointACCObj23.TrajPointACCObj23_InvDir_b=getValue(this);
    }
}

on envVar E_pric_RadarFrontCenter_TrajPointACCObj23_TrajPointACCObj23_InvDir_b_SetVt
{
    if(getValue(E_pric_RadarFrontCenter_TrajPointACCObj23_TrajPointACCObj23_InvDir_b_SetVt))
    {
        //update the signal value
        Msg_TrajPointACCObj23.TrajPointACCObj23_InvDir_b=getvalue(E_pric_RadarFrontCenter_TrajPointACCObj23_TrajPointACCObj23_InvDir_b_Vt);
    }
    else
    {
        Msg_TrajPointACCObj23.TrajPointACCObj23_InvDir_b=getValue(E_pric_RadarFrontCenter_TrajPointACCObj23_TrajPointACCObj23_InvDir_b_Rv);
    }
}
 
on envVar E_pric_RadarFrontCenter_TrajPointACCObj23_TrajPointACCObj23_Valid_b_Rv
{
    qword rawValue = 0ll;
    float rawValue_float = 0.0;
    float phyValue = 0.0;        

    //set the signal with updated raw value
    if(getValue(E_pric_RadarFrontCenter_TrajPointACCObj23_TrajPointACCObj23_Valid_b_SetVt)==0)
    {
        rawValue = getvalue(this);
        if(chgEv_TrajPointACCObj23_TrajPointACCObj23_Valid_b == 0)
        {
            //type conversion to float
            rawValue_float = rawValue;        
            // raw to physical conversion
            phyValue = ((rawValue_float *1)+(0));
            putValue(E_pric_RadarFrontCenter_TrajPointACCObj23_TrajPointACCObj23_Valid_b_Pv, phyValue);
            chgEv_TrajPointACCObj23_TrajPointACCObj23_Valid_b = 1;
        }
        else
        {
            chgEv_TrajPointACCObj23_TrajPointACCObj23_Valid_b = 0;
        }    
        //update the signal value
        Msg_TrajPointACCObj23.TrajPointACCObj23_Valid_b=rawValue;        
    }                                                                           
}

on envVar E_pric_RadarFrontCenter_TrajPointACCObj23_TrajPointACCObj23_Valid_b_Pv
{
    qword rawValue = 0ll;
    float phyValue = 0.0;
    
    //update the raw value with physical value 
    if(getValue(E_pric_RadarFrontCenter_TrajPointACCObj23_TrajPointACCObj23_Valid_b_SetVt)==0)
    {
        if(chgEv_TrajPointACCObj23_TrajPointACCObj23_Valid_b == 0)
        {
            phyValue = getvalue(this);
            // physical to raw conversion
            rawValue = ((phyValue -(0))/1);
            putValue(E_pric_RadarFrontCenter_TrajPointACCObj23_TrajPointACCObj23_Valid_b_Rv, rawValue);
            chgEv_TrajPointACCObj23_TrajPointACCObj23_Valid_b = 1;  
        }
        else
        {
            chgEv_TrajPointACCObj23_TrajPointACCObj23_Valid_b = 0;
        }
    }
}

on envVar E_pric_RadarFrontCenter_TrajPointACCObj23_TrajPointACCObj23_Valid_b_Vt
{
    qword rawValue = 0ll;
    if(getValue(E_pric_RadarFrontCenter_TrajPointACCObj23_TrajPointACCObj23_Valid_b_SetVt))
    {
        //update the signal value
        Msg_TrajPointACCObj23.TrajPointACCObj23_Valid_b=getValue(this);
    }
}

on envVar E_pric_RadarFrontCenter_TrajPointACCObj23_TrajPointACCObj23_Valid_b_SetVt
{
    if(getValue(E_pric_RadarFrontCenter_TrajPointACCObj23_TrajPointACCObj23_Valid_b_SetVt))
    {
        //update the signal value
        Msg_TrajPointACCObj23.TrajPointACCObj23_Valid_b=getvalue(E_pric_RadarFrontCenter_TrajPointACCObj23_TrajPointACCObj23_Valid_b_Vt);
    }
    else
    {
        Msg_TrajPointACCObj23.TrajPointACCObj23_Valid_b=getValue(E_pric_RadarFrontCenter_TrajPointACCObj23_TrajPointACCObj23_Valid_b_Rv);
    }
}
 
on envVar E_pric_RadarFrontCenter_TrajPointACCObj23_TrajPointACCObj23_Stand_b_Rv
{
    qword rawValue = 0ll;
    float rawValue_float = 0.0;
    float phyValue = 0.0;        

    //set the signal with updated raw value
    if(getValue(E_pric_RadarFrontCenter_TrajPointACCObj23_TrajPointACCObj23_Stand_b_SetVt)==0)
    {
        rawValue = getvalue(this);
        if(chgEv_TrajPointACCObj23_TrajPointACCObj23_Stand_b == 0)
        {
            //type conversion to float
            rawValue_float = rawValue;        
            // raw to physical conversion
            phyValue = ((rawValue_float *1)+(0));
            putValue(E_pric_RadarFrontCenter_TrajPointACCObj23_TrajPointACCObj23_Stand_b_Pv, phyValue);
            chgEv_TrajPointACCObj23_TrajPointACCObj23_Stand_b = 1;
        }
        else
        {
            chgEv_TrajPointACCObj23_TrajPointACCObj23_Stand_b = 0;
        }    
        //update the signal value
        Msg_TrajPointACCObj23.TrajPointACCObj23_Stand_b=rawValue;        
    }                                                                           
}

on envVar E_pric_RadarFrontCenter_TrajPointACCObj23_TrajPointACCObj23_Stand_b_Pv
{
    qword rawValue = 0ll;
    float phyValue = 0.0;
    
    //update the raw value with physical value 
    if(getValue(E_pric_RadarFrontCenter_TrajPointACCObj23_TrajPointACCObj23_Stand_b_SetVt)==0)
    {
        if(chgEv_TrajPointACCObj23_TrajPointACCObj23_Stand_b == 0)
        {
            phyValue = getvalue(this);
            // physical to raw conversion
            rawValue = ((phyValue -(0))/1);
            putValue(E_pric_RadarFrontCenter_TrajPointACCObj23_TrajPointACCObj23_Stand_b_Rv, rawValue);
            chgEv_TrajPointACCObj23_TrajPointACCObj23_Stand_b = 1;  
        }
        else
        {
            chgEv_TrajPointACCObj23_TrajPointACCObj23_Stand_b = 0;
        }
    }
}

on envVar E_pric_RadarFrontCenter_TrajPointACCObj23_TrajPointACCObj23_Stand_b_Vt
{
    qword rawValue = 0ll;
    if(getValue(E_pric_RadarFrontCenter_TrajPointACCObj23_TrajPointACCObj23_Stand_b_SetVt))
    {
        //update the signal value
        Msg_TrajPointACCObj23.TrajPointACCObj23_Stand_b=getValue(this);
    }
}

on envVar E_pric_RadarFrontCenter_TrajPointACCObj23_TrajPointACCObj23_Stand_b_SetVt
{
    if(getValue(E_pric_RadarFrontCenter_TrajPointACCObj23_TrajPointACCObj23_Stand_b_SetVt))
    {
        //update the signal value
        Msg_TrajPointACCObj23.TrajPointACCObj23_Stand_b=getvalue(E_pric_RadarFrontCenter_TrajPointACCObj23_TrajPointACCObj23_Stand_b_Vt);
    }
    else
    {
        Msg_TrajPointACCObj23.TrajPointACCObj23_Stand_b=getValue(E_pric_RadarFrontCenter_TrajPointACCObj23_TrajPointACCObj23_Stand_b_Rv);
    }
}
 
on envVar E_pric_RadarFrontCenter_TrajPointACCObj23_TrajPointACCObj23_dVarYv_uw_Rv
{
    qword rawValue = 0ll;
    float rawValue_float = 0.0;
    float phyValue = 0.0;        

    //set the signal with updated raw value
    {
        rawValue = getvalue(this);
        if(chgEv_TrajPointACCObj23_TrajPointACCObj23_dVarYv_uw == 0)
        {
            //type conversion to float
            rawValue_float = rawValue;        
            // raw to physical conversion
            phyValue = ((rawValue_float *0.00195313)+(0));
            putValue(E_pric_RadarFrontCenter_TrajPointACCObj23_TrajPointACCObj23_dVarYv_uw_Pv, phyValue);
            chgEv_TrajPointACCObj23_TrajPointACCObj23_dVarYv_uw = 1;
        }
        else
        {
            chgEv_TrajPointACCObj23_TrajPointACCObj23_dVarYv_uw = 0;
        }    
        //update the signal value
        Msg_TrajPointACCObj23.TrajPointACCObj23_dVarYv_uw=rawValue;        
    }                                                                           
}

on envVar E_pric_RadarFrontCenter_TrajPointACCObj23_TrajPointACCObj23_dVarYv_uw_Pv
{
    qword rawValue = 0ll;
    float phyValue = 0.0;
    
    //update the raw value with physical value 
    {
        if(chgEv_TrajPointACCObj23_TrajPointACCObj23_dVarYv_uw == 0)
        {
            phyValue = getvalue(this);
            // physical to raw conversion
            rawValue = ((phyValue -(0))/0.00195313);
            putValue(E_pric_RadarFrontCenter_TrajPointACCObj23_TrajPointACCObj23_dVarYv_uw_Rv, rawValue);
            chgEv_TrajPointACCObj23_TrajPointACCObj23_dVarYv_uw = 1;  
        }
        else
        {
            chgEv_TrajPointACCObj23_TrajPointACCObj23_dVarYv_uw = 0;
        }
    }
}


 
on envVar E_pric_RadarFrontCenter_TrajPointACCObj23_TrajPointACCObj23_dyv_sw_Rv
{
    qword rawValue = 0ll;
    float rawValue_float = 0.0;
    float phyValue = 0.0;        

    //set the signal with updated raw value
    {
        rawValue = getvalue(this);
        if(chgEv_TrajPointACCObj23_TrajPointACCObj23_dyv_sw == 0)
        {
            //type conversion to float
            rawValue_float = rawValue;        
            // raw to physical conversion
            phyValue = ((rawValue_float *0.0078125)+(0));
            putValue(E_pric_RadarFrontCenter_TrajPointACCObj23_TrajPointACCObj23_dyv_sw_Pv, phyValue);
            chgEv_TrajPointACCObj23_TrajPointACCObj23_dyv_sw = 1;
        }
        else
        {
            chgEv_TrajPointACCObj23_TrajPointACCObj23_dyv_sw = 0;
        }    
        //update the signal value
        Msg_TrajPointACCObj23.TrajPointACCObj23_dyv_sw=rawValue;        
    }                                                                           
}

on envVar E_pric_RadarFrontCenter_TrajPointACCObj23_TrajPointACCObj23_dyv_sw_Pv
{
    qword rawValue = 0ll;
    float phyValue = 0.0;
    
    //update the raw value with physical value 
    {
        if(chgEv_TrajPointACCObj23_TrajPointACCObj23_dyv_sw == 0)
        {
            phyValue = getvalue(this);
            // physical to raw conversion
            rawValue = ((phyValue -(0))/0.0078125);
            putValue(E_pric_RadarFrontCenter_TrajPointACCObj23_TrajPointACCObj23_dyv_sw_Rv, rawValue);
            chgEv_TrajPointACCObj23_TrajPointACCObj23_dyv_sw = 1;  
        }
        else
        {
            chgEv_TrajPointACCObj23_TrajPointACCObj23_dyv_sw = 0;
        }
    }
}


 
on envVar E_pric_RadarFrontCenter_TrajPointACCObj23_TrajPointACCObj23_TrajEnd_b_Rv
{
    qword rawValue = 0ll;
    float rawValue_float = 0.0;
    float phyValue = 0.0;        

    //set the signal with updated raw value
    if(getValue(E_pric_RadarFrontCenter_TrajPointACCObj23_TrajPointACCObj23_TrajEnd_b_SetVt)==0)
    {
        rawValue = getvalue(this);
        if(chgEv_TrajPointACCObj23_TrajPointACCObj23_TrajEnd_b == 0)
        {
            //type conversion to float
            rawValue_float = rawValue;        
            // raw to physical conversion
            phyValue = ((rawValue_float *1)+(0));
            putValue(E_pric_RadarFrontCenter_TrajPointACCObj23_TrajPointACCObj23_TrajEnd_b_Pv, phyValue);
            chgEv_TrajPointACCObj23_TrajPointACCObj23_TrajEnd_b = 1;
        }
        else
        {
            chgEv_TrajPointACCObj23_TrajPointACCObj23_TrajEnd_b = 0;
        }    
        //update the signal value
        Msg_TrajPointACCObj23.TrajPointACCObj23_TrajEnd_b=rawValue;        
    }                                                                           
}

on envVar E_pric_RadarFrontCenter_TrajPointACCObj23_TrajPointACCObj23_TrajEnd_b_Pv
{
    qword rawValue = 0ll;
    float phyValue = 0.0;
    
    //update the raw value with physical value 
    if(getValue(E_pric_RadarFrontCenter_TrajPointACCObj23_TrajPointACCObj23_TrajEnd_b_SetVt)==0)
    {
        if(chgEv_TrajPointACCObj23_TrajPointACCObj23_TrajEnd_b == 0)
        {
            phyValue = getvalue(this);
            // physical to raw conversion
            rawValue = ((phyValue -(0))/1);
            putValue(E_pric_RadarFrontCenter_TrajPointACCObj23_TrajPointACCObj23_TrajEnd_b_Rv, rawValue);
            chgEv_TrajPointACCObj23_TrajPointACCObj23_TrajEnd_b = 1;  
        }
        else
        {
            chgEv_TrajPointACCObj23_TrajPointACCObj23_TrajEnd_b = 0;
        }
    }
}

on envVar E_pric_RadarFrontCenter_TrajPointACCObj23_TrajPointACCObj23_TrajEnd_b_Vt
{
    qword rawValue = 0ll;
    if(getValue(E_pric_RadarFrontCenter_TrajPointACCObj23_TrajPointACCObj23_TrajEnd_b_SetVt))
    {
        //update the signal value
        Msg_TrajPointACCObj23.TrajPointACCObj23_TrajEnd_b=getValue(this);
    }
}

on envVar E_pric_RadarFrontCenter_TrajPointACCObj23_TrajPointACCObj23_TrajEnd_b_SetVt
{
    if(getValue(E_pric_RadarFrontCenter_TrajPointACCObj23_TrajPointACCObj23_TrajEnd_b_SetVt))
    {
        //update the signal value
        Msg_TrajPointACCObj23.TrajPointACCObj23_TrajEnd_b=getvalue(E_pric_RadarFrontCenter_TrajPointACCObj23_TrajPointACCObj23_TrajEnd_b_Vt);
    }
    else
    {
        Msg_TrajPointACCObj23.TrajPointACCObj23_TrajEnd_b=getValue(E_pric_RadarFrontCenter_TrajPointACCObj23_TrajPointACCObj23_TrajEnd_b_Rv);
    }
}
 
on envVar E_pric_RadarFrontCenter_TrajPointACCObj23_TrajPointACCObj23_dVarXv_uw_Rv
{
    qword rawValue = 0ll;
    float rawValue_float = 0.0;
    float phyValue = 0.0;        

    //set the signal with updated raw value
    {
        rawValue = getvalue(this);
        if(chgEv_TrajPointACCObj23_TrajPointACCObj23_dVarXv_uw == 0)
        {
            //type conversion to float
            rawValue_float = rawValue;        
            // raw to physical conversion
            phyValue = ((rawValue_float *0.00195313)+(0));
            putValue(E_pric_RadarFrontCenter_TrajPointACCObj23_TrajPointACCObj23_dVarXv_uw_Pv, phyValue);
            chgEv_TrajPointACCObj23_TrajPointACCObj23_dVarXv_uw = 1;
        }
        else
        {
            chgEv_TrajPointACCObj23_TrajPointACCObj23_dVarXv_uw = 0;
        }    
        //update the signal value
        Msg_TrajPointACCObj23.TrajPointACCObj23_dVarXv_uw=rawValue;        
    }                                                                           
}

on envVar E_pric_RadarFrontCenter_TrajPointACCObj23_TrajPointACCObj23_dVarXv_uw_Pv
{
    qword rawValue = 0ll;
    float phyValue = 0.0;
    
    //update the raw value with physical value 
    {
        if(chgEv_TrajPointACCObj23_TrajPointACCObj23_dVarXv_uw == 0)
        {
            phyValue = getvalue(this);
            // physical to raw conversion
            rawValue = ((phyValue -(0))/0.00195313);
            putValue(E_pric_RadarFrontCenter_TrajPointACCObj23_TrajPointACCObj23_dVarXv_uw_Rv, rawValue);
            chgEv_TrajPointACCObj23_TrajPointACCObj23_dVarXv_uw = 1;  
        }
        else
        {
            chgEv_TrajPointACCObj23_TrajPointACCObj23_dVarXv_uw = 0;
        }
    }
}


 
on envVar E_pric_RadarFrontCenter_TrajPointACCObj23_TrajPointACCObj23_wExistProb_ub_Rv
{
    qword rawValue = 0ll;
    float rawValue_float = 0.0;
    float phyValue = 0.0;        

    //set the signal with updated raw value
    {
        rawValue = getvalue(this);
        if(chgEv_TrajPointACCObj23_TrajPointACCObj23_wExistProb_ub == 0)
        {
            //type conversion to float
            rawValue_float = rawValue;        
            // raw to physical conversion
            phyValue = ((rawValue_float *0.00390625)+(0));
            putValue(E_pric_RadarFrontCenter_TrajPointACCObj23_TrajPointACCObj23_wExistProb_ub_Pv, phyValue);
            chgEv_TrajPointACCObj23_TrajPointACCObj23_wExistProb_ub = 1;
        }
        else
        {
            chgEv_TrajPointACCObj23_TrajPointACCObj23_wExistProb_ub = 0;
        }    
        //update the signal value
        Msg_TrajPointACCObj23.TrajPointACCObj23_wExistProb_ub=rawValue;        
    }                                                                           
}

on envVar E_pric_RadarFrontCenter_TrajPointACCObj23_TrajPointACCObj23_wExistProb_ub_Pv
{
    qword rawValue = 0ll;
    float phyValue = 0.0;
    
    //update the raw value with physical value 
    {
        if(chgEv_TrajPointACCObj23_TrajPointACCObj23_wExistProb_ub == 0)
        {
            phyValue = getvalue(this);
            // physical to raw conversion
            rawValue = ((phyValue -(0))/0.00390625);
            putValue(E_pric_RadarFrontCenter_TrajPointACCObj23_TrajPointACCObj23_wExistProb_ub_Rv, rawValue);
            chgEv_TrajPointACCObj23_TrajPointACCObj23_wExistProb_ub = 1;  
        }
        else
        {
            chgEv_TrajPointACCObj23_TrajPointACCObj23_wExistProb_ub = 0;
        }
    }
}


 
on envVar E_pric_RadarFrontCenter_TrajPointACCObj23_TrajPointACCObj23_dxv_sw_Rv
{
    qword rawValue = 0ll;
    float rawValue_float = 0.0;
    float phyValue = 0.0;        

    //set the signal with updated raw value
    {
        rawValue = getvalue(this);
        if(chgEv_TrajPointACCObj23_TrajPointACCObj23_dxv_sw == 0)
        {
            //type conversion to float
            rawValue_float = rawValue;        
            // raw to physical conversion
            phyValue = ((rawValue_float *0.0078125)+(0));
            putValue(E_pric_RadarFrontCenter_TrajPointACCObj23_TrajPointACCObj23_dxv_sw_Pv, phyValue);
            chgEv_TrajPointACCObj23_TrajPointACCObj23_dxv_sw = 1;
        }
        else
        {
            chgEv_TrajPointACCObj23_TrajPointACCObj23_dxv_sw = 0;
        }    
        //update the signal value
        Msg_TrajPointACCObj23.TrajPointACCObj23_dxv_sw=rawValue;        
    }                                                                           
}

on envVar E_pric_RadarFrontCenter_TrajPointACCObj23_TrajPointACCObj23_dxv_sw_Pv
{
    qword rawValue = 0ll;
    float phyValue = 0.0;
    
    //update the raw value with physical value 
    {
        if(chgEv_TrajPointACCObj23_TrajPointACCObj23_dxv_sw == 0)
        {
            phyValue = getvalue(this);
            // physical to raw conversion
            rawValue = ((phyValue -(0))/0.0078125);
            putValue(E_pric_RadarFrontCenter_TrajPointACCObj23_TrajPointACCObj23_dxv_sw_Rv, rawValue);
            chgEv_TrajPointACCObj23_TrajPointACCObj23_dxv_sw = 1;  
        }
        else
        {
            chgEv_TrajPointACCObj23_TrajPointACCObj23_dxv_sw = 0;
        }
    }
}


 
on envVar E_pric_RadarFrontCenter_TrajPointACCObj23_TrajPointACCObj23_timestamp_Rv
{
    qword rawValue = 0ll;
    float rawValue_float = 0.0;
    float phyValue = 0.0;        

    //set the signal with updated raw value
    {
        rawValue = getvalue(this);
        if(chgEv_TrajPointACCObj23_TrajPointACCObj23_timestamp == 0)
        {
            //type conversion to float
            rawValue_float = rawValue;        
            // raw to physical conversion
            phyValue = ((rawValue_float *0.000488281)+(0));
            putValue(E_pric_RadarFrontCenter_TrajPointACCObj23_TrajPointACCObj23_timestamp_Pv, phyValue);
            chgEv_TrajPointACCObj23_TrajPointACCObj23_timestamp = 1;
        }
        else
        {
            chgEv_TrajPointACCObj23_TrajPointACCObj23_timestamp = 0;
        }    
        //update the signal value
        Msg_TrajPointACCObj23.TrajPointACCObj23_timestamp=rawValue;        
    }                                                                           
}

on envVar E_pric_RadarFrontCenter_TrajPointACCObj23_TrajPointACCObj23_timestamp_Pv
{
    qword rawValue = 0ll;
    float phyValue = 0.0;
    
    //update the raw value with physical value 
    {
        if(chgEv_TrajPointACCObj23_TrajPointACCObj23_timestamp == 0)
        {
            phyValue = getvalue(this);
            // physical to raw conversion
            rawValue = ((phyValue -(0))/0.000488281);
            putValue(E_pric_RadarFrontCenter_TrajPointACCObj23_TrajPointACCObj23_timestamp_Rv, rawValue);
            chgEv_TrajPointACCObj23_TrajPointACCObj23_timestamp = 1;  
        }
        else
        {
            chgEv_TrajPointACCObj23_TrajPointACCObj23_timestamp = 0;
        }
    }
}


 
on envVar E_pric_RadarFrontCenter_TrajPointACCObj23_TrajPointACCObj23_Drive_b_Rv
{
    qword rawValue = 0ll;
    float rawValue_float = 0.0;
    float phyValue = 0.0;        

    //set the signal with updated raw value
    if(getValue(E_pric_RadarFrontCenter_TrajPointACCObj23_TrajPointACCObj23_Drive_b_SetVt)==0)
    {
        rawValue = getvalue(this);
        if(chgEv_TrajPointACCObj23_TrajPointACCObj23_Drive_b == 0)
        {
            //type conversion to float
            rawValue_float = rawValue;        
            // raw to physical conversion
            phyValue = ((rawValue_float *1)+(0));
            putValue(E_pric_RadarFrontCenter_TrajPointACCObj23_TrajPointACCObj23_Drive_b_Pv, phyValue);
            chgEv_TrajPointACCObj23_TrajPointACCObj23_Drive_b = 1;
        }
        else
        {
            chgEv_TrajPointACCObj23_TrajPointACCObj23_Drive_b = 0;
        }    
        //update the signal value
        Msg_TrajPointACCObj23.TrajPointACCObj23_Drive_b=rawValue;        
    }                                                                           
}

on envVar E_pric_RadarFrontCenter_TrajPointACCObj23_TrajPointACCObj23_Drive_b_Pv
{
    qword rawValue = 0ll;
    float phyValue = 0.0;
    
    //update the raw value with physical value 
    if(getValue(E_pric_RadarFrontCenter_TrajPointACCObj23_TrajPointACCObj23_Drive_b_SetVt)==0)
    {
        if(chgEv_TrajPointACCObj23_TrajPointACCObj23_Drive_b == 0)
        {
            phyValue = getvalue(this);
            // physical to raw conversion
            rawValue = ((phyValue -(0))/1);
            putValue(E_pric_RadarFrontCenter_TrajPointACCObj23_TrajPointACCObj23_Drive_b_Rv, rawValue);
            chgEv_TrajPointACCObj23_TrajPointACCObj23_Drive_b = 1;  
        }
        else
        {
            chgEv_TrajPointACCObj23_TrajPointACCObj23_Drive_b = 0;
        }
    }
}

on envVar E_pric_RadarFrontCenter_TrajPointACCObj23_TrajPointACCObj23_Drive_b_Vt
{
    qword rawValue = 0ll;
    if(getValue(E_pric_RadarFrontCenter_TrajPointACCObj23_TrajPointACCObj23_Drive_b_SetVt))
    {
        //update the signal value
        Msg_TrajPointACCObj23.TrajPointACCObj23_Drive_b=getValue(this);
    }
}

on envVar E_pric_RadarFrontCenter_TrajPointACCObj23_TrajPointACCObj23_Drive_b_SetVt
{
    if(getValue(E_pric_RadarFrontCenter_TrajPointACCObj23_TrajPointACCObj23_Drive_b_SetVt))
    {
        //update the signal value
        Msg_TrajPointACCObj23.TrajPointACCObj23_Drive_b=getvalue(E_pric_RadarFrontCenter_TrajPointACCObj23_TrajPointACCObj23_Drive_b_Vt);
    }
    else
    {
        Msg_TrajPointACCObj23.TrajPointACCObj23_Drive_b=getValue(E_pric_RadarFrontCenter_TrajPointACCObj23_TrajPointACCObj23_Drive_b_Rv);
    }
}
 
on envVar E_pric_RadarFrontCenter_TrajPointACCObj20_tx
{
    if(getValue(this))
    {       
        
        //update the BZ Signal
        if(TrajPointACCObj20_TrajPointACCObj20_blockCtr_wrongvalctr == 0)
        {
            update_TrajPointACCObj20_TrajPointACCObj20_blockCtr_counter();
            Msg_TrajPointACCObj20.TrajPointACCObj20_blockCtr= TrajPointACCObj20_TrajPointACCObj20_blockCtr_counter;
        }
        else if(TrajPointACCObj20_TrajPointACCObj20_blockCtr_wrongvalctr > 0)
        {
             TrajPointACCObj20_TrajPointACCObj20_blockCtr_wrongvalctr--;
              // if counter becomes zero, update panel controller to zero
             if(TrajPointACCObj20_TrajPointACCObj20_blockCtr_wrongvalctr == 0)
             {
                 putValue(E_pric_RadarFrontCenter_TrajPointACCObj20_TrajPointACCObj20_blockCtr_wrongvalctr,0);
             }
        }
        else
        {
            //do nothing
        }        
        //update the BZ Signal
        if(TrajPointACCObj20_TrajPointACCObj20_MsgCtr_wrongvalctr == 0)
        {
            update_TrajPointACCObj20_TrajPointACCObj20_MsgCtr_counter();
            Msg_TrajPointACCObj20.TrajPointACCObj20_MsgCtr= TrajPointACCObj20_TrajPointACCObj20_MsgCtr_counter;
        }
        else if(TrajPointACCObj20_TrajPointACCObj20_MsgCtr_wrongvalctr > 0)
        {
             TrajPointACCObj20_TrajPointACCObj20_MsgCtr_wrongvalctr--;
              // if counter becomes zero, update panel controller to zero
             if(TrajPointACCObj20_TrajPointACCObj20_MsgCtr_wrongvalctr == 0)
             {
                 putValue(E_pric_RadarFrontCenter_TrajPointACCObj20_TrajPointACCObj20_MsgCtr_wrongvalctr,0);
             }
        }
        else
        {
            //do nothing
        }        
        //calculate the CRC checksum
        update_TrajPointACCObj20_ChkSum_Checksum();

        output(Msg_TrajPointACCObj20);        
    }
}

on envVar E_pric_RadarFrontCenter_TrajPointACCObj20_Range
{
    qword rawstatus = 0ll;
    qword rawValue = 0ll;    
    
    rawstatus = getvalue(this);    
    // set all the signals with min raw /max raw /init raw
    switch (rawstatus) 
    {
     case(0) :
        rawValue= 0;
        putValue(E_pric_RadarFrontCenter_TrajPointACCObj20_TrajPointACCObj20_TrajEnd_b_Rv, rawValue);
        rawValue= 0;
        putValue(E_pric_RadarFrontCenter_TrajPointACCObj20_TrajPointACCObj20_dVarXv_uw_Rv, rawValue);
        rawValue= 0;
        putValue(E_pric_RadarFrontCenter_TrajPointACCObj20_TrajPointACCObj20_Valid_b_Rv, rawValue);
        rawValue= 0;
        putValue(E_pric_RadarFrontCenter_TrajPointACCObj20_TrajPointACCObj20_Drive_b_Rv, rawValue);
        rawValue= 0;
        putValue(E_pric_RadarFrontCenter_TrajPointACCObj20_TrajPointACCObj20_Stand_b_Rv, rawValue);
        rawValue= -32768;
        putValue(E_pric_RadarFrontCenter_TrajPointACCObj20_TrajPointACCObj20_dxv_sw_Rv, rawValue);
        rawValue= 0;
        putValue(E_pric_RadarFrontCenter_TrajPointACCObj20_TrajPointACCObj20_dVarYv_uw_Rv, rawValue);
        rawValue= 0;
        putValue(E_pric_RadarFrontCenter_TrajPointACCObj20_TrajPointACCObj20_InvDir_b_Rv, rawValue);
        rawValue= 0;
        putValue(E_pric_RadarFrontCenter_TrajPointACCObj20_TrajPointACCObj20_wExistProb_ub_Rv, rawValue);
        rawValue= 0;
        putValue(E_pric_RadarFrontCenter_TrajPointACCObj20_TrajPointACCObj20_timestamp_Rv, rawValue);
        rawValue= -32768;
        putValue(E_pric_RadarFrontCenter_TrajPointACCObj20_TrajPointACCObj20_dyv_sw_Rv, rawValue);
        rawValue= 0;
        putValue(E_pric_RadarFrontCenter_TrajPointACCObj20_TrajPointACCObj20_Stopped_b_Rv, rawValue);
        break;
     case(1) :
        rawValue= 1;
        putValue(E_pric_RadarFrontCenter_TrajPointACCObj20_TrajPointACCObj20_TrajEnd_b_Rv, rawValue);
        rawValue= 65534;
        putValue(E_pric_RadarFrontCenter_TrajPointACCObj20_TrajPointACCObj20_dVarXv_uw_Rv, rawValue);
        rawValue= 1;
        putValue(E_pric_RadarFrontCenter_TrajPointACCObj20_TrajPointACCObj20_Valid_b_Rv, rawValue);
        rawValue= 1;
        putValue(E_pric_RadarFrontCenter_TrajPointACCObj20_TrajPointACCObj20_Drive_b_Rv, rawValue);
        rawValue= 1;
        putValue(E_pric_RadarFrontCenter_TrajPointACCObj20_TrajPointACCObj20_Stand_b_Rv, rawValue);
        rawValue= 32767;
        putValue(E_pric_RadarFrontCenter_TrajPointACCObj20_TrajPointACCObj20_dxv_sw_Rv, rawValue);
        rawValue= 65534;
        putValue(E_pric_RadarFrontCenter_TrajPointACCObj20_TrajPointACCObj20_dVarYv_uw_Rv, rawValue);
        rawValue= 1;
        putValue(E_pric_RadarFrontCenter_TrajPointACCObj20_TrajPointACCObj20_InvDir_b_Rv, rawValue);
        rawValue= 255;
        putValue(E_pric_RadarFrontCenter_TrajPointACCObj20_TrajPointACCObj20_wExistProb_ub_Rv, rawValue);
        rawValue= 65536;
        putValue(E_pric_RadarFrontCenter_TrajPointACCObj20_TrajPointACCObj20_timestamp_Rv, rawValue);
        rawValue= 32767;
        putValue(E_pric_RadarFrontCenter_TrajPointACCObj20_TrajPointACCObj20_dyv_sw_Rv, rawValue);
        rawValue= 1;
        putValue(E_pric_RadarFrontCenter_TrajPointACCObj20_TrajPointACCObj20_Stopped_b_Rv, rawValue);
        break;
     default :
        rawValue= 0;
        putValue(E_pric_RadarFrontCenter_TrajPointACCObj20_TrajPointACCObj20_TrajEnd_b_Rv, rawValue);
        rawValue= 0;
        putValue(E_pric_RadarFrontCenter_TrajPointACCObj20_TrajPointACCObj20_dVarXv_uw_Rv, rawValue);
        rawValue= 0;
        putValue(E_pric_RadarFrontCenter_TrajPointACCObj20_TrajPointACCObj20_Valid_b_Rv, rawValue);
        rawValue= 0;
        putValue(E_pric_RadarFrontCenter_TrajPointACCObj20_TrajPointACCObj20_Drive_b_Rv, rawValue);
        rawValue= 0;
        putValue(E_pric_RadarFrontCenter_TrajPointACCObj20_TrajPointACCObj20_Stand_b_Rv, rawValue);
        rawValue= -32768;
        putValue(E_pric_RadarFrontCenter_TrajPointACCObj20_TrajPointACCObj20_dxv_sw_Rv, rawValue);
        rawValue= 0;
        putValue(E_pric_RadarFrontCenter_TrajPointACCObj20_TrajPointACCObj20_dVarYv_uw_Rv, rawValue);
        rawValue= 0;
        putValue(E_pric_RadarFrontCenter_TrajPointACCObj20_TrajPointACCObj20_InvDir_b_Rv, rawValue);
        rawValue= 0;
        putValue(E_pric_RadarFrontCenter_TrajPointACCObj20_TrajPointACCObj20_wExistProb_ub_Rv, rawValue);
        rawValue= 0;
        putValue(E_pric_RadarFrontCenter_TrajPointACCObj20_TrajPointACCObj20_timestamp_Rv, rawValue);
        rawValue= -32768;
        putValue(E_pric_RadarFrontCenter_TrajPointACCObj20_TrajPointACCObj20_dyv_sw_Rv, rawValue);
        rawValue= 0;
        putValue(E_pric_RadarFrontCenter_TrajPointACCObj20_TrajPointACCObj20_Stopped_b_Rv, rawValue);
      break;
   }
}

on envVar E_pric_RadarFrontCenter_TrajPointACCObj20_Dlc
{
    if(getValue(E_pric_RadarFrontCenter_TrajPointACCObj20_enDlc))
    {
        Msg_TrajPointACCObj20.dlc =getValue(this);
    }
    else
    {
       Dbc_dlc = 16;
	   Msg_TrajPointACCObj20.dlc = Calc_Canfd_dlc(Dbc_dlc);
	   	
  }
}

on envVar E_pric_RadarFrontCenter_TrajPointACCObj20_enDlc
{
    //For Messages with DLC = 8, set wrong DLC to smaller than defined DLC
    //For Messages with DLC < 8 set wrong DLC to smaller/longer than defined DLC
    if(getValue(this))
    {
        Msg_TrajPointACCObj20.dlc =getValue(E_pric_RadarFrontCenter_TrajPointACCObj20_Dlc);
    }
    else
    {
       Dbc_dlc = 16;
	   Msg_TrajPointACCObj20.dlc = Calc_Canfd_dlc(Dbc_dlc);
			
    }
}

on envVar E_pric_RadarFrontCenter_TrajPointACCObj20_TrajPointACCObj20_CRC_wrongvalctr
{
    //update disturb count
    //disturb value range:(-1 = always send wrong value),( X>0 ,x is the number of Messages with wrong CHK sent)
    TrajPointACCObj20_TrajPointACCObj20_CRC_wrongvalctr =getValue(this);    
}
on envVar E_pric_RadarFrontCenter_TrajPointACCObj20_TrajPointACCObj20_MsgCtr_wrongvalctr
{
    //update disturb count
    //disturb value range:(-1 = always send wrong value),( X>0 ,x is the number of Messages with wrong CHK sent)
    TrajPointACCObj20_TrajPointACCObj20_MsgCtr_wrongvalctr =getValue(this);    
}
on envVar E_pric_RadarFrontCenter_TrajPointACCObj20_TrajPointACCObj20_blockCtr_wrongvalctr
{
    //update disturb count
    //disturb value range:(-1 = always send wrong value),( X>0 ,x is the number of Messages with wrong CHK sent)
    TrajPointACCObj20_TrajPointACCObj20_blockCtr_wrongvalctr =getValue(this);    
}

on envVar E_pric_RadarFrontCenter_TrajPointACCObj20_TrajPointACCObj20_TrajEnd_b_Rv
{
    qword rawValue = 0ll;
    float rawValue_float = 0.0;
    float phyValue = 0.0;        

    //set the signal with updated raw value
    if(getValue(E_pric_RadarFrontCenter_TrajPointACCObj20_TrajPointACCObj20_TrajEnd_b_SetVt)==0)
    {
        rawValue = getvalue(this);
        if(chgEv_TrajPointACCObj20_TrajPointACCObj20_TrajEnd_b == 0)
        {
            //type conversion to float
            rawValue_float = rawValue;        
            // raw to physical conversion
            phyValue = ((rawValue_float *1)+(0));
            putValue(E_pric_RadarFrontCenter_TrajPointACCObj20_TrajPointACCObj20_TrajEnd_b_Pv, phyValue);
            chgEv_TrajPointACCObj20_TrajPointACCObj20_TrajEnd_b = 1;
        }
        else
        {
            chgEv_TrajPointACCObj20_TrajPointACCObj20_TrajEnd_b = 0;
        }    
        //update the signal value
        Msg_TrajPointACCObj20.TrajPointACCObj20_TrajEnd_b=rawValue;        
    }                                                                           
}

on envVar E_pric_RadarFrontCenter_TrajPointACCObj20_TrajPointACCObj20_TrajEnd_b_Pv
{
    qword rawValue = 0ll;
    float phyValue = 0.0;
    
    //update the raw value with physical value 
    if(getValue(E_pric_RadarFrontCenter_TrajPointACCObj20_TrajPointACCObj20_TrajEnd_b_SetVt)==0)
    {
        if(chgEv_TrajPointACCObj20_TrajPointACCObj20_TrajEnd_b == 0)
        {
            phyValue = getvalue(this);
            // physical to raw conversion
            rawValue = ((phyValue -(0))/1);
            putValue(E_pric_RadarFrontCenter_TrajPointACCObj20_TrajPointACCObj20_TrajEnd_b_Rv, rawValue);
            chgEv_TrajPointACCObj20_TrajPointACCObj20_TrajEnd_b = 1;  
        }
        else
        {
            chgEv_TrajPointACCObj20_TrajPointACCObj20_TrajEnd_b = 0;
        }
    }
}

on envVar E_pric_RadarFrontCenter_TrajPointACCObj20_TrajPointACCObj20_TrajEnd_b_Vt
{
    qword rawValue = 0ll;
    if(getValue(E_pric_RadarFrontCenter_TrajPointACCObj20_TrajPointACCObj20_TrajEnd_b_SetVt))
    {
        //update the signal value
        Msg_TrajPointACCObj20.TrajPointACCObj20_TrajEnd_b=getValue(this);
    }
}

on envVar E_pric_RadarFrontCenter_TrajPointACCObj20_TrajPointACCObj20_TrajEnd_b_SetVt
{
    if(getValue(E_pric_RadarFrontCenter_TrajPointACCObj20_TrajPointACCObj20_TrajEnd_b_SetVt))
    {
        //update the signal value
        Msg_TrajPointACCObj20.TrajPointACCObj20_TrajEnd_b=getvalue(E_pric_RadarFrontCenter_TrajPointACCObj20_TrajPointACCObj20_TrajEnd_b_Vt);
    }
    else
    {
        Msg_TrajPointACCObj20.TrajPointACCObj20_TrajEnd_b=getValue(E_pric_RadarFrontCenter_TrajPointACCObj20_TrajPointACCObj20_TrajEnd_b_Rv);
    }
}
 
on envVar E_pric_RadarFrontCenter_TrajPointACCObj20_TrajPointACCObj20_dVarXv_uw_Rv
{
    qword rawValue = 0ll;
    float rawValue_float = 0.0;
    float phyValue = 0.0;        

    //set the signal with updated raw value
    {
        rawValue = getvalue(this);
        if(chgEv_TrajPointACCObj20_TrajPointACCObj20_dVarXv_uw == 0)
        {
            //type conversion to float
            rawValue_float = rawValue;        
            // raw to physical conversion
            phyValue = ((rawValue_float *0.00195313)+(0));
            putValue(E_pric_RadarFrontCenter_TrajPointACCObj20_TrajPointACCObj20_dVarXv_uw_Pv, phyValue);
            chgEv_TrajPointACCObj20_TrajPointACCObj20_dVarXv_uw = 1;
        }
        else
        {
            chgEv_TrajPointACCObj20_TrajPointACCObj20_dVarXv_uw = 0;
        }    
        //update the signal value
        Msg_TrajPointACCObj20.TrajPointACCObj20_dVarXv_uw=rawValue;        
    }                                                                           
}

on envVar E_pric_RadarFrontCenter_TrajPointACCObj20_TrajPointACCObj20_dVarXv_uw_Pv
{
    qword rawValue = 0ll;
    float phyValue = 0.0;
    
    //update the raw value with physical value 
    {
        if(chgEv_TrajPointACCObj20_TrajPointACCObj20_dVarXv_uw == 0)
        {
            phyValue = getvalue(this);
            // physical to raw conversion
            rawValue = ((phyValue -(0))/0.00195313);
            putValue(E_pric_RadarFrontCenter_TrajPointACCObj20_TrajPointACCObj20_dVarXv_uw_Rv, rawValue);
            chgEv_TrajPointACCObj20_TrajPointACCObj20_dVarXv_uw = 1;  
        }
        else
        {
            chgEv_TrajPointACCObj20_TrajPointACCObj20_dVarXv_uw = 0;
        }
    }
}


 
on envVar E_pric_RadarFrontCenter_TrajPointACCObj20_TrajPointACCObj20_Valid_b_Rv
{
    qword rawValue = 0ll;
    float rawValue_float = 0.0;
    float phyValue = 0.0;        

    //set the signal with updated raw value
    if(getValue(E_pric_RadarFrontCenter_TrajPointACCObj20_TrajPointACCObj20_Valid_b_SetVt)==0)
    {
        rawValue = getvalue(this);
        if(chgEv_TrajPointACCObj20_TrajPointACCObj20_Valid_b == 0)
        {
            //type conversion to float
            rawValue_float = rawValue;        
            // raw to physical conversion
            phyValue = ((rawValue_float *1)+(0));
            putValue(E_pric_RadarFrontCenter_TrajPointACCObj20_TrajPointACCObj20_Valid_b_Pv, phyValue);
            chgEv_TrajPointACCObj20_TrajPointACCObj20_Valid_b = 1;
        }
        else
        {
            chgEv_TrajPointACCObj20_TrajPointACCObj20_Valid_b = 0;
        }    
        //update the signal value
        Msg_TrajPointACCObj20.TrajPointACCObj20_Valid_b=rawValue;        
    }                                                                           
}

on envVar E_pric_RadarFrontCenter_TrajPointACCObj20_TrajPointACCObj20_Valid_b_Pv
{
    qword rawValue = 0ll;
    float phyValue = 0.0;
    
    //update the raw value with physical value 
    if(getValue(E_pric_RadarFrontCenter_TrajPointACCObj20_TrajPointACCObj20_Valid_b_SetVt)==0)
    {
        if(chgEv_TrajPointACCObj20_TrajPointACCObj20_Valid_b == 0)
        {
            phyValue = getvalue(this);
            // physical to raw conversion
            rawValue = ((phyValue -(0))/1);
            putValue(E_pric_RadarFrontCenter_TrajPointACCObj20_TrajPointACCObj20_Valid_b_Rv, rawValue);
            chgEv_TrajPointACCObj20_TrajPointACCObj20_Valid_b = 1;  
        }
        else
        {
            chgEv_TrajPointACCObj20_TrajPointACCObj20_Valid_b = 0;
        }
    }
}

on envVar E_pric_RadarFrontCenter_TrajPointACCObj20_TrajPointACCObj20_Valid_b_Vt
{
    qword rawValue = 0ll;
    if(getValue(E_pric_RadarFrontCenter_TrajPointACCObj20_TrajPointACCObj20_Valid_b_SetVt))
    {
        //update the signal value
        Msg_TrajPointACCObj20.TrajPointACCObj20_Valid_b=getValue(this);
    }
}

on envVar E_pric_RadarFrontCenter_TrajPointACCObj20_TrajPointACCObj20_Valid_b_SetVt
{
    if(getValue(E_pric_RadarFrontCenter_TrajPointACCObj20_TrajPointACCObj20_Valid_b_SetVt))
    {
        //update the signal value
        Msg_TrajPointACCObj20.TrajPointACCObj20_Valid_b=getvalue(E_pric_RadarFrontCenter_TrajPointACCObj20_TrajPointACCObj20_Valid_b_Vt);
    }
    else
    {
        Msg_TrajPointACCObj20.TrajPointACCObj20_Valid_b=getValue(E_pric_RadarFrontCenter_TrajPointACCObj20_TrajPointACCObj20_Valid_b_Rv);
    }
}
 
on envVar E_pric_RadarFrontCenter_TrajPointACCObj20_TrajPointACCObj20_Drive_b_Rv
{
    qword rawValue = 0ll;
    float rawValue_float = 0.0;
    float phyValue = 0.0;        

    //set the signal with updated raw value
    if(getValue(E_pric_RadarFrontCenter_TrajPointACCObj20_TrajPointACCObj20_Drive_b_SetVt)==0)
    {
        rawValue = getvalue(this);
        if(chgEv_TrajPointACCObj20_TrajPointACCObj20_Drive_b == 0)
        {
            //type conversion to float
            rawValue_float = rawValue;        
            // raw to physical conversion
            phyValue = ((rawValue_float *1)+(0));
            putValue(E_pric_RadarFrontCenter_TrajPointACCObj20_TrajPointACCObj20_Drive_b_Pv, phyValue);
            chgEv_TrajPointACCObj20_TrajPointACCObj20_Drive_b = 1;
        }
        else
        {
            chgEv_TrajPointACCObj20_TrajPointACCObj20_Drive_b = 0;
        }    
        //update the signal value
        Msg_TrajPointACCObj20.TrajPointACCObj20_Drive_b=rawValue;        
    }                                                                           
}

on envVar E_pric_RadarFrontCenter_TrajPointACCObj20_TrajPointACCObj20_Drive_b_Pv
{
    qword rawValue = 0ll;
    float phyValue = 0.0;
    
    //update the raw value with physical value 
    if(getValue(E_pric_RadarFrontCenter_TrajPointACCObj20_TrajPointACCObj20_Drive_b_SetVt)==0)
    {
        if(chgEv_TrajPointACCObj20_TrajPointACCObj20_Drive_b == 0)
        {
            phyValue = getvalue(this);
            // physical to raw conversion
            rawValue = ((phyValue -(0))/1);
            putValue(E_pric_RadarFrontCenter_TrajPointACCObj20_TrajPointACCObj20_Drive_b_Rv, rawValue);
            chgEv_TrajPointACCObj20_TrajPointACCObj20_Drive_b = 1;  
        }
        else
        {
            chgEv_TrajPointACCObj20_TrajPointACCObj20_Drive_b = 0;
        }
    }
}

on envVar E_pric_RadarFrontCenter_TrajPointACCObj20_TrajPointACCObj20_Drive_b_Vt
{
    qword rawValue = 0ll;
    if(getValue(E_pric_RadarFrontCenter_TrajPointACCObj20_TrajPointACCObj20_Drive_b_SetVt))
    {
        //update the signal value
        Msg_TrajPointACCObj20.TrajPointACCObj20_Drive_b=getValue(this);
    }
}

on envVar E_pric_RadarFrontCenter_TrajPointACCObj20_TrajPointACCObj20_Drive_b_SetVt
{
    if(getValue(E_pric_RadarFrontCenter_TrajPointACCObj20_TrajPointACCObj20_Drive_b_SetVt))
    {
        //update the signal value
        Msg_TrajPointACCObj20.TrajPointACCObj20_Drive_b=getvalue(E_pric_RadarFrontCenter_TrajPointACCObj20_TrajPointACCObj20_Drive_b_Vt);
    }
    else
    {
        Msg_TrajPointACCObj20.TrajPointACCObj20_Drive_b=getValue(E_pric_RadarFrontCenter_TrajPointACCObj20_TrajPointACCObj20_Drive_b_Rv);
    }
}
 
on envVar E_pric_RadarFrontCenter_TrajPointACCObj20_TrajPointACCObj20_Stand_b_Rv
{
    qword rawValue = 0ll;
    float rawValue_float = 0.0;
    float phyValue = 0.0;        

    //set the signal with updated raw value
    if(getValue(E_pric_RadarFrontCenter_TrajPointACCObj20_TrajPointACCObj20_Stand_b_SetVt)==0)
    {
        rawValue = getvalue(this);
        if(chgEv_TrajPointACCObj20_TrajPointACCObj20_Stand_b == 0)
        {
            //type conversion to float
            rawValue_float = rawValue;        
            // raw to physical conversion
            phyValue = ((rawValue_float *1)+(0));
            putValue(E_pric_RadarFrontCenter_TrajPointACCObj20_TrajPointACCObj20_Stand_b_Pv, phyValue);
            chgEv_TrajPointACCObj20_TrajPointACCObj20_Stand_b = 1;
        }
        else
        {
            chgEv_TrajPointACCObj20_TrajPointACCObj20_Stand_b = 0;
        }    
        //update the signal value
        Msg_TrajPointACCObj20.TrajPointACCObj20_Stand_b=rawValue;        
    }                                                                           
}

on envVar E_pric_RadarFrontCenter_TrajPointACCObj20_TrajPointACCObj20_Stand_b_Pv
{
    qword rawValue = 0ll;
    float phyValue = 0.0;
    
    //update the raw value with physical value 
    if(getValue(E_pric_RadarFrontCenter_TrajPointACCObj20_TrajPointACCObj20_Stand_b_SetVt)==0)
    {
        if(chgEv_TrajPointACCObj20_TrajPointACCObj20_Stand_b == 0)
        {
            phyValue = getvalue(this);
            // physical to raw conversion
            rawValue = ((phyValue -(0))/1);
            putValue(E_pric_RadarFrontCenter_TrajPointACCObj20_TrajPointACCObj20_Stand_b_Rv, rawValue);
            chgEv_TrajPointACCObj20_TrajPointACCObj20_Stand_b = 1;  
        }
        else
        {
            chgEv_TrajPointACCObj20_TrajPointACCObj20_Stand_b = 0;
        }
    }
}

on envVar E_pric_RadarFrontCenter_TrajPointACCObj20_TrajPointACCObj20_Stand_b_Vt
{
    qword rawValue = 0ll;
    if(getValue(E_pric_RadarFrontCenter_TrajPointACCObj20_TrajPointACCObj20_Stand_b_SetVt))
    {
        //update the signal value
        Msg_TrajPointACCObj20.TrajPointACCObj20_Stand_b=getValue(this);
    }
}

on envVar E_pric_RadarFrontCenter_TrajPointACCObj20_TrajPointACCObj20_Stand_b_SetVt
{
    if(getValue(E_pric_RadarFrontCenter_TrajPointACCObj20_TrajPointACCObj20_Stand_b_SetVt))
    {
        //update the signal value
        Msg_TrajPointACCObj20.TrajPointACCObj20_Stand_b=getvalue(E_pric_RadarFrontCenter_TrajPointACCObj20_TrajPointACCObj20_Stand_b_Vt);
    }
    else
    {
        Msg_TrajPointACCObj20.TrajPointACCObj20_Stand_b=getValue(E_pric_RadarFrontCenter_TrajPointACCObj20_TrajPointACCObj20_Stand_b_Rv);
    }
}
 
on envVar E_pric_RadarFrontCenter_TrajPointACCObj20_TrajPointACCObj20_dxv_sw_Rv
{
    qword rawValue = 0ll;
    float rawValue_float = 0.0;
    float phyValue = 0.0;        

    //set the signal with updated raw value
    {
        rawValue = getvalue(this);
        if(chgEv_TrajPointACCObj20_TrajPointACCObj20_dxv_sw == 0)
        {
            //type conversion to float
            rawValue_float = rawValue;        
            // raw to physical conversion
            phyValue = ((rawValue_float *0.0078125)+(0));
            putValue(E_pric_RadarFrontCenter_TrajPointACCObj20_TrajPointACCObj20_dxv_sw_Pv, phyValue);
            chgEv_TrajPointACCObj20_TrajPointACCObj20_dxv_sw = 1;
        }
        else
        {
            chgEv_TrajPointACCObj20_TrajPointACCObj20_dxv_sw = 0;
        }    
        //update the signal value
        Msg_TrajPointACCObj20.TrajPointACCObj20_dxv_sw=rawValue;        
    }                                                                           
}

on envVar E_pric_RadarFrontCenter_TrajPointACCObj20_TrajPointACCObj20_dxv_sw_Pv
{
    qword rawValue = 0ll;
    float phyValue = 0.0;
    
    //update the raw value with physical value 
    {
        if(chgEv_TrajPointACCObj20_TrajPointACCObj20_dxv_sw == 0)
        {
            phyValue = getvalue(this);
            // physical to raw conversion
            rawValue = ((phyValue -(0))/0.0078125);
            putValue(E_pric_RadarFrontCenter_TrajPointACCObj20_TrajPointACCObj20_dxv_sw_Rv, rawValue);
            chgEv_TrajPointACCObj20_TrajPointACCObj20_dxv_sw = 1;  
        }
        else
        {
            chgEv_TrajPointACCObj20_TrajPointACCObj20_dxv_sw = 0;
        }
    }
}


 
on envVar E_pric_RadarFrontCenter_TrajPointACCObj20_TrajPointACCObj20_dVarYv_uw_Rv
{
    qword rawValue = 0ll;
    float rawValue_float = 0.0;
    float phyValue = 0.0;        

    //set the signal with updated raw value
    {
        rawValue = getvalue(this);
        if(chgEv_TrajPointACCObj20_TrajPointACCObj20_dVarYv_uw == 0)
        {
            //type conversion to float
            rawValue_float = rawValue;        
            // raw to physical conversion
            phyValue = ((rawValue_float *0.00195313)+(0));
            putValue(E_pric_RadarFrontCenter_TrajPointACCObj20_TrajPointACCObj20_dVarYv_uw_Pv, phyValue);
            chgEv_TrajPointACCObj20_TrajPointACCObj20_dVarYv_uw = 1;
        }
        else
        {
            chgEv_TrajPointACCObj20_TrajPointACCObj20_dVarYv_uw = 0;
        }    
        //update the signal value
        Msg_TrajPointACCObj20.TrajPointACCObj20_dVarYv_uw=rawValue;        
    }                                                                           
}

on envVar E_pric_RadarFrontCenter_TrajPointACCObj20_TrajPointACCObj20_dVarYv_uw_Pv
{
    qword rawValue = 0ll;
    float phyValue = 0.0;
    
    //update the raw value with physical value 
    {
        if(chgEv_TrajPointACCObj20_TrajPointACCObj20_dVarYv_uw == 0)
        {
            phyValue = getvalue(this);
            // physical to raw conversion
            rawValue = ((phyValue -(0))/0.00195313);
            putValue(E_pric_RadarFrontCenter_TrajPointACCObj20_TrajPointACCObj20_dVarYv_uw_Rv, rawValue);
            chgEv_TrajPointACCObj20_TrajPointACCObj20_dVarYv_uw = 1;  
        }
        else
        {
            chgEv_TrajPointACCObj20_TrajPointACCObj20_dVarYv_uw = 0;
        }
    }
}


 
on envVar E_pric_RadarFrontCenter_TrajPointACCObj20_TrajPointACCObj20_InvDir_b_Rv
{
    qword rawValue = 0ll;
    float rawValue_float = 0.0;
    float phyValue = 0.0;        

    //set the signal with updated raw value
    if(getValue(E_pric_RadarFrontCenter_TrajPointACCObj20_TrajPointACCObj20_InvDir_b_SetVt)==0)
    {
        rawValue = getvalue(this);
        if(chgEv_TrajPointACCObj20_TrajPointACCObj20_InvDir_b == 0)
        {
            //type conversion to float
            rawValue_float = rawValue;        
            // raw to physical conversion
            phyValue = ((rawValue_float *1)+(0));
            putValue(E_pric_RadarFrontCenter_TrajPointACCObj20_TrajPointACCObj20_InvDir_b_Pv, phyValue);
            chgEv_TrajPointACCObj20_TrajPointACCObj20_InvDir_b = 1;
        }
        else
        {
            chgEv_TrajPointACCObj20_TrajPointACCObj20_InvDir_b = 0;
        }    
        //update the signal value
        Msg_TrajPointACCObj20.TrajPointACCObj20_InvDir_b=rawValue;        
    }                                                                           
}

on envVar E_pric_RadarFrontCenter_TrajPointACCObj20_TrajPointACCObj20_InvDir_b_Pv
{
    qword rawValue = 0ll;
    float phyValue = 0.0;
    
    //update the raw value with physical value 
    if(getValue(E_pric_RadarFrontCenter_TrajPointACCObj20_TrajPointACCObj20_InvDir_b_SetVt)==0)
    {
        if(chgEv_TrajPointACCObj20_TrajPointACCObj20_InvDir_b == 0)
        {
            phyValue = getvalue(this);
            // physical to raw conversion
            rawValue = ((phyValue -(0))/1);
            putValue(E_pric_RadarFrontCenter_TrajPointACCObj20_TrajPointACCObj20_InvDir_b_Rv, rawValue);
            chgEv_TrajPointACCObj20_TrajPointACCObj20_InvDir_b = 1;  
        }
        else
        {
            chgEv_TrajPointACCObj20_TrajPointACCObj20_InvDir_b = 0;
        }
    }
}

on envVar E_pric_RadarFrontCenter_TrajPointACCObj20_TrajPointACCObj20_InvDir_b_Vt
{
    qword rawValue = 0ll;
    if(getValue(E_pric_RadarFrontCenter_TrajPointACCObj20_TrajPointACCObj20_InvDir_b_SetVt))
    {
        //update the signal value
        Msg_TrajPointACCObj20.TrajPointACCObj20_InvDir_b=getValue(this);
    }
}

on envVar E_pric_RadarFrontCenter_TrajPointACCObj20_TrajPointACCObj20_InvDir_b_SetVt
{
    if(getValue(E_pric_RadarFrontCenter_TrajPointACCObj20_TrajPointACCObj20_InvDir_b_SetVt))
    {
        //update the signal value
        Msg_TrajPointACCObj20.TrajPointACCObj20_InvDir_b=getvalue(E_pric_RadarFrontCenter_TrajPointACCObj20_TrajPointACCObj20_InvDir_b_Vt);
    }
    else
    {
        Msg_TrajPointACCObj20.TrajPointACCObj20_InvDir_b=getValue(E_pric_RadarFrontCenter_TrajPointACCObj20_TrajPointACCObj20_InvDir_b_Rv);
    }
}
 
on envVar E_pric_RadarFrontCenter_TrajPointACCObj20_TrajPointACCObj20_wExistProb_ub_Rv
{
    qword rawValue = 0ll;
    float rawValue_float = 0.0;
    float phyValue = 0.0;        

    //set the signal with updated raw value
    {
        rawValue = getvalue(this);
        if(chgEv_TrajPointACCObj20_TrajPointACCObj20_wExistProb_ub == 0)
        {
            //type conversion to float
            rawValue_float = rawValue;        
            // raw to physical conversion
            phyValue = ((rawValue_float *0.00390625)+(0));
            putValue(E_pric_RadarFrontCenter_TrajPointACCObj20_TrajPointACCObj20_wExistProb_ub_Pv, phyValue);
            chgEv_TrajPointACCObj20_TrajPointACCObj20_wExistProb_ub = 1;
        }
        else
        {
            chgEv_TrajPointACCObj20_TrajPointACCObj20_wExistProb_ub = 0;
        }    
        //update the signal value
        Msg_TrajPointACCObj20.TrajPointACCObj20_wExistProb_ub=rawValue;        
    }                                                                           
}

on envVar E_pric_RadarFrontCenter_TrajPointACCObj20_TrajPointACCObj20_wExistProb_ub_Pv
{
    qword rawValue = 0ll;
    float phyValue = 0.0;
    
    //update the raw value with physical value 
    {
        if(chgEv_TrajPointACCObj20_TrajPointACCObj20_wExistProb_ub == 0)
        {
            phyValue = getvalue(this);
            // physical to raw conversion
            rawValue = ((phyValue -(0))/0.00390625);
            putValue(E_pric_RadarFrontCenter_TrajPointACCObj20_TrajPointACCObj20_wExistProb_ub_Rv, rawValue);
            chgEv_TrajPointACCObj20_TrajPointACCObj20_wExistProb_ub = 1;  
        }
        else
        {
            chgEv_TrajPointACCObj20_TrajPointACCObj20_wExistProb_ub = 0;
        }
    }
}


 
on envVar E_pric_RadarFrontCenter_TrajPointACCObj20_TrajPointACCObj20_timestamp_Rv
{
    qword rawValue = 0ll;
    float rawValue_float = 0.0;
    float phyValue = 0.0;        

    //set the signal with updated raw value
    {
        rawValue = getvalue(this);
        if(chgEv_TrajPointACCObj20_TrajPointACCObj20_timestamp == 0)
        {
            //type conversion to float
            rawValue_float = rawValue;        
            // raw to physical conversion
            phyValue = ((rawValue_float *0.000488281)+(0));
            putValue(E_pric_RadarFrontCenter_TrajPointACCObj20_TrajPointACCObj20_timestamp_Pv, phyValue);
            chgEv_TrajPointACCObj20_TrajPointACCObj20_timestamp = 1;
        }
        else
        {
            chgEv_TrajPointACCObj20_TrajPointACCObj20_timestamp = 0;
        }    
        //update the signal value
        Msg_TrajPointACCObj20.TrajPointACCObj20_timestamp=rawValue;        
    }                                                                           
}

on envVar E_pric_RadarFrontCenter_TrajPointACCObj20_TrajPointACCObj20_timestamp_Pv
{
    qword rawValue = 0ll;
    float phyValue = 0.0;
    
    //update the raw value with physical value 
    {
        if(chgEv_TrajPointACCObj20_TrajPointACCObj20_timestamp == 0)
        {
            phyValue = getvalue(this);
            // physical to raw conversion
            rawValue = ((phyValue -(0))/0.000488281);
            putValue(E_pric_RadarFrontCenter_TrajPointACCObj20_TrajPointACCObj20_timestamp_Rv, rawValue);
            chgEv_TrajPointACCObj20_TrajPointACCObj20_timestamp = 1;  
        }
        else
        {
            chgEv_TrajPointACCObj20_TrajPointACCObj20_timestamp = 0;
        }
    }
}


 
on envVar E_pric_RadarFrontCenter_TrajPointACCObj20_TrajPointACCObj20_dyv_sw_Rv
{
    qword rawValue = 0ll;
    float rawValue_float = 0.0;
    float phyValue = 0.0;        

    //set the signal with updated raw value
    {
        rawValue = getvalue(this);
        if(chgEv_TrajPointACCObj20_TrajPointACCObj20_dyv_sw == 0)
        {
            //type conversion to float
            rawValue_float = rawValue;        
            // raw to physical conversion
            phyValue = ((rawValue_float *0.0078125)+(0));
            putValue(E_pric_RadarFrontCenter_TrajPointACCObj20_TrajPointACCObj20_dyv_sw_Pv, phyValue);
            chgEv_TrajPointACCObj20_TrajPointACCObj20_dyv_sw = 1;
        }
        else
        {
            chgEv_TrajPointACCObj20_TrajPointACCObj20_dyv_sw = 0;
        }    
        //update the signal value
        Msg_TrajPointACCObj20.TrajPointACCObj20_dyv_sw=rawValue;        
    }                                                                           
}

on envVar E_pric_RadarFrontCenter_TrajPointACCObj20_TrajPointACCObj20_dyv_sw_Pv
{
    qword rawValue = 0ll;
    float phyValue = 0.0;
    
    //update the raw value with physical value 
    {
        if(chgEv_TrajPointACCObj20_TrajPointACCObj20_dyv_sw == 0)
        {
            phyValue = getvalue(this);
            // physical to raw conversion
            rawValue = ((phyValue -(0))/0.0078125);
            putValue(E_pric_RadarFrontCenter_TrajPointACCObj20_TrajPointACCObj20_dyv_sw_Rv, rawValue);
            chgEv_TrajPointACCObj20_TrajPointACCObj20_dyv_sw = 1;  
        }
        else
        {
            chgEv_TrajPointACCObj20_TrajPointACCObj20_dyv_sw = 0;
        }
    }
}


 
on envVar E_pric_RadarFrontCenter_TrajPointACCObj20_TrajPointACCObj20_Stopped_b_Rv
{
    qword rawValue = 0ll;
    float rawValue_float = 0.0;
    float phyValue = 0.0;        

    //set the signal with updated raw value
    if(getValue(E_pric_RadarFrontCenter_TrajPointACCObj20_TrajPointACCObj20_Stopped_b_SetVt)==0)
    {
        rawValue = getvalue(this);
        if(chgEv_TrajPointACCObj20_TrajPointACCObj20_Stopped_b == 0)
        {
            //type conversion to float
            rawValue_float = rawValue;        
            // raw to physical conversion
            phyValue = ((rawValue_float *1)+(0));
            putValue(E_pric_RadarFrontCenter_TrajPointACCObj20_TrajPointACCObj20_Stopped_b_Pv, phyValue);
            chgEv_TrajPointACCObj20_TrajPointACCObj20_Stopped_b = 1;
        }
        else
        {
            chgEv_TrajPointACCObj20_TrajPointACCObj20_Stopped_b = 0;
        }    
        //update the signal value
        Msg_TrajPointACCObj20.TrajPointACCObj20_Stopped_b=rawValue;        
    }                                                                           
}

on envVar E_pric_RadarFrontCenter_TrajPointACCObj20_TrajPointACCObj20_Stopped_b_Pv
{
    qword rawValue = 0ll;
    float phyValue = 0.0;
    
    //update the raw value with physical value 
    if(getValue(E_pric_RadarFrontCenter_TrajPointACCObj20_TrajPointACCObj20_Stopped_b_SetVt)==0)
    {
        if(chgEv_TrajPointACCObj20_TrajPointACCObj20_Stopped_b == 0)
        {
            phyValue = getvalue(this);
            // physical to raw conversion
            rawValue = ((phyValue -(0))/1);
            putValue(E_pric_RadarFrontCenter_TrajPointACCObj20_TrajPointACCObj20_Stopped_b_Rv, rawValue);
            chgEv_TrajPointACCObj20_TrajPointACCObj20_Stopped_b = 1;  
        }
        else
        {
            chgEv_TrajPointACCObj20_TrajPointACCObj20_Stopped_b = 0;
        }
    }
}

on envVar E_pric_RadarFrontCenter_TrajPointACCObj20_TrajPointACCObj20_Stopped_b_Vt
{
    qword rawValue = 0ll;
    if(getValue(E_pric_RadarFrontCenter_TrajPointACCObj20_TrajPointACCObj20_Stopped_b_SetVt))
    {
        //update the signal value
        Msg_TrajPointACCObj20.TrajPointACCObj20_Stopped_b=getValue(this);
    }
}

on envVar E_pric_RadarFrontCenter_TrajPointACCObj20_TrajPointACCObj20_Stopped_b_SetVt
{
    if(getValue(E_pric_RadarFrontCenter_TrajPointACCObj20_TrajPointACCObj20_Stopped_b_SetVt))
    {
        //update the signal value
        Msg_TrajPointACCObj20.TrajPointACCObj20_Stopped_b=getvalue(E_pric_RadarFrontCenter_TrajPointACCObj20_TrajPointACCObj20_Stopped_b_Vt);
    }
    else
    {
        Msg_TrajPointACCObj20.TrajPointACCObj20_Stopped_b=getValue(E_pric_RadarFrontCenter_TrajPointACCObj20_TrajPointACCObj20_Stopped_b_Rv);
    }
}
 
on envVar E_pric_RadarFrontCenter_TrajPointACCObj21_tx
{
    if(getValue(this))
    {       
        
        //update the BZ Signal
        if(TrajPointACCObj21_TrajPointACCObj21_blockCtr_wrongvalctr == 0)
        {
            update_TrajPointACCObj21_TrajPointACCObj21_blockCtr_counter();
            Msg_TrajPointACCObj21.TrajPointACCObj21_blockCtr= TrajPointACCObj21_TrajPointACCObj21_blockCtr_counter;
        }
        else if(TrajPointACCObj21_TrajPointACCObj21_blockCtr_wrongvalctr > 0)
        {
             TrajPointACCObj21_TrajPointACCObj21_blockCtr_wrongvalctr--;
              // if counter becomes zero, update panel controller to zero
             if(TrajPointACCObj21_TrajPointACCObj21_blockCtr_wrongvalctr == 0)
             {
                 putValue(E_pric_RadarFrontCenter_TrajPointACCObj21_TrajPointACCObj21_blockCtr_wrongvalctr,0);
             }
        }
        else
        {
            //do nothing
        }        
        //update the BZ Signal
        if(TrajPointACCObj21_TrajPointACCObj21_MsgCtr_wrongvalctr == 0)
        {
            update_TrajPointACCObj21_TrajPointACCObj21_MsgCtr_counter();
            Msg_TrajPointACCObj21.TrajPointACCObj21_MsgCtr= TrajPointACCObj21_TrajPointACCObj21_MsgCtr_counter;
        }
        else if(TrajPointACCObj21_TrajPointACCObj21_MsgCtr_wrongvalctr > 0)
        {
             TrajPointACCObj21_TrajPointACCObj21_MsgCtr_wrongvalctr--;
              // if counter becomes zero, update panel controller to zero
             if(TrajPointACCObj21_TrajPointACCObj21_MsgCtr_wrongvalctr == 0)
             {
                 putValue(E_pric_RadarFrontCenter_TrajPointACCObj21_TrajPointACCObj21_MsgCtr_wrongvalctr,0);
             }
        }
        else
        {
            //do nothing
        }        
        //calculate the CRC checksum
        update_TrajPointACCObj21_ChkSum_Checksum();

        output(Msg_TrajPointACCObj21);        
    }
}

on envVar E_pric_RadarFrontCenter_TrajPointACCObj21_Range
{
    qword rawstatus = 0ll;
    qword rawValue = 0ll;    
    
    rawstatus = getvalue(this);    
    // set all the signals with min raw /max raw /init raw
    switch (rawstatus) 
    {
     case(0) :
        rawValue= 0;
        putValue(E_pric_RadarFrontCenter_TrajPointACCObj21_TrajPointACCObj21_Drive_b_Rv, rawValue);
        rawValue= -32768;
        putValue(E_pric_RadarFrontCenter_TrajPointACCObj21_TrajPointACCObj21_dyv_sw_Rv, rawValue);
        rawValue= -32768;
        putValue(E_pric_RadarFrontCenter_TrajPointACCObj21_TrajPointACCObj21_dxv_sw_Rv, rawValue);
        rawValue= 0;
        putValue(E_pric_RadarFrontCenter_TrajPointACCObj21_TrajPointACCObj21_InvDir_b_Rv, rawValue);
        rawValue= 0;
        putValue(E_pric_RadarFrontCenter_TrajPointACCObj21_TrajPointACCObj21_Stopped_b_Rv, rawValue);
        rawValue= 0;
        putValue(E_pric_RadarFrontCenter_TrajPointACCObj21_TrajPointACCObj21_dVarXv_uw_Rv, rawValue);
        rawValue= 0;
        putValue(E_pric_RadarFrontCenter_TrajPointACCObj21_TrajPointACCObj21_timestamp_Rv, rawValue);
        rawValue= 0;
        putValue(E_pric_RadarFrontCenter_TrajPointACCObj21_TrajPointACCObj21_dVarYv_uw_Rv, rawValue);
        rawValue= 0;
        putValue(E_pric_RadarFrontCenter_TrajPointACCObj21_TrajPointACCObj21_Valid_b_Rv, rawValue);
        rawValue= 0;
        putValue(E_pric_RadarFrontCenter_TrajPointACCObj21_TrajPointACCObj21_Stand_b_Rv, rawValue);
        rawValue= 0;
        putValue(E_pric_RadarFrontCenter_TrajPointACCObj21_TrajPointACCObj21_TrajEnd_b_Rv, rawValue);
        rawValue= 0;
        putValue(E_pric_RadarFrontCenter_TrajPointACCObj21_TrajPointACCObj21_wExistProb_ub_Rv, rawValue);
        break;
     case(1) :
        rawValue= 1;
        putValue(E_pric_RadarFrontCenter_TrajPointACCObj21_TrajPointACCObj21_Drive_b_Rv, rawValue);
        rawValue= 32767;
        putValue(E_pric_RadarFrontCenter_TrajPointACCObj21_TrajPointACCObj21_dyv_sw_Rv, rawValue);
        rawValue= 32767;
        putValue(E_pric_RadarFrontCenter_TrajPointACCObj21_TrajPointACCObj21_dxv_sw_Rv, rawValue);
        rawValue= 1;
        putValue(E_pric_RadarFrontCenter_TrajPointACCObj21_TrajPointACCObj21_InvDir_b_Rv, rawValue);
        rawValue= 1;
        putValue(E_pric_RadarFrontCenter_TrajPointACCObj21_TrajPointACCObj21_Stopped_b_Rv, rawValue);
        rawValue= 65534;
        putValue(E_pric_RadarFrontCenter_TrajPointACCObj21_TrajPointACCObj21_dVarXv_uw_Rv, rawValue);
        rawValue= 65536;
        putValue(E_pric_RadarFrontCenter_TrajPointACCObj21_TrajPointACCObj21_timestamp_Rv, rawValue);
        rawValue= 65534;
        putValue(E_pric_RadarFrontCenter_TrajPointACCObj21_TrajPointACCObj21_dVarYv_uw_Rv, rawValue);
        rawValue= 1;
        putValue(E_pric_RadarFrontCenter_TrajPointACCObj21_TrajPointACCObj21_Valid_b_Rv, rawValue);
        rawValue= 1;
        putValue(E_pric_RadarFrontCenter_TrajPointACCObj21_TrajPointACCObj21_Stand_b_Rv, rawValue);
        rawValue= 1;
        putValue(E_pric_RadarFrontCenter_TrajPointACCObj21_TrajPointACCObj21_TrajEnd_b_Rv, rawValue);
        rawValue= 255;
        putValue(E_pric_RadarFrontCenter_TrajPointACCObj21_TrajPointACCObj21_wExistProb_ub_Rv, rawValue);
        break;
     default :
        rawValue= 0;
        putValue(E_pric_RadarFrontCenter_TrajPointACCObj21_TrajPointACCObj21_Drive_b_Rv, rawValue);
        rawValue= -32768;
        putValue(E_pric_RadarFrontCenter_TrajPointACCObj21_TrajPointACCObj21_dyv_sw_Rv, rawValue);
        rawValue= -32768;
        putValue(E_pric_RadarFrontCenter_TrajPointACCObj21_TrajPointACCObj21_dxv_sw_Rv, rawValue);
        rawValue= 0;
        putValue(E_pric_RadarFrontCenter_TrajPointACCObj21_TrajPointACCObj21_InvDir_b_Rv, rawValue);
        rawValue= 0;
        putValue(E_pric_RadarFrontCenter_TrajPointACCObj21_TrajPointACCObj21_Stopped_b_Rv, rawValue);
        rawValue= 0;
        putValue(E_pric_RadarFrontCenter_TrajPointACCObj21_TrajPointACCObj21_dVarXv_uw_Rv, rawValue);
        rawValue= 0;
        putValue(E_pric_RadarFrontCenter_TrajPointACCObj21_TrajPointACCObj21_timestamp_Rv, rawValue);
        rawValue= 0;
        putValue(E_pric_RadarFrontCenter_TrajPointACCObj21_TrajPointACCObj21_dVarYv_uw_Rv, rawValue);
        rawValue= 0;
        putValue(E_pric_RadarFrontCenter_TrajPointACCObj21_TrajPointACCObj21_Valid_b_Rv, rawValue);
        rawValue= 0;
        putValue(E_pric_RadarFrontCenter_TrajPointACCObj21_TrajPointACCObj21_Stand_b_Rv, rawValue);
        rawValue= 0;
        putValue(E_pric_RadarFrontCenter_TrajPointACCObj21_TrajPointACCObj21_TrajEnd_b_Rv, rawValue);
        rawValue= 0;
        putValue(E_pric_RadarFrontCenter_TrajPointACCObj21_TrajPointACCObj21_wExistProb_ub_Rv, rawValue);
      break;
   }
}

on envVar E_pric_RadarFrontCenter_TrajPointACCObj21_Dlc
{
    if(getValue(E_pric_RadarFrontCenter_TrajPointACCObj21_enDlc))
    {
        Msg_TrajPointACCObj21.dlc =getValue(this);
    }
    else
    {
       Dbc_dlc = 16;
	   Msg_TrajPointACCObj21.dlc = Calc_Canfd_dlc(Dbc_dlc);
	   	
  }
}

on envVar E_pric_RadarFrontCenter_TrajPointACCObj21_enDlc
{
    //For Messages with DLC = 8, set wrong DLC to smaller than defined DLC
    //For Messages with DLC < 8 set wrong DLC to smaller/longer than defined DLC
    if(getValue(this))
    {
        Msg_TrajPointACCObj21.dlc =getValue(E_pric_RadarFrontCenter_TrajPointACCObj21_Dlc);
    }
    else
    {
       Dbc_dlc = 16;
	   Msg_TrajPointACCObj21.dlc = Calc_Canfd_dlc(Dbc_dlc);
			
    }
}

on envVar E_pric_RadarFrontCenter_TrajPointACCObj21_TrajPointACCObj21_CRC_wrongvalctr
{
    //update disturb count
    //disturb value range:(-1 = always send wrong value),( X>0 ,x is the number of Messages with wrong CHK sent)
    TrajPointACCObj21_TrajPointACCObj21_CRC_wrongvalctr =getValue(this);    
}
on envVar E_pric_RadarFrontCenter_TrajPointACCObj21_TrajPointACCObj21_MsgCtr_wrongvalctr
{
    //update disturb count
    //disturb value range:(-1 = always send wrong value),( X>0 ,x is the number of Messages with wrong CHK sent)
    TrajPointACCObj21_TrajPointACCObj21_MsgCtr_wrongvalctr =getValue(this);    
}
on envVar E_pric_RadarFrontCenter_TrajPointACCObj21_TrajPointACCObj21_blockCtr_wrongvalctr
{
    //update disturb count
    //disturb value range:(-1 = always send wrong value),( X>0 ,x is the number of Messages with wrong CHK sent)
    TrajPointACCObj21_TrajPointACCObj21_blockCtr_wrongvalctr =getValue(this);    
}

on envVar E_pric_RadarFrontCenter_TrajPointACCObj21_TrajPointACCObj21_Drive_b_Rv
{
    qword rawValue = 0ll;
    float rawValue_float = 0.0;
    float phyValue = 0.0;        

    //set the signal with updated raw value
    if(getValue(E_pric_RadarFrontCenter_TrajPointACCObj21_TrajPointACCObj21_Drive_b_SetVt)==0)
    {
        rawValue = getvalue(this);
        if(chgEv_TrajPointACCObj21_TrajPointACCObj21_Drive_b == 0)
        {
            //type conversion to float
            rawValue_float = rawValue;        
            // raw to physical conversion
            phyValue = ((rawValue_float *1)+(0));
            putValue(E_pric_RadarFrontCenter_TrajPointACCObj21_TrajPointACCObj21_Drive_b_Pv, phyValue);
            chgEv_TrajPointACCObj21_TrajPointACCObj21_Drive_b = 1;
        }
        else
        {
            chgEv_TrajPointACCObj21_TrajPointACCObj21_Drive_b = 0;
        }    
        //update the signal value
        Msg_TrajPointACCObj21.TrajPointACCObj21_Drive_b=rawValue;        
    }                                                                           
}

on envVar E_pric_RadarFrontCenter_TrajPointACCObj21_TrajPointACCObj21_Drive_b_Pv
{
    qword rawValue = 0ll;
    float phyValue = 0.0;
    
    //update the raw value with physical value 
    if(getValue(E_pric_RadarFrontCenter_TrajPointACCObj21_TrajPointACCObj21_Drive_b_SetVt)==0)
    {
        if(chgEv_TrajPointACCObj21_TrajPointACCObj21_Drive_b == 0)
        {
            phyValue = getvalue(this);
            // physical to raw conversion
            rawValue = ((phyValue -(0))/1);
            putValue(E_pric_RadarFrontCenter_TrajPointACCObj21_TrajPointACCObj21_Drive_b_Rv, rawValue);
            chgEv_TrajPointACCObj21_TrajPointACCObj21_Drive_b = 1;  
        }
        else
        {
            chgEv_TrajPointACCObj21_TrajPointACCObj21_Drive_b = 0;
        }
    }
}

on envVar E_pric_RadarFrontCenter_TrajPointACCObj21_TrajPointACCObj21_Drive_b_Vt
{
    qword rawValue = 0ll;
    if(getValue(E_pric_RadarFrontCenter_TrajPointACCObj21_TrajPointACCObj21_Drive_b_SetVt))
    {
        //update the signal value
        Msg_TrajPointACCObj21.TrajPointACCObj21_Drive_b=getValue(this);
    }
}

on envVar E_pric_RadarFrontCenter_TrajPointACCObj21_TrajPointACCObj21_Drive_b_SetVt
{
    if(getValue(E_pric_RadarFrontCenter_TrajPointACCObj21_TrajPointACCObj21_Drive_b_SetVt))
    {
        //update the signal value
        Msg_TrajPointACCObj21.TrajPointACCObj21_Drive_b=getvalue(E_pric_RadarFrontCenter_TrajPointACCObj21_TrajPointACCObj21_Drive_b_Vt);
    }
    else
    {
        Msg_TrajPointACCObj21.TrajPointACCObj21_Drive_b=getValue(E_pric_RadarFrontCenter_TrajPointACCObj21_TrajPointACCObj21_Drive_b_Rv);
    }
}
 
on envVar E_pric_RadarFrontCenter_TrajPointACCObj21_TrajPointACCObj21_dyv_sw_Rv
{
    qword rawValue = 0ll;
    float rawValue_float = 0.0;
    float phyValue = 0.0;        

    //set the signal with updated raw value
    {
        rawValue = getvalue(this);
        if(chgEv_TrajPointACCObj21_TrajPointACCObj21_dyv_sw == 0)
        {
            //type conversion to float
            rawValue_float = rawValue;        
            // raw to physical conversion
            phyValue = ((rawValue_float *0.0078125)+(0));
            putValue(E_pric_RadarFrontCenter_TrajPointACCObj21_TrajPointACCObj21_dyv_sw_Pv, phyValue);
            chgEv_TrajPointACCObj21_TrajPointACCObj21_dyv_sw = 1;
        }
        else
        {
            chgEv_TrajPointACCObj21_TrajPointACCObj21_dyv_sw = 0;
        }    
        //update the signal value
        Msg_TrajPointACCObj21.TrajPointACCObj21_dyv_sw=rawValue;        
    }                                                                           
}

on envVar E_pric_RadarFrontCenter_TrajPointACCObj21_TrajPointACCObj21_dyv_sw_Pv
{
    qword rawValue = 0ll;
    float phyValue = 0.0;
    
    //update the raw value with physical value 
    {
        if(chgEv_TrajPointACCObj21_TrajPointACCObj21_dyv_sw == 0)
        {
            phyValue = getvalue(this);
            // physical to raw conversion
            rawValue = ((phyValue -(0))/0.0078125);
            putValue(E_pric_RadarFrontCenter_TrajPointACCObj21_TrajPointACCObj21_dyv_sw_Rv, rawValue);
            chgEv_TrajPointACCObj21_TrajPointACCObj21_dyv_sw = 1;  
        }
        else
        {
            chgEv_TrajPointACCObj21_TrajPointACCObj21_dyv_sw = 0;
        }
    }
}


 
on envVar E_pric_RadarFrontCenter_TrajPointACCObj21_TrajPointACCObj21_dxv_sw_Rv
{
    qword rawValue = 0ll;
    float rawValue_float = 0.0;
    float phyValue = 0.0;        

    //set the signal with updated raw value
    {
        rawValue = getvalue(this);
        if(chgEv_TrajPointACCObj21_TrajPointACCObj21_dxv_sw == 0)
        {
            //type conversion to float
            rawValue_float = rawValue;        
            // raw to physical conversion
            phyValue = ((rawValue_float *0.0078125)+(0));
            putValue(E_pric_RadarFrontCenter_TrajPointACCObj21_TrajPointACCObj21_dxv_sw_Pv, phyValue);
            chgEv_TrajPointACCObj21_TrajPointACCObj21_dxv_sw = 1;
        }
        else
        {
            chgEv_TrajPointACCObj21_TrajPointACCObj21_dxv_sw = 0;
        }    
        //update the signal value
        Msg_TrajPointACCObj21.TrajPointACCObj21_dxv_sw=rawValue;        
    }                                                                           
}

on envVar E_pric_RadarFrontCenter_TrajPointACCObj21_TrajPointACCObj21_dxv_sw_Pv
{
    qword rawValue = 0ll;
    float phyValue = 0.0;
    
    //update the raw value with physical value 
    {
        if(chgEv_TrajPointACCObj21_TrajPointACCObj21_dxv_sw == 0)
        {
            phyValue = getvalue(this);
            // physical to raw conversion
            rawValue = ((phyValue -(0))/0.0078125);
            putValue(E_pric_RadarFrontCenter_TrajPointACCObj21_TrajPointACCObj21_dxv_sw_Rv, rawValue);
            chgEv_TrajPointACCObj21_TrajPointACCObj21_dxv_sw = 1;  
        }
        else
        {
            chgEv_TrajPointACCObj21_TrajPointACCObj21_dxv_sw = 0;
        }
    }
}


 
on envVar E_pric_RadarFrontCenter_TrajPointACCObj21_TrajPointACCObj21_InvDir_b_Rv
{
    qword rawValue = 0ll;
    float rawValue_float = 0.0;
    float phyValue = 0.0;        

    //set the signal with updated raw value
    if(getValue(E_pric_RadarFrontCenter_TrajPointACCObj21_TrajPointACCObj21_InvDir_b_SetVt)==0)
    {
        rawValue = getvalue(this);
        if(chgEv_TrajPointACCObj21_TrajPointACCObj21_InvDir_b == 0)
        {
            //type conversion to float
            rawValue_float = rawValue;        
            // raw to physical conversion
            phyValue = ((rawValue_float *1)+(0));
            putValue(E_pric_RadarFrontCenter_TrajPointACCObj21_TrajPointACCObj21_InvDir_b_Pv, phyValue);
            chgEv_TrajPointACCObj21_TrajPointACCObj21_InvDir_b = 1;
        }
        else
        {
            chgEv_TrajPointACCObj21_TrajPointACCObj21_InvDir_b = 0;
        }    
        //update the signal value
        Msg_TrajPointACCObj21.TrajPointACCObj21_InvDir_b=rawValue;        
    }                                                                           
}

on envVar E_pric_RadarFrontCenter_TrajPointACCObj21_TrajPointACCObj21_InvDir_b_Pv
{
    qword rawValue = 0ll;
    float phyValue = 0.0;
    
    //update the raw value with physical value 
    if(getValue(E_pric_RadarFrontCenter_TrajPointACCObj21_TrajPointACCObj21_InvDir_b_SetVt)==0)
    {
        if(chgEv_TrajPointACCObj21_TrajPointACCObj21_InvDir_b == 0)
        {
            phyValue = getvalue(this);
            // physical to raw conversion
            rawValue = ((phyValue -(0))/1);
            putValue(E_pric_RadarFrontCenter_TrajPointACCObj21_TrajPointACCObj21_InvDir_b_Rv, rawValue);
            chgEv_TrajPointACCObj21_TrajPointACCObj21_InvDir_b = 1;  
        }
        else
        {
            chgEv_TrajPointACCObj21_TrajPointACCObj21_InvDir_b = 0;
        }
    }
}

on envVar E_pric_RadarFrontCenter_TrajPointACCObj21_TrajPointACCObj21_InvDir_b_Vt
{
    qword rawValue = 0ll;
    if(getValue(E_pric_RadarFrontCenter_TrajPointACCObj21_TrajPointACCObj21_InvDir_b_SetVt))
    {
        //update the signal value
        Msg_TrajPointACCObj21.TrajPointACCObj21_InvDir_b=getValue(this);
    }
}

on envVar E_pric_RadarFrontCenter_TrajPointACCObj21_TrajPointACCObj21_InvDir_b_SetVt
{
    if(getValue(E_pric_RadarFrontCenter_TrajPointACCObj21_TrajPointACCObj21_InvDir_b_SetVt))
    {
        //update the signal value
        Msg_TrajPointACCObj21.TrajPointACCObj21_InvDir_b=getvalue(E_pric_RadarFrontCenter_TrajPointACCObj21_TrajPointACCObj21_InvDir_b_Vt);
    }
    else
    {
        Msg_TrajPointACCObj21.TrajPointACCObj21_InvDir_b=getValue(E_pric_RadarFrontCenter_TrajPointACCObj21_TrajPointACCObj21_InvDir_b_Rv);
    }
}
 
on envVar E_pric_RadarFrontCenter_TrajPointACCObj21_TrajPointACCObj21_Stopped_b_Rv
{
    qword rawValue = 0ll;
    float rawValue_float = 0.0;
    float phyValue = 0.0;        

    //set the signal with updated raw value
    if(getValue(E_pric_RadarFrontCenter_TrajPointACCObj21_TrajPointACCObj21_Stopped_b_SetVt)==0)
    {
        rawValue = getvalue(this);
        if(chgEv_TrajPointACCObj21_TrajPointACCObj21_Stopped_b == 0)
        {
            //type conversion to float
            rawValue_float = rawValue;        
            // raw to physical conversion
            phyValue = ((rawValue_float *1)+(0));
            putValue(E_pric_RadarFrontCenter_TrajPointACCObj21_TrajPointACCObj21_Stopped_b_Pv, phyValue);
            chgEv_TrajPointACCObj21_TrajPointACCObj21_Stopped_b = 1;
        }
        else
        {
            chgEv_TrajPointACCObj21_TrajPointACCObj21_Stopped_b = 0;
        }    
        //update the signal value
        Msg_TrajPointACCObj21.TrajPointACCObj21_Stopped_b=rawValue;        
    }                                                                           
}

on envVar E_pric_RadarFrontCenter_TrajPointACCObj21_TrajPointACCObj21_Stopped_b_Pv
{
    qword rawValue = 0ll;
    float phyValue = 0.0;
    
    //update the raw value with physical value 
    if(getValue(E_pric_RadarFrontCenter_TrajPointACCObj21_TrajPointACCObj21_Stopped_b_SetVt)==0)
    {
        if(chgEv_TrajPointACCObj21_TrajPointACCObj21_Stopped_b == 0)
        {
            phyValue = getvalue(this);
            // physical to raw conversion
            rawValue = ((phyValue -(0))/1);
            putValue(E_pric_RadarFrontCenter_TrajPointACCObj21_TrajPointACCObj21_Stopped_b_Rv, rawValue);
            chgEv_TrajPointACCObj21_TrajPointACCObj21_Stopped_b = 1;  
        }
        else
        {
            chgEv_TrajPointACCObj21_TrajPointACCObj21_Stopped_b = 0;
        }
    }
}

on envVar E_pric_RadarFrontCenter_TrajPointACCObj21_TrajPointACCObj21_Stopped_b_Vt
{
    qword rawValue = 0ll;
    if(getValue(E_pric_RadarFrontCenter_TrajPointACCObj21_TrajPointACCObj21_Stopped_b_SetVt))
    {
        //update the signal value
        Msg_TrajPointACCObj21.TrajPointACCObj21_Stopped_b=getValue(this);
    }
}

on envVar E_pric_RadarFrontCenter_TrajPointACCObj21_TrajPointACCObj21_Stopped_b_SetVt
{
    if(getValue(E_pric_RadarFrontCenter_TrajPointACCObj21_TrajPointACCObj21_Stopped_b_SetVt))
    {
        //update the signal value
        Msg_TrajPointACCObj21.TrajPointACCObj21_Stopped_b=getvalue(E_pric_RadarFrontCenter_TrajPointACCObj21_TrajPointACCObj21_Stopped_b_Vt);
    }
    else
    {
        Msg_TrajPointACCObj21.TrajPointACCObj21_Stopped_b=getValue(E_pric_RadarFrontCenter_TrajPointACCObj21_TrajPointACCObj21_Stopped_b_Rv);
    }
}
 
on envVar E_pric_RadarFrontCenter_TrajPointACCObj21_TrajPointACCObj21_dVarXv_uw_Rv
{
    qword rawValue = 0ll;
    float rawValue_float = 0.0;
    float phyValue = 0.0;        

    //set the signal with updated raw value
    {
        rawValue = getvalue(this);
        if(chgEv_TrajPointACCObj21_TrajPointACCObj21_dVarXv_uw == 0)
        {
            //type conversion to float
            rawValue_float = rawValue;        
            // raw to physical conversion
            phyValue = ((rawValue_float *0.00195313)+(0));
            putValue(E_pric_RadarFrontCenter_TrajPointACCObj21_TrajPointACCObj21_dVarXv_uw_Pv, phyValue);
            chgEv_TrajPointACCObj21_TrajPointACCObj21_dVarXv_uw = 1;
        }
        else
        {
            chgEv_TrajPointACCObj21_TrajPointACCObj21_dVarXv_uw = 0;
        }    
        //update the signal value
        Msg_TrajPointACCObj21.TrajPointACCObj21_dVarXv_uw=rawValue;        
    }                                                                           
}

on envVar E_pric_RadarFrontCenter_TrajPointACCObj21_TrajPointACCObj21_dVarXv_uw_Pv
{
    qword rawValue = 0ll;
    float phyValue = 0.0;
    
    //update the raw value with physical value 
    {
        if(chgEv_TrajPointACCObj21_TrajPointACCObj21_dVarXv_uw == 0)
        {
            phyValue = getvalue(this);
            // physical to raw conversion
            rawValue = ((phyValue -(0))/0.00195313);
            putValue(E_pric_RadarFrontCenter_TrajPointACCObj21_TrajPointACCObj21_dVarXv_uw_Rv, rawValue);
            chgEv_TrajPointACCObj21_TrajPointACCObj21_dVarXv_uw = 1;  
        }
        else
        {
            chgEv_TrajPointACCObj21_TrajPointACCObj21_dVarXv_uw = 0;
        }
    }
}


 
on envVar E_pric_RadarFrontCenter_TrajPointACCObj21_TrajPointACCObj21_timestamp_Rv
{
    qword rawValue = 0ll;
    float rawValue_float = 0.0;
    float phyValue = 0.0;        

    //set the signal with updated raw value
    {
        rawValue = getvalue(this);
        if(chgEv_TrajPointACCObj21_TrajPointACCObj21_timestamp == 0)
        {
            //type conversion to float
            rawValue_float = rawValue;        
            // raw to physical conversion
            phyValue = ((rawValue_float *0.000488281)+(0));
            putValue(E_pric_RadarFrontCenter_TrajPointACCObj21_TrajPointACCObj21_timestamp_Pv, phyValue);
            chgEv_TrajPointACCObj21_TrajPointACCObj21_timestamp = 1;
        }
        else
        {
            chgEv_TrajPointACCObj21_TrajPointACCObj21_timestamp = 0;
        }    
        //update the signal value
        Msg_TrajPointACCObj21.TrajPointACCObj21_timestamp=rawValue;        
    }                                                                           
}

on envVar E_pric_RadarFrontCenter_TrajPointACCObj21_TrajPointACCObj21_timestamp_Pv
{
    qword rawValue = 0ll;
    float phyValue = 0.0;
    
    //update the raw value with physical value 
    {
        if(chgEv_TrajPointACCObj21_TrajPointACCObj21_timestamp == 0)
        {
            phyValue = getvalue(this);
            // physical to raw conversion
            rawValue = ((phyValue -(0))/0.000488281);
            putValue(E_pric_RadarFrontCenter_TrajPointACCObj21_TrajPointACCObj21_timestamp_Rv, rawValue);
            chgEv_TrajPointACCObj21_TrajPointACCObj21_timestamp = 1;  
        }
        else
        {
            chgEv_TrajPointACCObj21_TrajPointACCObj21_timestamp = 0;
        }
    }
}


 
on envVar E_pric_RadarFrontCenter_TrajPointACCObj21_TrajPointACCObj21_dVarYv_uw_Rv
{
    qword rawValue = 0ll;
    float rawValue_float = 0.0;
    float phyValue = 0.0;        

    //set the signal with updated raw value
    {
        rawValue = getvalue(this);
        if(chgEv_TrajPointACCObj21_TrajPointACCObj21_dVarYv_uw == 0)
        {
            //type conversion to float
            rawValue_float = rawValue;        
            // raw to physical conversion
            phyValue = ((rawValue_float *0.00195313)+(0));
            putValue(E_pric_RadarFrontCenter_TrajPointACCObj21_TrajPointACCObj21_dVarYv_uw_Pv, phyValue);
            chgEv_TrajPointACCObj21_TrajPointACCObj21_dVarYv_uw = 1;
        }
        else
        {
            chgEv_TrajPointACCObj21_TrajPointACCObj21_dVarYv_uw = 0;
        }    
        //update the signal value
        Msg_TrajPointACCObj21.TrajPointACCObj21_dVarYv_uw=rawValue;        
    }                                                                           
}

on envVar E_pric_RadarFrontCenter_TrajPointACCObj21_TrajPointACCObj21_dVarYv_uw_Pv
{
    qword rawValue = 0ll;
    float phyValue = 0.0;
    
    //update the raw value with physical value 
    {
        if(chgEv_TrajPointACCObj21_TrajPointACCObj21_dVarYv_uw == 0)
        {
            phyValue = getvalue(this);
            // physical to raw conversion
            rawValue = ((phyValue -(0))/0.00195313);
            putValue(E_pric_RadarFrontCenter_TrajPointACCObj21_TrajPointACCObj21_dVarYv_uw_Rv, rawValue);
            chgEv_TrajPointACCObj21_TrajPointACCObj21_dVarYv_uw = 1;  
        }
        else
        {
            chgEv_TrajPointACCObj21_TrajPointACCObj21_dVarYv_uw = 0;
        }
    }
}


 
on envVar E_pric_RadarFrontCenter_TrajPointACCObj21_TrajPointACCObj21_Valid_b_Rv
{
    qword rawValue = 0ll;
    float rawValue_float = 0.0;
    float phyValue = 0.0;        

    //set the signal with updated raw value
    if(getValue(E_pric_RadarFrontCenter_TrajPointACCObj21_TrajPointACCObj21_Valid_b_SetVt)==0)
    {
        rawValue = getvalue(this);
        if(chgEv_TrajPointACCObj21_TrajPointACCObj21_Valid_b == 0)
        {
            //type conversion to float
            rawValue_float = rawValue;        
            // raw to physical conversion
            phyValue = ((rawValue_float *1)+(0));
            putValue(E_pric_RadarFrontCenter_TrajPointACCObj21_TrajPointACCObj21_Valid_b_Pv, phyValue);
            chgEv_TrajPointACCObj21_TrajPointACCObj21_Valid_b = 1;
        }
        else
        {
            chgEv_TrajPointACCObj21_TrajPointACCObj21_Valid_b = 0;
        }    
        //update the signal value
        Msg_TrajPointACCObj21.TrajPointACCObj21_Valid_b=rawValue;        
    }                                                                           
}

on envVar E_pric_RadarFrontCenter_TrajPointACCObj21_TrajPointACCObj21_Valid_b_Pv
{
    qword rawValue = 0ll;
    float phyValue = 0.0;
    
    //update the raw value with physical value 
    if(getValue(E_pric_RadarFrontCenter_TrajPointACCObj21_TrajPointACCObj21_Valid_b_SetVt)==0)
    {
        if(chgEv_TrajPointACCObj21_TrajPointACCObj21_Valid_b == 0)
        {
            phyValue = getvalue(this);
            // physical to raw conversion
            rawValue = ((phyValue -(0))/1);
            putValue(E_pric_RadarFrontCenter_TrajPointACCObj21_TrajPointACCObj21_Valid_b_Rv, rawValue);
            chgEv_TrajPointACCObj21_TrajPointACCObj21_Valid_b = 1;  
        }
        else
        {
            chgEv_TrajPointACCObj21_TrajPointACCObj21_Valid_b = 0;
        }
    }
}

on envVar E_pric_RadarFrontCenter_TrajPointACCObj21_TrajPointACCObj21_Valid_b_Vt
{
    qword rawValue = 0ll;
    if(getValue(E_pric_RadarFrontCenter_TrajPointACCObj21_TrajPointACCObj21_Valid_b_SetVt))
    {
        //update the signal value
        Msg_TrajPointACCObj21.TrajPointACCObj21_Valid_b=getValue(this);
    }
}

on envVar E_pric_RadarFrontCenter_TrajPointACCObj21_TrajPointACCObj21_Valid_b_SetVt
{
    if(getValue(E_pric_RadarFrontCenter_TrajPointACCObj21_TrajPointACCObj21_Valid_b_SetVt))
    {
        //update the signal value
        Msg_TrajPointACCObj21.TrajPointACCObj21_Valid_b=getvalue(E_pric_RadarFrontCenter_TrajPointACCObj21_TrajPointACCObj21_Valid_b_Vt);
    }
    else
    {
        Msg_TrajPointACCObj21.TrajPointACCObj21_Valid_b=getValue(E_pric_RadarFrontCenter_TrajPointACCObj21_TrajPointACCObj21_Valid_b_Rv);
    }
}
 
on envVar E_pric_RadarFrontCenter_TrajPointACCObj21_TrajPointACCObj21_Stand_b_Rv
{
    qword rawValue = 0ll;
    float rawValue_float = 0.0;
    float phyValue = 0.0;        

    //set the signal with updated raw value
    if(getValue(E_pric_RadarFrontCenter_TrajPointACCObj21_TrajPointACCObj21_Stand_b_SetVt)==0)
    {
        rawValue = getvalue(this);
        if(chgEv_TrajPointACCObj21_TrajPointACCObj21_Stand_b == 0)
        {
            //type conversion to float
            rawValue_float = rawValue;        
            // raw to physical conversion
            phyValue = ((rawValue_float *1)+(0));
            putValue(E_pric_RadarFrontCenter_TrajPointACCObj21_TrajPointACCObj21_Stand_b_Pv, phyValue);
            chgEv_TrajPointACCObj21_TrajPointACCObj21_Stand_b = 1;
        }
        else
        {
            chgEv_TrajPointACCObj21_TrajPointACCObj21_Stand_b = 0;
        }    
        //update the signal value
        Msg_TrajPointACCObj21.TrajPointACCObj21_Stand_b=rawValue;        
    }                                                                           
}

on envVar E_pric_RadarFrontCenter_TrajPointACCObj21_TrajPointACCObj21_Stand_b_Pv
{
    qword rawValue = 0ll;
    float phyValue = 0.0;
    
    //update the raw value with physical value 
    if(getValue(E_pric_RadarFrontCenter_TrajPointACCObj21_TrajPointACCObj21_Stand_b_SetVt)==0)
    {
        if(chgEv_TrajPointACCObj21_TrajPointACCObj21_Stand_b == 0)
        {
            phyValue = getvalue(this);
            // physical to raw conversion
            rawValue = ((phyValue -(0))/1);
            putValue(E_pric_RadarFrontCenter_TrajPointACCObj21_TrajPointACCObj21_Stand_b_Rv, rawValue);
            chgEv_TrajPointACCObj21_TrajPointACCObj21_Stand_b = 1;  
        }
        else
        {
            chgEv_TrajPointACCObj21_TrajPointACCObj21_Stand_b = 0;
        }
    }
}

on envVar E_pric_RadarFrontCenter_TrajPointACCObj21_TrajPointACCObj21_Stand_b_Vt
{
    qword rawValue = 0ll;
    if(getValue(E_pric_RadarFrontCenter_TrajPointACCObj21_TrajPointACCObj21_Stand_b_SetVt))
    {
        //update the signal value
        Msg_TrajPointACCObj21.TrajPointACCObj21_Stand_b=getValue(this);
    }
}

on envVar E_pric_RadarFrontCenter_TrajPointACCObj21_TrajPointACCObj21_Stand_b_SetVt
{
    if(getValue(E_pric_RadarFrontCenter_TrajPointACCObj21_TrajPointACCObj21_Stand_b_SetVt))
    {
        //update the signal value
        Msg_TrajPointACCObj21.TrajPointACCObj21_Stand_b=getvalue(E_pric_RadarFrontCenter_TrajPointACCObj21_TrajPointACCObj21_Stand_b_Vt);
    }
    else
    {
        Msg_TrajPointACCObj21.TrajPointACCObj21_Stand_b=getValue(E_pric_RadarFrontCenter_TrajPointACCObj21_TrajPointACCObj21_Stand_b_Rv);
    }
}
 
on envVar E_pric_RadarFrontCenter_TrajPointACCObj21_TrajPointACCObj21_TrajEnd_b_Rv
{
    qword rawValue = 0ll;
    float rawValue_float = 0.0;
    float phyValue = 0.0;        

    //set the signal with updated raw value
    if(getValue(E_pric_RadarFrontCenter_TrajPointACCObj21_TrajPointACCObj21_TrajEnd_b_SetVt)==0)
    {
        rawValue = getvalue(this);
        if(chgEv_TrajPointACCObj21_TrajPointACCObj21_TrajEnd_b == 0)
        {
            //type conversion to float
            rawValue_float = rawValue;        
            // raw to physical conversion
            phyValue = ((rawValue_float *1)+(0));
            putValue(E_pric_RadarFrontCenter_TrajPointACCObj21_TrajPointACCObj21_TrajEnd_b_Pv, phyValue);
            chgEv_TrajPointACCObj21_TrajPointACCObj21_TrajEnd_b = 1;
        }
        else
        {
            chgEv_TrajPointACCObj21_TrajPointACCObj21_TrajEnd_b = 0;
        }    
        //update the signal value
        Msg_TrajPointACCObj21.TrajPointACCObj21_TrajEnd_b=rawValue;        
    }                                                                           
}

on envVar E_pric_RadarFrontCenter_TrajPointACCObj21_TrajPointACCObj21_TrajEnd_b_Pv
{
    qword rawValue = 0ll;
    float phyValue = 0.0;
    
    //update the raw value with physical value 
    if(getValue(E_pric_RadarFrontCenter_TrajPointACCObj21_TrajPointACCObj21_TrajEnd_b_SetVt)==0)
    {
        if(chgEv_TrajPointACCObj21_TrajPointACCObj21_TrajEnd_b == 0)
        {
            phyValue = getvalue(this);
            // physical to raw conversion
            rawValue = ((phyValue -(0))/1);
            putValue(E_pric_RadarFrontCenter_TrajPointACCObj21_TrajPointACCObj21_TrajEnd_b_Rv, rawValue);
            chgEv_TrajPointACCObj21_TrajPointACCObj21_TrajEnd_b = 1;  
        }
        else
        {
            chgEv_TrajPointACCObj21_TrajPointACCObj21_TrajEnd_b = 0;
        }
    }
}

on envVar E_pric_RadarFrontCenter_TrajPointACCObj21_TrajPointACCObj21_TrajEnd_b_Vt
{
    qword rawValue = 0ll;
    if(getValue(E_pric_RadarFrontCenter_TrajPointACCObj21_TrajPointACCObj21_TrajEnd_b_SetVt))
    {
        //update the signal value
        Msg_TrajPointACCObj21.TrajPointACCObj21_TrajEnd_b=getValue(this);
    }
}

on envVar E_pric_RadarFrontCenter_TrajPointACCObj21_TrajPointACCObj21_TrajEnd_b_SetVt
{
    if(getValue(E_pric_RadarFrontCenter_TrajPointACCObj21_TrajPointACCObj21_TrajEnd_b_SetVt))
    {
        //update the signal value
        Msg_TrajPointACCObj21.TrajPointACCObj21_TrajEnd_b=getvalue(E_pric_RadarFrontCenter_TrajPointACCObj21_TrajPointACCObj21_TrajEnd_b_Vt);
    }
    else
    {
        Msg_TrajPointACCObj21.TrajPointACCObj21_TrajEnd_b=getValue(E_pric_RadarFrontCenter_TrajPointACCObj21_TrajPointACCObj21_TrajEnd_b_Rv);
    }
}
 
on envVar E_pric_RadarFrontCenter_TrajPointACCObj21_TrajPointACCObj21_wExistProb_ub_Rv
{
    qword rawValue = 0ll;
    float rawValue_float = 0.0;
    float phyValue = 0.0;        

    //set the signal with updated raw value
    {
        rawValue = getvalue(this);
        if(chgEv_TrajPointACCObj21_TrajPointACCObj21_wExistProb_ub == 0)
        {
            //type conversion to float
            rawValue_float = rawValue;        
            // raw to physical conversion
            phyValue = ((rawValue_float *0.00390625)+(0));
            putValue(E_pric_RadarFrontCenter_TrajPointACCObj21_TrajPointACCObj21_wExistProb_ub_Pv, phyValue);
            chgEv_TrajPointACCObj21_TrajPointACCObj21_wExistProb_ub = 1;
        }
        else
        {
            chgEv_TrajPointACCObj21_TrajPointACCObj21_wExistProb_ub = 0;
        }    
        //update the signal value
        Msg_TrajPointACCObj21.TrajPointACCObj21_wExistProb_ub=rawValue;        
    }                                                                           
}

on envVar E_pric_RadarFrontCenter_TrajPointACCObj21_TrajPointACCObj21_wExistProb_ub_Pv
{
    qword rawValue = 0ll;
    float phyValue = 0.0;
    
    //update the raw value with physical value 
    {
        if(chgEv_TrajPointACCObj21_TrajPointACCObj21_wExistProb_ub == 0)
        {
            phyValue = getvalue(this);
            // physical to raw conversion
            rawValue = ((phyValue -(0))/0.00390625);
            putValue(E_pric_RadarFrontCenter_TrajPointACCObj21_TrajPointACCObj21_wExistProb_ub_Rv, rawValue);
            chgEv_TrajPointACCObj21_TrajPointACCObj21_wExistProb_ub = 1;  
        }
        else
        {
            chgEv_TrajPointACCObj21_TrajPointACCObj21_wExistProb_ub = 0;
        }
    }
}


 

update_TrajPointACCObj16_TrajPointACCObj16_blockCtr_counter()
{
    //update the signal value
    Msg_TrajPointACCObj16.TrajPointACCObj16_blockCtr=TrajPointACCObj16_TrajPointACCObj16_blockCtr_counter;
    
    if(TrajPointACCObj16_TrajPointACCObj16_blockCtr_counter == 15)
    {
        TrajPointACCObj16_TrajPointACCObj16_blockCtr_counter =0;
    }
    else
    {
        TrajPointACCObj16_TrajPointACCObj16_blockCtr_counter =TrajPointACCObj16_TrajPointACCObj16_blockCtr_counter+1;
    }    
    
}
update_TrajPointACCObj16_TrajPointACCObj16_MsgCtr_counter()
{
    //update the signal value
    Msg_TrajPointACCObj16.TrajPointACCObj16_MsgCtr=TrajPointACCObj16_TrajPointACCObj16_MsgCtr_counter;
    
    if(TrajPointACCObj16_TrajPointACCObj16_MsgCtr_counter == 15)
    {
        TrajPointACCObj16_TrajPointACCObj16_MsgCtr_counter =0;
    }
    else
    {
        TrajPointACCObj16_TrajPointACCObj16_MsgCtr_counter =TrajPointACCObj16_TrajPointACCObj16_MsgCtr_counter+1;
    }    
    
}
update_RDR1Header_RDR1Header_MsgCtr_counter()
{
    //update the signal value
    Msg_RDR1Header.RDR1Header_MsgCtr=RDR1Header_RDR1Header_MsgCtr_counter;
    
    if(RDR1Header_RDR1Header_MsgCtr_counter == 15)
    {
        RDR1Header_RDR1Header_MsgCtr_counter =0;
    }
    else
    {
        RDR1Header_RDR1Header_MsgCtr_counter =RDR1Header_RDR1Header_MsgCtr_counter+1;
    }    
    
}
update_RDR1Header_RDR1Header_blockCtr_counter()
{
    //update the signal value
    Msg_RDR1Header.RDR1Header_blockCtr=RDR1Header_RDR1Header_blockCtr_counter;
    
    if(RDR1Header_RDR1Header_blockCtr_counter == 15)
    {
        RDR1Header_RDR1Header_blockCtr_counter =0;
    }
    else
    {
        RDR1Header_RDR1Header_blockCtr_counter =RDR1Header_RDR1Header_blockCtr_counter+1;
    }    
    
}
update_OnComingObj3_OnComingObj3_blockCtr_counter()
{
    //update the signal value
    Msg_OnComingObj3.OnComingObj3_blockCtr=OnComingObj3_OnComingObj3_blockCtr_counter;
    
    if(OnComingObj3_OnComingObj3_blockCtr_counter == 15)
    {
        OnComingObj3_OnComingObj3_blockCtr_counter =0;
    }
    else
    {
        OnComingObj3_OnComingObj3_blockCtr_counter =OnComingObj3_OnComingObj3_blockCtr_counter+1;
    }    
    
}
update_OnComingObj3_OnComingObj3_MsgCtr_counter()
{
    //update the signal value
    Msg_OnComingObj3.OnComingObj3_MsgCtr=OnComingObj3_OnComingObj3_MsgCtr_counter;
    
    if(OnComingObj3_OnComingObj3_MsgCtr_counter == 15)
    {
        OnComingObj3_OnComingObj3_MsgCtr_counter =0;
    }
    else
    {
        OnComingObj3_OnComingObj3_MsgCtr_counter =OnComingObj3_OnComingObj3_MsgCtr_counter+1;
    }    
    
}
update_OnComingObj2_OnComingObj2_MsgCtr_counter()
{
    //update the signal value
    Msg_OnComingObj2.OnComingObj2_MsgCtr=OnComingObj2_OnComingObj2_MsgCtr_counter;
    
    if(OnComingObj2_OnComingObj2_MsgCtr_counter == 15)
    {
        OnComingObj2_OnComingObj2_MsgCtr_counter =0;
    }
    else
    {
        OnComingObj2_OnComingObj2_MsgCtr_counter =OnComingObj2_OnComingObj2_MsgCtr_counter+1;
    }    
    
}
update_OnComingObj2_OnComingObj2_blockCtr_counter()
{
    //update the signal value
    Msg_OnComingObj2.OnComingObj2_blockCtr=OnComingObj2_OnComingObj2_blockCtr_counter;
    
    if(OnComingObj2_OnComingObj2_blockCtr_counter == 15)
    {
        OnComingObj2_OnComingObj2_blockCtr_counter =0;
    }
    else
    {
        OnComingObj2_OnComingObj2_blockCtr_counter =OnComingObj2_OnComingObj2_blockCtr_counter+1;
    }    
    
}
update_OnComingObj1_OnComingObj1_blockCtr_counter()
{
    //update the signal value
    Msg_OnComingObj1.OnComingObj1_blockCtr=OnComingObj1_OnComingObj1_blockCtr_counter;
    
    if(OnComingObj1_OnComingObj1_blockCtr_counter == 15)
    {
        OnComingObj1_OnComingObj1_blockCtr_counter =0;
    }
    else
    {
        OnComingObj1_OnComingObj1_blockCtr_counter =OnComingObj1_OnComingObj1_blockCtr_counter+1;
    }    
    
}
update_OnComingObj1_OnComingObj1_MsgCtr_counter()
{
    //update the signal value
    Msg_OnComingObj1.OnComingObj1_MsgCtr=OnComingObj1_OnComingObj1_MsgCtr_counter;
    
    if(OnComingObj1_OnComingObj1_MsgCtr_counter == 15)
    {
        OnComingObj1_OnComingObj1_MsgCtr_counter =0;
    }
    else
    {
        OnComingObj1_OnComingObj1_MsgCtr_counter =OnComingObj1_OnComingObj1_MsgCtr_counter+1;
    }    
    
}
update_OnComingObj0_OnComingObj0_MsgCtr_counter()
{
    //update the signal value
    Msg_OnComingObj0.OnComingObj0_MsgCtr=OnComingObj0_OnComingObj0_MsgCtr_counter;
    
    if(OnComingObj0_OnComingObj0_MsgCtr_counter == 15)
    {
        OnComingObj0_OnComingObj0_MsgCtr_counter =0;
    }
    else
    {
        OnComingObj0_OnComingObj0_MsgCtr_counter =OnComingObj0_OnComingObj0_MsgCtr_counter+1;
    }    
    
}
update_OnComingObj0_OnComingObj0_blockCtr_counter()
{
    //update the signal value
    Msg_OnComingObj0.OnComingObj0_blockCtr=OnComingObj0_OnComingObj0_blockCtr_counter;
    
    if(OnComingObj0_OnComingObj0_blockCtr_counter == 15)
    {
        OnComingObj0_OnComingObj0_blockCtr_counter =0;
    }
    else
    {
        OnComingObj0_OnComingObj0_blockCtr_counter =OnComingObj0_OnComingObj0_blockCtr_counter+1;
    }    
    
}
update_TrajPointACCObj19_TrajPointACCObj19_blockCtr_counter()
{
    //update the signal value
    Msg_TrajPointACCObj19.TrajPointACCObj19_blockCtr=TrajPointACCObj19_TrajPointACCObj19_blockCtr_counter;
    
    if(TrajPointACCObj19_TrajPointACCObj19_blockCtr_counter == 15)
    {
        TrajPointACCObj19_TrajPointACCObj19_blockCtr_counter =0;
    }
    else
    {
        TrajPointACCObj19_TrajPointACCObj19_blockCtr_counter =TrajPointACCObj19_TrajPointACCObj19_blockCtr_counter+1;
    }    
    
}
update_TrajPointACCObj19_TrajPointACCObj19_MsgCtr_counter()
{
    //update the signal value
    Msg_TrajPointACCObj19.TrajPointACCObj19_MsgCtr=TrajPointACCObj19_TrajPointACCObj19_MsgCtr_counter;
    
    if(TrajPointACCObj19_TrajPointACCObj19_MsgCtr_counter == 15)
    {
        TrajPointACCObj19_TrajPointACCObj19_MsgCtr_counter =0;
    }
    else
    {
        TrajPointACCObj19_TrajPointACCObj19_MsgCtr_counter =TrajPointACCObj19_TrajPointACCObj19_MsgCtr_counter+1;
    }    
    
}
update_TrajPointACCObj18_TrajPointACCObj18_blockCtr_counter()
{
    //update the signal value
    Msg_TrajPointACCObj18.TrajPointACCObj18_blockCtr=TrajPointACCObj18_TrajPointACCObj18_blockCtr_counter;
    
    if(TrajPointACCObj18_TrajPointACCObj18_blockCtr_counter == 15)
    {
        TrajPointACCObj18_TrajPointACCObj18_blockCtr_counter =0;
    }
    else
    {
        TrajPointACCObj18_TrajPointACCObj18_blockCtr_counter =TrajPointACCObj18_TrajPointACCObj18_blockCtr_counter+1;
    }    
    
}
update_TrajPointACCObj18_TrajPointACCObj18_MsgCtr_counter()
{
    //update the signal value
    Msg_TrajPointACCObj18.TrajPointACCObj18_MsgCtr=TrajPointACCObj18_TrajPointACCObj18_MsgCtr_counter;
    
    if(TrajPointACCObj18_TrajPointACCObj18_MsgCtr_counter == 15)
    {
        TrajPointACCObj18_TrajPointACCObj18_MsgCtr_counter =0;
    }
    else
    {
        TrajPointACCObj18_TrajPointACCObj18_MsgCtr_counter =TrajPointACCObj18_TrajPointACCObj18_MsgCtr_counter+1;
    }    
    
}
update_OnGoingObj1_OnGoingObj1_blockCtr_counter()
{
    //update the signal value
    Msg_OnGoingObj1.OnGoingObj1_blockCtr=OnGoingObj1_OnGoingObj1_blockCtr_counter;
    
    if(OnGoingObj1_OnGoingObj1_blockCtr_counter == 15)
    {
        OnGoingObj1_OnGoingObj1_blockCtr_counter =0;
    }
    else
    {
        OnGoingObj1_OnGoingObj1_blockCtr_counter =OnGoingObj1_OnGoingObj1_blockCtr_counter+1;
    }    
    
}
update_OnGoingObj1_OnGoingObj1_MsgCtr_counter()
{
    //update the signal value
    Msg_OnGoingObj1.OnGoingObj1_MsgCtr=OnGoingObj1_OnGoingObj1_MsgCtr_counter;
    
    if(OnGoingObj1_OnGoingObj1_MsgCtr_counter == 15)
    {
        OnGoingObj1_OnGoingObj1_MsgCtr_counter =0;
    }
    else
    {
        OnGoingObj1_OnGoingObj1_MsgCtr_counter =OnGoingObj1_OnGoingObj1_MsgCtr_counter+1;
    }    
    
}
update_OnGoingObj0_OnGoingObj0_MsgCtr_counter()
{
    //update the signal value
    Msg_OnGoingObj0.OnGoingObj0_MsgCtr=OnGoingObj0_OnGoingObj0_MsgCtr_counter;
    
    if(OnGoingObj0_OnGoingObj0_MsgCtr_counter == 15)
    {
        OnGoingObj0_OnGoingObj0_MsgCtr_counter =0;
    }
    else
    {
        OnGoingObj0_OnGoingObj0_MsgCtr_counter =OnGoingObj0_OnGoingObj0_MsgCtr_counter+1;
    }    
    
}
update_OnGoingObj0_OnGoingObj0_blockCtr_counter()
{
    //update the signal value
    Msg_OnGoingObj0.OnGoingObj0_blockCtr=OnGoingObj0_OnGoingObj0_blockCtr_counter;
    
    if(OnGoingObj0_OnGoingObj0_blockCtr_counter == 15)
    {
        OnGoingObj0_OnGoingObj0_blockCtr_counter =0;
    }
    else
    {
        OnGoingObj0_OnGoingObj0_blockCtr_counter =OnGoingObj0_OnGoingObj0_blockCtr_counter+1;
    }    
    
}
update_TrajPointACCObj13_TrajPointACCObj13_MsgCtr_counter()
{
    //update the signal value
    Msg_TrajPointACCObj13.TrajPointACCObj13_MsgCtr=TrajPointACCObj13_TrajPointACCObj13_MsgCtr_counter;
    
    if(TrajPointACCObj13_TrajPointACCObj13_MsgCtr_counter == 15)
    {
        TrajPointACCObj13_TrajPointACCObj13_MsgCtr_counter =0;
    }
    else
    {
        TrajPointACCObj13_TrajPointACCObj13_MsgCtr_counter =TrajPointACCObj13_TrajPointACCObj13_MsgCtr_counter+1;
    }    
    
}
update_TrajPointACCObj13_TrajPointACCObj13_blockCtr_counter()
{
    //update the signal value
    Msg_TrajPointACCObj13.TrajPointACCObj13_blockCtr=TrajPointACCObj13_TrajPointACCObj13_blockCtr_counter;
    
    if(TrajPointACCObj13_TrajPointACCObj13_blockCtr_counter == 15)
    {
        TrajPointACCObj13_TrajPointACCObj13_blockCtr_counter =0;
    }
    else
    {
        TrajPointACCObj13_TrajPointACCObj13_blockCtr_counter =TrajPointACCObj13_TrajPointACCObj13_blockCtr_counter+1;
    }    
    
}
update_TrajPointACCObj12_TrajPointACCObj12_MsgCtr_counter()
{
    //update the signal value
    Msg_TrajPointACCObj12.TrajPointACCObj12_MsgCtr=TrajPointACCObj12_TrajPointACCObj12_MsgCtr_counter;
    
    if(TrajPointACCObj12_TrajPointACCObj12_MsgCtr_counter == 15)
    {
        TrajPointACCObj12_TrajPointACCObj12_MsgCtr_counter =0;
    }
    else
    {
        TrajPointACCObj12_TrajPointACCObj12_MsgCtr_counter =TrajPointACCObj12_TrajPointACCObj12_MsgCtr_counter+1;
    }    
    
}
update_TrajPointACCObj12_TrajPointACCObj12_blockCtr_counter()
{
    //update the signal value
    Msg_TrajPointACCObj12.TrajPointACCObj12_blockCtr=TrajPointACCObj12_TrajPointACCObj12_blockCtr_counter;
    
    if(TrajPointACCObj12_TrajPointACCObj12_blockCtr_counter == 15)
    {
        TrajPointACCObj12_TrajPointACCObj12_blockCtr_counter =0;
    }
    else
    {
        TrajPointACCObj12_TrajPointACCObj12_blockCtr_counter =TrajPointACCObj12_TrajPointACCObj12_blockCtr_counter+1;
    }    
    
}
update_TrajPointACCObj11_TrajPointACCObj11_MsgCtr_counter()
{
    //update the signal value
    Msg_TrajPointACCObj11.TrajPointACCObj11_MsgCtr=TrajPointACCObj11_TrajPointACCObj11_MsgCtr_counter;
    
    if(TrajPointACCObj11_TrajPointACCObj11_MsgCtr_counter == 15)
    {
        TrajPointACCObj11_TrajPointACCObj11_MsgCtr_counter =0;
    }
    else
    {
        TrajPointACCObj11_TrajPointACCObj11_MsgCtr_counter =TrajPointACCObj11_TrajPointACCObj11_MsgCtr_counter+1;
    }    
    
}
update_TrajPointACCObj11_TrajPointACCObj11_blockCtr_counter()
{
    //update the signal value
    Msg_TrajPointACCObj11.TrajPointACCObj11_blockCtr=TrajPointACCObj11_TrajPointACCObj11_blockCtr_counter;
    
    if(TrajPointACCObj11_TrajPointACCObj11_blockCtr_counter == 15)
    {
        TrajPointACCObj11_TrajPointACCObj11_blockCtr_counter =0;
    }
    else
    {
        TrajPointACCObj11_TrajPointACCObj11_blockCtr_counter =TrajPointACCObj11_TrajPointACCObj11_blockCtr_counter+1;
    }    
    
}
update_TrajPointACCObj10_TrajPointACCObj10_blockCtr_counter()
{
    //update the signal value
    Msg_TrajPointACCObj10.TrajPointACCObj10_blockCtr=TrajPointACCObj10_TrajPointACCObj10_blockCtr_counter;
    
    if(TrajPointACCObj10_TrajPointACCObj10_blockCtr_counter == 15)
    {
        TrajPointACCObj10_TrajPointACCObj10_blockCtr_counter =0;
    }
    else
    {
        TrajPointACCObj10_TrajPointACCObj10_blockCtr_counter =TrajPointACCObj10_TrajPointACCObj10_blockCtr_counter+1;
    }    
    
}
update_TrajPointACCObj10_TrajPointACCObj10_MsgCtr_counter()
{
    //update the signal value
    Msg_TrajPointACCObj10.TrajPointACCObj10_MsgCtr=TrajPointACCObj10_TrajPointACCObj10_MsgCtr_counter;
    
    if(TrajPointACCObj10_TrajPointACCObj10_MsgCtr_counter == 15)
    {
        TrajPointACCObj10_TrajPointACCObj10_MsgCtr_counter =0;
    }
    else
    {
        TrajPointACCObj10_TrajPointACCObj10_MsgCtr_counter =TrajPointACCObj10_TrajPointACCObj10_MsgCtr_counter+1;
    }    
    
}
update_TrajPointACCObj17_TrajPointACCObj17_MsgCtr_counter()
{
    //update the signal value
    Msg_TrajPointACCObj17.TrajPointACCObj17_MsgCtr=TrajPointACCObj17_TrajPointACCObj17_MsgCtr_counter;
    
    if(TrajPointACCObj17_TrajPointACCObj17_MsgCtr_counter == 15)
    {
        TrajPointACCObj17_TrajPointACCObj17_MsgCtr_counter =0;
    }
    else
    {
        TrajPointACCObj17_TrajPointACCObj17_MsgCtr_counter =TrajPointACCObj17_TrajPointACCObj17_MsgCtr_counter+1;
    }    
    
}
update_TrajPointACCObj17_TrajPointACCObj17_blockCtr_counter()
{
    //update the signal value
    Msg_TrajPointACCObj17.TrajPointACCObj17_blockCtr=TrajPointACCObj17_TrajPointACCObj17_blockCtr_counter;
    
    if(TrajPointACCObj17_TrajPointACCObj17_blockCtr_counter == 15)
    {
        TrajPointACCObj17_TrajPointACCObj17_blockCtr_counter =0;
    }
    else
    {
        TrajPointACCObj17_TrajPointACCObj17_blockCtr_counter =TrajPointACCObj17_TrajPointACCObj17_blockCtr_counter+1;
    }    
    
}
update_TrajACC_TrajACC_blockCtr_counter()
{
    //update the signal value
    Msg_TrajACC.TrajACC_blockCtr=TrajACC_TrajACC_blockCtr_counter;
    
    if(TrajACC_TrajACC_blockCtr_counter == 15)
    {
        TrajACC_TrajACC_blockCtr_counter =0;
    }
    else
    {
        TrajACC_TrajACC_blockCtr_counter =TrajACC_TrajACC_blockCtr_counter+1;
    }    
    
}
update_TrajACC_TrajACC_MsgCtr_counter()
{
    //update the signal value
    Msg_TrajACC.TrajACC_MsgCtr=TrajACC_TrajACC_MsgCtr_counter;
    
    if(TrajACC_TrajACC_MsgCtr_counter == 15)
    {
        TrajACC_TrajACC_MsgCtr_counter =0;
    }
    else
    {
        TrajACC_TrajACC_MsgCtr_counter =TrajACC_TrajACC_MsgCtr_counter+1;
    }    
    
}
update_TrajPointACCObj15_TrajPointACCObj15_blockCtr_counter()
{
    //update the signal value
    Msg_TrajPointACCObj15.TrajPointACCObj15_blockCtr=TrajPointACCObj15_TrajPointACCObj15_blockCtr_counter;
    
    if(TrajPointACCObj15_TrajPointACCObj15_blockCtr_counter == 15)
    {
        TrajPointACCObj15_TrajPointACCObj15_blockCtr_counter =0;
    }
    else
    {
        TrajPointACCObj15_TrajPointACCObj15_blockCtr_counter =TrajPointACCObj15_TrajPointACCObj15_blockCtr_counter+1;
    }    
    
}
update_TrajPointACCObj15_TrajPointACCObj15_MsgCtr_counter()
{
    //update the signal value
    Msg_TrajPointACCObj15.TrajPointACCObj15_MsgCtr=TrajPointACCObj15_TrajPointACCObj15_MsgCtr_counter;
    
    if(TrajPointACCObj15_TrajPointACCObj15_MsgCtr_counter == 15)
    {
        TrajPointACCObj15_TrajPointACCObj15_MsgCtr_counter =0;
    }
    else
    {
        TrajPointACCObj15_TrajPointACCObj15_MsgCtr_counter =TrajPointACCObj15_TrajPointACCObj15_MsgCtr_counter+1;
    }    
    
}
update_TrajPointACCObj14_TrajPointACCObj14_blockCtr_counter()
{
    //update the signal value
    Msg_TrajPointACCObj14.TrajPointACCObj14_blockCtr=TrajPointACCObj14_TrajPointACCObj14_blockCtr_counter;
    
    if(TrajPointACCObj14_TrajPointACCObj14_blockCtr_counter == 15)
    {
        TrajPointACCObj14_TrajPointACCObj14_blockCtr_counter =0;
    }
    else
    {
        TrajPointACCObj14_TrajPointACCObj14_blockCtr_counter =TrajPointACCObj14_TrajPointACCObj14_blockCtr_counter+1;
    }    
    
}
update_TrajPointACCObj14_TrajPointACCObj14_MsgCtr_counter()
{
    //update the signal value
    Msg_TrajPointACCObj14.TrajPointACCObj14_MsgCtr=TrajPointACCObj14_TrajPointACCObj14_MsgCtr_counter;
    
    if(TrajPointACCObj14_TrajPointACCObj14_MsgCtr_counter == 15)
    {
        TrajPointACCObj14_TrajPointACCObj14_MsgCtr_counter =0;
    }
    else
    {
        TrajPointACCObj14_TrajPointACCObj14_MsgCtr_counter =TrajPointACCObj14_TrajPointACCObj14_MsgCtr_counter+1;
    }    
    
}
update_RDR_Status_RDR_Status_MsgCtr_counter()
{
    //update the signal value
    Msg_RDR_Status.RDR_Status_MsgCtr=RDR_Status_RDR_Status_MsgCtr_counter;
    
    if(RDR_Status_RDR_Status_MsgCtr_counter == 15)
    {
        RDR_Status_RDR_Status_MsgCtr_counter =0;
    }
    else
    {
        RDR_Status_RDR_Status_MsgCtr_counter =RDR_Status_RDR_Status_MsgCtr_counter+1;
    }    
    
}
update_RDR_Status_RDR_Status_blockCtr_counter()
{
    //update the signal value
    Msg_RDR_Status.RDR_Status_blockCtr=RDR_Status_RDR_Status_blockCtr_counter;
    
    if(RDR_Status_RDR_Status_blockCtr_counter == 15)
    {
        RDR_Status_RDR_Status_blockCtr_counter =0;
    }
    else
    {
        RDR_Status_RDR_Status_blockCtr_counter =RDR_Status_RDR_Status_blockCtr_counter+1;
    }    
    
}
update_TrajPointACCObj9_TrajPointACCObj9_MsgCtr_counter()
{
    //update the signal value
    Msg_TrajPointACCObj9.TrajPointACCObj9_MsgCtr=TrajPointACCObj9_TrajPointACCObj9_MsgCtr_counter;
    
    if(TrajPointACCObj9_TrajPointACCObj9_MsgCtr_counter == 15)
    {
        TrajPointACCObj9_TrajPointACCObj9_MsgCtr_counter =0;
    }
    else
    {
        TrajPointACCObj9_TrajPointACCObj9_MsgCtr_counter =TrajPointACCObj9_TrajPointACCObj9_MsgCtr_counter+1;
    }    
    
}
update_TrajPointACCObj9_TrajPointACCObj9_blockCtr_counter()
{
    //update the signal value
    Msg_TrajPointACCObj9.TrajPointACCObj9_blockCtr=TrajPointACCObj9_TrajPointACCObj9_blockCtr_counter;
    
    if(TrajPointACCObj9_TrajPointACCObj9_blockCtr_counter == 15)
    {
        TrajPointACCObj9_TrajPointACCObj9_blockCtr_counter =0;
    }
    else
    {
        TrajPointACCObj9_TrajPointACCObj9_blockCtr_counter =TrajPointACCObj9_TrajPointACCObj9_blockCtr_counter+1;
    }    
    
}
update_TrajPointACCObj8_TrajPointACCObj8_MsgCtr_counter()
{
    //update the signal value
    Msg_TrajPointACCObj8.TrajPointACCObj8_MsgCtr=TrajPointACCObj8_TrajPointACCObj8_MsgCtr_counter;
    
    if(TrajPointACCObj8_TrajPointACCObj8_MsgCtr_counter == 15)
    {
        TrajPointACCObj8_TrajPointACCObj8_MsgCtr_counter =0;
    }
    else
    {
        TrajPointACCObj8_TrajPointACCObj8_MsgCtr_counter =TrajPointACCObj8_TrajPointACCObj8_MsgCtr_counter+1;
    }    
    
}
update_TrajPointACCObj8_TrajPointACCObj8_blockCtr_counter()
{
    //update the signal value
    Msg_TrajPointACCObj8.TrajPointACCObj8_blockCtr=TrajPointACCObj8_TrajPointACCObj8_blockCtr_counter;
    
    if(TrajPointACCObj8_TrajPointACCObj8_blockCtr_counter == 15)
    {
        TrajPointACCObj8_TrajPointACCObj8_blockCtr_counter =0;
    }
    else
    {
        TrajPointACCObj8_TrajPointACCObj8_blockCtr_counter =TrajPointACCObj8_TrajPointACCObj8_blockCtr_counter+1;
    }    
    
}
update_TrajPointACCObj7_TrajPointACCObj7_MsgCtr_counter()
{
    //update the signal value
    Msg_TrajPointACCObj7.TrajPointACCObj7_MsgCtr=TrajPointACCObj7_TrajPointACCObj7_MsgCtr_counter;
    
    if(TrajPointACCObj7_TrajPointACCObj7_MsgCtr_counter == 15)
    {
        TrajPointACCObj7_TrajPointACCObj7_MsgCtr_counter =0;
    }
    else
    {
        TrajPointACCObj7_TrajPointACCObj7_MsgCtr_counter =TrajPointACCObj7_TrajPointACCObj7_MsgCtr_counter+1;
    }    
    
}
update_TrajPointACCObj7_TrajPointACCObj7_blockCtr_counter()
{
    //update the signal value
    Msg_TrajPointACCObj7.TrajPointACCObj7_blockCtr=TrajPointACCObj7_TrajPointACCObj7_blockCtr_counter;
    
    if(TrajPointACCObj7_TrajPointACCObj7_blockCtr_counter == 15)
    {
        TrajPointACCObj7_TrajPointACCObj7_blockCtr_counter =0;
    }
    else
    {
        TrajPointACCObj7_TrajPointACCObj7_blockCtr_counter =TrajPointACCObj7_TrajPointACCObj7_blockCtr_counter+1;
    }    
    
}
update_TrajPointACCObj6_TrajPointACCObj6_MsgCtr_counter()
{
    //update the signal value
    Msg_TrajPointACCObj6.TrajPointACCObj6_MsgCtr=TrajPointACCObj6_TrajPointACCObj6_MsgCtr_counter;
    
    if(TrajPointACCObj6_TrajPointACCObj6_MsgCtr_counter == 15)
    {
        TrajPointACCObj6_TrajPointACCObj6_MsgCtr_counter =0;
    }
    else
    {
        TrajPointACCObj6_TrajPointACCObj6_MsgCtr_counter =TrajPointACCObj6_TrajPointACCObj6_MsgCtr_counter+1;
    }    
    
}
update_TrajPointACCObj6_TrajPointACCObj6_blockCtr_counter()
{
    //update the signal value
    Msg_TrajPointACCObj6.TrajPointACCObj6_blockCtr=TrajPointACCObj6_TrajPointACCObj6_blockCtr_counter;
    
    if(TrajPointACCObj6_TrajPointACCObj6_blockCtr_counter == 15)
    {
        TrajPointACCObj6_TrajPointACCObj6_blockCtr_counter =0;
    }
    else
    {
        TrajPointACCObj6_TrajPointACCObj6_blockCtr_counter =TrajPointACCObj6_TrajPointACCObj6_blockCtr_counter+1;
    }    
    
}
update_TrajPointACCObj5_TrajPointACCObj5_blockCtr_counter()
{
    //update the signal value
    Msg_TrajPointACCObj5.TrajPointACCObj5_blockCtr=TrajPointACCObj5_TrajPointACCObj5_blockCtr_counter;
    
    if(TrajPointACCObj5_TrajPointACCObj5_blockCtr_counter == 15)
    {
        TrajPointACCObj5_TrajPointACCObj5_blockCtr_counter =0;
    }
    else
    {
        TrajPointACCObj5_TrajPointACCObj5_blockCtr_counter =TrajPointACCObj5_TrajPointACCObj5_blockCtr_counter+1;
    }    
    
}
update_TrajPointACCObj5_TrajPointACCObj5_MsgCtr_counter()
{
    //update the signal value
    Msg_TrajPointACCObj5.TrajPointACCObj5_MsgCtr=TrajPointACCObj5_TrajPointACCObj5_MsgCtr_counter;
    
    if(TrajPointACCObj5_TrajPointACCObj5_MsgCtr_counter == 15)
    {
        TrajPointACCObj5_TrajPointACCObj5_MsgCtr_counter =0;
    }
    else
    {
        TrajPointACCObj5_TrajPointACCObj5_MsgCtr_counter =TrajPointACCObj5_TrajPointACCObj5_MsgCtr_counter+1;
    }    
    
}
update_TrajPointACCObj4_TrajPointACCObj4_blockCtr_counter()
{
    //update the signal value
    Msg_TrajPointACCObj4.TrajPointACCObj4_blockCtr=TrajPointACCObj4_TrajPointACCObj4_blockCtr_counter;
    
    if(TrajPointACCObj4_TrajPointACCObj4_blockCtr_counter == 15)
    {
        TrajPointACCObj4_TrajPointACCObj4_blockCtr_counter =0;
    }
    else
    {
        TrajPointACCObj4_TrajPointACCObj4_blockCtr_counter =TrajPointACCObj4_TrajPointACCObj4_blockCtr_counter+1;
    }    
    
}
update_TrajPointACCObj4_TrajPointACCObj4_MsgCtr_counter()
{
    //update the signal value
    Msg_TrajPointACCObj4.TrajPointACCObj4_MsgCtr=TrajPointACCObj4_TrajPointACCObj4_MsgCtr_counter;
    
    if(TrajPointACCObj4_TrajPointACCObj4_MsgCtr_counter == 15)
    {
        TrajPointACCObj4_TrajPointACCObj4_MsgCtr_counter =0;
    }
    else
    {
        TrajPointACCObj4_TrajPointACCObj4_MsgCtr_counter =TrajPointACCObj4_TrajPointACCObj4_MsgCtr_counter+1;
    }    
    
}
update_TrajPointACCObj3_TrajPointACCObj3_MsgCtr_counter()
{
    //update the signal value
    Msg_TrajPointACCObj3.TrajPointACCObj3_MsgCtr=TrajPointACCObj3_TrajPointACCObj3_MsgCtr_counter;
    
    if(TrajPointACCObj3_TrajPointACCObj3_MsgCtr_counter == 15)
    {
        TrajPointACCObj3_TrajPointACCObj3_MsgCtr_counter =0;
    }
    else
    {
        TrajPointACCObj3_TrajPointACCObj3_MsgCtr_counter =TrajPointACCObj3_TrajPointACCObj3_MsgCtr_counter+1;
    }    
    
}
update_TrajPointACCObj3_TrajPointACCObj3_blockCtr_counter()
{
    //update the signal value
    Msg_TrajPointACCObj3.TrajPointACCObj3_blockCtr=TrajPointACCObj3_TrajPointACCObj3_blockCtr_counter;
    
    if(TrajPointACCObj3_TrajPointACCObj3_blockCtr_counter == 15)
    {
        TrajPointACCObj3_TrajPointACCObj3_blockCtr_counter =0;
    }
    else
    {
        TrajPointACCObj3_TrajPointACCObj3_blockCtr_counter =TrajPointACCObj3_TrajPointACCObj3_blockCtr_counter+1;
    }    
    
}
update_TrajPointACCObj2_TrajPointACCObj2_blockCtr_counter()
{
    //update the signal value
    Msg_TrajPointACCObj2.TrajPointACCObj2_blockCtr=TrajPointACCObj2_TrajPointACCObj2_blockCtr_counter;
    
    if(TrajPointACCObj2_TrajPointACCObj2_blockCtr_counter == 15)
    {
        TrajPointACCObj2_TrajPointACCObj2_blockCtr_counter =0;
    }
    else
    {
        TrajPointACCObj2_TrajPointACCObj2_blockCtr_counter =TrajPointACCObj2_TrajPointACCObj2_blockCtr_counter+1;
    }    
    
}
update_TrajPointACCObj2_TrajPointACCObj2_MsgCtr_counter()
{
    //update the signal value
    Msg_TrajPointACCObj2.TrajPointACCObj2_MsgCtr=TrajPointACCObj2_TrajPointACCObj2_MsgCtr_counter;
    
    if(TrajPointACCObj2_TrajPointACCObj2_MsgCtr_counter == 15)
    {
        TrajPointACCObj2_TrajPointACCObj2_MsgCtr_counter =0;
    }
    else
    {
        TrajPointACCObj2_TrajPointACCObj2_MsgCtr_counter =TrajPointACCObj2_TrajPointACCObj2_MsgCtr_counter+1;
    }    
    
}
update_TrajPointACCObj1_TrajPointACCObj1_blockCtr_counter()
{
    //update the signal value
    Msg_TrajPointACCObj1.TrajPointACCObj1_blockCtr=TrajPointACCObj1_TrajPointACCObj1_blockCtr_counter;
    
    if(TrajPointACCObj1_TrajPointACCObj1_blockCtr_counter == 15)
    {
        TrajPointACCObj1_TrajPointACCObj1_blockCtr_counter =0;
    }
    else
    {
        TrajPointACCObj1_TrajPointACCObj1_blockCtr_counter =TrajPointACCObj1_TrajPointACCObj1_blockCtr_counter+1;
    }    
    
}
update_TrajPointACCObj1_TrajPointACCObj1_MsgCtr_counter()
{
    //update the signal value
    Msg_TrajPointACCObj1.TrajPointACCObj1_MsgCtr=TrajPointACCObj1_TrajPointACCObj1_MsgCtr_counter;
    
    if(TrajPointACCObj1_TrajPointACCObj1_MsgCtr_counter == 15)
    {
        TrajPointACCObj1_TrajPointACCObj1_MsgCtr_counter =0;
    }
    else
    {
        TrajPointACCObj1_TrajPointACCObj1_MsgCtr_counter =TrajPointACCObj1_TrajPointACCObj1_MsgCtr_counter+1;
    }    
    
}
update_TrajPointACCObj0_TrajPointACCObj0_blockCtr_counter()
{
    //update the signal value
    Msg_TrajPointACCObj0.TrajPointACCObj0_blockCtr=TrajPointACCObj0_TrajPointACCObj0_blockCtr_counter;
    
    if(TrajPointACCObj0_TrajPointACCObj0_blockCtr_counter == 15)
    {
        TrajPointACCObj0_TrajPointACCObj0_blockCtr_counter =0;
    }
    else
    {
        TrajPointACCObj0_TrajPointACCObj0_blockCtr_counter =TrajPointACCObj0_TrajPointACCObj0_blockCtr_counter+1;
    }    
    
}
update_TrajPointACCObj0_TrajPointACCObj0_MsgCtr_counter()
{
    //update the signal value
    Msg_TrajPointACCObj0.TrajPointACCObj0_MsgCtr=TrajPointACCObj0_TrajPointACCObj0_MsgCtr_counter;
    
    if(TrajPointACCObj0_TrajPointACCObj0_MsgCtr_counter == 15)
    {
        TrajPointACCObj0_TrajPointACCObj0_MsgCtr_counter =0;
    }
    else
    {
        TrajPointACCObj0_TrajPointACCObj0_MsgCtr_counter =TrajPointACCObj0_TrajPointACCObj0_MsgCtr_counter+1;
    }    
    
}
update_ACCObjInfo_ACCObjInfo_MsgCtr_counter()
{
    //update the signal value
    Msg_ACCObjInfo.ACCObjInfo_MsgCtr=ACCObjInfo_ACCObjInfo_MsgCtr_counter;
    
    if(ACCObjInfo_ACCObjInfo_MsgCtr_counter == 15)
    {
        ACCObjInfo_ACCObjInfo_MsgCtr_counter =0;
    }
    else
    {
        ACCObjInfo_ACCObjInfo_MsgCtr_counter =ACCObjInfo_ACCObjInfo_MsgCtr_counter+1;
    }    
    
}
update_ACCObjInfo_ACCObjInfo_blockCtr_counter()
{
    //update the signal value
    Msg_ACCObjInfo.ACCObjInfo_blockCtr=ACCObjInfo_ACCObjInfo_blockCtr_counter;
    
    if(ACCObjInfo_ACCObjInfo_blockCtr_counter == 15)
    {
        ACCObjInfo_ACCObjInfo_blockCtr_counter =0;
    }
    else
    {
        ACCObjInfo_ACCObjInfo_blockCtr_counter =ACCObjInfo_ACCObjInfo_blockCtr_counter+1;
    }    
    
}
update_TIPLLaneInfo0_TIPLLaneInfo0_MsgCtr_counter()
{
    //update the signal value
    Msg_TIPLLaneInfo0.TIPLLaneInfo0_MsgCtr=TIPLLaneInfo0_TIPLLaneInfo0_MsgCtr_counter;
    
    if(TIPLLaneInfo0_TIPLLaneInfo0_MsgCtr_counter == 15)
    {
        TIPLLaneInfo0_TIPLLaneInfo0_MsgCtr_counter =0;
    }
    else
    {
        TIPLLaneInfo0_TIPLLaneInfo0_MsgCtr_counter =TIPLLaneInfo0_TIPLLaneInfo0_MsgCtr_counter+1;
    }    
    
}
update_TIPLLaneInfo0_TIPLLaneInfo0_blockCtr_counter()
{
    //update the signal value
    Msg_TIPLLaneInfo0.TIPLLaneInfo0_blockCtr=TIPLLaneInfo0_TIPLLaneInfo0_blockCtr_counter;
    
    if(TIPLLaneInfo0_TIPLLaneInfo0_blockCtr_counter == 15)
    {
        TIPLLaneInfo0_TIPLLaneInfo0_blockCtr_counter =0;
    }
    else
    {
        TIPLLaneInfo0_TIPLLaneInfo0_blockCtr_counter =TIPLLaneInfo0_TIPLLaneInfo0_blockCtr_counter+1;
    }    
    
}
update_TIPLLaneInfo1_TIPLLaneInfo1_MsgCtr_counter()
{
    //update the signal value
    Msg_TIPLLaneInfo1.TIPLLaneInfo1_MsgCtr=TIPLLaneInfo1_TIPLLaneInfo1_MsgCtr_counter;
    
    if(TIPLLaneInfo1_TIPLLaneInfo1_MsgCtr_counter == 15)
    {
        TIPLLaneInfo1_TIPLLaneInfo1_MsgCtr_counter =0;
    }
    else
    {
        TIPLLaneInfo1_TIPLLaneInfo1_MsgCtr_counter =TIPLLaneInfo1_TIPLLaneInfo1_MsgCtr_counter+1;
    }    
    
}
update_TIPLLaneInfo1_TIPLLaneInfo1_blockCtr_counter()
{
    //update the signal value
    Msg_TIPLLaneInfo1.TIPLLaneInfo1_blockCtr=TIPLLaneInfo1_TIPLLaneInfo1_blockCtr_counter;
    
    if(TIPLLaneInfo1_TIPLLaneInfo1_blockCtr_counter == 15)
    {
        TIPLLaneInfo1_TIPLLaneInfo1_blockCtr_counter =0;
    }
    else
    {
        TIPLLaneInfo1_TIPLLaneInfo1_blockCtr_counter =TIPLLaneInfo1_TIPLLaneInfo1_blockCtr_counter+1;
    }    
    
}
update_TIPLLaneInfo2_TIPLLaneInfo2_blockCtr_counter()
{
    //update the signal value
    Msg_TIPLLaneInfo2.TIPLLaneInfo2_blockCtr=TIPLLaneInfo2_TIPLLaneInfo2_blockCtr_counter;
    
    if(TIPLLaneInfo2_TIPLLaneInfo2_blockCtr_counter == 15)
    {
        TIPLLaneInfo2_TIPLLaneInfo2_blockCtr_counter =0;
    }
    else
    {
        TIPLLaneInfo2_TIPLLaneInfo2_blockCtr_counter =TIPLLaneInfo2_TIPLLaneInfo2_blockCtr_counter+1;
    }    
    
}
update_TIPLLaneInfo2_TIPLLaneInfo2_MsgCtr_counter()
{
    //update the signal value
    Msg_TIPLLaneInfo2.TIPLLaneInfo2_MsgCtr=TIPLLaneInfo2_TIPLLaneInfo2_MsgCtr_counter;
    
    if(TIPLLaneInfo2_TIPLLaneInfo2_MsgCtr_counter == 15)
    {
        TIPLLaneInfo2_TIPLLaneInfo2_MsgCtr_counter =0;
    }
    else
    {
        TIPLLaneInfo2_TIPLLaneInfo2_MsgCtr_counter =TIPLLaneInfo2_TIPLLaneInfo2_MsgCtr_counter+1;
    }    
    
}
update_TIPLLaneInfo3_TIPLLaneInfo3_MsgCtr_counter()
{
    //update the signal value
    Msg_TIPLLaneInfo3.TIPLLaneInfo3_MsgCtr=TIPLLaneInfo3_TIPLLaneInfo3_MsgCtr_counter;
    
    if(TIPLLaneInfo3_TIPLLaneInfo3_MsgCtr_counter == 15)
    {
        TIPLLaneInfo3_TIPLLaneInfo3_MsgCtr_counter =0;
    }
    else
    {
        TIPLLaneInfo3_TIPLLaneInfo3_MsgCtr_counter =TIPLLaneInfo3_TIPLLaneInfo3_MsgCtr_counter+1;
    }    
    
}
update_TIPLLaneInfo3_TIPLLaneInfo3_blockCtr_counter()
{
    //update the signal value
    Msg_TIPLLaneInfo3.TIPLLaneInfo3_blockCtr=TIPLLaneInfo3_TIPLLaneInfo3_blockCtr_counter;
    
    if(TIPLLaneInfo3_TIPLLaneInfo3_blockCtr_counter == 15)
    {
        TIPLLaneInfo3_TIPLLaneInfo3_blockCtr_counter =0;
    }
    else
    {
        TIPLLaneInfo3_TIPLLaneInfo3_blockCtr_counter =TIPLLaneInfo3_TIPLLaneInfo3_blockCtr_counter+1;
    }    
    
}
update_TIPLCourseInfo1_TIPLCourseInfo1_MsgCtr_counter()
{
    //update the signal value
    Msg_TIPLCourseInfo1.TIPLCourseInfo1_MsgCtr=TIPLCourseInfo1_TIPLCourseInfo1_MsgCtr_counter;
    
    if(TIPLCourseInfo1_TIPLCourseInfo1_MsgCtr_counter == 15)
    {
        TIPLCourseInfo1_TIPLCourseInfo1_MsgCtr_counter =0;
    }
    else
    {
        TIPLCourseInfo1_TIPLCourseInfo1_MsgCtr_counter =TIPLCourseInfo1_TIPLCourseInfo1_MsgCtr_counter+1;
    }    
    
}
update_TIPLCourseInfo1_TIPLCourseInfo1_blockCtr_counter()
{
    //update the signal value
    Msg_TIPLCourseInfo1.TIPLCourseInfo1_blockCtr=TIPLCourseInfo1_TIPLCourseInfo1_blockCtr_counter;
    
    if(TIPLCourseInfo1_TIPLCourseInfo1_blockCtr_counter == 15)
    {
        TIPLCourseInfo1_TIPLCourseInfo1_blockCtr_counter =0;
    }
    else
    {
        TIPLCourseInfo1_TIPLCourseInfo1_blockCtr_counter =TIPLCourseInfo1_TIPLCourseInfo1_blockCtr_counter+1;
    }    
    
}
update_TIPLCourseInfo0_TIPLCourseInfo0_MsgCtr_counter()
{
    //update the signal value
    Msg_TIPLCourseInfo0.TIPLCourseInfo0_MsgCtr=TIPLCourseInfo0_TIPLCourseInfo0_MsgCtr_counter;
    
    if(TIPLCourseInfo0_TIPLCourseInfo0_MsgCtr_counter == 15)
    {
        TIPLCourseInfo0_TIPLCourseInfo0_MsgCtr_counter =0;
    }
    else
    {
        TIPLCourseInfo0_TIPLCourseInfo0_MsgCtr_counter =TIPLCourseInfo0_TIPLCourseInfo0_MsgCtr_counter+1;
    }    
    
}
update_TIPLCourseInfo0_TIPLCourseInfo0_blockCtr_counter()
{
    //update the signal value
    Msg_TIPLCourseInfo0.TIPLCourseInfo0_blockCtr=TIPLCourseInfo0_TIPLCourseInfo0_blockCtr_counter;
    
    if(TIPLCourseInfo0_TIPLCourseInfo0_blockCtr_counter == 15)
    {
        TIPLCourseInfo0_TIPLCourseInfo0_blockCtr_counter =0;
    }
    else
    {
        TIPLCourseInfo0_TIPLCourseInfo0_blockCtr_counter =TIPLCourseInfo0_TIPLCourseInfo0_blockCtr_counter+1;
    }    
    
}
update_TIPLCourseInfo3_TIPLCourseInfo3_blockCtr_counter()
{
    //update the signal value
    Msg_TIPLCourseInfo3.TIPLCourseInfo3_blockCtr=TIPLCourseInfo3_TIPLCourseInfo3_blockCtr_counter;
    
    if(TIPLCourseInfo3_TIPLCourseInfo3_blockCtr_counter == 15)
    {
        TIPLCourseInfo3_TIPLCourseInfo3_blockCtr_counter =0;
    }
    else
    {
        TIPLCourseInfo3_TIPLCourseInfo3_blockCtr_counter =TIPLCourseInfo3_TIPLCourseInfo3_blockCtr_counter+1;
    }    
    
}
update_TIPLCourseInfo3_TIPLCourseInfo3_MsgCtr_counter()
{
    //update the signal value
    Msg_TIPLCourseInfo3.TIPLCourseInfo3_MsgCtr=TIPLCourseInfo3_TIPLCourseInfo3_MsgCtr_counter;
    
    if(TIPLCourseInfo3_TIPLCourseInfo3_MsgCtr_counter == 15)
    {
        TIPLCourseInfo3_TIPLCourseInfo3_MsgCtr_counter =0;
    }
    else
    {
        TIPLCourseInfo3_TIPLCourseInfo3_MsgCtr_counter =TIPLCourseInfo3_TIPLCourseInfo3_MsgCtr_counter+1;
    }    
    
}
update_TIPLCourseInfo2_TIPLCourseInfo2_blockCtr_counter()
{
    //update the signal value
    Msg_TIPLCourseInfo2.TIPLCourseInfo2_blockCtr=TIPLCourseInfo2_TIPLCourseInfo2_blockCtr_counter;
    
    if(TIPLCourseInfo2_TIPLCourseInfo2_blockCtr_counter == 15)
    {
        TIPLCourseInfo2_TIPLCourseInfo2_blockCtr_counter =0;
    }
    else
    {
        TIPLCourseInfo2_TIPLCourseInfo2_blockCtr_counter =TIPLCourseInfo2_TIPLCourseInfo2_blockCtr_counter+1;
    }    
    
}
update_TIPLCourseInfo2_TIPLCourseInfo2_MsgCtr_counter()
{
    //update the signal value
    Msg_TIPLCourseInfo2.TIPLCourseInfo2_MsgCtr=TIPLCourseInfo2_TIPLCourseInfo2_MsgCtr_counter;
    
    if(TIPLCourseInfo2_TIPLCourseInfo2_MsgCtr_counter == 15)
    {
        TIPLCourseInfo2_TIPLCourseInfo2_MsgCtr_counter =0;
    }
    else
    {
        TIPLCourseInfo2_TIPLCourseInfo2_MsgCtr_counter =TIPLCourseInfo2_TIPLCourseInfo2_MsgCtr_counter+1;
    }    
    
}
update_TIPLCourseInfo4_TIPLCourseInfo4_blockCtr_counter()
{
    //update the signal value
    Msg_TIPLCourseInfo4.TIPLCourseInfo4_blockCtr=TIPLCourseInfo4_TIPLCourseInfo4_blockCtr_counter;
    
    if(TIPLCourseInfo4_TIPLCourseInfo4_blockCtr_counter == 15)
    {
        TIPLCourseInfo4_TIPLCourseInfo4_blockCtr_counter =0;
    }
    else
    {
        TIPLCourseInfo4_TIPLCourseInfo4_blockCtr_counter =TIPLCourseInfo4_TIPLCourseInfo4_blockCtr_counter+1;
    }    
    
}
update_TIPLCourseInfo4_TIPLCourseInfo4_MsgCtr_counter()
{
    //update the signal value
    Msg_TIPLCourseInfo4.TIPLCourseInfo4_MsgCtr=TIPLCourseInfo4_TIPLCourseInfo4_MsgCtr_counter;
    
    if(TIPLCourseInfo4_TIPLCourseInfo4_MsgCtr_counter == 15)
    {
        TIPLCourseInfo4_TIPLCourseInfo4_MsgCtr_counter =0;
    }
    else
    {
        TIPLCourseInfo4_TIPLCourseInfo4_MsgCtr_counter =TIPLCourseInfo4_TIPLCourseInfo4_MsgCtr_counter+1;
    }    
    
}
/*@@caplFunc:update_ACC_0x95_ACC_RollingCounter_0x95_counter():*///function
update_ACC_0x95_ACC_RollingCounter_0x95_counter()
{
    //update the signal value
    Msg_ACC_0x95.ACC_RollingCounter_0x95=ACC_0x95_ACC_RollingCounter_0x95_counter;
    
    if(ACC_0x95_ACC_RollingCounter_0x95_counter == 15)
    {
        ACC_0x95_ACC_RollingCounter_0x95_counter =0;
    }
    else
    {
        ACC_0x95_ACC_RollingCounter_0x95_counter =ACC_0x95_ACC_RollingCounter_0x95_counter+1;
    }    
    
}
/*@@caplFunc:update_TrajPointACCObj22_TrajPointACCObj22_MsgCtr_counter():*///function
update_TrajPointACCObj22_TrajPointACCObj22_MsgCtr_counter()
{
    //update the signal value
    Msg_TrajPointACCObj22.TrajPointACCObj22_MsgCtr=TrajPointACCObj22_TrajPointACCObj22_MsgCtr_counter;
    
    if(TrajPointACCObj22_TrajPointACCObj22_MsgCtr_counter == 15)
    {
        TrajPointACCObj22_TrajPointACCObj22_MsgCtr_counter =0;
    }
    else
    {
        TrajPointACCObj22_TrajPointACCObj22_MsgCtr_counter =TrajPointACCObj22_TrajPointACCObj22_MsgCtr_counter+1;
    }    
    
}
update_TrajPointACCObj22_TrajPointACCObj22_blockCtr_counter()
{
    //update the signal value
    Msg_TrajPointACCObj22.TrajPointACCObj22_blockCtr=TrajPointACCObj22_TrajPointACCObj22_blockCtr_counter;
    
    if(TrajPointACCObj22_TrajPointACCObj22_blockCtr_counter == 15)
    {
        TrajPointACCObj22_TrajPointACCObj22_blockCtr_counter =0;
    }
    else
    {
        TrajPointACCObj22_TrajPointACCObj22_blockCtr_counter =TrajPointACCObj22_TrajPointACCObj22_blockCtr_counter+1;
    }    
    
}
update_TrajPointACCObj23_TrajPointACCObj23_blockCtr_counter()
{
    //update the signal value
    Msg_TrajPointACCObj23.TrajPointACCObj23_blockCtr=TrajPointACCObj23_TrajPointACCObj23_blockCtr_counter;
    
    if(TrajPointACCObj23_TrajPointACCObj23_blockCtr_counter == 15)
    {
        TrajPointACCObj23_TrajPointACCObj23_blockCtr_counter =0;
    }
    else
    {
        TrajPointACCObj23_TrajPointACCObj23_blockCtr_counter =TrajPointACCObj23_TrajPointACCObj23_blockCtr_counter+1;
    }    
    
}
update_TrajPointACCObj23_TrajPointACCObj23_MsgCtr_counter()
{
    //update the signal value
    Msg_TrajPointACCObj23.TrajPointACCObj23_MsgCtr=TrajPointACCObj23_TrajPointACCObj23_MsgCtr_counter;
    
    if(TrajPointACCObj23_TrajPointACCObj23_MsgCtr_counter == 15)
    {
        TrajPointACCObj23_TrajPointACCObj23_MsgCtr_counter =0;
    }
    else
    {
        TrajPointACCObj23_TrajPointACCObj23_MsgCtr_counter =TrajPointACCObj23_TrajPointACCObj23_MsgCtr_counter+1;
    }    
    
}
update_TrajPointACCObj20_TrajPointACCObj20_blockCtr_counter()
{
    //update the signal value
    Msg_TrajPointACCObj20.TrajPointACCObj20_blockCtr=TrajPointACCObj20_TrajPointACCObj20_blockCtr_counter;
    
    if(TrajPointACCObj20_TrajPointACCObj20_blockCtr_counter == 15)
    {
        TrajPointACCObj20_TrajPointACCObj20_blockCtr_counter =0;
    }
    else
    {
        TrajPointACCObj20_TrajPointACCObj20_blockCtr_counter =TrajPointACCObj20_TrajPointACCObj20_blockCtr_counter+1;
    }    
    
}
update_TrajPointACCObj20_TrajPointACCObj20_MsgCtr_counter()
{
    //update the signal value
    Msg_TrajPointACCObj20.TrajPointACCObj20_MsgCtr=TrajPointACCObj20_TrajPointACCObj20_MsgCtr_counter;
    
    if(TrajPointACCObj20_TrajPointACCObj20_MsgCtr_counter == 15)
    {
        TrajPointACCObj20_TrajPointACCObj20_MsgCtr_counter =0;
    }
    else
    {
        TrajPointACCObj20_TrajPointACCObj20_MsgCtr_counter =TrajPointACCObj20_TrajPointACCObj20_MsgCtr_counter+1;
    }    
    
}
update_TrajPointACCObj21_TrajPointACCObj21_blockCtr_counter()
{
    //update the signal value
    Msg_TrajPointACCObj21.TrajPointACCObj21_blockCtr=TrajPointACCObj21_TrajPointACCObj21_blockCtr_counter;
    
    if(TrajPointACCObj21_TrajPointACCObj21_blockCtr_counter == 15)
    {
        TrajPointACCObj21_TrajPointACCObj21_blockCtr_counter =0;
    }
    else
    {
        TrajPointACCObj21_TrajPointACCObj21_blockCtr_counter =TrajPointACCObj21_TrajPointACCObj21_blockCtr_counter+1;
    }    
    
}
update_TrajPointACCObj21_TrajPointACCObj21_MsgCtr_counter()
{
    //update the signal value
    Msg_TrajPointACCObj21.TrajPointACCObj21_MsgCtr=TrajPointACCObj21_TrajPointACCObj21_MsgCtr_counter;
    
    if(TrajPointACCObj21_TrajPointACCObj21_MsgCtr_counter == 15)
    {
        TrajPointACCObj21_TrajPointACCObj21_MsgCtr_counter =0;
    }
    else
    {
        TrajPointACCObj21_TrajPointACCObj21_MsgCtr_counter =TrajPointACCObj21_TrajPointACCObj21_MsgCtr_counter+1;
    }    
    
}


update_TrajPointACCObj16_ChkSum_CheckSum()
{
  int64 l_data[64],l_Crc_Len=0,l_count=0;
	
  l_Crc_Len = 16-1;
  
	for (l_count=0;l_count<l_Crc_Len;l_count++)
    {
      l_data[l_count] = Msg_TrajPointACCObj16.BYTE(l_count+1);    
    }
       
	Msg_TrajPointACCObj16.BYTE(0) = calc_SAE_J1850(l_data,l_Crc_Len); 
	
	if(TrajPointACCObj16_TrajPointACCObj16_CRC_wrongvalctr != 0)
    {
		Msg_TrajPointACCObj16.TrajPointACCObj16_CRC+=1;
        //update signal with wrong CRC value
		if(TrajPointACCObj16_TrajPointACCObj16_CRC_wrongvalctr > 0)
        {
            TrajPointACCObj16_TrajPointACCObj16_CRC_wrongvalctr--;
             // if counter becomes zero, update panel controller to zero
             if(TrajPointACCObj16_TrajPointACCObj16_CRC_wrongvalctr == 0)
             {
                putValue(E_pric_RadarFrontCenter_TrajPointACCObj16_TrajPointACCObj16_CRC_wrongvalctr,0);
             }
        }       
    }  
}
update_RDR1Header_ChkSum_CheckSum()
{
  int64 l_data[64],l_Crc_Len=0,l_count=0;
	
  l_Crc_Len = 8-1;
  
	for (l_count=0;l_count<l_Crc_Len;l_count++)
    {
      l_data[l_count] = Msg_RDR1Header.BYTE(l_count+1);    
    }
       
	Msg_RDR1Header.BYTE(0) = calc_SAE_J1850(l_data,l_Crc_Len); 
	
	if(RDR1Header_RDR1Header_CRC_wrongvalctr != 0)
    {
		Msg_RDR1Header.RDR1Header_CRC+=1;
        //update signal with wrong CRC value
		if(RDR1Header_RDR1Header_CRC_wrongvalctr > 0)
        {
            RDR1Header_RDR1Header_CRC_wrongvalctr--;
             // if counter becomes zero, update panel controller to zero
             if(RDR1Header_RDR1Header_CRC_wrongvalctr == 0)
             {
                putValue(E_pric_RadarFrontCenter_RDR1Header_RDR1Header_CRC_wrongvalctr,0);
             }
        }       
    }  
}
update_OnComingObj3_ChkSum_CheckSum()
{
  int64 l_data[64],l_Crc_Len=0,l_count=0;
	
  l_Crc_Len = 12-1;
  
	for (l_count=0;l_count<l_Crc_Len;l_count++)
    {
      l_data[l_count] = Msg_OnComingObj3.BYTE(l_count+1);    
    }
       
	Msg_OnComingObj3.BYTE(0) = calc_SAE_J1850(l_data,l_Crc_Len); 
	
	if(OnComingObj3_OnComingObj3_CRC_wrongvalctr != 0)
    {
		Msg_OnComingObj3.OnComingObj3_CRC+=1;
        //update signal with wrong CRC value
		if(OnComingObj3_OnComingObj3_CRC_wrongvalctr > 0)
        {
            OnComingObj3_OnComingObj3_CRC_wrongvalctr--;
             // if counter becomes zero, update panel controller to zero
             if(OnComingObj3_OnComingObj3_CRC_wrongvalctr == 0)
             {
                putValue(E_pric_RadarFrontCenter_OnComingObj3_OnComingObj3_CRC_wrongvalctr,0);
             }
        }       
    }  
}
update_OnComingObj2_ChkSum_CheckSum()
{
  int64 l_data[64],l_Crc_Len=0,l_count=0;
	
  l_Crc_Len = 12-1;
  
	for (l_count=0;l_count<l_Crc_Len;l_count++)
    {
      l_data[l_count] = Msg_OnComingObj2.BYTE(l_count+1);    
    }
       
	Msg_OnComingObj2.BYTE(0) = calc_SAE_J1850(l_data,l_Crc_Len); 
	
	if(OnComingObj2_OnComingObj2_CRC_wrongvalctr != 0)
    {
		Msg_OnComingObj2.OnComingObj2_CRC+=1;
        //update signal with wrong CRC value
		if(OnComingObj2_OnComingObj2_CRC_wrongvalctr > 0)
        {
            OnComingObj2_OnComingObj2_CRC_wrongvalctr--;
             // if counter becomes zero, update panel controller to zero
             if(OnComingObj2_OnComingObj2_CRC_wrongvalctr == 0)
             {
                putValue(E_pric_RadarFrontCenter_OnComingObj2_OnComingObj2_CRC_wrongvalctr,0);
             }
        }       
    }  
}
update_OnComingObj1_ChkSum_CheckSum()
{
  int64 l_data[64],l_Crc_Len=0,l_count=0;
	
  l_Crc_Len = 12-1;
  
	for (l_count=0;l_count<l_Crc_Len;l_count++)
    {
      l_data[l_count] = Msg_OnComingObj1.BYTE(l_count+1);    
    }
       
	Msg_OnComingObj1.BYTE(0) = calc_SAE_J1850(l_data,l_Crc_Len); 
	
	if(OnComingObj1_OnComingObj1_CRC_wrongvalctr != 0)
    {
		Msg_OnComingObj1.OnComingObj1_CRC+=1;
        //update signal with wrong CRC value
		if(OnComingObj1_OnComingObj1_CRC_wrongvalctr > 0)
        {
            OnComingObj1_OnComingObj1_CRC_wrongvalctr--;
             // if counter becomes zero, update panel controller to zero
             if(OnComingObj1_OnComingObj1_CRC_wrongvalctr == 0)
             {
                putValue(E_pric_RadarFrontCenter_OnComingObj1_OnComingObj1_CRC_wrongvalctr,0);
             }
        }       
    }  
}
update_OnComingObj0_ChkSum_CheckSum()
{
  int64 l_data[64],l_Crc_Len=0,l_count=0;
	
  l_Crc_Len = 12-1;
  
	for (l_count=0;l_count<l_Crc_Len;l_count++)
    {
      l_data[l_count] = Msg_OnComingObj0.BYTE(l_count+1);    
    }
       
	Msg_OnComingObj0.BYTE(0) = calc_SAE_J1850(l_data,l_Crc_Len); 
	
	if(OnComingObj0_OnComingObj0_CRC_wrongvalctr != 0)
    {
		Msg_OnComingObj0.OnComingObj0_CRC+=1;
        //update signal with wrong CRC value
		if(OnComingObj0_OnComingObj0_CRC_wrongvalctr > 0)
        {
            OnComingObj0_OnComingObj0_CRC_wrongvalctr--;
             // if counter becomes zero, update panel controller to zero
             if(OnComingObj0_OnComingObj0_CRC_wrongvalctr == 0)
             {
                putValue(E_pric_RadarFrontCenter_OnComingObj0_OnComingObj0_CRC_wrongvalctr,0);
             }
        }       
    }  
}
update_TrajPointACCObj19_ChkSum_CheckSum()
{
  int64 l_data[64],l_Crc_Len=0,l_count=0;
	
  l_Crc_Len = 16-1;
  
	for (l_count=0;l_count<l_Crc_Len;l_count++)
    {
      l_data[l_count] = Msg_TrajPointACCObj19.BYTE(l_count+1);    
    }
       
	Msg_TrajPointACCObj19.BYTE(0) = calc_SAE_J1850(l_data,l_Crc_Len); 
	
	if(TrajPointACCObj19_TrajPointACCObj19_CRC_wrongvalctr != 0)
    {
		Msg_TrajPointACCObj19.TrajPointACCObj19_CRC+=1;
        //update signal with wrong CRC value
		if(TrajPointACCObj19_TrajPointACCObj19_CRC_wrongvalctr > 0)
        {
            TrajPointACCObj19_TrajPointACCObj19_CRC_wrongvalctr--;
             // if counter becomes zero, update panel controller to zero
             if(TrajPointACCObj19_TrajPointACCObj19_CRC_wrongvalctr == 0)
             {
                putValue(E_pric_RadarFrontCenter_TrajPointACCObj19_TrajPointACCObj19_CRC_wrongvalctr,0);
             }
        }       
    }  
}
update_TrajPointACCObj18_ChkSum_CheckSum()
{
  int64 l_data[64],l_Crc_Len=0,l_count=0;
	
  l_Crc_Len = 16-1;
  
	for (l_count=0;l_count<l_Crc_Len;l_count++)
    {
      l_data[l_count] = Msg_TrajPointACCObj18.BYTE(l_count+1);    
    }
       
	Msg_TrajPointACCObj18.BYTE(0) = calc_SAE_J1850(l_data,l_Crc_Len); 
	
	if(TrajPointACCObj18_TrajPointACCObj18_CRC_wrongvalctr != 0)
    {
		Msg_TrajPointACCObj18.TrajPointACCObj18_CRC+=1;
        //update signal with wrong CRC value
		if(TrajPointACCObj18_TrajPointACCObj18_CRC_wrongvalctr > 0)
        {
            TrajPointACCObj18_TrajPointACCObj18_CRC_wrongvalctr--;
             // if counter becomes zero, update panel controller to zero
             if(TrajPointACCObj18_TrajPointACCObj18_CRC_wrongvalctr == 0)
             {
                putValue(E_pric_RadarFrontCenter_TrajPointACCObj18_TrajPointACCObj18_CRC_wrongvalctr,0);
             }
        }       
    }  
}
update_OnGoingObj1_ChkSum_CheckSum()
{
  int64 l_data[64],l_Crc_Len=0,l_count=0;
	
  l_Crc_Len = 12-1;
  
	for (l_count=0;l_count<l_Crc_Len;l_count++)
    {
      l_data[l_count] = Msg_OnGoingObj1.BYTE(l_count+1);    
    }
       
	Msg_OnGoingObj1.BYTE(0) = calc_SAE_J1850(l_data,l_Crc_Len); 
	
	if(OnGoingObj1_OnGoingObj1_CRC_wrongvalctr != 0)
    {
		Msg_OnGoingObj1.OnGoingObj1_CRC+=1;
        //update signal with wrong CRC value
		if(OnGoingObj1_OnGoingObj1_CRC_wrongvalctr > 0)
        {
            OnGoingObj1_OnGoingObj1_CRC_wrongvalctr--;
             // if counter becomes zero, update panel controller to zero
             if(OnGoingObj1_OnGoingObj1_CRC_wrongvalctr == 0)
             {
                putValue(E_pric_RadarFrontCenter_OnGoingObj1_OnGoingObj1_CRC_wrongvalctr,0);
             }
        }       
    }  
}
update_OnGoingObj0_ChkSum_CheckSum()
{
  int64 l_data[64],l_Crc_Len=0,l_count=0;
	
  l_Crc_Len = 12-1;
  
	for (l_count=0;l_count<l_Crc_Len;l_count++)
    {
      l_data[l_count] = Msg_OnGoingObj0.BYTE(l_count+1);    
    }
       
	Msg_OnGoingObj0.BYTE(0) = calc_SAE_J1850(l_data,l_Crc_Len); 
	
	if(OnGoingObj0_OnGoingObj0_CRC_wrongvalctr != 0)
    {
		Msg_OnGoingObj0.OnGoingObj0_CRC+=1;
        //update signal with wrong CRC value
		if(OnGoingObj0_OnGoingObj0_CRC_wrongvalctr > 0)
        {
            OnGoingObj0_OnGoingObj0_CRC_wrongvalctr--;
             // if counter becomes zero, update panel controller to zero
             if(OnGoingObj0_OnGoingObj0_CRC_wrongvalctr == 0)
             {
                putValue(E_pric_RadarFrontCenter_OnGoingObj0_OnGoingObj0_CRC_wrongvalctr,0);
             }
        }       
    }  
}
update_TrajPointACCObj13_ChkSum_CheckSum()
{
  int64 l_data[64],l_Crc_Len=0,l_count=0;
	
  l_Crc_Len = 16-1;
  
	for (l_count=0;l_count<l_Crc_Len;l_count++)
    {
      l_data[l_count] = Msg_TrajPointACCObj13.BYTE(l_count+1);    
    }
       
	Msg_TrajPointACCObj13.BYTE(0) = calc_SAE_J1850(l_data,l_Crc_Len); 
	
	if(TrajPointACCObj13_TrajPointACCObj13_CRC_wrongvalctr != 0)
    {
		Msg_TrajPointACCObj13.TrajPointACCObj13_CRC+=1;
        //update signal with wrong CRC value
		if(TrajPointACCObj13_TrajPointACCObj13_CRC_wrongvalctr > 0)
        {
            TrajPointACCObj13_TrajPointACCObj13_CRC_wrongvalctr--;
             // if counter becomes zero, update panel controller to zero
             if(TrajPointACCObj13_TrajPointACCObj13_CRC_wrongvalctr == 0)
             {
                putValue(E_pric_RadarFrontCenter_TrajPointACCObj13_TrajPointACCObj13_CRC_wrongvalctr,0);
             }
        }       
    }  
}
update_TrajPointACCObj12_ChkSum_CheckSum()
{
  int64 l_data[64],l_Crc_Len=0,l_count=0;
	
  l_Crc_Len = 16-1;
  
	for (l_count=0;l_count<l_Crc_Len;l_count++)
    {
      l_data[l_count] = Msg_TrajPointACCObj12.BYTE(l_count+1);    
    }
       
	Msg_TrajPointACCObj12.BYTE(0) = calc_SAE_J1850(l_data,l_Crc_Len); 
	
	if(TrajPointACCObj12_TrajPointACCObj12_CRC_wrongvalctr != 0)
    {
		Msg_TrajPointACCObj12.TrajPointACCObj12_CRC+=1;
        //update signal with wrong CRC value
		if(TrajPointACCObj12_TrajPointACCObj12_CRC_wrongvalctr > 0)
        {
            TrajPointACCObj12_TrajPointACCObj12_CRC_wrongvalctr--;
             // if counter becomes zero, update panel controller to zero
             if(TrajPointACCObj12_TrajPointACCObj12_CRC_wrongvalctr == 0)
             {
                putValue(E_pric_RadarFrontCenter_TrajPointACCObj12_TrajPointACCObj12_CRC_wrongvalctr,0);
             }
        }       
    }  
}
update_TrajPointACCObj11_ChkSum_CheckSum()
{
  int64 l_data[64],l_Crc_Len=0,l_count=0;
	
  l_Crc_Len = 16-1;
  
	for (l_count=0;l_count<l_Crc_Len;l_count++)
    {
      l_data[l_count] = Msg_TrajPointACCObj11.BYTE(l_count+1);    
    }
       
	Msg_TrajPointACCObj11.BYTE(0) = calc_SAE_J1850(l_data,l_Crc_Len); 
	
	if(TrajPointACCObj11_TrajPointACCObj11_CRC_wrongvalctr != 0)
    {
		Msg_TrajPointACCObj11.TrajPointACCObj11_CRC+=1;
        //update signal with wrong CRC value
		if(TrajPointACCObj11_TrajPointACCObj11_CRC_wrongvalctr > 0)
        {
            TrajPointACCObj11_TrajPointACCObj11_CRC_wrongvalctr--;
             // if counter becomes zero, update panel controller to zero
             if(TrajPointACCObj11_TrajPointACCObj11_CRC_wrongvalctr == 0)
             {
                putValue(E_pric_RadarFrontCenter_TrajPointACCObj11_TrajPointACCObj11_CRC_wrongvalctr,0);
             }
        }       
    }  
}
update_TrajPointACCObj10_ChkSum_CheckSum()
{
  int64 l_data[64],l_Crc_Len=0,l_count=0;
	
  l_Crc_Len = 16-1;
  
	for (l_count=0;l_count<l_Crc_Len;l_count++)
    {
      l_data[l_count] = Msg_TrajPointACCObj10.BYTE(l_count+1);    
    }
       
	Msg_TrajPointACCObj10.BYTE(0) = calc_SAE_J1850(l_data,l_Crc_Len); 
	
	if(TrajPointACCObj10_TrajPointACCObj10_CRC_wrongvalctr != 0)
    {
		Msg_TrajPointACCObj10.TrajPointACCObj10_CRC+=1;
        //update signal with wrong CRC value
		if(TrajPointACCObj10_TrajPointACCObj10_CRC_wrongvalctr > 0)
        {
            TrajPointACCObj10_TrajPointACCObj10_CRC_wrongvalctr--;
             // if counter becomes zero, update panel controller to zero
             if(TrajPointACCObj10_TrajPointACCObj10_CRC_wrongvalctr == 0)
             {
                putValue(E_pric_RadarFrontCenter_TrajPointACCObj10_TrajPointACCObj10_CRC_wrongvalctr,0);
             }
        }       
    }  
}
update_TrajPointACCObj17_ChkSum_CheckSum()
{
  int64 l_data[64],l_Crc_Len=0,l_count=0;
	
  l_Crc_Len = 16-1;
  
	for (l_count=0;l_count<l_Crc_Len;l_count++)
    {
      l_data[l_count] = Msg_TrajPointACCObj17.BYTE(l_count+1);    
    }
       
	Msg_TrajPointACCObj17.BYTE(0) = calc_SAE_J1850(l_data,l_Crc_Len); 
	
	if(TrajPointACCObj17_TrajPointACCObj17_CRC_wrongvalctr != 0)
    {
		Msg_TrajPointACCObj17.TrajPointACCObj17_CRC+=1;
        //update signal with wrong CRC value
		if(TrajPointACCObj17_TrajPointACCObj17_CRC_wrongvalctr > 0)
        {
            TrajPointACCObj17_TrajPointACCObj17_CRC_wrongvalctr--;
             // if counter becomes zero, update panel controller to zero
             if(TrajPointACCObj17_TrajPointACCObj17_CRC_wrongvalctr == 0)
             {
                putValue(E_pric_RadarFrontCenter_TrajPointACCObj17_TrajPointACCObj17_CRC_wrongvalctr,0);
             }
        }       
    }  
}
update_TrajACC_ChkSum_CheckSum()
{
  int64 l_data[64],l_Crc_Len=0,l_count=0;
	
  l_Crc_Len = 4-1;
  
	for (l_count=0;l_count<l_Crc_Len;l_count++)
    {
      l_data[l_count] = Msg_TrajACC.BYTE(l_count+1);    
    }
       
	Msg_TrajACC.BYTE(0) = calc_SAE_J1850(l_data,l_Crc_Len); 
	
	if(TrajACC_TrajACC_CRC_wrongvalctr != 0)
    {
		Msg_TrajACC.TrajACC_CRC+=1;
        //update signal with wrong CRC value
		if(TrajACC_TrajACC_CRC_wrongvalctr > 0)
        {
            TrajACC_TrajACC_CRC_wrongvalctr--;
             // if counter becomes zero, update panel controller to zero
             if(TrajACC_TrajACC_CRC_wrongvalctr == 0)
             {
                putValue(E_pric_RadarFrontCenter_TrajACC_TrajACC_CRC_wrongvalctr,0);
             }
        }       
    }  
}
update_TrajPointACCObj15_ChkSum_CheckSum()
{
  int64 l_data[64],l_Crc_Len=0,l_count=0;
	
  l_Crc_Len = 16-1;
  
	for (l_count=0;l_count<l_Crc_Len;l_count++)
    {
      l_data[l_count] = Msg_TrajPointACCObj15.BYTE(l_count+1);    
    }
       
	Msg_TrajPointACCObj15.BYTE(0) = calc_SAE_J1850(l_data,l_Crc_Len); 
	
	if(TrajPointACCObj15_TrajPointACCObj15_CRC_wrongvalctr != 0)
    {
		Msg_TrajPointACCObj15.TrajPointACCObj15_CRC+=1;
        //update signal with wrong CRC value
		if(TrajPointACCObj15_TrajPointACCObj15_CRC_wrongvalctr > 0)
        {
            TrajPointACCObj15_TrajPointACCObj15_CRC_wrongvalctr--;
             // if counter becomes zero, update panel controller to zero
             if(TrajPointACCObj15_TrajPointACCObj15_CRC_wrongvalctr == 0)
             {
                putValue(E_pric_RadarFrontCenter_TrajPointACCObj15_TrajPointACCObj15_CRC_wrongvalctr,0);
             }
        }       
    }  
}
update_TrajPointACCObj14_ChkSum_CheckSum()
{
  int64 l_data[64],l_Crc_Len=0,l_count=0;
	
  l_Crc_Len = 16-1;
  
	for (l_count=0;l_count<l_Crc_Len;l_count++)
    {
      l_data[l_count] = Msg_TrajPointACCObj14.BYTE(l_count+1);    
    }
       
	Msg_TrajPointACCObj14.BYTE(0) = calc_SAE_J1850(l_data,l_Crc_Len); 
	
	if(TrajPointACCObj14_TrajPointACCObj14_CRC_wrongvalctr != 0)
    {
		Msg_TrajPointACCObj14.TrajPointACCObj14_CRC+=1;
        //update signal with wrong CRC value
		if(TrajPointACCObj14_TrajPointACCObj14_CRC_wrongvalctr > 0)
        {
            TrajPointACCObj14_TrajPointACCObj14_CRC_wrongvalctr--;
             // if counter becomes zero, update panel controller to zero
             if(TrajPointACCObj14_TrajPointACCObj14_CRC_wrongvalctr == 0)
             {
                putValue(E_pric_RadarFrontCenter_TrajPointACCObj14_TrajPointACCObj14_CRC_wrongvalctr,0);
             }
        }       
    }  
}
update_RDR_Status_ChkSum_CheckSum()
{
  int64 l_data[64],l_Crc_Len=0,l_count=0;
	
  l_Crc_Len = 8-1;
  
	for (l_count=0;l_count<l_Crc_Len;l_count++)
    {
      l_data[l_count] = Msg_RDR_Status.BYTE(l_count+1);    
    }
       
	Msg_RDR_Status.BYTE(0) = calc_SAE_J1850(l_data,l_Crc_Len); 
	
	if(RDR_Status_RDR_Status_CRC_wrongvalctr != 0)
    {
		Msg_RDR_Status.RDR_Status_CRC+=1;
        //update signal with wrong CRC value
		if(RDR_Status_RDR_Status_CRC_wrongvalctr > 0)
        {
            RDR_Status_RDR_Status_CRC_wrongvalctr--;
             // if counter becomes zero, update panel controller to zero
             if(RDR_Status_RDR_Status_CRC_wrongvalctr == 0)
             {
                putValue(E_pric_RadarFrontCenter_RDR_Status_RDR_Status_CRC_wrongvalctr,0);
             }
        }       
    }  
}
update_TrajPointACCObj9_ChkSum_CheckSum()
{
  int64 l_data[64],l_Crc_Len=0,l_count=0;
	
  l_Crc_Len = 16-1;
  
	for (l_count=0;l_count<l_Crc_Len;l_count++)
    {
      l_data[l_count] = Msg_TrajPointACCObj9.BYTE(l_count+1);    
    }
       
	Msg_TrajPointACCObj9.BYTE(0) = calc_SAE_J1850(l_data,l_Crc_Len); 
	
	if(TrajPointACCObj9_TrajPointACCObj9_CRC_wrongvalctr != 0)
    {
		Msg_TrajPointACCObj9.TrajPointACCObj9_CRC+=1;
        //update signal with wrong CRC value
		if(TrajPointACCObj9_TrajPointACCObj9_CRC_wrongvalctr > 0)
        {
            TrajPointACCObj9_TrajPointACCObj9_CRC_wrongvalctr--;
             // if counter becomes zero, update panel controller to zero
             if(TrajPointACCObj9_TrajPointACCObj9_CRC_wrongvalctr == 0)
             {
                putValue(E_pric_RadarFrontCenter_TrajPointACCObj9_TrajPointACCObj9_CRC_wrongvalctr,0);
             }
        }       
    }  
}
update_TrajPointACCObj8_ChkSum_CheckSum()
{
  int64 l_data[64],l_Crc_Len=0,l_count=0;
	
  l_Crc_Len = 16-1;
  
	for (l_count=0;l_count<l_Crc_Len;l_count++)
    {
      l_data[l_count] = Msg_TrajPointACCObj8.BYTE(l_count+1);    
    }
       
	Msg_TrajPointACCObj8.BYTE(0) = calc_SAE_J1850(l_data,l_Crc_Len); 
	
	if(TrajPointACCObj8_TrajPointACCObj8_CRC_wrongvalctr != 0)
    {
		Msg_TrajPointACCObj8.TrajPointACCObj8_CRC+=1;
        //update signal with wrong CRC value
		if(TrajPointACCObj8_TrajPointACCObj8_CRC_wrongvalctr > 0)
        {
            TrajPointACCObj8_TrajPointACCObj8_CRC_wrongvalctr--;
             // if counter becomes zero, update panel controller to zero
             if(TrajPointACCObj8_TrajPointACCObj8_CRC_wrongvalctr == 0)
             {
                putValue(E_pric_RadarFrontCenter_TrajPointACCObj8_TrajPointACCObj8_CRC_wrongvalctr,0);
             }
        }       
    }  
}
update_TrajPointACCObj7_ChkSum_CheckSum()
{
  int64 l_data[64],l_Crc_Len=0,l_count=0;
	
  l_Crc_Len = 16-1;
  
	for (l_count=0;l_count<l_Crc_Len;l_count++)
    {
      l_data[l_count] = Msg_TrajPointACCObj7.BYTE(l_count+1);    
    }
       
	Msg_TrajPointACCObj7.BYTE(0) = calc_SAE_J1850(l_data,l_Crc_Len); 
	
	if(TrajPointACCObj7_TrajPointACCObj7_CRC_wrongvalctr != 0)
    {
		Msg_TrajPointACCObj7.TrajPointACCObj7_CRC+=1;
        //update signal with wrong CRC value
		if(TrajPointACCObj7_TrajPointACCObj7_CRC_wrongvalctr > 0)
        {
            TrajPointACCObj7_TrajPointACCObj7_CRC_wrongvalctr--;
             // if counter becomes zero, update panel controller to zero
             if(TrajPointACCObj7_TrajPointACCObj7_CRC_wrongvalctr == 0)
             {
                putValue(E_pric_RadarFrontCenter_TrajPointACCObj7_TrajPointACCObj7_CRC_wrongvalctr,0);
             }
        }       
    }  
}
update_TrajPointACCObj6_ChkSum_CheckSum()
{
  int64 l_data[64],l_Crc_Len=0,l_count=0;
	
  l_Crc_Len = 16-1;
  
	for (l_count=0;l_count<l_Crc_Len;l_count++)
    {
      l_data[l_count] = Msg_TrajPointACCObj6.BYTE(l_count+1);    
    }
       
	Msg_TrajPointACCObj6.BYTE(0) = calc_SAE_J1850(l_data,l_Crc_Len); 
	
	if(TrajPointACCObj6_TrajPointACCObj6_CRC_wrongvalctr != 0)
    {
		Msg_TrajPointACCObj6.TrajPointACCObj6_CRC+=1;
        //update signal with wrong CRC value
		if(TrajPointACCObj6_TrajPointACCObj6_CRC_wrongvalctr > 0)
        {
            TrajPointACCObj6_TrajPointACCObj6_CRC_wrongvalctr--;
             // if counter becomes zero, update panel controller to zero
             if(TrajPointACCObj6_TrajPointACCObj6_CRC_wrongvalctr == 0)
             {
                putValue(E_pric_RadarFrontCenter_TrajPointACCObj6_TrajPointACCObj6_CRC_wrongvalctr,0);
             }
        }       
    }  
}
update_TrajPointACCObj5_ChkSum_CheckSum()
{
  int64 l_data[64],l_Crc_Len=0,l_count=0;
	
  l_Crc_Len = 16-1;
  
	for (l_count=0;l_count<l_Crc_Len;l_count++)
    {
      l_data[l_count] = Msg_TrajPointACCObj5.BYTE(l_count+1);    
    }
       
	Msg_TrajPointACCObj5.BYTE(0) = calc_SAE_J1850(l_data,l_Crc_Len); 
	
	if(TrajPointACCObj5_TrajPointACCObj5_CRC_wrongvalctr != 0)
    {
		Msg_TrajPointACCObj5.TrajPointACCObj5_CRC+=1;
        //update signal with wrong CRC value
		if(TrajPointACCObj5_TrajPointACCObj5_CRC_wrongvalctr > 0)
        {
            TrajPointACCObj5_TrajPointACCObj5_CRC_wrongvalctr--;
             // if counter becomes zero, update panel controller to zero
             if(TrajPointACCObj5_TrajPointACCObj5_CRC_wrongvalctr == 0)
             {
                putValue(E_pric_RadarFrontCenter_TrajPointACCObj5_TrajPointACCObj5_CRC_wrongvalctr,0);
             }
        }       
    }  
}
update_TrajPointACCObj4_ChkSum_CheckSum()
{
  int64 l_data[64],l_Crc_Len=0,l_count=0;
	
  l_Crc_Len = 16-1;
  
	for (l_count=0;l_count<l_Crc_Len;l_count++)
    {
      l_data[l_count] = Msg_TrajPointACCObj4.BYTE(l_count+1);    
    }
       
	Msg_TrajPointACCObj4.BYTE(0) = calc_SAE_J1850(l_data,l_Crc_Len); 
	
	if(TrajPointACCObj4_TrajPointACCObj4_CRC_wrongvalctr != 0)
    {
		Msg_TrajPointACCObj4.TrajPointACCObj4_CRC+=1;
        //update signal with wrong CRC value
		if(TrajPointACCObj4_TrajPointACCObj4_CRC_wrongvalctr > 0)
        {
            TrajPointACCObj4_TrajPointACCObj4_CRC_wrongvalctr--;
             // if counter becomes zero, update panel controller to zero
             if(TrajPointACCObj4_TrajPointACCObj4_CRC_wrongvalctr == 0)
             {
                putValue(E_pric_RadarFrontCenter_TrajPointACCObj4_TrajPointACCObj4_CRC_wrongvalctr,0);
             }
        }       
    }  
}
update_TrajPointACCObj3_ChkSum_CheckSum()
{
  int64 l_data[64],l_Crc_Len=0,l_count=0;
	
  l_Crc_Len = 16-1;
  
	for (l_count=0;l_count<l_Crc_Len;l_count++)
    {
      l_data[l_count] = Msg_TrajPointACCObj3.BYTE(l_count+1);    
    }
       
	Msg_TrajPointACCObj3.BYTE(0) = calc_SAE_J1850(l_data,l_Crc_Len); 
	
	if(TrajPointACCObj3_TrajPointACCObj3_CRC_wrongvalctr != 0)
    {
		Msg_TrajPointACCObj3.TrajPointACCObj3_CRC+=1;
        //update signal with wrong CRC value
		if(TrajPointACCObj3_TrajPointACCObj3_CRC_wrongvalctr > 0)
        {
            TrajPointACCObj3_TrajPointACCObj3_CRC_wrongvalctr--;
             // if counter becomes zero, update panel controller to zero
             if(TrajPointACCObj3_TrajPointACCObj3_CRC_wrongvalctr == 0)
             {
                putValue(E_pric_RadarFrontCenter_TrajPointACCObj3_TrajPointACCObj3_CRC_wrongvalctr,0);
             }
        }       
    }  
}
update_TrajPointACCObj2_ChkSum_CheckSum()
{
  int64 l_data[64],l_Crc_Len=0,l_count=0;
	
  l_Crc_Len = 16-1;
  
	for (l_count=0;l_count<l_Crc_Len;l_count++)
    {
      l_data[l_count] = Msg_TrajPointACCObj2.BYTE(l_count+1);    
    }
       
	Msg_TrajPointACCObj2.BYTE(0) = calc_SAE_J1850(l_data,l_Crc_Len); 
	
	if(TrajPointACCObj2_TrajPointACCObj2_CRC_wrongvalctr != 0)
    {
		Msg_TrajPointACCObj2.TrajPointACCObj2_CRC+=1;
        //update signal with wrong CRC value
		if(TrajPointACCObj2_TrajPointACCObj2_CRC_wrongvalctr > 0)
        {
            TrajPointACCObj2_TrajPointACCObj2_CRC_wrongvalctr--;
             // if counter becomes zero, update panel controller to zero
             if(TrajPointACCObj2_TrajPointACCObj2_CRC_wrongvalctr == 0)
             {
                putValue(E_pric_RadarFrontCenter_TrajPointACCObj2_TrajPointACCObj2_CRC_wrongvalctr,0);
             }
        }       
    }  
}
update_TrajPointACCObj1_ChkSum_CheckSum()
{
  int64 l_data[64],l_Crc_Len=0,l_count=0;
	
  l_Crc_Len = 16-1;
  
	for (l_count=0;l_count<l_Crc_Len;l_count++)
    {
      l_data[l_count] = Msg_TrajPointACCObj1.BYTE(l_count+1);    
    }
       
	Msg_TrajPointACCObj1.BYTE(0) = calc_SAE_J1850(l_data,l_Crc_Len); 
	
	if(TrajPointACCObj1_TrajPointACCObj1_CRC_wrongvalctr != 0)
    {
		Msg_TrajPointACCObj1.TrajPointACCObj1_CRC+=1;
        //update signal with wrong CRC value
		if(TrajPointACCObj1_TrajPointACCObj1_CRC_wrongvalctr > 0)
        {
            TrajPointACCObj1_TrajPointACCObj1_CRC_wrongvalctr--;
             // if counter becomes zero, update panel controller to zero
             if(TrajPointACCObj1_TrajPointACCObj1_CRC_wrongvalctr == 0)
             {
                putValue(E_pric_RadarFrontCenter_TrajPointACCObj1_TrajPointACCObj1_CRC_wrongvalctr,0);
             }
        }       
    }  
}
update_TrajPointACCObj0_ChkSum_CheckSum()
{
  int64 l_data[64],l_Crc_Len=0,l_count=0;
	
  l_Crc_Len = 16-1;
  
	for (l_count=0;l_count<l_Crc_Len;l_count++)
    {
      l_data[l_count] = Msg_TrajPointACCObj0.BYTE(l_count+1);    
    }
       
	Msg_TrajPointACCObj0.BYTE(0) = calc_SAE_J1850(l_data,l_Crc_Len); 
	
	if(TrajPointACCObj0_TrajPointACCObj0_CRC_wrongvalctr != 0)
    {
		Msg_TrajPointACCObj0.TrajPointACCObj0_CRC+=1;
        //update signal with wrong CRC value
		if(TrajPointACCObj0_TrajPointACCObj0_CRC_wrongvalctr > 0)
        {
            TrajPointACCObj0_TrajPointACCObj0_CRC_wrongvalctr--;
             // if counter becomes zero, update panel controller to zero
             if(TrajPointACCObj0_TrajPointACCObj0_CRC_wrongvalctr == 0)
             {
                putValue(E_pric_RadarFrontCenter_TrajPointACCObj0_TrajPointACCObj0_CRC_wrongvalctr,0);
             }
        }       
    }  
}
update_ACCObjInfo_ChkSum_CheckSum()
{
  int64 l_data[64],l_Crc_Len=0,l_count=0;
	
  l_Crc_Len = 16-1;
  
	for (l_count=0;l_count<l_Crc_Len;l_count++)
    {
      l_data[l_count] = Msg_ACCObjInfo.BYTE(l_count+1);    
    }
       
	Msg_ACCObjInfo.BYTE(0) = calc_SAE_J1850(l_data,l_Crc_Len); 
	
	if(ACCObjInfo_ACCObjInfo_CRC_wrongvalctr != 0)
    {
		Msg_ACCObjInfo.ACCObjInfo_CRC+=1;
        //update signal with wrong CRC value
		if(ACCObjInfo_ACCObjInfo_CRC_wrongvalctr > 0)
        {
            ACCObjInfo_ACCObjInfo_CRC_wrongvalctr--;
             // if counter becomes zero, update panel controller to zero
             if(ACCObjInfo_ACCObjInfo_CRC_wrongvalctr == 0)
             {
                putValue(E_pric_RadarFrontCenter_ACCObjInfo_ACCObjInfo_CRC_wrongvalctr,0);
             }
        }       
    }  
}
update_TIPLLaneInfo0_ChkSum_CheckSum()
{
  int64 l_data[64],l_Crc_Len=0,l_count=0;
	
  l_Crc_Len = 12-1;
  
	for (l_count=0;l_count<l_Crc_Len;l_count++)
    {
      l_data[l_count] = Msg_TIPLLaneInfo0.BYTE(l_count+1);    
    }
       
	Msg_TIPLLaneInfo0.BYTE(0) = calc_SAE_J1850(l_data,l_Crc_Len); 
	
	if(TIPLLaneInfo0_TIPLLaneInfo0_CRC_wrongvalctr != 0)
    {
		Msg_TIPLLaneInfo0.TIPLLaneInfo0_CRC+=1;
        //update signal with wrong CRC value
		if(TIPLLaneInfo0_TIPLLaneInfo0_CRC_wrongvalctr > 0)
        {
            TIPLLaneInfo0_TIPLLaneInfo0_CRC_wrongvalctr--;
             // if counter becomes zero, update panel controller to zero
             if(TIPLLaneInfo0_TIPLLaneInfo0_CRC_wrongvalctr == 0)
             {
                putValue(E_pric_RadarFrontCenter_TIPLLaneInfo0_TIPLLaneInfo0_CRC_wrongvalctr,0);
             }
        }       
    }  
}
update_TIPLLaneInfo1_ChkSum_CheckSum()
{
  int64 l_data[64],l_Crc_Len=0,l_count=0;
	
  l_Crc_Len = 12-1;
  
	for (l_count=0;l_count<l_Crc_Len;l_count++)
    {
      l_data[l_count] = Msg_TIPLLaneInfo1.BYTE(l_count+1);    
    }
       
	Msg_TIPLLaneInfo1.BYTE(0) = calc_SAE_J1850(l_data,l_Crc_Len); 
	
	if(TIPLLaneInfo1_TIPLLaneInfo1_CRC_wrongvalctr != 0)
    {
		Msg_TIPLLaneInfo1.TIPLLaneInfo1_CRC+=1;
        //update signal with wrong CRC value
		if(TIPLLaneInfo1_TIPLLaneInfo1_CRC_wrongvalctr > 0)
        {
            TIPLLaneInfo1_TIPLLaneInfo1_CRC_wrongvalctr--;
             // if counter becomes zero, update panel controller to zero
             if(TIPLLaneInfo1_TIPLLaneInfo1_CRC_wrongvalctr == 0)
             {
                putValue(E_pric_RadarFrontCenter_TIPLLaneInfo1_TIPLLaneInfo1_CRC_wrongvalctr,0);
             }
        }       
    }  
}
update_TIPLLaneInfo2_ChkSum_CheckSum()
{
  int64 l_data[64],l_Crc_Len=0,l_count=0;
	
  l_Crc_Len = 12-1;
  
	for (l_count=0;l_count<l_Crc_Len;l_count++)
    {
      l_data[l_count] = Msg_TIPLLaneInfo2.BYTE(l_count+1);    
    }
       
	Msg_TIPLLaneInfo2.BYTE(0) = calc_SAE_J1850(l_data,l_Crc_Len); 
	
	if(TIPLLaneInfo2_TIPLLaneInfo2_CRC_wrongvalctr != 0)
    {
		Msg_TIPLLaneInfo2.TIPLLaneInfo2_CRC+=1;
        //update signal with wrong CRC value
		if(TIPLLaneInfo2_TIPLLaneInfo2_CRC_wrongvalctr > 0)
        {
            TIPLLaneInfo2_TIPLLaneInfo2_CRC_wrongvalctr--;
             // if counter becomes zero, update panel controller to zero
             if(TIPLLaneInfo2_TIPLLaneInfo2_CRC_wrongvalctr == 0)
             {
                putValue(E_pric_RadarFrontCenter_TIPLLaneInfo2_TIPLLaneInfo2_CRC_wrongvalctr,0);
             }
        }       
    }  
}
update_TIPLLaneInfo3_ChkSum_CheckSum()
{
  int64 l_data[64],l_Crc_Len=0,l_count=0;
	
  l_Crc_Len = 12-1;
  
	for (l_count=0;l_count<l_Crc_Len;l_count++)
    {
      l_data[l_count] = Msg_TIPLLaneInfo3.BYTE(l_count+1);    
    }
       
	Msg_TIPLLaneInfo3.BYTE(0) = calc_SAE_J1850(l_data,l_Crc_Len); 
	
	if(TIPLLaneInfo3_TIPLLaneInfo3_CRC_wrongvalctr != 0)
    {
		Msg_TIPLLaneInfo3.TIPLLaneInfo3_CRC+=1;
        //update signal with wrong CRC value
		if(TIPLLaneInfo3_TIPLLaneInfo3_CRC_wrongvalctr > 0)
        {
            TIPLLaneInfo3_TIPLLaneInfo3_CRC_wrongvalctr--;
             // if counter becomes zero, update panel controller to zero
             if(TIPLLaneInfo3_TIPLLaneInfo3_CRC_wrongvalctr == 0)
             {
                putValue(E_pric_RadarFrontCenter_TIPLLaneInfo3_TIPLLaneInfo3_CRC_wrongvalctr,0);
             }
        }       
    }  
}
update_TIPLCourseInfo1_ChkSum_CheckSum()
{
  int64 l_data[64],l_Crc_Len=0,l_count=0;
	
  l_Crc_Len = 16-1;
  
	for (l_count=0;l_count<l_Crc_Len;l_count++)
    {
      l_data[l_count] = Msg_TIPLCourseInfo1.BYTE(l_count+1);    
    }
       
	Msg_TIPLCourseInfo1.BYTE(0) = calc_SAE_J1850(l_data,l_Crc_Len); 
	
	if(TIPLCourseInfo1_TIPLCourseInfo1_CRC_wrongvalctr != 0)
    {
		Msg_TIPLCourseInfo1.TIPLCourseInfo1_CRC+=1;
        //update signal with wrong CRC value
		if(TIPLCourseInfo1_TIPLCourseInfo1_CRC_wrongvalctr > 0)
        {
            TIPLCourseInfo1_TIPLCourseInfo1_CRC_wrongvalctr--;
             // if counter becomes zero, update panel controller to zero
             if(TIPLCourseInfo1_TIPLCourseInfo1_CRC_wrongvalctr == 0)
             {
                putValue(E_pric_RadarFrontCenter_TIPLCourseInfo1_TIPLCourseInfo1_CRC_wrongvalctr,0);
             }
        }       
    }  
}
update_TIPLCourseInfo0_ChkSum_CheckSum()
{
  int64 l_data[64],l_Crc_Len=0,l_count=0;
	
  l_Crc_Len = 16-1;
  
	for (l_count=0;l_count<l_Crc_Len;l_count++)
    {
      l_data[l_count] = Msg_TIPLCourseInfo0.BYTE(l_count+1);    
    }
       
	Msg_TIPLCourseInfo0.BYTE(0) = calc_SAE_J1850(l_data,l_Crc_Len); 
	
	if(TIPLCourseInfo0_TIPLCourseInfo0_CRC_wrongvalctr != 0)
    {
		Msg_TIPLCourseInfo0.TIPLCourseInfo0_CRC+=1;
        //update signal with wrong CRC value
		if(TIPLCourseInfo0_TIPLCourseInfo0_CRC_wrongvalctr > 0)
        {
            TIPLCourseInfo0_TIPLCourseInfo0_CRC_wrongvalctr--;
             // if counter becomes zero, update panel controller to zero
             if(TIPLCourseInfo0_TIPLCourseInfo0_CRC_wrongvalctr == 0)
             {
                putValue(E_pric_RadarFrontCenter_TIPLCourseInfo0_TIPLCourseInfo0_CRC_wrongvalctr,0);
             }
        }       
    }  
}
update_TIPLCourseInfo3_ChkSum_CheckSum()
{
  int64 l_data[64],l_Crc_Len=0,l_count=0;
	
  l_Crc_Len = 16-1;
  
	for (l_count=0;l_count<l_Crc_Len;l_count++)
    {
      l_data[l_count] = Msg_TIPLCourseInfo3.BYTE(l_count+1);    
    }
       
	Msg_TIPLCourseInfo3.BYTE(0) = calc_SAE_J1850(l_data,l_Crc_Len); 
	
	if(TIPLCourseInfo3_TIPLCourseInfo3_CRC_wrongvalctr != 0)
    {
		Msg_TIPLCourseInfo3.TIPLCourseInfo3_CRC+=1;
        //update signal with wrong CRC value
		if(TIPLCourseInfo3_TIPLCourseInfo3_CRC_wrongvalctr > 0)
        {
            TIPLCourseInfo3_TIPLCourseInfo3_CRC_wrongvalctr--;
             // if counter becomes zero, update panel controller to zero
             if(TIPLCourseInfo3_TIPLCourseInfo3_CRC_wrongvalctr == 0)
             {
                putValue(E_pric_RadarFrontCenter_TIPLCourseInfo3_TIPLCourseInfo3_CRC_wrongvalctr,0);
             }
        }       
    }  
}
update_TIPLCourseInfo2_ChkSum_CheckSum()
{
  int64 l_data[64],l_Crc_Len=0,l_count=0;
	
  l_Crc_Len = 16-1;
  
	for (l_count=0;l_count<l_Crc_Len;l_count++)
    {
      l_data[l_count] = Msg_TIPLCourseInfo2.BYTE(l_count+1);    
    }
       
	Msg_TIPLCourseInfo2.BYTE(0) = calc_SAE_J1850(l_data,l_Crc_Len); 
	
	if(TIPLCourseInfo2_TIPLCourseInfo2_CRC_wrongvalctr != 0)
    {
		Msg_TIPLCourseInfo2.TIPLCourseInfo2_CRC+=1;
        //update signal with wrong CRC value
		if(TIPLCourseInfo2_TIPLCourseInfo2_CRC_wrongvalctr > 0)
        {
            TIPLCourseInfo2_TIPLCourseInfo2_CRC_wrongvalctr--;
             // if counter becomes zero, update panel controller to zero
             if(TIPLCourseInfo2_TIPLCourseInfo2_CRC_wrongvalctr == 0)
             {
                putValue(E_pric_RadarFrontCenter_TIPLCourseInfo2_TIPLCourseInfo2_CRC_wrongvalctr,0);
             }
        }       
    }  
}
update_TIPLCourseInfo4_ChkSum_CheckSum()
{
  int64 l_data[64],l_Crc_Len=0,l_count=0;
	
  l_Crc_Len = 16-1;
  
	for (l_count=0;l_count<l_Crc_Len;l_count++)
    {
      l_data[l_count] = Msg_TIPLCourseInfo4.BYTE(l_count+1);    
    }
       
	Msg_TIPLCourseInfo4.BYTE(0) = calc_SAE_J1850(l_data,l_Crc_Len); 
	
	if(TIPLCourseInfo4_TIPLCourseInfo4_CRC_wrongvalctr != 0)
    {
		Msg_TIPLCourseInfo4.TIPLCourseInfo4_CRC+=1;
        //update signal with wrong CRC value
		if(TIPLCourseInfo4_TIPLCourseInfo4_CRC_wrongvalctr > 0)
        {
            TIPLCourseInfo4_TIPLCourseInfo4_CRC_wrongvalctr--;
             // if counter becomes zero, update panel controller to zero
             if(TIPLCourseInfo4_TIPLCourseInfo4_CRC_wrongvalctr == 0)
             {
                putValue(E_pric_RadarFrontCenter_TIPLCourseInfo4_TIPLCourseInfo4_CRC_wrongvalctr,0);
             }
        }       
    }  
}
/*@@caplFunc:update_ACC_0x95_CRC_CheckSum():*///function
update_ACC_0x95_ChkSum_CheckSum()
{
  int64 l_data[64],l_Crc_Len=0,l_count=0;
	
  l_Crc_Len = 8-1;
  
	for (l_count=0;l_count<l_Crc_Len;l_count++)
    {
      l_data[l_count] = Msg_ACC_0x95.BYTE(l_count+1);    
    }
       
	Msg_ACC_0x95.BYTE(7) = calc_SAE_J1850(l_data,l_Crc_Len); 
	
	if(ACC_0x95_ACC_CRCCheck_0x95_wrongvalctr != 0)
    {
		Msg_ACC_0x95.ACC_CRCCheck_0x95+=1;
        //update signal with wrong CRC value
		if(ACC_0x95_ACC_CRCCheck_0x95_wrongvalctr > 0)
        {
            ACC_0x95_ACC_CRCCheck_0x95_wrongvalctr--;
             // if counter becomes zero, update panel controller to zero
             if(ACC_0x95_ACC_CRCCheck_0x95_wrongvalctr == 0)
             {
                putValue(E_pric_RadarFrontCenter_ACC_0x95_ACC_CRCCheck_0x95_wrongvalctr,0);
             }
        }       
    }  
}
/*@@caplFunc:update_TrajPointACCObj22_CRC_CheckSum():*///function
update_TrajPointACCObj22_ChkSum_CheckSum()
{
  int64 l_data[64],l_Crc_Len=0,l_count=0;
	
  l_Crc_Len = 16-1;
  
	for (l_count=0;l_count<l_Crc_Len;l_count++)
    {
      l_data[l_count] = Msg_TrajPointACCObj22.BYTE(l_count+1);    
    }
       
	Msg_TrajPointACCObj22.BYTE(0) = calc_SAE_J1850(l_data,l_Crc_Len); 
	
	if(TrajPointACCObj22_TrajPointACCObj22_CRC_wrongvalctr != 0)
    {
		Msg_TrajPointACCObj22.TrajPointACCObj22_CRC+=1;
        //update signal with wrong CRC value
		if(TrajPointACCObj22_TrajPointACCObj22_CRC_wrongvalctr > 0)
        {
            TrajPointACCObj22_TrajPointACCObj22_CRC_wrongvalctr--;
             // if counter becomes zero, update panel controller to zero
             if(TrajPointACCObj22_TrajPointACCObj22_CRC_wrongvalctr == 0)
             {
                putValue(E_pric_RadarFrontCenter_TrajPointACCObj22_TrajPointACCObj22_CRC_wrongvalctr,0);
             }
        }       
    }  
}
update_TrajPointACCObj23_ChkSum_CheckSum()
{
  int64 l_data[64],l_Crc_Len=0,l_count=0;
	
  l_Crc_Len = 16-1;
  
	for (l_count=0;l_count<l_Crc_Len;l_count++)
    {
      l_data[l_count] = Msg_TrajPointACCObj23.BYTE(l_count+1);    
    }
       
	Msg_TrajPointACCObj23.BYTE(0) = calc_SAE_J1850(l_data,l_Crc_Len); 
	
	if(TrajPointACCObj23_TrajPointACCObj23_CRC_wrongvalctr != 0)
    {
		Msg_TrajPointACCObj23.TrajPointACCObj23_CRC+=1;
        //update signal with wrong CRC value
		if(TrajPointACCObj23_TrajPointACCObj23_CRC_wrongvalctr > 0)
        {
            TrajPointACCObj23_TrajPointACCObj23_CRC_wrongvalctr--;
             // if counter becomes zero, update panel controller to zero
             if(TrajPointACCObj23_TrajPointACCObj23_CRC_wrongvalctr == 0)
             {
                putValue(E_pric_RadarFrontCenter_TrajPointACCObj23_TrajPointACCObj23_CRC_wrongvalctr,0);
             }
        }       
    }  
}
update_TrajPointACCObj20_ChkSum_CheckSum()
{
  int64 l_data[64],l_Crc_Len=0,l_count=0;
	
  l_Crc_Len = 16-1;
  
	for (l_count=0;l_count<l_Crc_Len;l_count++)
    {
      l_data[l_count] = Msg_TrajPointACCObj20.BYTE(l_count+1);    
    }
       
	Msg_TrajPointACCObj20.BYTE(0) = calc_SAE_J1850(l_data,l_Crc_Len); 
	
	if(TrajPointACCObj20_TrajPointACCObj20_CRC_wrongvalctr != 0)
    {
		Msg_TrajPointACCObj20.TrajPointACCObj20_CRC+=1;
        //update signal with wrong CRC value
		if(TrajPointACCObj20_TrajPointACCObj20_CRC_wrongvalctr > 0)
        {
            TrajPointACCObj20_TrajPointACCObj20_CRC_wrongvalctr--;
             // if counter becomes zero, update panel controller to zero
             if(TrajPointACCObj20_TrajPointACCObj20_CRC_wrongvalctr == 0)
             {
                putValue(E_pric_RadarFrontCenter_TrajPointACCObj20_TrajPointACCObj20_CRC_wrongvalctr,0);
             }
        }       
    }  
}
update_TrajPointACCObj21_ChkSum_CheckSum()
{
  int64 l_data[64],l_Crc_Len=0,l_count=0;
	
  l_Crc_Len = 16-1;
  
	for (l_count=0;l_count<l_Crc_Len;l_count++)
    {
      l_data[l_count] = Msg_TrajPointACCObj21.BYTE(l_count+1);    
    }
       
	Msg_TrajPointACCObj21.BYTE(0) = calc_SAE_J1850(l_data,l_Crc_Len); 
	
	if(TrajPointACCObj21_TrajPointACCObj21_CRC_wrongvalctr != 0)
    {
		Msg_TrajPointACCObj21.TrajPointACCObj21_CRC+=1;
        //update signal with wrong CRC value
		if(TrajPointACCObj21_TrajPointACCObj21_CRC_wrongvalctr > 0)
        {
            TrajPointACCObj21_TrajPointACCObj21_CRC_wrongvalctr--;
             // if counter becomes zero, update panel controller to zero
             if(TrajPointACCObj21_TrajPointACCObj21_CRC_wrongvalctr == 0)
             {
                putValue(E_pric_RadarFrontCenter_TrajPointACCObj21_TrajPointACCObj21_CRC_wrongvalctr,0);
             }
        }       
    }  
}















int calc_SAE_J1850(int64 data[], int Crc_len)
	{
		int idx,crc,temp,temp1;
		crc = 0xFF;
        idx = 0;
        temp = 0;
        temp1 = 0;
	
        for(idx=0;idx < Crc_len;idx++)
        {
         temp1 = data[idx];
         temp = (crc^temp1);
         crc = CRC_J1850_Table[temp];
       }
		crc ^= 0xFF;
		return crc;
	}
	
	int Calc_Canfd_dlc(byte Dbc_dlc1)
	{
		if(Dbc_dlc > 8)
		    {
			 while (i<=7)
			  {
				if (CANFD_DLC[i]==Dbc_dlc)
				{
				return CAN_DLC[i];
				 break;
				}
				i++ ;
			}
		}
    else
	
	return Dbc_dlc1 ;
	
		
	}
	//For Messages with DLC = 8, CAN FD data length =8
	//For Messages with DLC = 9, CAN FD data length =12
	//For Messages with DLC = 10, CAN FD data length =16
	//For Messages with DLC = 11, CAN FD data length =20
	//For Messages with DLC = 12, CAN FD data length =24
	//For Messages with DLC = 13, CAN FD data length =32
	//For Messages with DLC = 14, CAN FD data length =48
	//For Messages with DLC = 15, CAN FD data length =64
	
	

