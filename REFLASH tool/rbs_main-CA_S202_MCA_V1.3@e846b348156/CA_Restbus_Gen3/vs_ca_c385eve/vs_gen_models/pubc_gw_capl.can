
/*@@var:*/
variables
{
    //Used interact between raw and the physical environment variables
    byte chgEv_GW_387_BCM_RLS_Light_switch_reason = 0;
    byte chgEv_GW_387_BCM_RainfallLevel = 0;
    byte chgEv_GW_288_BcmRiReDoorSts = 0;
    byte chgEv_GW_288_BcmHoodSts = 0;
    byte chgEv_GW_288_BcmLoBeamSts = 0;
    byte chgEv_GW_288_BcmDrvrDoorSts = 0;
    byte chgEv_GW_288_BcmHiBeamSts = 0;
    byte chgEv_GW_288_BcmFrntFogLmpSts = 0;
    byte chgEv_GW_288_BcmTurnIndcrLe = 0;
    byte chgEv_GW_288_BcmPassDoorSts = 0;
    byte chgEv_GW_288_BcmStsRainSnsr = 0;
    byte chgEv_GW_288_BcmLeReDoorSts = 0;
    byte chgEv_GW_288_BcmReFoglmpSts = 0;
    byte chgEv_GW_288_BcmAutHeadLiSts = 0;
    byte chgEv_GW_288_BcmLiSnsrFlt = 0;
    byte chgEv_GW_288_BcmTurnIndcrRi = 0;
    byte chgEv_GW_288_BcmFrntWiperSts = 0;
    byte chgEv_GW_288_BcmEmgyLiSts = 0;
    byte chgEv_GW_1D2_EspVirtMstCylTarBrkPVld = 0;
    byte chgEv_GW_1D2_EspEstimdWhlBrkPMax = 0;
    byte chgEv_GW_1D2_EspVehSpdIB = 0;
    byte chgEv_GW_1D2_EspVirtMstCylTarBrkP = 0;
    byte chgEv_GW_1D2_EspVehSpdVldIB = 0;
    byte chgEv_GW_1D2_EspMstCylBrkPVldIB = 0;
    byte chgEv_GW_1D2_EspMstCylBrkPIB = 0;
    byte chgEv_GW_284_RRC_OBJ7_RefPointLoc = 0;
    byte chgEv_GW_284_RRC_OBJ2_RefPointDx = 0;
    byte chgEv_GW_284_RRC_OBJ2_RefPointDy = 0;
    byte chgEv_GW_284_RRC_OBJ8_RefPointDx = 0;
    byte chgEv_GW_284_RRC_OBJ8_RefPointDy = 0;
    byte chgEv_GW_284_RRC_OBJ6_RefPointDx = 0;
    byte chgEv_GW_284_RRC_OBJ6_RefPointDy = 0;
    byte chgEv_GW_284_RRC_OBJ1_RefPointLoc = 0;
    byte chgEv_GW_284_RRC_OBJ1_RefPointDx = 0;
    byte chgEv_GW_284_RRC_OBJ5_RefPointDy = 0;
    byte chgEv_GW_284_RRC_OBJ5_RefPointDx = 0;
    byte chgEv_GW_284_RRC_OBJ7_RefPointDy = 0;
    byte chgEv_GW_284_RRC_OBJ7_RefPointDx = 0;
    byte chgEv_GW_284_RRC_OBJ10_RefPointDx = 0;
    byte chgEv_GW_284_RRC_OBJ10_RefPointDy = 0;
    byte chgEv_GW_284_RRC_OBJ5_RefPointLoc = 0;
    byte chgEv_GW_284_RRC_OBJ1_RefPointDy = 0;
    byte chgEv_GW_284_RRC_OBJ4_RefPointDx = 0;
    byte chgEv_GW_284_RRC_OBJ4_RefPointDy = 0;
    byte chgEv_GW_284_RRC_OBJ2_RefPointLoc = 0;
    byte chgEv_GW_284_RRC_OBJ10_RefPointLoc = 0;
    byte chgEv_GW_284_RRC_OBJ3_RefPointDy = 0;
    byte chgEv_GW_284_RRC_OBJ3_RefPointDx = 0;
    byte chgEv_GW_284_RRC_OBJ6_RefPointLoc = 0;
    byte chgEv_GW_284_RRC_OBJ9_RefPointDy = 0;
    byte chgEv_GW_284_RRC_OBJ9_RefPointDx = 0;
    byte chgEv_GW_284_RRC_OBJ3_RefPointLoc = 0;
    byte chgEv_GW_284_RRC_OBJ9_RefPointLoc = 0;
    byte chgEv_GW_284_RRC_OBJ8_RefPointLoc = 0;
    byte chgEv_GW_284_RRC_OBJ4_RefPointLoc = 0;
    byte chgEv_GW_2DE_IP_DISFail = 0;
    byte chgEv_GW_2DE_IP_QDashACCFail = 0;
    byte chgEv_GW_50_SrsCrashOutpStsChks = 0;
    byte chgEv_GW_50_SrsPassBucSwtSts = 0;
    byte chgEv_GW_50_SrsCrashOutpSts = 0;
    byte chgEv_GW_50_SrsDrvrBucSwtSts = 0;
    byte chgEv_GW_50_SrsWarnLampSts = 0;
    byte chgEv_GW_20B_ESP_AWBavailable = 0;
    byte chgEv_GW_20B_ESP_AWBactive = 0;
    byte chgEv_GW_20B_ESP_PrefillActive = 0;
    byte chgEv_GW_20B_ESP_QDCACC = 0;
    byte chgEv_GW_20B_ESP_PrefillAvailable = 0;
    byte chgEv_GW_20B_ESP_BrakeOverHeatBrakeDiscTemp = 0;
    byte chgEv_GW_20B_ESP_CDD_Active = 0;
    byte chgEv_GW_20B_ESP_ABAavailable = 0;
    byte chgEv_GW_20B_ESP_AEBdecActive = 0;
    byte chgEv_GW_20B_ESP_BrakeForce = 0;
    byte chgEv_GW_20B_ESP_ABAactive = 0;
    byte chgEv_GW_20B_ESP_AEBAvailable = 0;
    byte chgEv_GW_20B_ESP_CDD_Available = 0;
    byte chgEv_GW_1C2_EspVehStandstill = 0;
    byte chgEv_GW_1C2_WhlSpdRiReDir = 0;
    byte chgEv_GW_1C2_WhlSpdRiReDataVld = 0;
    byte chgEv_GW_1C2_WhlSpdLeReDataVld = 0;
    byte chgEv_GW_1C2_WhlSpdRiFrntDir = 0;
    byte chgEv_GW_1C2_WhlSpdRiFrntData = 0;
    byte chgEv_GW_1C2_WhlSpdFrntRiPls = 0;
    byte chgEv_GW_1C2_EspMstCylBrkPVld = 0;
    byte chgEv_GW_1C2_EspLgtAccel = 0;
    byte chgEv_GW_1C2_EspTcsActvSts = 0;
    byte chgEv_GW_1C2_EspLatAccel = 0;
    byte chgEv_GW_1C2_WhlSpdFrntLePls = 0;
    byte chgEv_GW_1C2_WhlSpdRiReData = 0;
    byte chgEv_GW_1C2_MbRgnTarWhlQlfr = 0;
    byte chgEv_GW_1C2_EspLatAccelVld = 0;
    byte chgEv_GW_1C2_WhlSpdLeFrntData = 0;
    byte chgEv_GW_1C2_EspAbsActv = 0;
    byte chgEv_GW_1C2_EspVdcActvSts = 0;
    byte chgEv_GW_1C2_WhlSpdLeFrntDataVld = 0;
    byte chgEv_GW_1C2_EspAutoHoldActvSts = 0;
    byte chgEv_GW_1C2_MbRgnTarWhl = 0;
    byte chgEv_GW_1C2_EspYawAgSpdVld = 0;
    byte chgEv_GW_1C2_EspReWhlDecTarTqActv = 0;
    byte chgEv_GW_1C2_WhlSpdReRiPls = 0;
    byte chgEv_GW_1C2_EspReWhlDecTarTq = 0;
    byte chgEv_GW_1C2_WhlSpdRiFrntDataVld = 0;
    byte chgEv_GW_1C2_EspReWhlIncTarTqActv = 0;
    byte chgEv_GW_1C2_EspLgtAccelVld = 0;
    byte chgEv_GW_1C2_WhlSpdReLePls = 0;
    byte chgEv_GW_1C2_EspTcsFailr = 0;
    byte chgEv_GW_1C2_EspAbsFailr = 0;
    byte chgEv_GW_1C2_EspMstCylBrkP = 0;
    byte chgEv_GW_1C2_EspFctOpenSts = 0;
    byte chgEv_GW_1C2_EspReWhlIncTarTq = 0;
    byte chgEv_GW_1C2_EspYawAgSpd = 0;
    byte chgEv_GW_1C2_EspActvSts = 0;
    byte chgEv_GW_1C2_EspVehSpd = 0;
    byte chgEv_GW_1C2_EspVehSpdVld = 0;
    byte chgEv_GW_1C2_WhlSpdLeReDir = 0;
    byte chgEv_GW_1C2_WhlSpdLeFrntDir = 0;
    byte chgEv_GW_1C2_WhlSpdLeReData = 0;
    byte chgEv_GW_24F_EPS_TorqSensorStatus = 0;
    byte chgEv_GW_24F_EpsSteerModFb = 0;
    byte chgEv_GW_24F_EPS_SteeringTorque = 0;
    byte chgEv_GW_24F_EPS_IACC_abortreason = 0;
    byte chgEv_GW_24F_EpsFaild = 0;
    byte chgEv_GW_24F_EPS_ConcussAvailabilityStatus = 0;
    byte chgEv_GW_356_IMS_EyeGazeStatus = 0;
    byte chgEv_GW_356_IMS_BrowOffsetValue = 0;
    byte chgEv_GW_356_IMS_DistractionStatus = 0;
    byte chgEv_GW_356_IMS_HeadDetectSts_Pitch = 0;
    byte chgEv_GW_356_IMS_IMSStatus = 0;
    byte chgEv_GW_356_IMS_DriverEyesFovArea = 0;
    byte chgEv_GW_356_IMS_EyeDetectSatus = 0;
    byte chgEv_GW_356_IMS_JawOffsetValue = 0;
    byte chgEv_GW_356_IMS_HeadDetectSts_Roll = 0;
    byte chgEv_GW_356_IMS_DriverEyeConfidence = 0;
    byte chgEv_GW_356_IMS_PhoneCallSts = 0;
    byte chgEv_GW_356_IMS_DriverEyeDetect = 0;
    byte chgEv_GW_356_IMS_DrowsinessStatus = 0;
    byte chgEv_GW_356_IMS_DriverEyeClosestatus = 0;
    byte chgEv_GW_356_IMS_HeadDetectSts_Yaw = 0;
    byte chgEv_GW_356_IMS_DriverHeadDetect = 0;
    byte chgEv_GW_507_HU_VC_CruiseSetDistance = 0;
    byte chgEv_GW_507_HU_VC_CruiseControl = 0;
    byte chgEv_GW_507_HU_VC_CruiseSetSpeed = 0;
    byte chgEv_GW_507_HU_OverspeedWarningOffset = 0;
    byte chgEv_GW_507_HU_LASWarningModeSelection = 0;
    byte chgEv_GW_507_HU_AutoBrakeEnable = 0;
    byte chgEv_GW_507_HU_LASModeSelection = 0;
    byte chgEv_GW_507_HU_TSRSwitch = 0;
    byte chgEv_GW_507_HU_OverspeedWarningEnable = 0;
    byte chgEv_GW_507_HU_OverspeedSoundWarEnable = 0;
    byte chgEv_GW_507_HU_HMAEnable = 0;
    byte chgEv_GW_507_HU_LDWShakeLev = 0;
    byte chgEv_GW_507_HU_IACCEnable = 0;
    byte chgEv_GW_507_HU_FCWSetting = 0;
    byte chgEv_GW_507_HU_CruiseControlSet = 0;
    byte chgEv_GW_3C4_HU_RoadCurvature_30m = 0;
    byte chgEv_GW_3C4_HU_TrafficAccident_Info = 0;
    byte chgEv_GW_3C4_HU_RoadCurvature_20m = 0;
    byte chgEv_GW_3C4_HU_EnterTunnelInfo = 0;
    byte chgEv_GW_3C4_HU_MapDataUpdateStatus = 0;
    byte chgEv_GW_3C4_HU_TunnelDistance = 0;
    byte chgEv_GW_3C4_HU_FallingRockDi = 0;
    byte chgEv_GW_3C4_HU_Byroad = 0;
    byte chgEv_GW_3C4_HU_BranchInfo = 0;
    byte chgEv_GW_3C4_HU_RoadCurvature = 0;
    byte chgEv_GW_3C4_HU_RoadCurvature_80m = 0;
    byte chgEv_GW_3C4_HU_RoadCurvature_90m = 0;
    byte chgEv_GW_3C4_HU_RoadCurvature_600m = 0;
    byte chgEv_GW_3C4_HU_SlopeDistance = 0;
    byte chgEv_GW_3C4_HU_LaneCnt = 0;
    byte chgEv_GW_3C4_HU_RoadCurvature_100m = 0;
    byte chgEv_GW_3C4_HU_TollDis = 0;
    byte chgEv_GW_3C4_HU_To_Construction_Dis = 0;
    byte chgEv_GW_3C4_HU_To_Branch_Dis = 0;
    byte chgEv_GW_3C4_HU_RoadCurvature_70m = 0;
    byte chgEv_GW_3C4_HU_To_TrafficAccident_Dis = 0;
    byte chgEv_GW_3C4_HU_To_NumchangeOfLanes_Dist = 0;
    byte chgEv_GW_3C4_HU_RoadCurvature_60m = 0;
    byte chgEv_GW_3C4_HU_TunnelLength = 0;
    byte chgEv_GW_3C4_HU_Construction_Info = 0;
    byte chgEv_GW_3C4_HU_TollInfo = 0;
    byte chgEv_GW_3C4_HU_RoadCurvature_300m = 0;
    byte chgEv_GW_3C4_HU_NavGuiganceStatus = 0;
    byte chgEv_GW_3C4_HU_Lane_Changtype = 0;
    byte chgEv_GW_3C4_HU_RoadCurvatureFar = 0;
    byte chgEv_GW_3C4_HU_RampSide = 0;
    byte chgEv_GW_3C4_HU_ForwardRoadType = 0;
    byte chgEv_GW_3C4_HU_RoadCurvature_400m = 0;
    byte chgEv_GW_3C4_HU_FallingRockInfo = 0;
    byte chgEv_GW_3C4_HU_MapMatchStatus = 0;
    byte chgEv_GW_3C4_HU_EnterSlopeInfo = 0;
    byte chgEv_GW_3C4_HU_SlopeGradient_300m = 0;
    byte chgEv_GW_3C4_HU_Road_TrafficFlow = 0;
    byte chgEv_GW_3C4_HU_RoadCurvature_50m = 0;
    byte chgEv_GW_3C4_HU_RoadCurvature_10m = 0;
    byte chgEv_GW_3C4_HU_RoadCurvature_40m = 0;
    byte chgEv_GW_3C2_EpbDriverReqParkBrakeDominant = 0;
    byte chgEv_GW_3C2_EpbRiAchievedClmpF = 0;
    byte chgEv_GW_3C2_EpbFailrSts = 0;
    byte chgEv_GW_3C2_EspEpbReqAvl = 0;
    byte chgEv_GW_3C2_EpbSts = 0;
    byte chgEv_GW_3C2_EpbLeAchievedClmpF = 0;
    byte chgEv_GW_3AF_HU_SlopeGradientFar = 0;
    byte chgEv_GW_3AF_HU_NavCurrentRoadType = 0;
    byte chgEv_GW_3AF_HU_AccidentProne = 0;
    byte chgEv_GW_3AF_HU_CurveDistance = 0;
    byte chgEv_GW_3AF_HU_IntervalVelocityDis = 0;
    byte chgEv_GW_3AF_HU_SlopeGradient = 0;
    byte chgEv_GW_3AF_HU_NavStatus = 0;
    byte chgEv_GW_3AF_HU_IntervalVelocityInfo = 0;
    byte chgEv_GW_3AF_HU_SlopeGradient_50m = 0;
    byte chgEv_GW_3AF_HU_BridgeDis = 0;
    byte chgEv_GW_3AF_HU_SlopeGradient_40m = 0;
    byte chgEv_GW_3AF_HU_LaneType_ID5 = 0;
    byte chgEv_GW_3AF_HU_LaneType_ID4 = 0;
    byte chgEv_GW_3AF_HU_LaneType_ID6 = 0;
    byte chgEv_GW_3AF_HU_LaneType_ID1 = 0;
    byte chgEv_GW_3AF_HU_LaneType_ID3 = 0;
    byte chgEv_GW_3AF_HU_RampInfo = 0;
    byte chgEv_GW_3AF_HU_NavCountryCode = 0;
    byte chgEv_GW_3AF_HU_SpeedLimitDistance = 0;
    byte chgEv_GW_3AF_HU_NavSpeedLimitType = 0;
    byte chgEv_GW_3AF_HU_NavSpeedLimitUnits = 0;
    byte chgEv_GW_3AF_HU_ServiceRoadDis = 0;
    byte chgEv_GW_3AF_HU_WeatherType = 0;
    byte chgEv_GW_3AF_HU_EnterCurveInfo = 0;
    byte chgEv_GW_3AF_HU_ServiceRoad = 0;
    byte chgEv_GW_3AF_HU_SlopeGradient_100m = 0;
    byte chgEv_GW_3AF_HU_LaneConfluenceDis = 0;
    byte chgEv_GW_3AF_HU_AccidentProneDistance = 0;
    byte chgEv_GW_3AF_HU_SlopeGradient_30m = 0;
    byte chgEv_GW_3AF_HU_LaneConfluence = 0;
    byte chgEv_GW_3AF_HU_BridgeInfo = 0;
    byte chgEv_GW_3AF_HU_SlopeGradient_20m = 0;
    byte chgEv_GW_3AF_HU_NavSpeedLimit = 0;
    byte chgEv_GW_3AF_HU_SlopeGradient_10m = 0;
    byte chgEv_GW_3AF_HU_RampDistance = 0;
    byte chgEv_GW_3AF_HU_NavSpeedLimitStatus = 0;
    byte chgEv_GW_3AF_HU_LaneType_ID2 = 0;
    byte chgEv_GW_3AF_HU_EnterRampInfo = 0;
    byte chgEv_GW_2AD_LCDAL_SystemStatus = 0;
    byte chgEv_GW_170_EPS_ActualTorsionBarTorq = 0;
    byte chgEv_GW_170_EPS_MinSafetyTorsionBarTorq = 0;
    byte chgEv_GW_170_EPS_MaxSafetyTorsionBarTorq = 0;
    byte chgEv_GW_2A8_TmsAcEnvtlT = 0;
    byte chgEv_GW_2A8_TmsAcEnvtlTVld = 0;
    byte chgEv_GW_2A8_TmsActPwr = 0;
    byte chgEv_GW_2A8_TmsFrntBlowMod = 0;
    byte chgEv_GW_3EE_GW_SafCertSts = 0;
    byte chgEv_GW_2C8_RRC_OBJ3_Height = 0;
    byte chgEv_GW_2C8_RRC_OBJ5_Length = 0;
    byte chgEv_GW_2C8_RRC_OBJ1_Height = 0;
    byte chgEv_GW_2C8_RRC_OBJ10_Track_ID = 0;
    byte chgEv_GW_2C8_RRC_OBJ10_Type = 0;
    byte chgEv_GW_2C8_RRC_OBJ5_Track_ID = 0;
    byte chgEv_GW_2C8_RRC_TiStamp = 0;
    byte chgEv_GW_2C8_RRC_OBJ5_Ay = 0;
    byte chgEv_GW_2C8_RRC_OBJ5_Ax = 0;
    byte chgEv_GW_2C8_RRC_OBJ10_Location = 0;
    byte chgEv_GW_2C8_RRC_OBJ5_ExistProb = 0;
    byte chgEv_GW_2C8_RRC_OBJ5_Height = 0;
    byte chgEv_GW_2C8_RRC_OBJ10_Height = 0;
    byte chgEv_GW_2C8_RRC_OBJ10_ObstacleProb = 0;
    byte chgEv_GW_2C8_RRC_OBJ5_Width = 0;
    byte chgEv_GW_2C8_RRC_OBJ5_Location = 0;
    byte chgEv_GW_2C8_RRC_OBJ4_Height = 0;
    byte chgEv_GW_2C8_RRC_OBJ6_Height = 0;
    byte chgEv_GW_2C8_RRC_OBJ8_Height = 0;
    byte chgEv_GW_2C8_RRC_TiBas = 0;
    byte chgEv_GW_2C8_RRC_OBJ5_Vx = 0;
    byte chgEv_GW_2C8_RRC_OBJ5_Vy = 0;
    byte chgEv_GW_2C8_RRC_OBJ2_Height = 0;
    byte chgEv_GW_2C8_RRC_OBJ10_Measured = 0;
    byte chgEv_GW_2C8_RRC_TiOut = 0;
    byte chgEv_GW_2C8_RRC_OBJ10_Ax = 0;
    byte chgEv_GW_2C8_RRC_OBJ10_Ay = 0;
    byte chgEv_GW_2C8_RRC_OBJ10_Dy = 0;
    byte chgEv_GW_2C8_RRC_OBJ10_Dx = 0;
    byte chgEv_GW_2C8_RRC_OBJ10_Length = 0;
    byte chgEv_GW_2C8_RRC_OBJ5_Measured = 0;
    byte chgEv_GW_2C8_RRC_OBJ9_Height = 0;
    byte chgEv_GW_2C8_RRC_OBJ5_HeadingAngle = 0;
    byte chgEv_GW_2C8_RRC_OBJ5_ObstacleProb = 0;
    byte chgEv_GW_2C8_RRC_OBJ10_Width = 0;
    byte chgEv_GW_2C8_RRC_ObjDelay = 0;
    byte chgEv_GW_2C8_RRC_TiLeap = 0;
    byte chgEv_GW_2C8_RRC_OBJ10_HeadingAngle = 0;
    byte chgEv_GW_2C8_RRC_OBJ10_ExistProb = 0;
    byte chgEv_GW_2C8_RRC_OBJ7_Height = 0;
    byte chgEv_GW_2C8_RRC_OBJ10_Vy = 0;
    byte chgEv_GW_2C8_RRC_OBJ10_Vx = 0;
    byte chgEv_GW_2C8_RRC_OBJ5_Type = 0;
    byte chgEv_GW_2C8_RRC_OBJ5_Dx = 0;
    byte chgEv_GW_2C8_RRC_OBJ5_Dy = 0;
    byte chgEv_GW_NM_GW_NMSourceAddress = 0;
    byte chgEv_GW_17E_EPS_LatCtrlActive = 0;
    byte chgEv_GW_17E_EPS_MeasuredTorsionBarTorqValid = 0;
    byte chgEv_GW_17E_EPS_MeasuredTorsionBarTorque = 0;
    byte chgEv_GW_17E_EPS_LatCtrlAvailabilityStatus = 0;
    byte chgEv_GW_2C2_IbBrkPedlStsGbVld = 0;
    byte chgEv_GW_2C2_IB_EPBrequestValid = 0;
    byte chgEv_GW_2C2_IbBrkPedlStsGb = 0;
    byte chgEv_GW_2C2_IB_EPBrequest = 0;
    byte chgEv_GW_2A4_LCDAR_Left_ELK_oAlert = 0;
    byte chgEv_GW_2A4_LCDAR_RCTBEnable = 0;
    byte chgEv_GW_2A4_LCDAR_ELK_oAlert = 0;
    byte chgEv_GW_2A4_LCDAR_ELK_oStatus = 0;
    byte chgEv_GW_2A4_LCDAR_RCTBTargetDecel = 0;
    byte chgEv_GW_2A4_LCDAR_SystemStatus = 0;
    byte chgEv_GW_2A4_LCDAR_RCTBActive = 0;
    byte chgEv_GW_2A4_LCDAR_Left_RCTAAlert = 0;
    byte chgEv_GW_516_HU_CurrentLocationLatitude = 0;
    byte chgEv_GW_516_HU_CurrentLocationLongitude = 0;
    byte chgEv_GW_516_HU_CurrentLocationValid = 0;
    byte chgEv_GW_2D2_CdcTotMilg = 0;
    byte chgEv_GW_3D2_EpbRiAchievedClmpF = 0;
    byte chgEv_GW_3D2_EpbFailrSts = 0;
    byte chgEv_GW_3D2_EspEpbReqAvl = 0;
    byte chgEv_GW_3D2_EpbLeAchievedClmpF = 0;
    byte chgEv_GW_3D2_EpbSts = 0;
    byte chgEv_GW_3D2_EpbDriverReqParkBrakeDominant = 0;
    byte chgEv_GW_180_EpsSteerAgSensFilr = 0;
    byte chgEv_GW_180_EpsSasSteerAg = 0;
    byte chgEv_GW_180_EpsSteerAgRate = 0;
    byte chgEv_GW_180_EpsSasCalSts = 0;
    byte chgEv_GW_180_EpsSasSteerAgVld = 0;
    byte chgEv_GW_2BD_RRC_OBJ1_Measured = 0;
    byte chgEv_GW_2BD_RRC_OBJ3_Ay = 0;
    byte chgEv_GW_2BD_RRC_OBJ4_Measured = 0;
    byte chgEv_GW_2BD_RRC_OBJ2_Measured = 0;
    byte chgEv_GW_2BD_RRC_OBJ4_Vy = 0;
    byte chgEv_GW_2BD_RRC_OBJ4_Vx = 0;
    byte chgEv_GW_2BD_RRC_OBJ4_Ax = 0;
    byte chgEv_GW_2BD_RRC_OBJ4_Ay = 0;
    byte chgEv_GW_2BD_RRC_OBJ2_Width = 0;
    byte chgEv_GW_2BD_RRC_OBJ2_Type = 0;
    byte chgEv_GW_2BD_RRC_OBJ2_ObstacleProb = 0;
    byte chgEv_GW_2BD_RRC_OBJ4_Width = 0;
    byte chgEv_GW_2BD_RRC_OBJ4_ObstacleProb = 0;
    byte chgEv_GW_2BD_RRC_OBJ2_Dy = 0;
    byte chgEv_GW_2BD_RRC_OBJ2_Dx = 0;
    byte chgEv_GW_2BD_RRC_OBJ2_ExistProb = 0;
    byte chgEv_GW_2BD_RRC_OBJ4_Location = 0;
    byte chgEv_GW_2BD_RRC_OBJ2_Length = 0;
    byte chgEv_GW_2BD_RRC_OBJ1_Type = 0;
    byte chgEv_GW_2BD_RRC_OBJ3_Ax = 0;
    byte chgEv_GW_2BD_RRC_OBJ4_ExistProb = 0;
    byte chgEv_GW_2BD_RRC_OBJ1_ExistProb = 0;
    byte chgEv_GW_2BD_RRC_OBJ4_HeadingAngle = 0;
    byte chgEv_GW_2BD_RRC_OBJ3_Type = 0;
    byte chgEv_GW_2BD_RRC_OBJ1_Vx = 0;
    byte chgEv_GW_2BD_RRC_OBJ3_HeadingAngle = 0;
    byte chgEv_GW_2BD_RRC_OBJ4_Type = 0;
    byte chgEv_GW_2BD_RRC_OBJ2_Track_ID = 0;
    byte chgEv_GW_2BD_RRC_OBJ1_Ay = 0;
    byte chgEv_GW_2BD_RRC_OBJ1_Ax = 0;
    byte chgEv_GW_2BD_RRC_OBJ3_ExistProb = 0;
    byte chgEv_GW_2BD_RRC_OBJ3_Length = 0;
    byte chgEv_GW_2BD_RRC_OBJ1_Vy = 0;
    byte chgEv_GW_2BD_RRC_OBJ3_Measured = 0;
    byte chgEv_GW_2BD_RRC_OBJ3_Width = 0;
    byte chgEv_GW_2BD_RRC_OBJ2_Vy = 0;
    byte chgEv_GW_2BD_RRC_OBJ2_Vx = 0;
    byte chgEv_GW_2BD_RRC_OBJ1_ObstacleProb = 0;
    byte chgEv_GW_2BD_RRC_OBJ1_HeadingAngle = 0;
    byte chgEv_GW_2BD_RRC_OBJ3_Dx = 0;
    byte chgEv_GW_2BD_RRC_OBJ3_Dy = 0;
    byte chgEv_GW_2BD_RRC_OBJ3_Location = 0;
    byte chgEv_GW_2BD_RRC_OBJ4_Dy = 0;
    byte chgEv_GW_2BD_RRC_OBJ4_Dx = 0;
    byte chgEv_GW_2BD_RRC_OBJ2_Location = 0;
    byte chgEv_GW_2BD_RRC_OBJ1_Width = 0;
    byte chgEv_GW_2BD_RRC_OBJ1_Location = 0;
    byte chgEv_GW_2BD_RRC_OBJ4_Track_ID = 0;
    byte chgEv_GW_2BD_RRC_OBJ1_Track_ID = 0;
    byte chgEv_GW_2BD_RRC_OBJ2_Ax = 0;
    byte chgEv_GW_2BD_RRC_OBJ2_Ay = 0;
    byte chgEv_GW_2BD_RRC_OBJ1_Length = 0;
    byte chgEv_GW_2BD_RRC_OBJ3_ObstacleProb = 0;
    byte chgEv_GW_2BD_RRC_OBJ4_Length = 0;
    byte chgEv_GW_2BD_RRC_OBJ3_Vx = 0;
    byte chgEv_GW_2BD_RRC_OBJ3_Vy = 0;
    byte chgEv_GW_2BD_RRC_OBJ2_HeadingAngle = 0;
    byte chgEv_GW_2BD_RRC_OBJ3_Track_ID = 0;
    byte chgEv_GW_2BD_RRC_OBJ1_Dx = 0;
    byte chgEv_GW_2BD_RRC_OBJ1_Dy = 0;
    byte chgEv_GW_2BF_RRC_OBJ8_HeadingAngle = 0;
    byte chgEv_GW_2BF_RRC_OBJ9_Type = 0;
    byte chgEv_GW_2BF_RRC_OBJ8_Vy = 0;
    byte chgEv_GW_2BF_RRC_OBJ6_Dy = 0;
    byte chgEv_GW_2BF_RRC_OBJ6_Dx = 0;
    byte chgEv_GW_2BF_RRC_OBJ6_HeadingAngle = 0;
    byte chgEv_GW_2BF_RRC_OBJ9_Ay = 0;
    byte chgEv_GW_2BF_RRC_OBJ9_Ax = 0;
    byte chgEv_GW_2BF_RRC_OBJ8_Vx = 0;
    byte chgEv_GW_2BF_RRC_OBJ7_Length = 0;
    byte chgEv_GW_2BF_RRC_OBJ8_Length = 0;
    byte chgEv_GW_2BF_RRC_OBJ6_Vy = 0;
    byte chgEv_GW_2BF_RRC_OBJ6_Vx = 0;
    byte chgEv_GW_2BF_RRC_OBJ8_Ax = 0;
    byte chgEv_GW_2BF_RRC_OBJ8_Measured = 0;
    byte chgEv_GW_2BF_RRC_OBJ7_Dx = 0;
    byte chgEv_GW_2BF_RRC_OBJ7_Dy = 0;
    byte chgEv_GW_2BF_RRC_OBJ8_Ay = 0;
    byte chgEv_GW_2BF_RRC_OBJ7_Track_ID = 0;
    byte chgEv_GW_2BF_RRC_OBJ6_Width = 0;
    byte chgEv_GW_2BF_RRC_OBJ9_Vx = 0;
    byte chgEv_GW_2BF_RRC_OBJ9_Vy = 0;
    byte chgEv_GW_2BF_RRC_OBJ9_ObstacleProb = 0;
    byte chgEv_GW_2BF_RRC_OBJ7_HeadingAngle = 0;
    byte chgEv_GW_2BF_RRC_OBJ8_Type = 0;
    byte chgEv_GW_2BF_RRC_OBJ9_Length = 0;
    byte chgEv_GW_2BF_RRC_OBJ6_ExistProb = 0;
    byte chgEv_GW_2BF_RRC_OBJ9_Track_ID = 0;
    byte chgEv_GW_2BF_RRC_OBJ6_Location = 0;
    byte chgEv_GW_2BF_RRC_OBJ9_Location = 0;
    byte chgEv_GW_2BF_RRC_OBJ7_Width = 0;
    byte chgEv_GW_2BF_RRC_OBJ6_Ax = 0;
    byte chgEv_GW_2BF_RRC_OBJ6_Ay = 0;
    byte chgEv_GW_2BF_RRC_OBJ6_Track_ID = 0;
    byte chgEv_GW_2BF_RRC_OBJ9_Dy = 0;
    byte chgEv_GW_2BF_RRC_OBJ9_Dx = 0;
    byte chgEv_GW_2BF_RRC_OBJ7_ExistProb = 0;
    byte chgEv_GW_2BF_RRC_OBJ8_Track_ID = 0;
    byte chgEv_GW_2BF_RRC_OBJ7_Measured = 0;
    byte chgEv_GW_2BF_RRC_OBJ7_Type = 0;
    byte chgEv_GW_2BF_RRC_OBJ7_Location = 0;
    byte chgEv_GW_2BF_RRC_OBJ9_Measured = 0;
    byte chgEv_GW_2BF_RRC_OBJ7_Vx = 0;
    byte chgEv_GW_2BF_RRC_OBJ7_Vy = 0;
    byte chgEv_GW_2BF_RRC_OBJ8_Location = 0;
    byte chgEv_GW_2BF_RRC_OBJ8_Dy = 0;
    byte chgEv_GW_2BF_RRC_OBJ9_Width = 0;
    byte chgEv_GW_2BF_RRC_OBJ6_Length = 0;
    byte chgEv_GW_2BF_RRC_OBJ6_Type = 0;
    byte chgEv_GW_2BF_RRC_OBJ9_HeadingAngle = 0;
    byte chgEv_GW_2BF_RRC_OBJ8_ExistProb = 0;
    byte chgEv_GW_2BF_RRC_OBJ6_ObstacleProb = 0;
    byte chgEv_GW_2BF_RRC_OBJ7_ObstacleProb = 0;
    byte chgEv_GW_2BF_RRC_OBJ8_ObstacleProb = 0;
    byte chgEv_GW_2BF_RRC_OBJ8_Dx = 0;
    byte chgEv_GW_2BF_RRC_OBJ9_ExistProb = 0;
    byte chgEv_GW_2BF_RRC_OBJ7_Ay = 0;
    byte chgEv_GW_2BF_RRC_OBJ7_Ax = 0;
    byte chgEv_GW_2BF_RRC_OBJ8_Width = 0;
    byte chgEv_GW_2BF_RRC_OBJ6_Measured = 0;
    byte chgEv_GW_3BD_HU_TLAEnable = 0;
    byte chgEv_GW_3BD_HU_ELKEnable = 0;
    byte chgEv_GW_3BD_HU_CSLAEnable = 0;
    byte chgEv_GW_28B_BCM_TurnLightSwitchSts = 0;
    
    message GW_387        Msg_GW_387;
    msTimer Tm_GW_387;
    int Cycle_GW_387 = 100;
    message GW_288        Msg_GW_288;
    msTimer Tm_GW_288;
    int Cycle_GW_288 = 40;
    message GW_1D2        Msg_GW_1D2;
    msTimer Tm_GW_1D2;
    int Cycle_GW_1D2 = 10;
    message GW_284        Msg_GW_284;
    msTimer Tm_GW_284;
    int Cycle_GW_284 = 50;
    message GW_2DE        Msg_GW_2DE;
    msTimer Tm_GW_2DE;
    int Cycle_GW_2DE = 50;
    message GW_50        Msg_GW_50;
    msTimer Tm_GW_50;
    int Cycle_GW_50 = 500;
    message GW_20B        Msg_GW_20B;
    msTimer Tm_GW_20B;
    int Cycle_GW_20B = 20;
    message GW_1C2        Msg_GW_1C2;
    msTimer Tm_GW_1C2;
    int Cycle_GW_1C2 = 10;
    message GW_24F        Msg_GW_24F;
    msTimer Tm_GW_24F;
    int Cycle_GW_24F = 20;
    message GW_356        Msg_GW_356;
    msTimer Tm_GW_356;
    int Cycle_GW_356 = 100;
    message GW_507        Msg_GW_507;
    message GW_3C4        Msg_GW_3C4;
    msTimer Tm_GW_3C4;
    int Cycle_GW_3C4 = 100;
    message GW_3C2        Msg_GW_3C2;
    msTimer Tm_GW_3C2;
    int Cycle_GW_3C2 = 10;
    message GW_3AF        Msg_GW_3AF;
    msTimer Tm_GW_3AF;
    int Cycle_GW_3AF = 100;
    message GW_2AD        Msg_GW_2AD;
    msTimer Tm_GW_2AD;
    int Cycle_GW_2AD = 50;
    message GW_170        Msg_GW_170;
    msTimer Tm_GW_170;
    int Cycle_GW_170 = 10;
    message GW_2A8        Msg_GW_2A8;
    msTimer Tm_GW_2A8;
    int Cycle_GW_2A8 = 100;
    message GW_3EE        Msg_GW_3EE;
    msTimer Tm_GW_3EE;
    int Cycle_GW_3EE = 100;
    message GW_2C8        Msg_GW_2C8;
    msTimer Tm_GW_2C8;
    int Cycle_GW_2C8 = 50;
    message GW_NM        Msg_GW_NM;
    msTimer Tm_GW_NM;
    int Cycle_GW_NM = 1000;
    message GW_17E        Msg_GW_17E;
    msTimer Tm_GW_17E;
    int Cycle_GW_17E = 10;
    message GW_2C2        Msg_GW_2C2;
    msTimer Tm_GW_2C2;
    int Cycle_GW_2C2 = 10;
    message GW_2A4        Msg_GW_2A4;
    msTimer Tm_GW_2A4;
    int Cycle_GW_2A4 = 50;
    message GW_516        Msg_GW_516;
    msTimer Tm_GW_516;
    int Cycle_GW_516 = 1000;
    message GW_2D2        Msg_GW_2D2;
    msTimer Tm_GW_2D2;
    int Cycle_GW_2D2 = 100;
    message GW_3D2        Msg_GW_3D2;
    msTimer Tm_GW_3D2;
    int Cycle_GW_3D2 = 10;
    message GW_180        Msg_GW_180;
    msTimer Tm_GW_180;
    int Cycle_GW_180 = 10;
    message GW_2BD        Msg_GW_2BD;
    msTimer Tm_GW_2BD;
    int Cycle_GW_2BD = 50;
    message GW_2BF        Msg_GW_2BF;
    msTimer Tm_GW_2BF;
    int Cycle_GW_2BF = 50;
    message GW_3BD        Msg_GW_3BD;
    msTimer Tm_GW_3BD;
    int Cycle_GW_3BD = 100;
    message GW_28B        Msg_GW_28B;
    msTimer Tm_GW_28B;
    int Cycle_GW_28B = 40;
    
    int GW_387_BCM_CRCCheck_387_counter =0;
    int GW_387_BCM_CRCCheck_387_wrongvalctr =0;
    int GW_387_BCM_RollingCounter_387_counter =0;
    int GW_387_BCM_RollingCounter_387_wrongvalctr =0;
    int GW_288_BcmCrcChk288_counter =0;
    int GW_288_BcmCrcChk288_wrongvalctr =0;
    int GW_288_BcmCycCntr288_counter =0;
    int GW_288_BcmCycCntr288_wrongvalctr =0;
    int GW_1D2_EspCrcChk1D2_counter =0;
    int GW_1D2_EspCrcChk1D2_wrongvalctr =0;
    int GW_1D2_EspCycCntr1D2_counter =0;
    int GW_1D2_EspCycCntr1D2_wrongvalctr =0;
    int GW_2DE_IP_CRCCheck_2DE_counter =0;
    int GW_2DE_IP_CRCCheck_2DE_wrongvalctr =0;
    int GW_2DE_IP_RollingCounter_2DE_counter =0;
    int GW_2DE_IP_RollingCounter_2DE_wrongvalctr =0;
    int GW_50_SrsCrcChk050_counter =0;
    int GW_50_SrsCrcChk050_wrongvalctr =0;
    int GW_50_SrsCycCntr050_counter =0;
    int GW_50_SrsCycCntr050_wrongvalctr =0;
    int GW_20B_EspCrcChk20B_counter =0;
    int GW_20B_EspCrcChk20B_wrongvalctr =0;
    int GW_20B_EspCycCntr20B_counter =0;
    int GW_20B_EspCycCntr20B_wrongvalctr =0;
    int GW_1C2_EspCrcChk1C2_counter =0;
    int GW_1C2_EspCrcChk1C2_wrongvalctr =0;
    int GW_1C2_EspCycCntr1C2_counter =0;
    int GW_1C2_EspCycCntr1C2_wrongvalctr =0;
    int GW_24F_EPS_CRCCheck_24F_counter =0;
    int GW_24F_EPS_CRCCheck_24F_wrongvalctr =0;
    int GW_24F_EPS_RollingCounter_24F_counter =0;
    int GW_24F_EPS_RollingCounter_24F_wrongvalctr =0;
    int GW_356_IMS_CRCCheck_356_counter =0;
    int GW_356_IMS_CRCCheck_356_wrongvalctr =0;
    int GW_356_IMS_CRCCheck_360_counter =0;
    int GW_356_IMS_CRCCheck_360_wrongvalctr =0;
    int GW_356_IMS_RollingCounter_356_counter =0;
    int GW_356_IMS_RollingCounter_356_wrongvalctr =0;
    int GW_356_IMS_RollingCounter_360_counter =0;
    int GW_356_IMS_RollingCounter_360_wrongvalctr =0;
    int GW_3C4_HU_CRCCheck_3B8_counter =0;
    int GW_3C4_HU_CRCCheck_3B8_wrongvalctr =0;
    int GW_3C4_HU_CRCCheck_3C2_counter =0;
    int GW_3C4_HU_CRCCheck_3C2_wrongvalctr =0;
    int GW_3C4_HU_CRCCheck_3C4_counter =0;
    int GW_3C4_HU_CRCCheck_3C4_wrongvalctr =0;
    int GW_3C4_HU_CRCCheck_3C6_counter =0;
    int GW_3C4_HU_CRCCheck_3C6_wrongvalctr =0;
    int GW_3C4_HU_CRCCheck_3C7_counter =0;
    int GW_3C4_HU_CRCCheck_3C7_wrongvalctr =0;
    int GW_3C4_HU_RollingCounter_3B8_counter =0;
    int GW_3C4_HU_RollingCounter_3B8_wrongvalctr =0;
    int GW_3C4_HU_RollingCounter_3C2_counter =0;
    int GW_3C4_HU_RollingCounter_3C2_wrongvalctr =0;
    int GW_3C4_HU_RollingCounter_3C4_counter =0;
    int GW_3C4_HU_RollingCounter_3C4_wrongvalctr =0;
    int GW_3C4_HU_RollingCounter_3C6_counter =0;
    int GW_3C4_HU_RollingCounter_3C6_wrongvalctr =0;
    int GW_3C4_HU_RollingCounter_3C7_counter =0;
    int GW_3C4_HU_RollingCounter_3C7_wrongvalctr =0;
    int GW_3C2_EspCrcChk3C2_counter =0;
    int GW_3C2_EspCrcChk3C2_wrongvalctr =0;
    int GW_3C2_EspCycCntr3C2_counter =0;
    int GW_3C2_EspCycCntr3C2_wrongvalctr =0;
    int GW_3AF_HU_CRCCheck_3AF_counter =0;
    int GW_3AF_HU_CRCCheck_3AF_wrongvalctr =0;
    int GW_3AF_HU_CRCCheck_3BB_counter =0;
    int GW_3AF_HU_CRCCheck_3BB_wrongvalctr =0;
    int GW_3AF_HU_RollingCounter_3AF_counter =0;
    int GW_3AF_HU_RollingCounter_3AF_wrongvalctr =0;
    int GW_3AF_HU_RollingCounter_3BB_counter =0;
    int GW_3AF_HU_RollingCounter_3BB_wrongvalctr =0;
    int GW_170_EPS_CRCCheck_170_counter =0;
    int GW_170_EPS_CRCCheck_170_wrongvalctr =0;
    int GW_170_EPS_RollingCounter_170_counter =0;
    int GW_170_EPS_RollingCounter_170_wrongvalctr =0;
    int GW_2C8_RRC_CRCCheck_2C8_counter =0;
    int GW_2C8_RRC_CRCCheck_2C8_wrongvalctr =0;
    int GW_2C8_RRC_RollingCounter_2C8_counter =0;
    int GW_2C8_RRC_RollingCounter_2C8_wrongvalctr =0;
    int GW_17E_EPS_CRCCheck_17E_counter =0;
    int GW_17E_EPS_CRCCheck_17E_wrongvalctr =0;
    int GW_17E_EPS_RollingCounter_17E_counter =0;
    int GW_17E_EPS_RollingCounter_17E_wrongvalctr =0;
    int GW_2C2_IbCrcChk2C2_counter =0;
    int GW_2C2_IbCrcChk2C2_wrongvalctr =0;
    int GW_2C2_IbCycCntr2C2_counter =0;
    int GW_2C2_IbCycCntr2C2_wrongvalctr =0;
    int GW_2A4_LCDAR_CRCCheck_2AF_counter =0;
    int GW_2A4_LCDAR_CRCCheck_2AF_wrongvalctr =0;
    int GW_2A4_LCDAR_RollingCounter_2AF_counter =0;
    int GW_2A4_LCDAR_RollingCounter_2AF_wrongvalctr =0;
    int GW_2A4_RRC_CRCCheck_2A4_counter =0;
    int GW_2A4_RRC_CRCCheck_2A4_wrongvalctr =0;
    int GW_2A4_RRC_RollingCounter_2A4_counter =0;
    int GW_2A4_RRC_RollingCounter_2A4_wrongvalctr =0;
    int GW_2D2_CdcCycChk2D2_counter =0;
    int GW_2D2_CdcCycChk2D2_wrongvalctr =0;
    int GW_2D2_CdcCycCntr2D2_counter =0;
    int GW_2D2_CdcCycCntr2D2_wrongvalctr =0;
    int GW_3D2_EspCrcChk3D2_counter =0;
    int GW_3D2_EspCrcChk3D2_wrongvalctr =0;
    int GW_3D2_EspCycCntr3D2_counter =0;
    int GW_3D2_EspCycCntr3D2_wrongvalctr =0;
    int GW_180_EpsCrcChk180_counter =0;
    int GW_180_EpsCrcChk180_wrongvalctr =0;
    int GW_180_EpsCycCntr180_counter =0;
    int GW_180_EpsCycCntr180_wrongvalctr =0;
    int GW_2BD_RRC_CRCCheck_2BD_counter =0;
    int GW_2BD_RRC_CRCCheck_2BD_wrongvalctr =0;
    int GW_2BD_RRC_RollingCounter_2BD_counter =0;
    int GW_2BD_RRC_RollingCounter_2BD_wrongvalctr =0;
    int GW_2BF_RRC_CRCCheck_2BF_counter =0;
    int GW_2BF_RRC_CRCCheck_2BF_wrongvalctr =0;
    int GW_2BF_RRC_RollingCounter_2BF_counter =0;
    int GW_2BF_RRC_RollingCounter_2BF_wrongvalctr =0;
    int GW_28B_BCM_CRCCheck_28B_counter =0;
    int GW_28B_BCM_CRCCheck_28B_wrongvalctr =0;
    int GW_28B_BCM_RollingCounter_28B_counter =0;
    int GW_28B_BCM_RollingCounter_28B_wrongvalctr =0;
    
    //CRC Polynomial for MQB     
    byte cb_ChkSum_POLY_MQB =0x2F;
	// CANFD DLC
	byte Dbc_dlc;
	int i=0;
	char CAN_DLC[7]={9,10,11,12,13,14,15};
	char CANFD_DLC[7]={12,16,20,24,32,48,64};
    

    
        byte CRC_J1850_Table[256] = {
 /*0 - 7*/  0x00, 0x1D, 0x3A, 0x27, 0x74, 0x69, 0x4E, 0x53,
 /*8 - 15*/ 0xE8, 0xF5, 0xD2, 0xCF, 0x9C, 0x81, 0xA6, 0xBB,
 /*16 - 23*/ 0xCD, 0xD0, 0xF7, 0xEA, 0xB9, 0xA4, 0x83, 0x9E,
 /*24 - 31*/ 0x25, 0x38, 0x1F, 0x02, 0x51, 0x4C, 0x6B, 0x76,
 /*32 - 39*/ 0x87, 0x9A, 0xBD, 0xA0, 0xF3, 0xEE, 0xC9, 0xD4,
 /*40 - 47*/ 0x6F, 0x72, 0x55, 0x48, 0x1B, 0x06, 0x21, 0x3C,
 /*48 - 55*/ 0x4A, 0x57, 0x70, 0x6D, 0x3E, 0x23, 0x04, 0x19,
 /*56 - 63*/ 0xA2, 0xBF, 0x98, 0x85, 0xD6, 0xCB, 0xEC, 0xF1,
 /*64 - 71*/  0x13, 0x0E, 0x29, 0x34, 0x67, 0x7A, 0x5D, 0x40,
 /*72 - 79*/ 0xFB, 0xE6, 0xC1, 0xDC, 0x8F, 0x92, 0xB5, 0xA8,
 /*80 - 87*/ 0xDE, 0xC3, 0xE4, 0xF9, 0xAA, 0xB7, 0x90, 0x8D,
 /*88 - 95*/ 0x36, 0x2B, 0x0C, 0x11, 0x42, 0x5F, 0x78, 0x65,
 /*96 - 103*/ 0x94, 0x89, 0xAE, 0xB3, 0xE0, 0xFD, 0xDA, 0xC7,
 /*104 - 111*/ 0x7C, 0x61, 0x46, 0x5B, 0x08, 0x15, 0x32, 0x2F,
 /*112 - 119*/ 0x59, 0x44, 0x63, 0x7E, 0x2D, 0x30, 0x17, 0x0A,
 /*120 - 127*/ 0xB1, 0xAC, 0x8B, 0x96, 0xC5, 0xD8, 0xFF, 0xE2,
 /*128 - 135*/ 0x26, 0x3B, 0x1C, 0x01, 0x52, 0x4F, 0x68, 0x75,
 /*136 - 143*/ 0xCE, 0xD3, 0xF4, 0xE9, 0xBA, 0xA7, 0x80, 0x9D,
 /*144 - 151*/ 0xEB, 0xF6, 0xD1, 0xCC, 0x9F, 0x82, 0xA5, 0xB8,
 /*152 - 159*/ 0x03, 0x1E, 0x39, 0x24, 0x77, 0x6A, 0x4D, 0x50,
 /*160 - 167*/ 0xA1, 0xBC, 0x9B, 0x86, 0xD5, 0xC8, 0xEF, 0xF2,
 /*168 - 175*/ 0x49, 0x54, 0x73, 0x6E, 0x3D, 0x20, 0x07, 0x1A,
 /*176 - 183*/ 0x6C, 0x71, 0x56, 0x4B, 0x18, 0x05, 0x22, 0x3F,
 /*184 - 191*/ 0x84, 0x99, 0xBE, 0xA3, 0xF0, 0xED, 0xCA, 0xD7,
 /*192 - 199*/ 0x35, 0x28, 0x0F, 0x12, 0x41, 0x5C, 0x7B, 0x66,
 /*200 - 207*/ 0xDD, 0xC0, 0xE7, 0xFA, 0xA9, 0xB4, 0x93, 0x8E,
 /*208 - 215*/ 0xF8, 0xE5, 0xC2, 0xDF, 0x8C, 0x91, 0xB6, 0xAB,
 /*216 - 223*/ 0x10, 0x0D, 0x2A, 0x37, 0x64, 0x79, 0x5E, 0x43,
 /*224 - 231*/ 0xB2, 0xAF, 0x88, 0x95, 0xC6, 0xDB, 0xFC, 0xE1,
 /*232 - 239*/ 0x5A, 0x47, 0x60, 0x7D, 0x2E, 0x33, 0x14, 0x09,
 /*240 - 247*/ 0x7F, 0x62, 0x45, 0x58, 0x0B, 0x16, 0x31, 0x2C,
 /*248 - 255*/ 0x97, 0x8A, 0xAD, 0xB0, 0xE3, 0xFE, 0xD9, 0xC4
};

int64 CRC16_CCITT_FALSE_H1021_Table[256] =
{
    /*0 - 7*/     0x0000, 0x1021, 0x2042, 0x3063, 0x4084, 0x50A5, 0x60C6, 0x70E7,
    /*8 - 15*/    0x8108, 0x9129, 0xA14A, 0xB16B, 0xC18C, 0xD1AD, 0xE1CE, 0xF1EF,
    /*16 - 23*/   0x1231, 0x0210, 0x3273, 0x2252, 0x52B5, 0x4294, 0x72F7, 0x62D6,
    /*24 - 31*/   0x9339, 0x8318, 0xB37B, 0xA35A, 0xD3BD, 0xC39C, 0xF3FF, 0xE3DE,
    /*32 - 39*/   0x2462, 0x3443, 0x0420, 0x1401, 0x64E6, 0x74C7, 0x44A4, 0x5485,
    /*40 - 47*/   0xA56A, 0xB54B, 0x8528, 0x9509, 0xE5EE, 0xF5CF, 0xC5AC, 0xD58D,
    /*48 - 55*/   0x3653, 0x2672, 0x1611, 0x0630, 0x76D7, 0x66F6, 0x5695, 0x46B4,
    /*56 - 63*/   0xB75B, 0xA77A, 0x9719, 0x8738, 0xF7DF, 0xE7FE, 0xD79D, 0xC7BC,
    /*64 - 71*/   0x48C4, 0x58E5, 0x6886, 0x78A7, 0x0840, 0x1861, 0x2802, 0x3823,
    /*72 - 79*/   0xC9CC, 0xD9ED, 0xE98E, 0xF9AF, 0x8948, 0x9969, 0xA90A, 0xB92B,
    /*80 - 87*/   0x5AF5, 0x4AD4, 0x7AB7, 0x6A96, 0x1A71, 0x0A50, 0x3A33, 0x2A12,
    /*88 - 95*/   0xDBFD, 0xCBDC, 0xFBBF, 0xEB9E, 0x9B79, 0x8B58, 0xBB3B, 0xAB1A,
    /*96 - 103*/  0x6CA6, 0x7C87, 0x4CE4, 0x5CC5, 0x2C22, 0x3C03, 0x0C60, 0x1C41,
    /*104 - 111*/ 0xEDAE, 0xFD8F, 0xCDEC, 0xDDCD, 0xAD2A, 0xBD0B, 0x8D68, 0x9D49,
    /*112 - 119*/ 0x7E97, 0x6EB6, 0x5ED5, 0x4EF4, 0x3E13, 0x2E32, 0x1E51, 0x0E70,
    /*120 - 127*/ 0xFF9F, 0xEFBE, 0xDFDD, 0xCFFC, 0xBF1B, 0xAF3A, 0x9F59, 0x8F78,
    /*128 - 135*/ 0x9188, 0x81A9, 0xB1CA, 0xA1EB, 0xD10C, 0xC12D, 0xF14E, 0xE16F,
    /*136 - 143*/ 0x1080, 0x00A1, 0x30C2, 0x20E3, 0x5004, 0x4025, 0x7046, 0x6067,
    /*144 - 151*/ 0x83B9, 0x9398, 0xA3FB, 0xB3DA, 0xC33D, 0xD31C, 0xE37F, 0xF35E,
    /*152 - 159*/ 0x02B1, 0x1290, 0x22F3, 0x32D2, 0x4235, 0x5214, 0x6277, 0x7256,
    /*160 - 167*/ 0xB5EA, 0xA5CB, 0x95A8, 0x8589, 0xF56E, 0xE54F, 0xD52C, 0xC50D,
    /*168 - 175*/ 0x34E2, 0x24C3, 0x14A0, 0x0481, 0x7466, 0x6447, 0x5424, 0x4405,
    /*176 - 183*/ 0xA7DB, 0xB7FA, 0x8799, 0x97B8, 0xE75F, 0xF77E, 0xC71D, 0xD73C,
    /*184 - 191*/ 0x26D3, 0x36F2, 0x0691, 0x16B0, 0x6657, 0x7676, 0x4615, 0x5634,
    /*192 - 199*/ 0xD94C, 0xC96D, 0xF90E, 0xE92F, 0x99C8, 0x89E9, 0xB98A, 0xA9AB,
    /*200 - 207*/ 0x5844, 0x4865, 0x7806, 0x6827, 0x18C0, 0x08E1, 0x3882, 0x28A3,
    /*208 - 215*/ 0xCB7D, 0xDB5C, 0xEB3F, 0xFB1E, 0x8BF9, 0x9BD8, 0xABBB, 0xBB9A,
    /*216 - 223*/ 0x4A75, 0x5A54, 0x6A37, 0x7A16, 0x0AF1, 0x1AD0, 0x2AB3, 0x3A92,
    /*224 - 231*/ 0xFD2E, 0xED0F, 0xDD6C, 0xCD4D, 0xBDAA, 0xAD8B, 0x9DE8, 0x8DC9,
    /*232 - 239*/ 0x7C26, 0x6C07, 0x5C64, 0x4C45, 0x3CA2, 0x2C83, 0x1CE0, 0x0CC1,
    /*240 - 247*/ 0xEF1F, 0xFF3E, 0xCF5D, 0xDF7C, 0xAF9B, 0xBFBA, 0x8FD9, 0x9FF8,
    /*248 - 255*/ 0x6E17, 0x7E36, 0x4E55, 0x5E74, 0x2E93, 0x3EB2, 0x0ED1, 0x1EF0
};
         
}
/*@@end*/


/*@@startStart:Start:*/
on start
{
    //Initialise cycle time and message timer 
    putValue(E_pubc_GW_GW_387_cycleTm,Cycle_GW_387);
    SetTimer( Tm_GW_387,100);
    putValue(E_pubc_GW_GW_387_Tm,1);
    putValue(E_pubc_GW_GW_288_cycleTm,Cycle_GW_288);
    SetTimer( Tm_GW_288,101);
    putValue(E_pubc_GW_GW_288_Tm,1);
    putValue(E_pubc_GW_GW_1D2_cycleTm,Cycle_GW_1D2);
    SetTimer( Tm_GW_1D2,102);
    putValue(E_pubc_GW_GW_1D2_Tm,1);
    putValue(E_pubc_GW_GW_284_cycleTm,Cycle_GW_284);
    SetTimer( Tm_GW_284,103);
    putValue(E_pubc_GW_GW_284_Tm,1);
    putValue(E_pubc_GW_GW_2DE_cycleTm,Cycle_GW_2DE);
    SetTimer( Tm_GW_2DE,104);
    putValue(E_pubc_GW_GW_2DE_Tm,1);
    putValue(E_pubc_GW_GW_50_cycleTm,Cycle_GW_50);
    SetTimer( Tm_GW_50,105);
    putValue(E_pubc_GW_GW_50_Tm,1);
    putValue(E_pubc_GW_GW_20B_cycleTm,Cycle_GW_20B);
    SetTimer( Tm_GW_20B,106);
    putValue(E_pubc_GW_GW_20B_Tm,1);
    putValue(E_pubc_GW_GW_1C2_cycleTm,Cycle_GW_1C2);
    SetTimer( Tm_GW_1C2,107);
    putValue(E_pubc_GW_GW_1C2_Tm,1);
    putValue(E_pubc_GW_GW_24F_cycleTm,Cycle_GW_24F);
    SetTimer( Tm_GW_24F,108);
    putValue(E_pubc_GW_GW_24F_Tm,1);
    putValue(E_pubc_GW_GW_356_cycleTm,Cycle_GW_356);
    SetTimer( Tm_GW_356,109);
    putValue(E_pubc_GW_GW_356_Tm,1);
    putValue(E_pubc_GW_GW_3C4_cycleTm,Cycle_GW_3C4);
    SetTimer( Tm_GW_3C4,110);
    putValue(E_pubc_GW_GW_3C4_Tm,1);
    putValue(E_pubc_GW_GW_3C2_cycleTm,Cycle_GW_3C2);
    SetTimer( Tm_GW_3C2,111);
    putValue(E_pubc_GW_GW_3C2_Tm,1);
    putValue(E_pubc_GW_GW_3AF_cycleTm,Cycle_GW_3AF);
    SetTimer( Tm_GW_3AF,112);
    putValue(E_pubc_GW_GW_3AF_Tm,1);
    putValue(E_pubc_GW_GW_2AD_cycleTm,Cycle_GW_2AD);
    SetTimer( Tm_GW_2AD,113);
    putValue(E_pubc_GW_GW_2AD_Tm,1);
    putValue(E_pubc_GW_GW_170_cycleTm,Cycle_GW_170);
    SetTimer( Tm_GW_170,114);
    putValue(E_pubc_GW_GW_170_Tm,1);
    putValue(E_pubc_GW_GW_2A8_cycleTm,Cycle_GW_2A8);
    SetTimer( Tm_GW_2A8,115);
    putValue(E_pubc_GW_GW_2A8_Tm,1);
    putValue(E_pubc_GW_GW_3EE_cycleTm,Cycle_GW_3EE);
    SetTimer( Tm_GW_3EE,116);
    putValue(E_pubc_GW_GW_3EE_Tm,1);
    putValue(E_pubc_GW_GW_2C8_cycleTm,Cycle_GW_2C8);
    SetTimer( Tm_GW_2C8,117);
    putValue(E_pubc_GW_GW_2C8_Tm,1);
    putValue(E_pubc_GW_GW_NM_cycleTm,Cycle_GW_NM);
    SetTimer( Tm_GW_NM,118);
    putValue(E_pubc_GW_GW_NM_Tm,1);
    putValue(E_pubc_GW_GW_17E_cycleTm,Cycle_GW_17E);
    SetTimer( Tm_GW_17E,119);
    putValue(E_pubc_GW_GW_17E_Tm,1);
    putValue(E_pubc_GW_GW_2C2_cycleTm,Cycle_GW_2C2);
    SetTimer( Tm_GW_2C2,120);
    putValue(E_pubc_GW_GW_2C2_Tm,1);
    putValue(E_pubc_GW_GW_2A4_cycleTm,Cycle_GW_2A4);
    SetTimer( Tm_GW_2A4,121);
    putValue(E_pubc_GW_GW_2A4_Tm,1);
    putValue(E_pubc_GW_GW_516_cycleTm,Cycle_GW_516);
    SetTimer( Tm_GW_516,122);
    putValue(E_pubc_GW_GW_516_Tm,1);
    putValue(E_pubc_GW_GW_2D2_cycleTm,Cycle_GW_2D2);
    SetTimer( Tm_GW_2D2,123);
    putValue(E_pubc_GW_GW_2D2_Tm,1);
    putValue(E_pubc_GW_GW_3D2_cycleTm,Cycle_GW_3D2);
    SetTimer( Tm_GW_3D2,124);
    putValue(E_pubc_GW_GW_3D2_Tm,1);
    putValue(E_pubc_GW_GW_180_cycleTm,Cycle_GW_180);
    SetTimer( Tm_GW_180,125);
    putValue(E_pubc_GW_GW_180_Tm,1);
    putValue(E_pubc_GW_GW_2BD_cycleTm,Cycle_GW_2BD);
    SetTimer( Tm_GW_2BD,126);
    putValue(E_pubc_GW_GW_2BD_Tm,1);
    putValue(E_pubc_GW_GW_2BF_cycleTm,Cycle_GW_2BF);
    SetTimer( Tm_GW_2BF,127);
    putValue(E_pubc_GW_GW_2BF_Tm,1);
    putValue(E_pubc_GW_GW_3BD_cycleTm,Cycle_GW_3BD);
    SetTimer( Tm_GW_3BD,128);
    putValue(E_pubc_GW_GW_3BD_Tm,1);
    putValue(E_pubc_GW_GW_28B_cycleTm,Cycle_GW_28B);
    SetTimer( Tm_GW_28B,129);
    putValue(E_pubc_GW_GW_28B_Tm,1);
    
    //Initialise signals with init raw value
    Msg_GW_387.BCM_RLS_Light_switch_reason   =getvalue(E_pubc_GW_GW_387_BCM_RLS_Light_switch_reason_Rv);
    Msg_GW_387.BCM_RainfallLevel   =getvalue(E_pubc_GW_GW_387_BCM_RainfallLevel_Rv);
    Msg_GW_288.BcmRiReDoorSts   =getvalue(E_pubc_GW_GW_288_BcmRiReDoorSts_Rv);
    Msg_GW_288.BcmHoodSts   =getvalue(E_pubc_GW_GW_288_BcmHoodSts_Rv);
    Msg_GW_288.BcmLoBeamSts   =getvalue(E_pubc_GW_GW_288_BcmLoBeamSts_Rv);
    Msg_GW_288.BcmDrvrDoorSts   =getvalue(E_pubc_GW_GW_288_BcmDrvrDoorSts_Rv);
    Msg_GW_288.BcmHiBeamSts   =getvalue(E_pubc_GW_GW_288_BcmHiBeamSts_Rv);
    Msg_GW_288.BcmFrntFogLmpSts   =getvalue(E_pubc_GW_GW_288_BcmFrntFogLmpSts_Rv);
    Msg_GW_288.BcmTurnIndcrLe   =getvalue(E_pubc_GW_GW_288_BcmTurnIndcrLe_Rv);
    Msg_GW_288.BcmPassDoorSts   =getvalue(E_pubc_GW_GW_288_BcmPassDoorSts_Rv);
    Msg_GW_288.BcmStsRainSnsr   =getvalue(E_pubc_GW_GW_288_BcmStsRainSnsr_Rv);
    Msg_GW_288.BcmLeReDoorSts   =getvalue(E_pubc_GW_GW_288_BcmLeReDoorSts_Rv);
    Msg_GW_288.BcmReFoglmpSts   =getvalue(E_pubc_GW_GW_288_BcmReFoglmpSts_Rv);
    Msg_GW_288.BcmAutHeadLiSts   =getvalue(E_pubc_GW_GW_288_BcmAutHeadLiSts_Rv);
    Msg_GW_288.BcmLiSnsrFlt   =getvalue(E_pubc_GW_GW_288_BcmLiSnsrFlt_Rv);
    Msg_GW_288.BcmTurnIndcrRi   =getvalue(E_pubc_GW_GW_288_BcmTurnIndcrRi_Rv);
    Msg_GW_288.BcmFrntWiperSts   =getvalue(E_pubc_GW_GW_288_BcmFrntWiperSts_Rv);
    Msg_GW_288.BcmEmgyLiSts   =getvalue(E_pubc_GW_GW_288_BcmEmgyLiSts_Rv);
    Msg_GW_1D2.EspVirtMstCylTarBrkPVld   =getvalue(E_pubc_GW_GW_1D2_EspVirtMstCylTarBrkPVld_Rv);
    Msg_GW_1D2.EspEstimdWhlBrkPMax   =getvalue(E_pubc_GW_GW_1D2_EspEstimdWhlBrkPMax_Rv);
    Msg_GW_1D2.EspVehSpdIB   =getvalue(E_pubc_GW_GW_1D2_EspVehSpdIB_Rv);
    Msg_GW_1D2.EspVirtMstCylTarBrkP   =getvalue(E_pubc_GW_GW_1D2_EspVirtMstCylTarBrkP_Rv);
    Msg_GW_1D2.EspVehSpdVldIB   =getvalue(E_pubc_GW_GW_1D2_EspVehSpdVldIB_Rv);
    Msg_GW_1D2.EspMstCylBrkPVldIB   =getvalue(E_pubc_GW_GW_1D2_EspMstCylBrkPVldIB_Rv);
    Msg_GW_1D2.EspMstCylBrkPIB   =getvalue(E_pubc_GW_GW_1D2_EspMstCylBrkPIB_Rv);
    Msg_GW_284.RRC_OBJ7_RefPointLoc   =getvalue(E_pubc_GW_GW_284_RRC_OBJ7_RefPointLoc_Rv);
    Msg_GW_284.RRC_OBJ2_RefPointDx   =getvalue(E_pubc_GW_GW_284_RRC_OBJ2_RefPointDx_Rv);
    Msg_GW_284.RRC_OBJ2_RefPointDy   =getvalue(E_pubc_GW_GW_284_RRC_OBJ2_RefPointDy_Rv);
    Msg_GW_284.RRC_OBJ8_RefPointDx   =getvalue(E_pubc_GW_GW_284_RRC_OBJ8_RefPointDx_Rv);
    Msg_GW_284.RRC_OBJ8_RefPointDy   =getvalue(E_pubc_GW_GW_284_RRC_OBJ8_RefPointDy_Rv);
    Msg_GW_284.RRC_OBJ6_RefPointDx   =getvalue(E_pubc_GW_GW_284_RRC_OBJ6_RefPointDx_Rv);
    Msg_GW_284.RRC_OBJ6_RefPointDy   =getvalue(E_pubc_GW_GW_284_RRC_OBJ6_RefPointDy_Rv);
    Msg_GW_284.RRC_OBJ1_RefPointLoc   =getvalue(E_pubc_GW_GW_284_RRC_OBJ1_RefPointLoc_Rv);
    Msg_GW_284.RRC_OBJ1_RefPointDx   =getvalue(E_pubc_GW_GW_284_RRC_OBJ1_RefPointDx_Rv);
    Msg_GW_284.RRC_OBJ5_RefPointDy   =getvalue(E_pubc_GW_GW_284_RRC_OBJ5_RefPointDy_Rv);
    Msg_GW_284.RRC_OBJ5_RefPointDx   =getvalue(E_pubc_GW_GW_284_RRC_OBJ5_RefPointDx_Rv);
    Msg_GW_284.RRC_OBJ7_RefPointDy   =getvalue(E_pubc_GW_GW_284_RRC_OBJ7_RefPointDy_Rv);
    Msg_GW_284.RRC_OBJ7_RefPointDx   =getvalue(E_pubc_GW_GW_284_RRC_OBJ7_RefPointDx_Rv);
    Msg_GW_284.RRC_OBJ10_RefPointDx   =getvalue(E_pubc_GW_GW_284_RRC_OBJ10_RefPointDx_Rv);
    Msg_GW_284.RRC_OBJ10_RefPointDy   =getvalue(E_pubc_GW_GW_284_RRC_OBJ10_RefPointDy_Rv);
    Msg_GW_284.RRC_OBJ5_RefPointLoc   =getvalue(E_pubc_GW_GW_284_RRC_OBJ5_RefPointLoc_Rv);
    Msg_GW_284.RRC_OBJ1_RefPointDy   =getvalue(E_pubc_GW_GW_284_RRC_OBJ1_RefPointDy_Rv);
    Msg_GW_284.RRC_OBJ4_RefPointDx   =getvalue(E_pubc_GW_GW_284_RRC_OBJ4_RefPointDx_Rv);
    Msg_GW_284.RRC_OBJ4_RefPointDy   =getvalue(E_pubc_GW_GW_284_RRC_OBJ4_RefPointDy_Rv);
    Msg_GW_284.RRC_OBJ2_RefPointLoc   =getvalue(E_pubc_GW_GW_284_RRC_OBJ2_RefPointLoc_Rv);
    Msg_GW_284.RRC_OBJ10_RefPointLoc   =getvalue(E_pubc_GW_GW_284_RRC_OBJ10_RefPointLoc_Rv);
    Msg_GW_284.RRC_OBJ3_RefPointDy   =getvalue(E_pubc_GW_GW_284_RRC_OBJ3_RefPointDy_Rv);
    Msg_GW_284.RRC_OBJ3_RefPointDx   =getvalue(E_pubc_GW_GW_284_RRC_OBJ3_RefPointDx_Rv);
    Msg_GW_284.RRC_OBJ6_RefPointLoc   =getvalue(E_pubc_GW_GW_284_RRC_OBJ6_RefPointLoc_Rv);
    Msg_GW_284.RRC_OBJ9_RefPointDy   =getvalue(E_pubc_GW_GW_284_RRC_OBJ9_RefPointDy_Rv);
    Msg_GW_284.RRC_OBJ9_RefPointDx   =getvalue(E_pubc_GW_GW_284_RRC_OBJ9_RefPointDx_Rv);
    Msg_GW_284.RRC_OBJ3_RefPointLoc   =getvalue(E_pubc_GW_GW_284_RRC_OBJ3_RefPointLoc_Rv);
    Msg_GW_284.RRC_OBJ9_RefPointLoc   =getvalue(E_pubc_GW_GW_284_RRC_OBJ9_RefPointLoc_Rv);
    Msg_GW_284.RRC_OBJ8_RefPointLoc   =getvalue(E_pubc_GW_GW_284_RRC_OBJ8_RefPointLoc_Rv);
    Msg_GW_284.RRC_OBJ4_RefPointLoc   =getvalue(E_pubc_GW_GW_284_RRC_OBJ4_RefPointLoc_Rv);
    Msg_GW_2DE.IP_DISFail   =getvalue(E_pubc_GW_GW_2DE_IP_DISFail_Rv);
    Msg_GW_2DE.IP_QDashACCFail   =getvalue(E_pubc_GW_GW_2DE_IP_QDashACCFail_Rv);
    Msg_GW_50.SrsCrashOutpStsChks   =getvalue(E_pubc_GW_GW_50_SrsCrashOutpStsChks_Rv);
    Msg_GW_50.SrsPassBucSwtSts   =getvalue(E_pubc_GW_GW_50_SrsPassBucSwtSts_Rv);
    Msg_GW_50.SrsCrashOutpSts   =getvalue(E_pubc_GW_GW_50_SrsCrashOutpSts_Rv);
    Msg_GW_50.SrsDrvrBucSwtSts   =getvalue(E_pubc_GW_GW_50_SrsDrvrBucSwtSts_Rv);
    Msg_GW_50.SrsWarnLampSts   =getvalue(E_pubc_GW_GW_50_SrsWarnLampSts_Rv);
    Msg_GW_20B.ESP_AWBavailable   =getvalue(E_pubc_GW_GW_20B_ESP_AWBavailable_Rv);
    Msg_GW_20B.ESP_AWBactive   =getvalue(E_pubc_GW_GW_20B_ESP_AWBactive_Rv);
    Msg_GW_20B.ESP_PrefillActive   =getvalue(E_pubc_GW_GW_20B_ESP_PrefillActive_Rv);
    Msg_GW_20B.ESP_QDCACC   =getvalue(E_pubc_GW_GW_20B_ESP_QDCACC_Rv);
    Msg_GW_20B.ESP_PrefillAvailable   =getvalue(E_pubc_GW_GW_20B_ESP_PrefillAvailable_Rv);
    Msg_GW_20B.ESP_BrakeOverHeatBrakeDiscTemp   =getvalue(E_pubc_GW_GW_20B_ESP_BrakeOverHeatBrakeDiscTemp_Rv);
    Msg_GW_20B.ESP_CDD_Active   =getvalue(E_pubc_GW_GW_20B_ESP_CDD_Active_Rv);
    Msg_GW_20B.ESP_ABAavailable   =getvalue(E_pubc_GW_GW_20B_ESP_ABAavailable_Rv);
    Msg_GW_20B.ESP_AEBdecActive   =getvalue(E_pubc_GW_GW_20B_ESP_AEBdecActive_Rv);
    Msg_GW_20B.ESP_BrakeForce   =getvalue(E_pubc_GW_GW_20B_ESP_BrakeForce_Rv);
    Msg_GW_20B.ESP_ABAactive   =getvalue(E_pubc_GW_GW_20B_ESP_ABAactive_Rv);
    Msg_GW_20B.ESP_AEBAvailable   =getvalue(E_pubc_GW_GW_20B_ESP_AEBAvailable_Rv);
    Msg_GW_20B.ESP_CDD_Available   =getvalue(E_pubc_GW_GW_20B_ESP_CDD_Available_Rv);
    Msg_GW_1C2.EspVehStandstill   =getvalue(E_pubc_GW_GW_1C2_EspVehStandstill_Rv);
    Msg_GW_1C2.WhlSpdRiReDir   =getvalue(E_pubc_GW_GW_1C2_WhlSpdRiReDir_Rv);
    Msg_GW_1C2.WhlSpdRiReDataVld   =getvalue(E_pubc_GW_GW_1C2_WhlSpdRiReDataVld_Rv);
    Msg_GW_1C2.WhlSpdLeReDataVld   =getvalue(E_pubc_GW_GW_1C2_WhlSpdLeReDataVld_Rv);
    Msg_GW_1C2.WhlSpdRiFrntDir   =getvalue(E_pubc_GW_GW_1C2_WhlSpdRiFrntDir_Rv);
    Msg_GW_1C2.WhlSpdRiFrntData   =getvalue(E_pubc_GW_GW_1C2_WhlSpdRiFrntData_Rv);
    Msg_GW_1C2.WhlSpdFrntRiPls   =getvalue(E_pubc_GW_GW_1C2_WhlSpdFrntRiPls_Rv);
    Msg_GW_1C2.EspMstCylBrkPVld   =getvalue(E_pubc_GW_GW_1C2_EspMstCylBrkPVld_Rv);
    Msg_GW_1C2.EspLgtAccel   =getvalue(E_pubc_GW_GW_1C2_EspLgtAccel_Rv);
    Msg_GW_1C2.EspTcsActvSts   =getvalue(E_pubc_GW_GW_1C2_EspTcsActvSts_Rv);
    Msg_GW_1C2.EspLatAccel   =getvalue(E_pubc_GW_GW_1C2_EspLatAccel_Rv);
    Msg_GW_1C2.WhlSpdFrntLePls   =getvalue(E_pubc_GW_GW_1C2_WhlSpdFrntLePls_Rv);
    Msg_GW_1C2.WhlSpdRiReData   =getvalue(E_pubc_GW_GW_1C2_WhlSpdRiReData_Rv);
    Msg_GW_1C2.MbRgnTarWhlQlfr   =getvalue(E_pubc_GW_GW_1C2_MbRgnTarWhlQlfr_Rv);
    Msg_GW_1C2.EspLatAccelVld   =getvalue(E_pubc_GW_GW_1C2_EspLatAccelVld_Rv);
    Msg_GW_1C2.WhlSpdLeFrntData   =getvalue(E_pubc_GW_GW_1C2_WhlSpdLeFrntData_Rv);
    Msg_GW_1C2.EspAbsActv   =getvalue(E_pubc_GW_GW_1C2_EspAbsActv_Rv);
    Msg_GW_1C2.EspVdcActvSts   =getvalue(E_pubc_GW_GW_1C2_EspVdcActvSts_Rv);
    Msg_GW_1C2.WhlSpdLeFrntDataVld   =getvalue(E_pubc_GW_GW_1C2_WhlSpdLeFrntDataVld_Rv);
    Msg_GW_1C2.EspAutoHoldActvSts   =getvalue(E_pubc_GW_GW_1C2_EspAutoHoldActvSts_Rv);
    Msg_GW_1C2.MbRgnTarWhl   =getvalue(E_pubc_GW_GW_1C2_MbRgnTarWhl_Rv);
    Msg_GW_1C2.EspYawAgSpdVld   =getvalue(E_pubc_GW_GW_1C2_EspYawAgSpdVld_Rv);
    Msg_GW_1C2.EspReWhlDecTarTqActv   =getvalue(E_pubc_GW_GW_1C2_EspReWhlDecTarTqActv_Rv);
    Msg_GW_1C2.WhlSpdReRiPls   =getvalue(E_pubc_GW_GW_1C2_WhlSpdReRiPls_Rv);
    Msg_GW_1C2.EspReWhlDecTarTq   =getvalue(E_pubc_GW_GW_1C2_EspReWhlDecTarTq_Rv);
    Msg_GW_1C2.WhlSpdRiFrntDataVld   =getvalue(E_pubc_GW_GW_1C2_WhlSpdRiFrntDataVld_Rv);
    Msg_GW_1C2.EspReWhlIncTarTqActv   =getvalue(E_pubc_GW_GW_1C2_EspReWhlIncTarTqActv_Rv);
    Msg_GW_1C2.EspLgtAccelVld   =getvalue(E_pubc_GW_GW_1C2_EspLgtAccelVld_Rv);
    Msg_GW_1C2.WhlSpdReLePls   =getvalue(E_pubc_GW_GW_1C2_WhlSpdReLePls_Rv);
    Msg_GW_1C2.EspTcsFailr   =getvalue(E_pubc_GW_GW_1C2_EspTcsFailr_Rv);
    Msg_GW_1C2.EspAbsFailr   =getvalue(E_pubc_GW_GW_1C2_EspAbsFailr_Rv);
    Msg_GW_1C2.EspMstCylBrkP   =getvalue(E_pubc_GW_GW_1C2_EspMstCylBrkP_Rv);
    Msg_GW_1C2.EspFctOpenSts   =getvalue(E_pubc_GW_GW_1C2_EspFctOpenSts_Rv);
    Msg_GW_1C2.EspReWhlIncTarTq   =getvalue(E_pubc_GW_GW_1C2_EspReWhlIncTarTq_Rv);
    Msg_GW_1C2.EspYawAgSpd   =getvalue(E_pubc_GW_GW_1C2_EspYawAgSpd_Rv);
    Msg_GW_1C2.EspActvSts   =getvalue(E_pubc_GW_GW_1C2_EspActvSts_Rv);
    Msg_GW_1C2.EspVehSpd   =getvalue(E_pubc_GW_GW_1C2_EspVehSpd_Rv);
    Msg_GW_1C2.EspVehSpdVld   =getvalue(E_pubc_GW_GW_1C2_EspVehSpdVld_Rv);
    Msg_GW_1C2.WhlSpdLeReDir   =getvalue(E_pubc_GW_GW_1C2_WhlSpdLeReDir_Rv);
    Msg_GW_1C2.WhlSpdLeFrntDir   =getvalue(E_pubc_GW_GW_1C2_WhlSpdLeFrntDir_Rv);
    Msg_GW_1C2.WhlSpdLeReData   =getvalue(E_pubc_GW_GW_1C2_WhlSpdLeReData_Rv);
    Msg_GW_24F.EPS_TorqSensorStatus   =getvalue(E_pubc_GW_GW_24F_EPS_TorqSensorStatus_Rv);
    Msg_GW_24F.EpsSteerModFb   =getvalue(E_pubc_GW_GW_24F_EpsSteerModFb_Rv);
    Msg_GW_24F.EPS_SteeringTorque   =getvalue(E_pubc_GW_GW_24F_EPS_SteeringTorque_Rv);
    Msg_GW_24F.EPS_IACC_abortreason   =getvalue(E_pubc_GW_GW_24F_EPS_IACC_abortreason_Rv);
    Msg_GW_24F.EpsFaild   =getvalue(E_pubc_GW_GW_24F_EpsFaild_Rv);
    Msg_GW_24F.EPS_ConcussAvailabilityStatus   =getvalue(E_pubc_GW_GW_24F_EPS_ConcussAvailabilityStatus_Rv);
    Msg_GW_356.IMS_EyeGazeStatus   =getvalue(E_pubc_GW_GW_356_IMS_EyeGazeStatus_Rv);
    Msg_GW_356.IMS_BrowOffsetValue   =getvalue(E_pubc_GW_GW_356_IMS_BrowOffsetValue_Rv);
    Msg_GW_356.IMS_DistractionStatus   =getvalue(E_pubc_GW_GW_356_IMS_DistractionStatus_Rv);
    Msg_GW_356.IMS_HeadDetectSts_Pitch   =getvalue(E_pubc_GW_GW_356_IMS_HeadDetectSts_Pitch_Rv);
    Msg_GW_356.IMS_IMSStatus   =getvalue(E_pubc_GW_GW_356_IMS_IMSStatus_Rv);
    Msg_GW_356.IMS_DriverEyesFovArea   =getvalue(E_pubc_GW_GW_356_IMS_DriverEyesFovArea_Rv);
    Msg_GW_356.IMS_EyeDetectSatus   =getvalue(E_pubc_GW_GW_356_IMS_EyeDetectSatus_Rv);
    Msg_GW_356.IMS_JawOffsetValue   =getvalue(E_pubc_GW_GW_356_IMS_JawOffsetValue_Rv);
    Msg_GW_356.IMS_HeadDetectSts_Roll   =getvalue(E_pubc_GW_GW_356_IMS_HeadDetectSts_Roll_Rv);
    Msg_GW_356.IMS_DriverEyeConfidence   =getvalue(E_pubc_GW_GW_356_IMS_DriverEyeConfidence_Rv);
    Msg_GW_356.IMS_PhoneCallSts   =getvalue(E_pubc_GW_GW_356_IMS_PhoneCallSts_Rv);
    Msg_GW_356.IMS_DriverEyeDetect   =getvalue(E_pubc_GW_GW_356_IMS_DriverEyeDetect_Rv);
    Msg_GW_356.IMS_DrowsinessStatus   =getvalue(E_pubc_GW_GW_356_IMS_DrowsinessStatus_Rv);
    Msg_GW_356.IMS_DriverEyeClosestatus   =getvalue(E_pubc_GW_GW_356_IMS_DriverEyeClosestatus_Rv);
    Msg_GW_356.IMS_HeadDetectSts_Yaw   =getvalue(E_pubc_GW_GW_356_IMS_HeadDetectSts_Yaw_Rv);
    Msg_GW_356.IMS_DriverHeadDetect   =getvalue(E_pubc_GW_GW_356_IMS_DriverHeadDetect_Rv);
    Msg_GW_507.HU_VC_CruiseSetDistance   =getvalue(E_pubc_GW_GW_507_HU_VC_CruiseSetDistance_Rv);
    Msg_GW_507.HU_VC_CruiseControl   =getvalue(E_pubc_GW_GW_507_HU_VC_CruiseControl_Rv);
    Msg_GW_507.HU_VC_CruiseSetSpeed   =getvalue(E_pubc_GW_GW_507_HU_VC_CruiseSetSpeed_Rv);
    Msg_GW_507.HU_OverspeedWarningOffset   =getvalue(E_pubc_GW_GW_507_HU_OverspeedWarningOffset_Rv);
    Msg_GW_507.HU_LASWarningModeSelection   =getvalue(E_pubc_GW_GW_507_HU_LASWarningModeSelection_Rv);
    Msg_GW_507.HU_AutoBrakeEnable   =getvalue(E_pubc_GW_GW_507_HU_AutoBrakeEnable_Rv);
    Msg_GW_507.HU_LASModeSelection   =getvalue(E_pubc_GW_GW_507_HU_LASModeSelection_Rv);
    Msg_GW_507.HU_TSRSwitch   =getvalue(E_pubc_GW_GW_507_HU_TSRSwitch_Rv);
    Msg_GW_507.HU_OverspeedWarningEnable   =getvalue(E_pubc_GW_GW_507_HU_OverspeedWarningEnable_Rv);
    Msg_GW_507.HU_OverspeedSoundWarEnable   =getvalue(E_pubc_GW_GW_507_HU_OverspeedSoundWarEnable_Rv);
    Msg_GW_507.HU_HMAEnable   =getvalue(E_pubc_GW_GW_507_HU_HMAEnable_Rv);
    Msg_GW_507.HU_LDWShakeLev   =getvalue(E_pubc_GW_GW_507_HU_LDWShakeLev_Rv);
    Msg_GW_507.HU_IACCEnable   =getvalue(E_pubc_GW_GW_507_HU_IACCEnable_Rv);
    Msg_GW_507.HU_FCWSetting   =getvalue(E_pubc_GW_GW_507_HU_FCWSetting_Rv);
    Msg_GW_507.HU_CruiseControlSet   =getvalue(E_pubc_GW_GW_507_HU_CruiseControlSet_Rv);
    Msg_GW_3C4.HU_RoadCurvature_30m   =getvalue(E_pubc_GW_GW_3C4_HU_RoadCurvature_30m_Rv);
    Msg_GW_3C4.HU_TrafficAccident_Info   =getvalue(E_pubc_GW_GW_3C4_HU_TrafficAccident_Info_Rv);
    Msg_GW_3C4.HU_RoadCurvature_20m   =getvalue(E_pubc_GW_GW_3C4_HU_RoadCurvature_20m_Rv);
    Msg_GW_3C4.HU_EnterTunnelInfo   =getvalue(E_pubc_GW_GW_3C4_HU_EnterTunnelInfo_Rv);
    Msg_GW_3C4.HU_MapDataUpdateStatus   =getvalue(E_pubc_GW_GW_3C4_HU_MapDataUpdateStatus_Rv);
    Msg_GW_3C4.HU_TunnelDistance   =getvalue(E_pubc_GW_GW_3C4_HU_TunnelDistance_Rv);
    Msg_GW_3C4.HU_FallingRockDi   =getvalue(E_pubc_GW_GW_3C4_HU_FallingRockDi_Rv);
    Msg_GW_3C4.HU_Byroad   =getvalue(E_pubc_GW_GW_3C4_HU_Byroad_Rv);
    Msg_GW_3C4.HU_BranchInfo   =getvalue(E_pubc_GW_GW_3C4_HU_BranchInfo_Rv);
    Msg_GW_3C4.HU_RoadCurvature   =getvalue(E_pubc_GW_GW_3C4_HU_RoadCurvature_Rv);
    Msg_GW_3C4.HU_RoadCurvature_80m   =getvalue(E_pubc_GW_GW_3C4_HU_RoadCurvature_80m_Rv);
    Msg_GW_3C4.HU_RoadCurvature_90m   =getvalue(E_pubc_GW_GW_3C4_HU_RoadCurvature_90m_Rv);
    Msg_GW_3C4.HU_RoadCurvature_600m   =getvalue(E_pubc_GW_GW_3C4_HU_RoadCurvature_600m_Rv);
    Msg_GW_3C4.HU_SlopeDistance   =getvalue(E_pubc_GW_GW_3C4_HU_SlopeDistance_Rv);
    Msg_GW_3C4.HU_LaneCnt   =getvalue(E_pubc_GW_GW_3C4_HU_LaneCnt_Rv);
    Msg_GW_3C4.HU_RoadCurvature_100m   =getvalue(E_pubc_GW_GW_3C4_HU_RoadCurvature_100m_Rv);
    Msg_GW_3C4.HU_TollDis   =getvalue(E_pubc_GW_GW_3C4_HU_TollDis_Rv);
    Msg_GW_3C4.HU_To_Construction_Dis   =getvalue(E_pubc_GW_GW_3C4_HU_To_Construction_Dis_Rv);
    Msg_GW_3C4.HU_To_Branch_Dis   =getvalue(E_pubc_GW_GW_3C4_HU_To_Branch_Dis_Rv);
    Msg_GW_3C4.HU_RoadCurvature_70m   =getvalue(E_pubc_GW_GW_3C4_HU_RoadCurvature_70m_Rv);
    Msg_GW_3C4.HU_To_TrafficAccident_Dis   =getvalue(E_pubc_GW_GW_3C4_HU_To_TrafficAccident_Dis_Rv);
    Msg_GW_3C4.HU_To_NumchangeOfLanes_Dist   =getvalue(E_pubc_GW_GW_3C4_HU_To_NumchangeOfLanes_Dist_Rv);
    Msg_GW_3C4.HU_RoadCurvature_60m   =getvalue(E_pubc_GW_GW_3C4_HU_RoadCurvature_60m_Rv);
    Msg_GW_3C4.HU_TunnelLength   =getvalue(E_pubc_GW_GW_3C4_HU_TunnelLength_Rv);
    Msg_GW_3C4.HU_Construction_Info   =getvalue(E_pubc_GW_GW_3C4_HU_Construction_Info_Rv);
    Msg_GW_3C4.HU_TollInfo   =getvalue(E_pubc_GW_GW_3C4_HU_TollInfo_Rv);
    Msg_GW_3C4.HU_RoadCurvature_300m   =getvalue(E_pubc_GW_GW_3C4_HU_RoadCurvature_300m_Rv);
    Msg_GW_3C4.HU_NavGuiganceStatus   =getvalue(E_pubc_GW_GW_3C4_HU_NavGuiganceStatus_Rv);
    Msg_GW_3C4.HU_Lane_Changtype   =getvalue(E_pubc_GW_GW_3C4_HU_Lane_Changtype_Rv);
    Msg_GW_3C4.HU_RoadCurvatureFar   =getvalue(E_pubc_GW_GW_3C4_HU_RoadCurvatureFar_Rv);
    Msg_GW_3C4.HU_RampSide   =getvalue(E_pubc_GW_GW_3C4_HU_RampSide_Rv);
    Msg_GW_3C4.HU_ForwardRoadType   =getvalue(E_pubc_GW_GW_3C4_HU_ForwardRoadType_Rv);
    Msg_GW_3C4.HU_RoadCurvature_400m   =getvalue(E_pubc_GW_GW_3C4_HU_RoadCurvature_400m_Rv);
    Msg_GW_3C4.HU_FallingRockInfo   =getvalue(E_pubc_GW_GW_3C4_HU_FallingRockInfo_Rv);
    Msg_GW_3C4.HU_MapMatchStatus   =getvalue(E_pubc_GW_GW_3C4_HU_MapMatchStatus_Rv);
    Msg_GW_3C4.HU_EnterSlopeInfo   =getvalue(E_pubc_GW_GW_3C4_HU_EnterSlopeInfo_Rv);
    Msg_GW_3C4.HU_SlopeGradient_300m   =getvalue(E_pubc_GW_GW_3C4_HU_SlopeGradient_300m_Rv);
    Msg_GW_3C4.HU_Road_TrafficFlow   =getvalue(E_pubc_GW_GW_3C4_HU_Road_TrafficFlow_Rv);
    Msg_GW_3C4.HU_RoadCurvature_50m   =getvalue(E_pubc_GW_GW_3C4_HU_RoadCurvature_50m_Rv);
    Msg_GW_3C4.HU_RoadCurvature_10m   =getvalue(E_pubc_GW_GW_3C4_HU_RoadCurvature_10m_Rv);
    Msg_GW_3C4.HU_RoadCurvature_40m   =getvalue(E_pubc_GW_GW_3C4_HU_RoadCurvature_40m_Rv);
    Msg_GW_3C2.EpbDriverReqParkBrakeDominant   =getvalue(E_pubc_GW_GW_3C2_EpbDriverReqParkBrakeDominant_Rv);
    Msg_GW_3C2.EpbRiAchievedClmpF   =getvalue(E_pubc_GW_GW_3C2_EpbRiAchievedClmpF_Rv);
    Msg_GW_3C2.EpbFailrSts   =getvalue(E_pubc_GW_GW_3C2_EpbFailrSts_Rv);
    Msg_GW_3C2.EspEpbReqAvl   =getvalue(E_pubc_GW_GW_3C2_EspEpbReqAvl_Rv);
    Msg_GW_3C2.EpbSts   =getvalue(E_pubc_GW_GW_3C2_EpbSts_Rv);
    Msg_GW_3C2.EpbLeAchievedClmpF   =getvalue(E_pubc_GW_GW_3C2_EpbLeAchievedClmpF_Rv);
    Msg_GW_3AF.HU_SlopeGradientFar   =getvalue(E_pubc_GW_GW_3AF_HU_SlopeGradientFar_Rv);
    Msg_GW_3AF.HU_NavCurrentRoadType   =getvalue(E_pubc_GW_GW_3AF_HU_NavCurrentRoadType_Rv);
    Msg_GW_3AF.HU_AccidentProne   =getvalue(E_pubc_GW_GW_3AF_HU_AccidentProne_Rv);
    Msg_GW_3AF.HU_CurveDistance   =getvalue(E_pubc_GW_GW_3AF_HU_CurveDistance_Rv);
    Msg_GW_3AF.HU_IntervalVelocityDis   =getvalue(E_pubc_GW_GW_3AF_HU_IntervalVelocityDis_Rv);
    Msg_GW_3AF.HU_SlopeGradient   =getvalue(E_pubc_GW_GW_3AF_HU_SlopeGradient_Rv);
    Msg_GW_3AF.HU_NavStatus   =getvalue(E_pubc_GW_GW_3AF_HU_NavStatus_Rv);
    Msg_GW_3AF.HU_IntervalVelocityInfo   =getvalue(E_pubc_GW_GW_3AF_HU_IntervalVelocityInfo_Rv);
    Msg_GW_3AF.HU_SlopeGradient_50m   =getvalue(E_pubc_GW_GW_3AF_HU_SlopeGradient_50m_Rv);
    Msg_GW_3AF.HU_BridgeDis   =getvalue(E_pubc_GW_GW_3AF_HU_BridgeDis_Rv);
    Msg_GW_3AF.HU_SlopeGradient_40m   =getvalue(E_pubc_GW_GW_3AF_HU_SlopeGradient_40m_Rv);
    Msg_GW_3AF.HU_LaneType_ID5   =getvalue(E_pubc_GW_GW_3AF_HU_LaneType_ID5_Rv);
    Msg_GW_3AF.HU_LaneType_ID4   =getvalue(E_pubc_GW_GW_3AF_HU_LaneType_ID4_Rv);
    Msg_GW_3AF.HU_LaneType_ID6   =getvalue(E_pubc_GW_GW_3AF_HU_LaneType_ID6_Rv);
    Msg_GW_3AF.HU_LaneType_ID1   =getvalue(E_pubc_GW_GW_3AF_HU_LaneType_ID1_Rv);
    Msg_GW_3AF.HU_LaneType_ID3   =getvalue(E_pubc_GW_GW_3AF_HU_LaneType_ID3_Rv);
    Msg_GW_3AF.HU_RampInfo   =getvalue(E_pubc_GW_GW_3AF_HU_RampInfo_Rv);
    Msg_GW_3AF.HU_NavCountryCode   =getvalue(E_pubc_GW_GW_3AF_HU_NavCountryCode_Rv);
    Msg_GW_3AF.HU_SpeedLimitDistance   =getvalue(E_pubc_GW_GW_3AF_HU_SpeedLimitDistance_Rv);
    Msg_GW_3AF.HU_NavSpeedLimitType   =getvalue(E_pubc_GW_GW_3AF_HU_NavSpeedLimitType_Rv);
    Msg_GW_3AF.HU_NavSpeedLimitUnits   =getvalue(E_pubc_GW_GW_3AF_HU_NavSpeedLimitUnits_Rv);
    Msg_GW_3AF.HU_ServiceRoadDis   =getvalue(E_pubc_GW_GW_3AF_HU_ServiceRoadDis_Rv);
    Msg_GW_3AF.HU_WeatherType   =getvalue(E_pubc_GW_GW_3AF_HU_WeatherType_Rv);
    Msg_GW_3AF.HU_EnterCurveInfo   =getvalue(E_pubc_GW_GW_3AF_HU_EnterCurveInfo_Rv);
    Msg_GW_3AF.HU_ServiceRoad   =getvalue(E_pubc_GW_GW_3AF_HU_ServiceRoad_Rv);
    Msg_GW_3AF.HU_SlopeGradient_100m   =getvalue(E_pubc_GW_GW_3AF_HU_SlopeGradient_100m_Rv);
    Msg_GW_3AF.HU_LaneConfluenceDis   =getvalue(E_pubc_GW_GW_3AF_HU_LaneConfluenceDis_Rv);
    Msg_GW_3AF.HU_AccidentProneDistance   =getvalue(E_pubc_GW_GW_3AF_HU_AccidentProneDistance_Rv);
    Msg_GW_3AF.HU_SlopeGradient_30m   =getvalue(E_pubc_GW_GW_3AF_HU_SlopeGradient_30m_Rv);
    Msg_GW_3AF.HU_LaneConfluence   =getvalue(E_pubc_GW_GW_3AF_HU_LaneConfluence_Rv);
    Msg_GW_3AF.HU_BridgeInfo   =getvalue(E_pubc_GW_GW_3AF_HU_BridgeInfo_Rv);
    Msg_GW_3AF.HU_SlopeGradient_20m   =getvalue(E_pubc_GW_GW_3AF_HU_SlopeGradient_20m_Rv);
    Msg_GW_3AF.HU_NavSpeedLimit   =getvalue(E_pubc_GW_GW_3AF_HU_NavSpeedLimit_Rv);
    Msg_GW_3AF.HU_SlopeGradient_10m   =getvalue(E_pubc_GW_GW_3AF_HU_SlopeGradient_10m_Rv);
    Msg_GW_3AF.HU_RampDistance   =getvalue(E_pubc_GW_GW_3AF_HU_RampDistance_Rv);
    Msg_GW_3AF.HU_NavSpeedLimitStatus   =getvalue(E_pubc_GW_GW_3AF_HU_NavSpeedLimitStatus_Rv);
    Msg_GW_3AF.HU_LaneType_ID2   =getvalue(E_pubc_GW_GW_3AF_HU_LaneType_ID2_Rv);
    Msg_GW_3AF.HU_EnterRampInfo   =getvalue(E_pubc_GW_GW_3AF_HU_EnterRampInfo_Rv);
    Msg_GW_2AD.LCDAL_SystemStatus   =getvalue(E_pubc_GW_GW_2AD_LCDAL_SystemStatus_Rv);
    Msg_GW_170.EPS_ActualTorsionBarTorq   =getvalue(E_pubc_GW_GW_170_EPS_ActualTorsionBarTorq_Rv);
    Msg_GW_170.EPS_MinSafetyTorsionBarTorq   =getvalue(E_pubc_GW_GW_170_EPS_MinSafetyTorsionBarTorq_Rv);
    Msg_GW_170.EPS_MaxSafetyTorsionBarTorq   =getvalue(E_pubc_GW_GW_170_EPS_MaxSafetyTorsionBarTorq_Rv);
    Msg_GW_2A8.TmsAcEnvtlT   =getvalue(E_pubc_GW_GW_2A8_TmsAcEnvtlT_Rv);
    Msg_GW_2A8.TmsAcEnvtlTVld   =getvalue(E_pubc_GW_GW_2A8_TmsAcEnvtlTVld_Rv);
    Msg_GW_2A8.TmsActPwr   =getvalue(E_pubc_GW_GW_2A8_TmsActPwr_Rv);
    Msg_GW_2A8.TmsFrntBlowMod   =getvalue(E_pubc_GW_GW_2A8_TmsFrntBlowMod_Rv);
    Msg_GW_3EE.GW_SafCertSts   =getvalue(E_pubc_GW_GW_3EE_GW_SafCertSts_Rv);
    Msg_GW_2C8.RRC_OBJ3_Height   =getvalue(E_pubc_GW_GW_2C8_RRC_OBJ3_Height_Rv);
    Msg_GW_2C8.RRC_OBJ5_Length   =getvalue(E_pubc_GW_GW_2C8_RRC_OBJ5_Length_Rv);
    Msg_GW_2C8.RRC_OBJ1_Height   =getvalue(E_pubc_GW_GW_2C8_RRC_OBJ1_Height_Rv);
    Msg_GW_2C8.RRC_OBJ10_Track_ID   =getvalue(E_pubc_GW_GW_2C8_RRC_OBJ10_Track_ID_Rv);
    Msg_GW_2C8.RRC_OBJ10_Type   =getvalue(E_pubc_GW_GW_2C8_RRC_OBJ10_Type_Rv);
    Msg_GW_2C8.RRC_OBJ5_Track_ID   =getvalue(E_pubc_GW_GW_2C8_RRC_OBJ5_Track_ID_Rv);
    Msg_GW_2C8.RRC_TiStamp   =getvalue(E_pubc_GW_GW_2C8_RRC_TiStamp_Rv);
    Msg_GW_2C8.RRC_OBJ5_Ay   =getvalue(E_pubc_GW_GW_2C8_RRC_OBJ5_Ay_Rv);
    Msg_GW_2C8.RRC_OBJ5_Ax   =getvalue(E_pubc_GW_GW_2C8_RRC_OBJ5_Ax_Rv);
    Msg_GW_2C8.RRC_OBJ10_Location   =getvalue(E_pubc_GW_GW_2C8_RRC_OBJ10_Location_Rv);
    Msg_GW_2C8.RRC_OBJ5_ExistProb   =getvalue(E_pubc_GW_GW_2C8_RRC_OBJ5_ExistProb_Rv);
    Msg_GW_2C8.RRC_OBJ5_Height   =getvalue(E_pubc_GW_GW_2C8_RRC_OBJ5_Height_Rv);
    Msg_GW_2C8.RRC_OBJ10_Height   =getvalue(E_pubc_GW_GW_2C8_RRC_OBJ10_Height_Rv);
    Msg_GW_2C8.RRC_OBJ10_ObstacleProb   =getvalue(E_pubc_GW_GW_2C8_RRC_OBJ10_ObstacleProb_Rv);
    Msg_GW_2C8.RRC_OBJ5_Width   =getvalue(E_pubc_GW_GW_2C8_RRC_OBJ5_Width_Rv);
    Msg_GW_2C8.RRC_OBJ5_Location   =getvalue(E_pubc_GW_GW_2C8_RRC_OBJ5_Location_Rv);
    Msg_GW_2C8.RRC_OBJ4_Height   =getvalue(E_pubc_GW_GW_2C8_RRC_OBJ4_Height_Rv);
    Msg_GW_2C8.RRC_OBJ6_Height   =getvalue(E_pubc_GW_GW_2C8_RRC_OBJ6_Height_Rv);
    Msg_GW_2C8.RRC_OBJ8_Height   =getvalue(E_pubc_GW_GW_2C8_RRC_OBJ8_Height_Rv);
    Msg_GW_2C8.RRC_TiBas   =getvalue(E_pubc_GW_GW_2C8_RRC_TiBas_Rv);
    Msg_GW_2C8.RRC_OBJ5_Vx   =getvalue(E_pubc_GW_GW_2C8_RRC_OBJ5_Vx_Rv);
    Msg_GW_2C8.RRC_OBJ5_Vy   =getvalue(E_pubc_GW_GW_2C8_RRC_OBJ5_Vy_Rv);
    Msg_GW_2C8.RRC_OBJ2_Height   =getvalue(E_pubc_GW_GW_2C8_RRC_OBJ2_Height_Rv);
    Msg_GW_2C8.RRC_OBJ10_Measured   =getvalue(E_pubc_GW_GW_2C8_RRC_OBJ10_Measured_Rv);
    Msg_GW_2C8.RRC_TiOut   =getvalue(E_pubc_GW_GW_2C8_RRC_TiOut_Rv);
    Msg_GW_2C8.RRC_OBJ10_Ax   =getvalue(E_pubc_GW_GW_2C8_RRC_OBJ10_Ax_Rv);
    Msg_GW_2C8.RRC_OBJ10_Ay   =getvalue(E_pubc_GW_GW_2C8_RRC_OBJ10_Ay_Rv);
    Msg_GW_2C8.RRC_OBJ10_Dy   =getvalue(E_pubc_GW_GW_2C8_RRC_OBJ10_Dy_Rv);
    Msg_GW_2C8.RRC_OBJ10_Dx   =getvalue(E_pubc_GW_GW_2C8_RRC_OBJ10_Dx_Rv);
    Msg_GW_2C8.RRC_OBJ10_Length   =getvalue(E_pubc_GW_GW_2C8_RRC_OBJ10_Length_Rv);
    Msg_GW_2C8.RRC_OBJ5_Measured   =getvalue(E_pubc_GW_GW_2C8_RRC_OBJ5_Measured_Rv);
    Msg_GW_2C8.RRC_OBJ9_Height   =getvalue(E_pubc_GW_GW_2C8_RRC_OBJ9_Height_Rv);
    Msg_GW_2C8.RRC_OBJ5_HeadingAngle   =getvalue(E_pubc_GW_GW_2C8_RRC_OBJ5_HeadingAngle_Rv);
    Msg_GW_2C8.RRC_OBJ5_ObstacleProb   =getvalue(E_pubc_GW_GW_2C8_RRC_OBJ5_ObstacleProb_Rv);
    Msg_GW_2C8.RRC_OBJ10_Width   =getvalue(E_pubc_GW_GW_2C8_RRC_OBJ10_Width_Rv);
    Msg_GW_2C8.RRC_ObjDelay   =getvalue(E_pubc_GW_GW_2C8_RRC_ObjDelay_Rv);
    Msg_GW_2C8.RRC_TiLeap   =getvalue(E_pubc_GW_GW_2C8_RRC_TiLeap_Rv);
    Msg_GW_2C8.RRC_OBJ10_HeadingAngle   =getvalue(E_pubc_GW_GW_2C8_RRC_OBJ10_HeadingAngle_Rv);
    Msg_GW_2C8.RRC_OBJ10_ExistProb   =getvalue(E_pubc_GW_GW_2C8_RRC_OBJ10_ExistProb_Rv);
    Msg_GW_2C8.RRC_OBJ7_Height   =getvalue(E_pubc_GW_GW_2C8_RRC_OBJ7_Height_Rv);
    Msg_GW_2C8.RRC_OBJ10_Vy   =getvalue(E_pubc_GW_GW_2C8_RRC_OBJ10_Vy_Rv);
    Msg_GW_2C8.RRC_OBJ10_Vx   =getvalue(E_pubc_GW_GW_2C8_RRC_OBJ10_Vx_Rv);
    Msg_GW_2C8.RRC_OBJ5_Type   =getvalue(E_pubc_GW_GW_2C8_RRC_OBJ5_Type_Rv);
    Msg_GW_2C8.RRC_OBJ5_Dx   =getvalue(E_pubc_GW_GW_2C8_RRC_OBJ5_Dx_Rv);
    Msg_GW_2C8.RRC_OBJ5_Dy   =getvalue(E_pubc_GW_GW_2C8_RRC_OBJ5_Dy_Rv);
    Msg_GW_NM.GW_NMSourceAddress   =getvalue(E_pubc_GW_GW_NM_GW_NMSourceAddress_Rv);
    Msg_GW_17E.EPS_LatCtrlActive   =getvalue(E_pubc_GW_GW_17E_EPS_LatCtrlActive_Rv);
    Msg_GW_17E.EPS_MeasuredTorsionBarTorqValid   =getvalue(E_pubc_GW_GW_17E_EPS_MeasuredTorsionBarTorqValid_Rv);
    Msg_GW_17E.EPS_MeasuredTorsionBarTorque   =getvalue(E_pubc_GW_GW_17E_EPS_MeasuredTorsionBarTorque_Rv);
    Msg_GW_17E.EPS_LatCtrlAvailabilityStatus   =getvalue(E_pubc_GW_GW_17E_EPS_LatCtrlAvailabilityStatus_Rv);
    Msg_GW_2C2.IbBrkPedlStsGbVld   =getvalue(E_pubc_GW_GW_2C2_IbBrkPedlStsGbVld_Rv);
    Msg_GW_2C2.IB_EPBrequestValid   =getvalue(E_pubc_GW_GW_2C2_IB_EPBrequestValid_Rv);
    Msg_GW_2C2.IbBrkPedlStsGb   =getvalue(E_pubc_GW_GW_2C2_IbBrkPedlStsGb_Rv);
    Msg_GW_2C2.IB_EPBrequest   =getvalue(E_pubc_GW_GW_2C2_IB_EPBrequest_Rv);
    Msg_GW_2A4.LCDAR_Left_ELK_oAlert   =getvalue(E_pubc_GW_GW_2A4_LCDAR_Left_ELK_oAlert_Rv);
    Msg_GW_2A4.LCDAR_RCTBEnable   =getvalue(E_pubc_GW_GW_2A4_LCDAR_RCTBEnable_Rv);
    Msg_GW_2A4.LCDAR_ELK_oAlert   =getvalue(E_pubc_GW_GW_2A4_LCDAR_ELK_oAlert_Rv);
    Msg_GW_2A4.LCDAR_ELK_oStatus   =getvalue(E_pubc_GW_GW_2A4_LCDAR_ELK_oStatus_Rv);
    Msg_GW_2A4.LCDAR_RCTBTargetDecel   =getvalue(E_pubc_GW_GW_2A4_LCDAR_RCTBTargetDecel_Rv);
    Msg_GW_2A4.LCDAR_SystemStatus   =getvalue(E_pubc_GW_GW_2A4_LCDAR_SystemStatus_Rv);
    Msg_GW_2A4.LCDAR_RCTBActive   =getvalue(E_pubc_GW_GW_2A4_LCDAR_RCTBActive_Rv);
    Msg_GW_2A4.LCDAR_Left_RCTAAlert   =getvalue(E_pubc_GW_GW_2A4_LCDAR_Left_RCTAAlert_Rv);
    Msg_GW_516.HU_CurrentLocationLatitude   =getvalue(E_pubc_GW_GW_516_HU_CurrentLocationLatitude_Rv);
    Msg_GW_516.HU_CurrentLocationLongitude   =getvalue(E_pubc_GW_GW_516_HU_CurrentLocationLongitude_Rv);
    Msg_GW_516.HU_CurrentLocationValid   =getvalue(E_pubc_GW_GW_516_HU_CurrentLocationValid_Rv);
    Msg_GW_2D2.CdcTotMilg   =getvalue(E_pubc_GW_GW_2D2_CdcTotMilg_Rv);
    Msg_GW_3D2.EpbRiAchievedClmpF   =getvalue(E_pubc_GW_GW_3D2_EpbRiAchievedClmpF_Rv);
    Msg_GW_3D2.EpbFailrSts   =getvalue(E_pubc_GW_GW_3D2_EpbFailrSts_Rv);
    Msg_GW_3D2.EspEpbReqAvl   =getvalue(E_pubc_GW_GW_3D2_EspEpbReqAvl_Rv);
    Msg_GW_3D2.EpbLeAchievedClmpF   =getvalue(E_pubc_GW_GW_3D2_EpbLeAchievedClmpF_Rv);
    Msg_GW_3D2.EpbSts   =getvalue(E_pubc_GW_GW_3D2_EpbSts_Rv);
    Msg_GW_3D2.EpbDriverReqParkBrakeDominant   =getvalue(E_pubc_GW_GW_3D2_EpbDriverReqParkBrakeDominant_Rv);
    Msg_GW_180.EpsSteerAgSensFilr   =getvalue(E_pubc_GW_GW_180_EpsSteerAgSensFilr_Rv);
    Msg_GW_180.EpsSasSteerAg   =getvalue(E_pubc_GW_GW_180_EpsSasSteerAg_Rv);
    Msg_GW_180.EpsSteerAgRate   =getvalue(E_pubc_GW_GW_180_EpsSteerAgRate_Rv);
    Msg_GW_180.EpsSasCalSts   =getvalue(E_pubc_GW_GW_180_EpsSasCalSts_Rv);
    Msg_GW_180.EpsSasSteerAgVld   =getvalue(E_pubc_GW_GW_180_EpsSasSteerAgVld_Rv);
    Msg_GW_2BD.RRC_OBJ1_Measured   =getvalue(E_pubc_GW_GW_2BD_RRC_OBJ1_Measured_Rv);
    Msg_GW_2BD.RRC_OBJ3_Ay   =getvalue(E_pubc_GW_GW_2BD_RRC_OBJ3_Ay_Rv);
    Msg_GW_2BD.RRC_OBJ4_Measured   =getvalue(E_pubc_GW_GW_2BD_RRC_OBJ4_Measured_Rv);
    Msg_GW_2BD.RRC_OBJ2_Measured   =getvalue(E_pubc_GW_GW_2BD_RRC_OBJ2_Measured_Rv);
    Msg_GW_2BD.RRC_OBJ4_Vy   =getvalue(E_pubc_GW_GW_2BD_RRC_OBJ4_Vy_Rv);
    Msg_GW_2BD.RRC_OBJ4_Vx   =getvalue(E_pubc_GW_GW_2BD_RRC_OBJ4_Vx_Rv);
    Msg_GW_2BD.RRC_OBJ4_Ax   =getvalue(E_pubc_GW_GW_2BD_RRC_OBJ4_Ax_Rv);
    Msg_GW_2BD.RRC_OBJ4_Ay   =getvalue(E_pubc_GW_GW_2BD_RRC_OBJ4_Ay_Rv);
    Msg_GW_2BD.RRC_OBJ2_Width   =getvalue(E_pubc_GW_GW_2BD_RRC_OBJ2_Width_Rv);
    Msg_GW_2BD.RRC_OBJ2_Type   =getvalue(E_pubc_GW_GW_2BD_RRC_OBJ2_Type_Rv);
    Msg_GW_2BD.RRC_OBJ2_ObstacleProb   =getvalue(E_pubc_GW_GW_2BD_RRC_OBJ2_ObstacleProb_Rv);
    Msg_GW_2BD.RRC_OBJ4_Width   =getvalue(E_pubc_GW_GW_2BD_RRC_OBJ4_Width_Rv);
    Msg_GW_2BD.RRC_OBJ4_ObstacleProb   =getvalue(E_pubc_GW_GW_2BD_RRC_OBJ4_ObstacleProb_Rv);
    Msg_GW_2BD.RRC_OBJ2_Dy   =getvalue(E_pubc_GW_GW_2BD_RRC_OBJ2_Dy_Rv);
    Msg_GW_2BD.RRC_OBJ2_Dx   =getvalue(E_pubc_GW_GW_2BD_RRC_OBJ2_Dx_Rv);
    Msg_GW_2BD.RRC_OBJ2_ExistProb   =getvalue(E_pubc_GW_GW_2BD_RRC_OBJ2_ExistProb_Rv);
    Msg_GW_2BD.RRC_OBJ4_Location   =getvalue(E_pubc_GW_GW_2BD_RRC_OBJ4_Location_Rv);
    Msg_GW_2BD.RRC_OBJ2_Length   =getvalue(E_pubc_GW_GW_2BD_RRC_OBJ2_Length_Rv);
    Msg_GW_2BD.RRC_OBJ1_Type   =getvalue(E_pubc_GW_GW_2BD_RRC_OBJ1_Type_Rv);
    Msg_GW_2BD.RRC_OBJ3_Ax   =getvalue(E_pubc_GW_GW_2BD_RRC_OBJ3_Ax_Rv);
    Msg_GW_2BD.RRC_OBJ4_ExistProb   =getvalue(E_pubc_GW_GW_2BD_RRC_OBJ4_ExistProb_Rv);
    Msg_GW_2BD.RRC_OBJ1_ExistProb   =getvalue(E_pubc_GW_GW_2BD_RRC_OBJ1_ExistProb_Rv);
    Msg_GW_2BD.RRC_OBJ4_HeadingAngle   =getvalue(E_pubc_GW_GW_2BD_RRC_OBJ4_HeadingAngle_Rv);
    Msg_GW_2BD.RRC_OBJ3_Type   =getvalue(E_pubc_GW_GW_2BD_RRC_OBJ3_Type_Rv);
    Msg_GW_2BD.RRC_OBJ1_Vx   =getvalue(E_pubc_GW_GW_2BD_RRC_OBJ1_Vx_Rv);
    Msg_GW_2BD.RRC_OBJ3_HeadingAngle   =getvalue(E_pubc_GW_GW_2BD_RRC_OBJ3_HeadingAngle_Rv);
    Msg_GW_2BD.RRC_OBJ4_Type   =getvalue(E_pubc_GW_GW_2BD_RRC_OBJ4_Type_Rv);
    Msg_GW_2BD.RRC_OBJ2_Track_ID   =getvalue(E_pubc_GW_GW_2BD_RRC_OBJ2_Track_ID_Rv);
    Msg_GW_2BD.RRC_OBJ1_Ay   =getvalue(E_pubc_GW_GW_2BD_RRC_OBJ1_Ay_Rv);
    Msg_GW_2BD.RRC_OBJ1_Ax   =getvalue(E_pubc_GW_GW_2BD_RRC_OBJ1_Ax_Rv);
    Msg_GW_2BD.RRC_OBJ3_ExistProb   =getvalue(E_pubc_GW_GW_2BD_RRC_OBJ3_ExistProb_Rv);
    Msg_GW_2BD.RRC_OBJ3_Length   =getvalue(E_pubc_GW_GW_2BD_RRC_OBJ3_Length_Rv);
    Msg_GW_2BD.RRC_OBJ1_Vy   =getvalue(E_pubc_GW_GW_2BD_RRC_OBJ1_Vy_Rv);
    Msg_GW_2BD.RRC_OBJ3_Measured   =getvalue(E_pubc_GW_GW_2BD_RRC_OBJ3_Measured_Rv);
    Msg_GW_2BD.RRC_OBJ3_Width   =getvalue(E_pubc_GW_GW_2BD_RRC_OBJ3_Width_Rv);
    Msg_GW_2BD.RRC_OBJ2_Vy   =getvalue(E_pubc_GW_GW_2BD_RRC_OBJ2_Vy_Rv);
    Msg_GW_2BD.RRC_OBJ2_Vx   =getvalue(E_pubc_GW_GW_2BD_RRC_OBJ2_Vx_Rv);
    Msg_GW_2BD.RRC_OBJ1_ObstacleProb   =getvalue(E_pubc_GW_GW_2BD_RRC_OBJ1_ObstacleProb_Rv);
    Msg_GW_2BD.RRC_OBJ1_HeadingAngle   =getvalue(E_pubc_GW_GW_2BD_RRC_OBJ1_HeadingAngle_Rv);
    Msg_GW_2BD.RRC_OBJ3_Dx   =getvalue(E_pubc_GW_GW_2BD_RRC_OBJ3_Dx_Rv);
    Msg_GW_2BD.RRC_OBJ3_Dy   =getvalue(E_pubc_GW_GW_2BD_RRC_OBJ3_Dy_Rv);
    Msg_GW_2BD.RRC_OBJ3_Location   =getvalue(E_pubc_GW_GW_2BD_RRC_OBJ3_Location_Rv);
    Msg_GW_2BD.RRC_OBJ4_Dy   =getvalue(E_pubc_GW_GW_2BD_RRC_OBJ4_Dy_Rv);
    Msg_GW_2BD.RRC_OBJ4_Dx   =getvalue(E_pubc_GW_GW_2BD_RRC_OBJ4_Dx_Rv);
    Msg_GW_2BD.RRC_OBJ2_Location   =getvalue(E_pubc_GW_GW_2BD_RRC_OBJ2_Location_Rv);
    Msg_GW_2BD.RRC_OBJ1_Width   =getvalue(E_pubc_GW_GW_2BD_RRC_OBJ1_Width_Rv);
    Msg_GW_2BD.RRC_OBJ1_Location   =getvalue(E_pubc_GW_GW_2BD_RRC_OBJ1_Location_Rv);
    Msg_GW_2BD.RRC_OBJ4_Track_ID   =getvalue(E_pubc_GW_GW_2BD_RRC_OBJ4_Track_ID_Rv);
    Msg_GW_2BD.RRC_OBJ1_Track_ID   =getvalue(E_pubc_GW_GW_2BD_RRC_OBJ1_Track_ID_Rv);
    Msg_GW_2BD.RRC_OBJ2_Ax   =getvalue(E_pubc_GW_GW_2BD_RRC_OBJ2_Ax_Rv);
    Msg_GW_2BD.RRC_OBJ2_Ay   =getvalue(E_pubc_GW_GW_2BD_RRC_OBJ2_Ay_Rv);
    Msg_GW_2BD.RRC_OBJ1_Length   =getvalue(E_pubc_GW_GW_2BD_RRC_OBJ1_Length_Rv);
    Msg_GW_2BD.RRC_OBJ3_ObstacleProb   =getvalue(E_pubc_GW_GW_2BD_RRC_OBJ3_ObstacleProb_Rv);
    Msg_GW_2BD.RRC_OBJ4_Length   =getvalue(E_pubc_GW_GW_2BD_RRC_OBJ4_Length_Rv);
    Msg_GW_2BD.RRC_OBJ3_Vx   =getvalue(E_pubc_GW_GW_2BD_RRC_OBJ3_Vx_Rv);
    Msg_GW_2BD.RRC_OBJ3_Vy   =getvalue(E_pubc_GW_GW_2BD_RRC_OBJ3_Vy_Rv);
    Msg_GW_2BD.RRC_OBJ2_HeadingAngle   =getvalue(E_pubc_GW_GW_2BD_RRC_OBJ2_HeadingAngle_Rv);
    Msg_GW_2BD.RRC_OBJ3_Track_ID   =getvalue(E_pubc_GW_GW_2BD_RRC_OBJ3_Track_ID_Rv);
    Msg_GW_2BD.RRC_OBJ1_Dx   =getvalue(E_pubc_GW_GW_2BD_RRC_OBJ1_Dx_Rv);
    Msg_GW_2BD.RRC_OBJ1_Dy   =getvalue(E_pubc_GW_GW_2BD_RRC_OBJ1_Dy_Rv);
    Msg_GW_2BF.RRC_OBJ8_HeadingAngle   =getvalue(E_pubc_GW_GW_2BF_RRC_OBJ8_HeadingAngle_Rv);
    Msg_GW_2BF.RRC_OBJ9_Type   =getvalue(E_pubc_GW_GW_2BF_RRC_OBJ9_Type_Rv);
    Msg_GW_2BF.RRC_OBJ8_Vy   =getvalue(E_pubc_GW_GW_2BF_RRC_OBJ8_Vy_Rv);
    Msg_GW_2BF.RRC_OBJ6_Dy   =getvalue(E_pubc_GW_GW_2BF_RRC_OBJ6_Dy_Rv);
    Msg_GW_2BF.RRC_OBJ6_Dx   =getvalue(E_pubc_GW_GW_2BF_RRC_OBJ6_Dx_Rv);
    Msg_GW_2BF.RRC_OBJ6_HeadingAngle   =getvalue(E_pubc_GW_GW_2BF_RRC_OBJ6_HeadingAngle_Rv);
    Msg_GW_2BF.RRC_OBJ9_Ay   =getvalue(E_pubc_GW_GW_2BF_RRC_OBJ9_Ay_Rv);
    Msg_GW_2BF.RRC_OBJ9_Ax   =getvalue(E_pubc_GW_GW_2BF_RRC_OBJ9_Ax_Rv);
    Msg_GW_2BF.RRC_OBJ8_Vx   =getvalue(E_pubc_GW_GW_2BF_RRC_OBJ8_Vx_Rv);
    Msg_GW_2BF.RRC_OBJ7_Length   =getvalue(E_pubc_GW_GW_2BF_RRC_OBJ7_Length_Rv);
    Msg_GW_2BF.RRC_OBJ8_Length   =getvalue(E_pubc_GW_GW_2BF_RRC_OBJ8_Length_Rv);
    Msg_GW_2BF.RRC_OBJ6_Vy   =getvalue(E_pubc_GW_GW_2BF_RRC_OBJ6_Vy_Rv);
    Msg_GW_2BF.RRC_OBJ6_Vx   =getvalue(E_pubc_GW_GW_2BF_RRC_OBJ6_Vx_Rv);
    Msg_GW_2BF.RRC_OBJ8_Ax   =getvalue(E_pubc_GW_GW_2BF_RRC_OBJ8_Ax_Rv);
    Msg_GW_2BF.RRC_OBJ8_Measured   =getvalue(E_pubc_GW_GW_2BF_RRC_OBJ8_Measured_Rv);
    Msg_GW_2BF.RRC_OBJ7_Dx   =getvalue(E_pubc_GW_GW_2BF_RRC_OBJ7_Dx_Rv);
    Msg_GW_2BF.RRC_OBJ7_Dy   =getvalue(E_pubc_GW_GW_2BF_RRC_OBJ7_Dy_Rv);
    Msg_GW_2BF.RRC_OBJ8_Ay   =getvalue(E_pubc_GW_GW_2BF_RRC_OBJ8_Ay_Rv);
    Msg_GW_2BF.RRC_OBJ7_Track_ID   =getvalue(E_pubc_GW_GW_2BF_RRC_OBJ7_Track_ID_Rv);
    Msg_GW_2BF.RRC_OBJ6_Width   =getvalue(E_pubc_GW_GW_2BF_RRC_OBJ6_Width_Rv);
    Msg_GW_2BF.RRC_OBJ9_Vx   =getvalue(E_pubc_GW_GW_2BF_RRC_OBJ9_Vx_Rv);
    Msg_GW_2BF.RRC_OBJ9_Vy   =getvalue(E_pubc_GW_GW_2BF_RRC_OBJ9_Vy_Rv);
    Msg_GW_2BF.RRC_OBJ9_ObstacleProb   =getvalue(E_pubc_GW_GW_2BF_RRC_OBJ9_ObstacleProb_Rv);
    Msg_GW_2BF.RRC_OBJ7_HeadingAngle   =getvalue(E_pubc_GW_GW_2BF_RRC_OBJ7_HeadingAngle_Rv);
    Msg_GW_2BF.RRC_OBJ8_Type   =getvalue(E_pubc_GW_GW_2BF_RRC_OBJ8_Type_Rv);
    Msg_GW_2BF.RRC_OBJ9_Length   =getvalue(E_pubc_GW_GW_2BF_RRC_OBJ9_Length_Rv);
    Msg_GW_2BF.RRC_OBJ6_ExistProb   =getvalue(E_pubc_GW_GW_2BF_RRC_OBJ6_ExistProb_Rv);
    Msg_GW_2BF.RRC_OBJ9_Track_ID   =getvalue(E_pubc_GW_GW_2BF_RRC_OBJ9_Track_ID_Rv);
    Msg_GW_2BF.RRC_OBJ6_Location   =getvalue(E_pubc_GW_GW_2BF_RRC_OBJ6_Location_Rv);
    Msg_GW_2BF.RRC_OBJ9_Location   =getvalue(E_pubc_GW_GW_2BF_RRC_OBJ9_Location_Rv);
    Msg_GW_2BF.RRC_OBJ7_Width   =getvalue(E_pubc_GW_GW_2BF_RRC_OBJ7_Width_Rv);
    Msg_GW_2BF.RRC_OBJ6_Ax   =getvalue(E_pubc_GW_GW_2BF_RRC_OBJ6_Ax_Rv);
    Msg_GW_2BF.RRC_OBJ6_Ay   =getvalue(E_pubc_GW_GW_2BF_RRC_OBJ6_Ay_Rv);
    Msg_GW_2BF.RRC_OBJ6_Track_ID   =getvalue(E_pubc_GW_GW_2BF_RRC_OBJ6_Track_ID_Rv);
    Msg_GW_2BF.RRC_OBJ9_Dy   =getvalue(E_pubc_GW_GW_2BF_RRC_OBJ9_Dy_Rv);
    Msg_GW_2BF.RRC_OBJ9_Dx   =getvalue(E_pubc_GW_GW_2BF_RRC_OBJ9_Dx_Rv);
    Msg_GW_2BF.RRC_OBJ7_ExistProb   =getvalue(E_pubc_GW_GW_2BF_RRC_OBJ7_ExistProb_Rv);
    Msg_GW_2BF.RRC_OBJ8_Track_ID   =getvalue(E_pubc_GW_GW_2BF_RRC_OBJ8_Track_ID_Rv);
    Msg_GW_2BF.RRC_OBJ7_Measured   =getvalue(E_pubc_GW_GW_2BF_RRC_OBJ7_Measured_Rv);
    Msg_GW_2BF.RRC_OBJ7_Type   =getvalue(E_pubc_GW_GW_2BF_RRC_OBJ7_Type_Rv);
    Msg_GW_2BF.RRC_OBJ7_Location   =getvalue(E_pubc_GW_GW_2BF_RRC_OBJ7_Location_Rv);
    Msg_GW_2BF.RRC_OBJ9_Measured   =getvalue(E_pubc_GW_GW_2BF_RRC_OBJ9_Measured_Rv);
    Msg_GW_2BF.RRC_OBJ7_Vx   =getvalue(E_pubc_GW_GW_2BF_RRC_OBJ7_Vx_Rv);
    Msg_GW_2BF.RRC_OBJ7_Vy   =getvalue(E_pubc_GW_GW_2BF_RRC_OBJ7_Vy_Rv);
    Msg_GW_2BF.RRC_OBJ8_Location   =getvalue(E_pubc_GW_GW_2BF_RRC_OBJ8_Location_Rv);
    Msg_GW_2BF.RRC_OBJ8_Dy   =getvalue(E_pubc_GW_GW_2BF_RRC_OBJ8_Dy_Rv);
    Msg_GW_2BF.RRC_OBJ9_Width   =getvalue(E_pubc_GW_GW_2BF_RRC_OBJ9_Width_Rv);
    Msg_GW_2BF.RRC_OBJ6_Length   =getvalue(E_pubc_GW_GW_2BF_RRC_OBJ6_Length_Rv);
    Msg_GW_2BF.RRC_OBJ6_Type   =getvalue(E_pubc_GW_GW_2BF_RRC_OBJ6_Type_Rv);
    Msg_GW_2BF.RRC_OBJ9_HeadingAngle   =getvalue(E_pubc_GW_GW_2BF_RRC_OBJ9_HeadingAngle_Rv);
    Msg_GW_2BF.RRC_OBJ8_ExistProb   =getvalue(E_pubc_GW_GW_2BF_RRC_OBJ8_ExistProb_Rv);
    Msg_GW_2BF.RRC_OBJ6_ObstacleProb   =getvalue(E_pubc_GW_GW_2BF_RRC_OBJ6_ObstacleProb_Rv);
    Msg_GW_2BF.RRC_OBJ7_ObstacleProb   =getvalue(E_pubc_GW_GW_2BF_RRC_OBJ7_ObstacleProb_Rv);
    Msg_GW_2BF.RRC_OBJ8_ObstacleProb   =getvalue(E_pubc_GW_GW_2BF_RRC_OBJ8_ObstacleProb_Rv);
    Msg_GW_2BF.RRC_OBJ8_Dx   =getvalue(E_pubc_GW_GW_2BF_RRC_OBJ8_Dx_Rv);
    Msg_GW_2BF.RRC_OBJ9_ExistProb   =getvalue(E_pubc_GW_GW_2BF_RRC_OBJ9_ExistProb_Rv);
    Msg_GW_2BF.RRC_OBJ7_Ay   =getvalue(E_pubc_GW_GW_2BF_RRC_OBJ7_Ay_Rv);
    Msg_GW_2BF.RRC_OBJ7_Ax   =getvalue(E_pubc_GW_GW_2BF_RRC_OBJ7_Ax_Rv);
    Msg_GW_2BF.RRC_OBJ8_Width   =getvalue(E_pubc_GW_GW_2BF_RRC_OBJ8_Width_Rv);
    Msg_GW_2BF.RRC_OBJ6_Measured   =getvalue(E_pubc_GW_GW_2BF_RRC_OBJ6_Measured_Rv);
    Msg_GW_3BD.HU_TLAEnable   =getvalue(E_pubc_GW_GW_3BD_HU_TLAEnable_Rv);
    Msg_GW_3BD.HU_ELKEnable   =getvalue(E_pubc_GW_GW_3BD_HU_ELKEnable_Rv);
    Msg_GW_3BD.HU_CSLAEnable   =getvalue(E_pubc_GW_GW_3BD_HU_CSLAEnable_Rv);
    Msg_GW_28B.BCM_TurnLightSwitchSts   =getvalue(E_pubc_GW_GW_28B_BCM_TurnLightSwitchSts_Rv);
}
/*@@end*/

/*@@envVar:E_pubc_GW_CycMsgsON:*/
on envVar E_pubc_GW_CycMsgsON
{
    // enable all the cyclic messages 
    putValue(E_pubc_GW_GW_387_Tm,1);
    putValue(E_pubc_GW_GW_288_Tm,1);
    putValue(E_pubc_GW_GW_1D2_Tm,1);
    putValue(E_pubc_GW_GW_284_Tm,1);
    putValue(E_pubc_GW_GW_2DE_Tm,1);
    putValue(E_pubc_GW_GW_50_Tm,1);
    putValue(E_pubc_GW_GW_20B_Tm,1);
    putValue(E_pubc_GW_GW_1C2_Tm,1);
    putValue(E_pubc_GW_GW_24F_Tm,1);
    putValue(E_pubc_GW_GW_356_Tm,1);
    putValue(E_pubc_GW_GW_3C4_Tm,1);
    putValue(E_pubc_GW_GW_3C2_Tm,1);
    putValue(E_pubc_GW_GW_3AF_Tm,1);
    putValue(E_pubc_GW_GW_2AD_Tm,1);
    putValue(E_pubc_GW_GW_170_Tm,1);
    putValue(E_pubc_GW_GW_2A8_Tm,1);
    putValue(E_pubc_GW_GW_3EE_Tm,1);
    putValue(E_pubc_GW_GW_2C8_Tm,1);
    putValue(E_pubc_GW_GW_NM_Tm,1);
    putValue(E_pubc_GW_GW_17E_Tm,1);
    putValue(E_pubc_GW_GW_2C2_Tm,1);
    putValue(E_pubc_GW_GW_2A4_Tm,1);
    putValue(E_pubc_GW_GW_516_Tm,1);
    putValue(E_pubc_GW_GW_2D2_Tm,1);
    putValue(E_pubc_GW_GW_3D2_Tm,1);
    putValue(E_pubc_GW_GW_180_Tm,1);
    putValue(E_pubc_GW_GW_2BD_Tm,1);
    putValue(E_pubc_GW_GW_2BF_Tm,1);
    putValue(E_pubc_GW_GW_3BD_Tm,1);
    putValue(E_pubc_GW_GW_28B_Tm,1);
}
/*@@end*/

/*@@envVar:E_pubc_GW_CycMsgsOFF:*/
on envVar E_pubc_GW_CycMsgsOFF
{
    // disable all the cyclic messages
    putValue(E_pubc_GW_GW_387_Tm,0);
    putValue(E_pubc_GW_GW_288_Tm,0);
    putValue(E_pubc_GW_GW_1D2_Tm,0);
    putValue(E_pubc_GW_GW_284_Tm,0);
    putValue(E_pubc_GW_GW_2DE_Tm,0);
    putValue(E_pubc_GW_GW_50_Tm,0);
    putValue(E_pubc_GW_GW_20B_Tm,0);
    putValue(E_pubc_GW_GW_1C2_Tm,0);
    putValue(E_pubc_GW_GW_24F_Tm,0);
    putValue(E_pubc_GW_GW_356_Tm,0);
    putValue(E_pubc_GW_GW_3C4_Tm,0);
    putValue(E_pubc_GW_GW_3C2_Tm,0);
    putValue(E_pubc_GW_GW_3AF_Tm,0);
    putValue(E_pubc_GW_GW_2AD_Tm,0);
    putValue(E_pubc_GW_GW_170_Tm,0);
    putValue(E_pubc_GW_GW_2A8_Tm,0);
    putValue(E_pubc_GW_GW_3EE_Tm,0);
    putValue(E_pubc_GW_GW_2C8_Tm,0);
    putValue(E_pubc_GW_GW_NM_Tm,0);
    putValue(E_pubc_GW_GW_17E_Tm,0);
    putValue(E_pubc_GW_GW_2C2_Tm,0);
    putValue(E_pubc_GW_GW_2A4_Tm,0);
    putValue(E_pubc_GW_GW_516_Tm,0);
    putValue(E_pubc_GW_GW_2D2_Tm,0);
    putValue(E_pubc_GW_GW_3D2_Tm,0);
    putValue(E_pubc_GW_GW_180_Tm,0);
    putValue(E_pubc_GW_GW_2BD_Tm,0);
    putValue(E_pubc_GW_GW_2BF_Tm,0);
    putValue(E_pubc_GW_GW_3BD_Tm,0);
    putValue(E_pubc_GW_GW_28B_Tm,0);
    
}
/*@@end*/
/*@@timer:Tm_GW_387:*/
on timer Tm_GW_387
{
    //cyclic message timer 
    if(getValue(E_pubc_GW_GW_387_Tm) == 1)
    {
        
		//update the BZ Signal
        if(GW_387_BCM_RollingCounter_387_wrongvalctr == 0)
        {
            update_GW_387_BCM_RollingCounter_387_counter();
            Msg_GW_387.BCM_RollingCounter_387= GW_387_BCM_RollingCounter_387_counter;
        }
        else if(GW_387_BCM_RollingCounter_387_wrongvalctr > 0)
        {
			GW_387_BCM_RollingCounter_387_counter=GW_387_BCM_RollingCounter_387_counter + GW_387_BCM_RollingCounter_387_wrongvalctr;
			 Msg_GW_387.BCM_RollingCounter_387= GW_387_BCM_RollingCounter_387_counter;
            /* GW_387_BCM_RollingCounter_387_wrongvalctr--;
             // if counter becomes zero, update panel controller to zero
             if(GW_387_BCM_RollingCounter_387_wrongvalctr == 0)
             {
                putValue(E_pubc_GW_GW_387_BCM_RollingCounter_387_wrongvalctr,0);
             } */
        }
        else
        {
            // do nothing
        }
	
        update_GW_387_CRC_CheckSum();
        output(Msg_GW_387);
        
    }
    //Reset Timer
    SetTimer(Tm_GW_387,Cycle_GW_387);
}
/*@@end*/

/*@@envVar:E_pubc_GW_GW_387_cycleTm:*/
on envVar E_pubc_GW_GW_387_cycleTm
{
    // update the cycle time 
    Cycle_GW_387=getvalue(this);
}
/*@@end*/
/*@@timer:Tm_GW_288:*/
on timer Tm_GW_288
{
    //cyclic message timer 
    if(getValue(E_pubc_GW_GW_288_Tm) == 1)
    {
        
		//update the BZ Signal
        if(GW_288_BcmCycCntr288_wrongvalctr == 0)
        {
            update_GW_288_BcmCycCntr288_counter();
            Msg_GW_288.BcmCycCntr288= GW_288_BcmCycCntr288_counter;
        }
        else if(GW_288_BcmCycCntr288_wrongvalctr > 0)
        {
			GW_288_BcmCycCntr288_counter=GW_288_BcmCycCntr288_counter + GW_288_BcmCycCntr288_wrongvalctr;
			 Msg_GW_288.BcmCycCntr288= GW_288_BcmCycCntr288_counter;
            /* GW_288_BcmCycCntr288_wrongvalctr--;
             // if counter becomes zero, update panel controller to zero
             if(GW_288_BcmCycCntr288_wrongvalctr == 0)
             {
                putValue(E_pubc_GW_GW_288_BcmCycCntr288_wrongvalctr,0);
             } */
        }
        else
        {
            // do nothing
        }
	
        update_GW_288_CRC_CheckSum();
        output(Msg_GW_288);
        
    }
    //Reset Timer
    SetTimer(Tm_GW_288,Cycle_GW_288);
}
/*@@end*/

/*@@envVar:E_pubc_GW_GW_288_cycleTm:*/
on envVar E_pubc_GW_GW_288_cycleTm
{
    // update the cycle time 
    Cycle_GW_288=getvalue(this);
}
/*@@end*/
/*@@timer:Tm_GW_1D2:*/
on timer Tm_GW_1D2
{
    //cyclic message timer 
    if(getValue(E_pubc_GW_GW_1D2_Tm) == 1)
    {
        
		//update the BZ Signal
        if(GW_1D2_EspCycCntr1D2_wrongvalctr == 0)
        {
            update_GW_1D2_EspCycCntr1D2_counter();
            Msg_GW_1D2.EspCycCntr1D2= GW_1D2_EspCycCntr1D2_counter;
        }
        else if(GW_1D2_EspCycCntr1D2_wrongvalctr > 0)
        {
			GW_1D2_EspCycCntr1D2_counter=GW_1D2_EspCycCntr1D2_counter + GW_1D2_EspCycCntr1D2_wrongvalctr;
			 Msg_GW_1D2.EspCycCntr1D2= GW_1D2_EspCycCntr1D2_counter;
            /* GW_1D2_EspCycCntr1D2_wrongvalctr--;
             // if counter becomes zero, update panel controller to zero
             if(GW_1D2_EspCycCntr1D2_wrongvalctr == 0)
             {
                putValue(E_pubc_GW_GW_1D2_EspCycCntr1D2_wrongvalctr,0);
             } */
        }
        else
        {
            // do nothing
        }
	
        update_GW_1D2_CRC_CheckSum();
        output(Msg_GW_1D2);
        
    }
    //Reset Timer
    SetTimer(Tm_GW_1D2,Cycle_GW_1D2);
}
/*@@end*/

/*@@envVar:E_pubc_GW_GW_1D2_cycleTm:*/
on envVar E_pubc_GW_GW_1D2_cycleTm
{
    // update the cycle time 
    Cycle_GW_1D2=getvalue(this);
}
/*@@end*/
/*@@timer:Tm_GW_284:*/
on timer Tm_GW_284
{
    //cyclic message timer 
    if(getValue(E_pubc_GW_GW_284_Tm) == 1)
    {
        
		//update the BZ Signal
	
        output(Msg_GW_284);
        
    }
    //Reset Timer
    SetTimer(Tm_GW_284,Cycle_GW_284);
}
/*@@end*/

/*@@envVar:E_pubc_GW_GW_284_cycleTm:*/
on envVar E_pubc_GW_GW_284_cycleTm
{
    // update the cycle time 
    Cycle_GW_284=getvalue(this);
}
/*@@end*/
/*@@timer:Tm_GW_2DE:*/
on timer Tm_GW_2DE
{
    //cyclic message timer 
    if(getValue(E_pubc_GW_GW_2DE_Tm) == 1)
    {
        
		//update the BZ Signal
        if(GW_2DE_IP_RollingCounter_2DE_wrongvalctr == 0)
        {
            update_GW_2DE_IP_RollingCounter_2DE_counter();
            Msg_GW_2DE.IP_RollingCounter_2DE= GW_2DE_IP_RollingCounter_2DE_counter;
        }
        else if(GW_2DE_IP_RollingCounter_2DE_wrongvalctr > 0)
        {
			GW_2DE_IP_RollingCounter_2DE_counter=GW_2DE_IP_RollingCounter_2DE_counter + GW_2DE_IP_RollingCounter_2DE_wrongvalctr;
			 Msg_GW_2DE.IP_RollingCounter_2DE= GW_2DE_IP_RollingCounter_2DE_counter;
            /* GW_2DE_IP_RollingCounter_2DE_wrongvalctr--;
             // if counter becomes zero, update panel controller to zero
             if(GW_2DE_IP_RollingCounter_2DE_wrongvalctr == 0)
             {
                putValue(E_pubc_GW_GW_2DE_IP_RollingCounter_2DE_wrongvalctr,0);
             } */
        }
        else
        {
            // do nothing
        }
	
        update_GW_2DE_CRC_CheckSum();
        output(Msg_GW_2DE);
        
    }
    //Reset Timer
    SetTimer(Tm_GW_2DE,Cycle_GW_2DE);
}
/*@@end*/

/*@@envVar:E_pubc_GW_GW_2DE_cycleTm:*/
on envVar E_pubc_GW_GW_2DE_cycleTm
{
    // update the cycle time 
    Cycle_GW_2DE=getvalue(this);
}
/*@@end*/
/*@@timer:Tm_GW_50:*/
on timer Tm_GW_50
{
    //cyclic message timer 
    if(getValue(E_pubc_GW_GW_50_Tm) == 1)
    {
        
		//update the BZ Signal
        if(GW_50_SrsCycCntr050_wrongvalctr == 0)
        {
            update_GW_50_SrsCycCntr050_counter();
            Msg_GW_50.SrsCycCntr050= GW_50_SrsCycCntr050_counter;
        }
        else if(GW_50_SrsCycCntr050_wrongvalctr > 0)
        {
			GW_50_SrsCycCntr050_counter=GW_50_SrsCycCntr050_counter + GW_50_SrsCycCntr050_wrongvalctr;
			 Msg_GW_50.SrsCycCntr050= GW_50_SrsCycCntr050_counter;
            /* GW_50_SrsCycCntr050_wrongvalctr--;
             // if counter becomes zero, update panel controller to zero
             if(GW_50_SrsCycCntr050_wrongvalctr == 0)
             {
                putValue(E_pubc_GW_GW_50_SrsCycCntr050_wrongvalctr,0);
             } */
        }
        else
        {
            // do nothing
        }
	
        update_GW_50_CRC_CheckSum();
        output(Msg_GW_50);
        
    }
    //Reset Timer
    SetTimer(Tm_GW_50,Cycle_GW_50);
}
/*@@end*/

/*@@envVar:E_pubc_GW_GW_50_cycleTm:*/
on envVar E_pubc_GW_GW_50_cycleTm
{
    // update the cycle time 
    Cycle_GW_50=getvalue(this);
}
/*@@end*/
/*@@timer:Tm_GW_20B:*/
on timer Tm_GW_20B
{
    //cyclic message timer 
    if(getValue(E_pubc_GW_GW_20B_Tm) == 1)
    {
        
		//update the BZ Signal
        if(GW_20B_EspCycCntr20B_wrongvalctr == 0)
        {
            update_GW_20B_EspCycCntr20B_counter();
            Msg_GW_20B.EspCycCntr20B= GW_20B_EspCycCntr20B_counter;
        }
        else if(GW_20B_EspCycCntr20B_wrongvalctr > 0)
        {
			GW_20B_EspCycCntr20B_counter=GW_20B_EspCycCntr20B_counter + GW_20B_EspCycCntr20B_wrongvalctr;
			 Msg_GW_20B.EspCycCntr20B= GW_20B_EspCycCntr20B_counter;
            /* GW_20B_EspCycCntr20B_wrongvalctr--;
             // if counter becomes zero, update panel controller to zero
             if(GW_20B_EspCycCntr20B_wrongvalctr == 0)
             {
                putValue(E_pubc_GW_GW_20B_EspCycCntr20B_wrongvalctr,0);
             } */
        }
        else
        {
            // do nothing
        }
	
        update_GW_20B_CRC_CheckSum();
        output(Msg_GW_20B);
        
    }
    //Reset Timer
    SetTimer(Tm_GW_20B,Cycle_GW_20B);
}
/*@@end*/

/*@@envVar:E_pubc_GW_GW_20B_cycleTm:*/
on envVar E_pubc_GW_GW_20B_cycleTm
{
    // update the cycle time 
    Cycle_GW_20B=getvalue(this);
}
/*@@end*/
/*@@timer:Tm_GW_1C2:*/
on timer Tm_GW_1C2
{
    //cyclic message timer 
    if(getValue(E_pubc_GW_GW_1C2_Tm) == 1)
    {
        
		//update the BZ Signal
        if(GW_1C2_EspCycCntr1C2_wrongvalctr == 0)
        {
            update_GW_1C2_EspCycCntr1C2_counter();
            Msg_GW_1C2.EspCycCntr1C2= GW_1C2_EspCycCntr1C2_counter;
        }
        else if(GW_1C2_EspCycCntr1C2_wrongvalctr > 0)
        {
			GW_1C2_EspCycCntr1C2_counter=GW_1C2_EspCycCntr1C2_counter + GW_1C2_EspCycCntr1C2_wrongvalctr;
			 Msg_GW_1C2.EspCycCntr1C2= GW_1C2_EspCycCntr1C2_counter;
            /* GW_1C2_EspCycCntr1C2_wrongvalctr--;
             // if counter becomes zero, update panel controller to zero
             if(GW_1C2_EspCycCntr1C2_wrongvalctr == 0)
             {
                putValue(E_pubc_GW_GW_1C2_EspCycCntr1C2_wrongvalctr,0);
             } */
        }
        else
        {
            // do nothing
        }
	
        update_GW_1C2_CRC_CheckSum();
        output(Msg_GW_1C2);
        
    }
    //Reset Timer
    SetTimer(Tm_GW_1C2,Cycle_GW_1C2);
}
/*@@end*/

/*@@envVar:E_pubc_GW_GW_1C2_cycleTm:*/
on envVar E_pubc_GW_GW_1C2_cycleTm
{
    // update the cycle time 
    Cycle_GW_1C2=getvalue(this);
}
/*@@end*/
/*@@timer:Tm_GW_24F:*/
on timer Tm_GW_24F
{
    //cyclic message timer 
    if(getValue(E_pubc_GW_GW_24F_Tm) == 1)
    {
        
		//update the BZ Signal
        if(GW_24F_EPS_RollingCounter_24F_wrongvalctr == 0)
        {
            update_GW_24F_EPS_RollingCounter_24F_counter();
            Msg_GW_24F.EPS_RollingCounter_24F= GW_24F_EPS_RollingCounter_24F_counter;
        }
        else if(GW_24F_EPS_RollingCounter_24F_wrongvalctr > 0)
        {
			GW_24F_EPS_RollingCounter_24F_counter=GW_24F_EPS_RollingCounter_24F_counter + GW_24F_EPS_RollingCounter_24F_wrongvalctr;
			 Msg_GW_24F.EPS_RollingCounter_24F= GW_24F_EPS_RollingCounter_24F_counter;
            /* GW_24F_EPS_RollingCounter_24F_wrongvalctr--;
             // if counter becomes zero, update panel controller to zero
             if(GW_24F_EPS_RollingCounter_24F_wrongvalctr == 0)
             {
                putValue(E_pubc_GW_GW_24F_EPS_RollingCounter_24F_wrongvalctr,0);
             } */
        }
        else
        {
            // do nothing
        }
	
        update_GW_24F_CRC_CheckSum();
        output(Msg_GW_24F);
        
    }
    //Reset Timer
    SetTimer(Tm_GW_24F,Cycle_GW_24F);
}
/*@@end*/

/*@@envVar:E_pubc_GW_GW_24F_cycleTm:*/
on envVar E_pubc_GW_GW_24F_cycleTm
{
    // update the cycle time 
    Cycle_GW_24F=getvalue(this);
}
/*@@end*/
/*@@timer:Tm_GW_356:*/
on timer Tm_GW_356
{
    //cyclic message timer 
    if(getValue(E_pubc_GW_GW_356_Tm) == 1)
    {
        
		//update the BZ Signal
        if(GW_356_IMS_RollingCounter_356_wrongvalctr == 0)
        {
            update_GW_356_IMS_RollingCounter_356_counter();
            Msg_GW_356.IMS_RollingCounter_356= GW_356_IMS_RollingCounter_356_counter;
        }
        else if(GW_356_IMS_RollingCounter_356_wrongvalctr > 0)
        {
			GW_356_IMS_RollingCounter_356_counter=GW_356_IMS_RollingCounter_356_counter + GW_356_IMS_RollingCounter_356_wrongvalctr;
			 Msg_GW_356.IMS_RollingCounter_356= GW_356_IMS_RollingCounter_356_counter;
            /* GW_356_IMS_RollingCounter_356_wrongvalctr--;
             // if counter becomes zero, update panel controller to zero
             if(GW_356_IMS_RollingCounter_356_wrongvalctr == 0)
             {
                putValue(E_pubc_GW_GW_356_IMS_RollingCounter_356_wrongvalctr,0);
             } */
        }
        else
        {
            // do nothing
        }
        if(GW_356_IMS_RollingCounter_360_wrongvalctr == 0)
        {
            update_GW_356_IMS_RollingCounter_360_counter();
            Msg_GW_356.IMS_RollingCounter_360= GW_356_IMS_RollingCounter_360_counter;
        }
        else if(GW_356_IMS_RollingCounter_360_wrongvalctr > 0)
        {
			GW_356_IMS_RollingCounter_360_counter=GW_356_IMS_RollingCounter_360_counter + GW_356_IMS_RollingCounter_360_wrongvalctr;
			 Msg_GW_356.IMS_RollingCounter_360= GW_356_IMS_RollingCounter_360_counter;
            /* GW_356_IMS_RollingCounter_360_wrongvalctr--;
             // if counter becomes zero, update panel controller to zero
             if(GW_356_IMS_RollingCounter_360_wrongvalctr == 0)
             {
                putValue(E_pubc_GW_GW_356_IMS_RollingCounter_360_wrongvalctr,0);
             } */
        }
        else
        {
            // do nothing
        }
	
        update_GW_356_CRC_CheckSum();
        output(Msg_GW_356);
        
    }
    //Reset Timer
    SetTimer(Tm_GW_356,Cycle_GW_356);
}
/*@@end*/

/*@@envVar:E_pubc_GW_GW_356_cycleTm:*/
on envVar E_pubc_GW_GW_356_cycleTm
{
    // update the cycle time 
    Cycle_GW_356=getvalue(this);
}
/*@@end*/
/*@@timer:Tm_GW_3C4:*/
on timer Tm_GW_3C4
{
    //cyclic message timer 
    if(getValue(E_pubc_GW_GW_3C4_Tm) == 1)
    {
        
		//update the BZ Signal
        if(GW_3C4_HU_RollingCounter_3B8_wrongvalctr == 0)
        {
            update_GW_3C4_HU_RollingCounter_3B8_counter();
            Msg_GW_3C4.HU_RollingCounter_3B8= GW_3C4_HU_RollingCounter_3B8_counter;
        }
        else if(GW_3C4_HU_RollingCounter_3B8_wrongvalctr > 0)
        {
			GW_3C4_HU_RollingCounter_3B8_counter=GW_3C4_HU_RollingCounter_3B8_counter + GW_3C4_HU_RollingCounter_3B8_wrongvalctr;
			 Msg_GW_3C4.HU_RollingCounter_3B8= GW_3C4_HU_RollingCounter_3B8_counter;
            /* GW_3C4_HU_RollingCounter_3B8_wrongvalctr--;
             // if counter becomes zero, update panel controller to zero
             if(GW_3C4_HU_RollingCounter_3B8_wrongvalctr == 0)
             {
                putValue(E_pubc_GW_GW_3C4_HU_RollingCounter_3B8_wrongvalctr,0);
             } */
        }
        else
        {
            // do nothing
        }
        if(GW_3C4_HU_RollingCounter_3C4_wrongvalctr == 0)
        {
            update_GW_3C4_HU_RollingCounter_3C4_counter();
            Msg_GW_3C4.HU_RollingCounter_3C4= GW_3C4_HU_RollingCounter_3C4_counter;
        }
        else if(GW_3C4_HU_RollingCounter_3C4_wrongvalctr > 0)
        {
			GW_3C4_HU_RollingCounter_3C4_counter=GW_3C4_HU_RollingCounter_3C4_counter + GW_3C4_HU_RollingCounter_3C4_wrongvalctr;
			 Msg_GW_3C4.HU_RollingCounter_3C4= GW_3C4_HU_RollingCounter_3C4_counter;
            /* GW_3C4_HU_RollingCounter_3C4_wrongvalctr--;
             // if counter becomes zero, update panel controller to zero
             if(GW_3C4_HU_RollingCounter_3C4_wrongvalctr == 0)
             {
                putValue(E_pubc_GW_GW_3C4_HU_RollingCounter_3C4_wrongvalctr,0);
             } */
        }
        else
        {
            // do nothing
        }
        if(GW_3C4_HU_RollingCounter_3C2_wrongvalctr == 0)
        {
            update_GW_3C4_HU_RollingCounter_3C2_counter();
            Msg_GW_3C4.HU_RollingCounter_3C2= GW_3C4_HU_RollingCounter_3C2_counter;
        }
        else if(GW_3C4_HU_RollingCounter_3C2_wrongvalctr > 0)
        {
			GW_3C4_HU_RollingCounter_3C2_counter=GW_3C4_HU_RollingCounter_3C2_counter + GW_3C4_HU_RollingCounter_3C2_wrongvalctr;
			 Msg_GW_3C4.HU_RollingCounter_3C2= GW_3C4_HU_RollingCounter_3C2_counter;
            /* GW_3C4_HU_RollingCounter_3C2_wrongvalctr--;
             // if counter becomes zero, update panel controller to zero
             if(GW_3C4_HU_RollingCounter_3C2_wrongvalctr == 0)
             {
                putValue(E_pubc_GW_GW_3C4_HU_RollingCounter_3C2_wrongvalctr,0);
             } */
        }
        else
        {
            // do nothing
        }
        if(GW_3C4_HU_RollingCounter_3C6_wrongvalctr == 0)
        {
            update_GW_3C4_HU_RollingCounter_3C6_counter();
            Msg_GW_3C4.HU_RollingCounter_3C6= GW_3C4_HU_RollingCounter_3C6_counter;
        }
        else if(GW_3C4_HU_RollingCounter_3C6_wrongvalctr > 0)
        {
			GW_3C4_HU_RollingCounter_3C6_counter=GW_3C4_HU_RollingCounter_3C6_counter + GW_3C4_HU_RollingCounter_3C6_wrongvalctr;
			 Msg_GW_3C4.HU_RollingCounter_3C6= GW_3C4_HU_RollingCounter_3C6_counter;
            /* GW_3C4_HU_RollingCounter_3C6_wrongvalctr--;
             // if counter becomes zero, update panel controller to zero
             if(GW_3C4_HU_RollingCounter_3C6_wrongvalctr == 0)
             {
                putValue(E_pubc_GW_GW_3C4_HU_RollingCounter_3C6_wrongvalctr,0);
             } */
        }
        else
        {
            // do nothing
        }
        if(GW_3C4_HU_RollingCounter_3C7_wrongvalctr == 0)
        {
            update_GW_3C4_HU_RollingCounter_3C7_counter();
            Msg_GW_3C4.HU_RollingCounter_3C7= GW_3C4_HU_RollingCounter_3C7_counter;
        }
        else if(GW_3C4_HU_RollingCounter_3C7_wrongvalctr > 0)
        {
			GW_3C4_HU_RollingCounter_3C7_counter=GW_3C4_HU_RollingCounter_3C7_counter + GW_3C4_HU_RollingCounter_3C7_wrongvalctr;
			 Msg_GW_3C4.HU_RollingCounter_3C7= GW_3C4_HU_RollingCounter_3C7_counter;
            /* GW_3C4_HU_RollingCounter_3C7_wrongvalctr--;
             // if counter becomes zero, update panel controller to zero
             if(GW_3C4_HU_RollingCounter_3C7_wrongvalctr == 0)
             {
                putValue(E_pubc_GW_GW_3C4_HU_RollingCounter_3C7_wrongvalctr,0);
             } */
        }
        else
        {
            // do nothing
        }
	
        update_GW_3C4_CRC_CheckSum();
        output(Msg_GW_3C4);
        
    }
    //Reset Timer
    SetTimer(Tm_GW_3C4,Cycle_GW_3C4);
}
/*@@end*/

/*@@envVar:E_pubc_GW_GW_3C4_cycleTm:*/
on envVar E_pubc_GW_GW_3C4_cycleTm
{
    // update the cycle time 
    Cycle_GW_3C4=getvalue(this);
}
/*@@end*/
/*@@timer:Tm_GW_3C2:*/
on timer Tm_GW_3C2
{
    //cyclic message timer 
    if(getValue(E_pubc_GW_GW_3C2_Tm) == 1)
    {
        
		//update the BZ Signal
        if(GW_3C2_EspCycCntr3C2_wrongvalctr == 0)
        {
            update_GW_3C2_EspCycCntr3C2_counter();
            Msg_GW_3C2.EspCycCntr3C2= GW_3C2_EspCycCntr3C2_counter;
        }
        else if(GW_3C2_EspCycCntr3C2_wrongvalctr > 0)
        {
			GW_3C2_EspCycCntr3C2_counter=GW_3C2_EspCycCntr3C2_counter + GW_3C2_EspCycCntr3C2_wrongvalctr;
			 Msg_GW_3C2.EspCycCntr3C2= GW_3C2_EspCycCntr3C2_counter;
            /* GW_3C2_EspCycCntr3C2_wrongvalctr--;
             // if counter becomes zero, update panel controller to zero
             if(GW_3C2_EspCycCntr3C2_wrongvalctr == 0)
             {
                putValue(E_pubc_GW_GW_3C2_EspCycCntr3C2_wrongvalctr,0);
             } */
        }
        else
        {
            // do nothing
        }
	
        update_GW_3C2_CRC_CheckSum();
        output(Msg_GW_3C2);
        
    }
    //Reset Timer
    SetTimer(Tm_GW_3C2,Cycle_GW_3C2);
}
/*@@end*/

/*@@envVar:E_pubc_GW_GW_3C2_cycleTm:*/
on envVar E_pubc_GW_GW_3C2_cycleTm
{
    // update the cycle time 
    Cycle_GW_3C2=getvalue(this);
}
/*@@end*/
/*@@timer:Tm_GW_3AF:*/
on timer Tm_GW_3AF
{
    //cyclic message timer 
    if(getValue(E_pubc_GW_GW_3AF_Tm) == 1)
    {
        
		//update the BZ Signal
        if(GW_3AF_HU_RollingCounter_3BB_wrongvalctr == 0)
        {
            update_GW_3AF_HU_RollingCounter_3BB_counter();
            Msg_GW_3AF.HU_RollingCounter_3BB= GW_3AF_HU_RollingCounter_3BB_counter;
        }
        else if(GW_3AF_HU_RollingCounter_3BB_wrongvalctr > 0)
        {
			GW_3AF_HU_RollingCounter_3BB_counter=GW_3AF_HU_RollingCounter_3BB_counter + GW_3AF_HU_RollingCounter_3BB_wrongvalctr;
			 Msg_GW_3AF.HU_RollingCounter_3BB= GW_3AF_HU_RollingCounter_3BB_counter;
            /* GW_3AF_HU_RollingCounter_3BB_wrongvalctr--;
             // if counter becomes zero, update panel controller to zero
             if(GW_3AF_HU_RollingCounter_3BB_wrongvalctr == 0)
             {
                putValue(E_pubc_GW_GW_3AF_HU_RollingCounter_3BB_wrongvalctr,0);
             } */
        }
        else
        {
            // do nothing
        }
        if(GW_3AF_HU_RollingCounter_3AF_wrongvalctr == 0)
        {
            update_GW_3AF_HU_RollingCounter_3AF_counter();
            Msg_GW_3AF.HU_RollingCounter_3AF= GW_3AF_HU_RollingCounter_3AF_counter;
        }
        else if(GW_3AF_HU_RollingCounter_3AF_wrongvalctr > 0)
        {
			GW_3AF_HU_RollingCounter_3AF_counter=GW_3AF_HU_RollingCounter_3AF_counter + GW_3AF_HU_RollingCounter_3AF_wrongvalctr;
			 Msg_GW_3AF.HU_RollingCounter_3AF= GW_3AF_HU_RollingCounter_3AF_counter;
            /* GW_3AF_HU_RollingCounter_3AF_wrongvalctr--;
             // if counter becomes zero, update panel controller to zero
             if(GW_3AF_HU_RollingCounter_3AF_wrongvalctr == 0)
             {
                putValue(E_pubc_GW_GW_3AF_HU_RollingCounter_3AF_wrongvalctr,0);
             } */
        }
        else
        {
            // do nothing
        }
	
        update_GW_3AF_CRC_CheckSum();
        output(Msg_GW_3AF);
        
    }
    //Reset Timer
    SetTimer(Tm_GW_3AF,Cycle_GW_3AF);
}
/*@@end*/

/*@@envVar:E_pubc_GW_GW_3AF_cycleTm:*/
on envVar E_pubc_GW_GW_3AF_cycleTm
{
    // update the cycle time 
    Cycle_GW_3AF=getvalue(this);
}
/*@@end*/
/*@@timer:Tm_GW_2AD:*/
on timer Tm_GW_2AD
{
    //cyclic message timer 
    if(getValue(E_pubc_GW_GW_2AD_Tm) == 1)
    {
        
		//update the BZ Signal
	
        output(Msg_GW_2AD);
        
    }
    //Reset Timer
    SetTimer(Tm_GW_2AD,Cycle_GW_2AD);
}
/*@@end*/

/*@@envVar:E_pubc_GW_GW_2AD_cycleTm:*/
on envVar E_pubc_GW_GW_2AD_cycleTm
{
    // update the cycle time 
    Cycle_GW_2AD=getvalue(this);
}
/*@@end*/
/*@@timer:Tm_GW_170:*/
on timer Tm_GW_170
{
    //cyclic message timer 
    if(getValue(E_pubc_GW_GW_170_Tm) == 1)
    {
        
		//update the BZ Signal
        if(GW_170_EPS_RollingCounter_170_wrongvalctr == 0)
        {
            update_GW_170_EPS_RollingCounter_170_counter();
            Msg_GW_170.EPS_RollingCounter_170= GW_170_EPS_RollingCounter_170_counter;
        }
        else if(GW_170_EPS_RollingCounter_170_wrongvalctr > 0)
        {
			GW_170_EPS_RollingCounter_170_counter=GW_170_EPS_RollingCounter_170_counter + GW_170_EPS_RollingCounter_170_wrongvalctr;
			 Msg_GW_170.EPS_RollingCounter_170= GW_170_EPS_RollingCounter_170_counter;
            /* GW_170_EPS_RollingCounter_170_wrongvalctr--;
             // if counter becomes zero, update panel controller to zero
             if(GW_170_EPS_RollingCounter_170_wrongvalctr == 0)
             {
                putValue(E_pubc_GW_GW_170_EPS_RollingCounter_170_wrongvalctr,0);
             } */
        }
        else
        {
            // do nothing
        }
	
        update_GW_170_CRC_CheckSum();
        output(Msg_GW_170);
        
    }
    //Reset Timer
    SetTimer(Tm_GW_170,Cycle_GW_170);
}
/*@@end*/

/*@@envVar:E_pubc_GW_GW_170_cycleTm:*/
on envVar E_pubc_GW_GW_170_cycleTm
{
    // update the cycle time 
    Cycle_GW_170=getvalue(this);
}
/*@@end*/
/*@@timer:Tm_GW_2A8:*/
on timer Tm_GW_2A8
{
    //cyclic message timer 
    if(getValue(E_pubc_GW_GW_2A8_Tm) == 1)
    {
        
		//update the BZ Signal
	
        output(Msg_GW_2A8);
        
    }
    //Reset Timer
    SetTimer(Tm_GW_2A8,Cycle_GW_2A8);
}
/*@@end*/

/*@@envVar:E_pubc_GW_GW_2A8_cycleTm:*/
on envVar E_pubc_GW_GW_2A8_cycleTm
{
    // update the cycle time 
    Cycle_GW_2A8=getvalue(this);
}
/*@@end*/
/*@@timer:Tm_GW_3EE:*/
on timer Tm_GW_3EE
{
    //cyclic message timer 
    if(getValue(E_pubc_GW_GW_3EE_Tm) == 1)
    {
        
		//update the BZ Signal
	
        output(Msg_GW_3EE);
        
    }
    //Reset Timer
    SetTimer(Tm_GW_3EE,Cycle_GW_3EE);
}
/*@@end*/

/*@@envVar:E_pubc_GW_GW_3EE_cycleTm:*/
on envVar E_pubc_GW_GW_3EE_cycleTm
{
    // update the cycle time 
    Cycle_GW_3EE=getvalue(this);
}
/*@@end*/
/*@@timer:Tm_GW_2C8:*/
on timer Tm_GW_2C8
{
    //cyclic message timer 
    if(getValue(E_pubc_GW_GW_2C8_Tm) == 1)
    {
        
		//update the BZ Signal
        if(GW_2C8_RRC_RollingCounter_2C8_wrongvalctr == 0)
        {
            update_GW_2C8_RRC_RollingCounter_2C8_counter();
            Msg_GW_2C8.RRC_RollingCounter_2C8= GW_2C8_RRC_RollingCounter_2C8_counter;
        }
        else if(GW_2C8_RRC_RollingCounter_2C8_wrongvalctr > 0)
        {
			GW_2C8_RRC_RollingCounter_2C8_counter=GW_2C8_RRC_RollingCounter_2C8_counter + GW_2C8_RRC_RollingCounter_2C8_wrongvalctr;
			 Msg_GW_2C8.RRC_RollingCounter_2C8= GW_2C8_RRC_RollingCounter_2C8_counter;
            /* GW_2C8_RRC_RollingCounter_2C8_wrongvalctr--;
             // if counter becomes zero, update panel controller to zero
             if(GW_2C8_RRC_RollingCounter_2C8_wrongvalctr == 0)
             {
                putValue(E_pubc_GW_GW_2C8_RRC_RollingCounter_2C8_wrongvalctr,0);
             } */
        }
        else
        {
            // do nothing
        }
	
        update_GW_2C8_CRC_CheckSum();
        output(Msg_GW_2C8);
        
    }
    //Reset Timer
    SetTimer(Tm_GW_2C8,Cycle_GW_2C8);
}
/*@@end*/

/*@@envVar:E_pubc_GW_GW_2C8_cycleTm:*/
on envVar E_pubc_GW_GW_2C8_cycleTm
{
    // update the cycle time 
    Cycle_GW_2C8=getvalue(this);
}
/*@@end*/
/*@@timer:Tm_GW_NM:*/
on timer Tm_GW_NM
{
    //cyclic message timer 
    if(getValue(E_pubc_GW_GW_NM_Tm) == 1)
    {
        
		//update the BZ Signal
	
        output(Msg_GW_NM);
        
    }
    //Reset Timer
    SetTimer(Tm_GW_NM,Cycle_GW_NM);
}
/*@@end*/

/*@@envVar:E_pubc_GW_GW_NM_cycleTm:*/
on envVar E_pubc_GW_GW_NM_cycleTm
{
    // update the cycle time 
    Cycle_GW_NM=getvalue(this);
}
/*@@end*/
/*@@timer:Tm_GW_17E:*/
on timer Tm_GW_17E
{
    //cyclic message timer 
    if(getValue(E_pubc_GW_GW_17E_Tm) == 1)
    {
        
		//update the BZ Signal
        if(GW_17E_EPS_RollingCounter_17E_wrongvalctr == 0)
        {
            update_GW_17E_EPS_RollingCounter_17E_counter();
            Msg_GW_17E.EPS_RollingCounter_17E= GW_17E_EPS_RollingCounter_17E_counter;
        }
        else if(GW_17E_EPS_RollingCounter_17E_wrongvalctr > 0)
        {
			GW_17E_EPS_RollingCounter_17E_counter=GW_17E_EPS_RollingCounter_17E_counter + GW_17E_EPS_RollingCounter_17E_wrongvalctr;
			 Msg_GW_17E.EPS_RollingCounter_17E= GW_17E_EPS_RollingCounter_17E_counter;
            /* GW_17E_EPS_RollingCounter_17E_wrongvalctr--;
             // if counter becomes zero, update panel controller to zero
             if(GW_17E_EPS_RollingCounter_17E_wrongvalctr == 0)
             {
                putValue(E_pubc_GW_GW_17E_EPS_RollingCounter_17E_wrongvalctr,0);
             } */
        }
        else
        {
            // do nothing
        }
	
        update_GW_17E_CRC_CheckSum();
        output(Msg_GW_17E);
        
    }
    //Reset Timer
    SetTimer(Tm_GW_17E,Cycle_GW_17E);
}
/*@@end*/

/*@@envVar:E_pubc_GW_GW_17E_cycleTm:*/
on envVar E_pubc_GW_GW_17E_cycleTm
{
    // update the cycle time 
    Cycle_GW_17E=getvalue(this);
}
/*@@end*/
/*@@timer:Tm_GW_2C2:*/
on timer Tm_GW_2C2
{
    //cyclic message timer 
    if(getValue(E_pubc_GW_GW_2C2_Tm) == 1)
    {
        
		//update the BZ Signal
        if(GW_2C2_IbCycCntr2C2_wrongvalctr == 0)
        {
            update_GW_2C2_IbCycCntr2C2_counter();
            Msg_GW_2C2.IbCycCntr2C2= GW_2C2_IbCycCntr2C2_counter;
        }
        else if(GW_2C2_IbCycCntr2C2_wrongvalctr > 0)
        {
			GW_2C2_IbCycCntr2C2_counter=GW_2C2_IbCycCntr2C2_counter + GW_2C2_IbCycCntr2C2_wrongvalctr;
			 Msg_GW_2C2.IbCycCntr2C2= GW_2C2_IbCycCntr2C2_counter;
            /* GW_2C2_IbCycCntr2C2_wrongvalctr--;
             // if counter becomes zero, update panel controller to zero
             if(GW_2C2_IbCycCntr2C2_wrongvalctr == 0)
             {
                putValue(E_pubc_GW_GW_2C2_IbCycCntr2C2_wrongvalctr,0);
             } */
        }
        else
        {
            // do nothing
        }
	
        update_GW_2C2_CRC_CheckSum();
        output(Msg_GW_2C2);
        
    }
    //Reset Timer
    SetTimer(Tm_GW_2C2,Cycle_GW_2C2);
}
/*@@end*/

/*@@envVar:E_pubc_GW_GW_2C2_cycleTm:*/
on envVar E_pubc_GW_GW_2C2_cycleTm
{
    // update the cycle time 
    Cycle_GW_2C2=getvalue(this);
}
/*@@end*/
/*@@timer:Tm_GW_2A4:*/
on timer Tm_GW_2A4
{
    //cyclic message timer 
    if(getValue(E_pubc_GW_GW_2A4_Tm) == 1)
    {
        
		//update the BZ Signal
        if(GW_2A4_LCDAR_RollingCounter_2AF_wrongvalctr == 0)
        {
            update_GW_2A4_LCDAR_RollingCounter_2AF_counter();
            Msg_GW_2A4.LCDAR_RollingCounter_2AF= GW_2A4_LCDAR_RollingCounter_2AF_counter;
        }
        else if(GW_2A4_LCDAR_RollingCounter_2AF_wrongvalctr > 0)
        {
			GW_2A4_LCDAR_RollingCounter_2AF_counter=GW_2A4_LCDAR_RollingCounter_2AF_counter + GW_2A4_LCDAR_RollingCounter_2AF_wrongvalctr;
			 Msg_GW_2A4.LCDAR_RollingCounter_2AF= GW_2A4_LCDAR_RollingCounter_2AF_counter;
            /* GW_2A4_LCDAR_RollingCounter_2AF_wrongvalctr--;
             // if counter becomes zero, update panel controller to zero
             if(GW_2A4_LCDAR_RollingCounter_2AF_wrongvalctr == 0)
             {
                putValue(E_pubc_GW_GW_2A4_LCDAR_RollingCounter_2AF_wrongvalctr,0);
             } */
        }
        else
        {
            // do nothing
        }
        if(GW_2A4_RRC_RollingCounter_2A4_wrongvalctr == 0)
        {
            update_GW_2A4_RRC_RollingCounter_2A4_counter();
            Msg_GW_2A4.RRC_RollingCounter_2A4= GW_2A4_RRC_RollingCounter_2A4_counter;
        }
        else if(GW_2A4_RRC_RollingCounter_2A4_wrongvalctr > 0)
        {
			GW_2A4_RRC_RollingCounter_2A4_counter=GW_2A4_RRC_RollingCounter_2A4_counter + GW_2A4_RRC_RollingCounter_2A4_wrongvalctr;
			 Msg_GW_2A4.RRC_RollingCounter_2A4= GW_2A4_RRC_RollingCounter_2A4_counter;
            /* GW_2A4_RRC_RollingCounter_2A4_wrongvalctr--;
             // if counter becomes zero, update panel controller to zero
             if(GW_2A4_RRC_RollingCounter_2A4_wrongvalctr == 0)
             {
                putValue(E_pubc_GW_GW_2A4_RRC_RollingCounter_2A4_wrongvalctr,0);
             } */
        }
        else
        {
            // do nothing
        }
	
        update_GW_2A4_CRC_CheckSum();
        output(Msg_GW_2A4);
        
    }
    //Reset Timer
    SetTimer(Tm_GW_2A4,Cycle_GW_2A4);
}
/*@@end*/

/*@@envVar:E_pubc_GW_GW_2A4_cycleTm:*/
on envVar E_pubc_GW_GW_2A4_cycleTm
{
    // update the cycle time 
    Cycle_GW_2A4=getvalue(this);
}
/*@@end*/
/*@@timer:Tm_GW_516:*/
on timer Tm_GW_516
{
    //cyclic message timer 
    if(getValue(E_pubc_GW_GW_516_Tm) == 1)
    {
        
		//update the BZ Signal
	
        output(Msg_GW_516);
        
    }
    //Reset Timer
    SetTimer(Tm_GW_516,Cycle_GW_516);
}
/*@@end*/

/*@@envVar:E_pubc_GW_GW_516_cycleTm:*/
on envVar E_pubc_GW_GW_516_cycleTm
{
    // update the cycle time 
    Cycle_GW_516=getvalue(this);
}
/*@@end*/
/*@@timer:Tm_GW_2D2:*/
on timer Tm_GW_2D2
{
    //cyclic message timer 
    if(getValue(E_pubc_GW_GW_2D2_Tm) == 1)
    {
        
		//update the BZ Signal
        if(GW_2D2_CdcCycCntr2D2_wrongvalctr == 0)
        {
            update_GW_2D2_CdcCycCntr2D2_counter();
            Msg_GW_2D2.CdcCycCntr2D2= GW_2D2_CdcCycCntr2D2_counter;
        }
        else if(GW_2D2_CdcCycCntr2D2_wrongvalctr > 0)
        {
			GW_2D2_CdcCycCntr2D2_counter=GW_2D2_CdcCycCntr2D2_counter + GW_2D2_CdcCycCntr2D2_wrongvalctr;
			 Msg_GW_2D2.CdcCycCntr2D2= GW_2D2_CdcCycCntr2D2_counter;
            /* GW_2D2_CdcCycCntr2D2_wrongvalctr--;
             // if counter becomes zero, update panel controller to zero
             if(GW_2D2_CdcCycCntr2D2_wrongvalctr == 0)
             {
                putValue(E_pubc_GW_GW_2D2_CdcCycCntr2D2_wrongvalctr,0);
             } */
        }
        else
        {
            // do nothing
        }
	
        update_GW_2D2_CRC_CheckSum();
        output(Msg_GW_2D2);
        
    }
    //Reset Timer
    SetTimer(Tm_GW_2D2,Cycle_GW_2D2);
}
/*@@end*/

/*@@envVar:E_pubc_GW_GW_2D2_cycleTm:*/
on envVar E_pubc_GW_GW_2D2_cycleTm
{
    // update the cycle time 
    Cycle_GW_2D2=getvalue(this);
}
/*@@end*/
/*@@timer:Tm_GW_3D2:*/
on timer Tm_GW_3D2
{
    //cyclic message timer 
    if(getValue(E_pubc_GW_GW_3D2_Tm) == 1)
    {
        
		//update the BZ Signal
        if(GW_3D2_EspCycCntr3D2_wrongvalctr == 0)
        {
            update_GW_3D2_EspCycCntr3D2_counter();
            Msg_GW_3D2.EspCycCntr3D2= GW_3D2_EspCycCntr3D2_counter;
        }
        else if(GW_3D2_EspCycCntr3D2_wrongvalctr > 0)
        {
			GW_3D2_EspCycCntr3D2_counter=GW_3D2_EspCycCntr3D2_counter + GW_3D2_EspCycCntr3D2_wrongvalctr;
			 Msg_GW_3D2.EspCycCntr3D2= GW_3D2_EspCycCntr3D2_counter;
            /* GW_3D2_EspCycCntr3D2_wrongvalctr--;
             // if counter becomes zero, update panel controller to zero
             if(GW_3D2_EspCycCntr3D2_wrongvalctr == 0)
             {
                putValue(E_pubc_GW_GW_3D2_EspCycCntr3D2_wrongvalctr,0);
             } */
        }
        else
        {
            // do nothing
        }
	
        update_GW_3D2_CRC_CheckSum();
        output(Msg_GW_3D2);
        
    }
    //Reset Timer
    SetTimer(Tm_GW_3D2,Cycle_GW_3D2);
}
/*@@end*/

/*@@envVar:E_pubc_GW_GW_3D2_cycleTm:*/
on envVar E_pubc_GW_GW_3D2_cycleTm
{
    // update the cycle time 
    Cycle_GW_3D2=getvalue(this);
}
/*@@end*/
/*@@timer:Tm_GW_180:*/
on timer Tm_GW_180
{
    //cyclic message timer 
    if(getValue(E_pubc_GW_GW_180_Tm) == 1)
    {
        
		//update the BZ Signal
        if(GW_180_EpsCycCntr180_wrongvalctr == 0)
        {
            update_GW_180_EpsCycCntr180_counter();
            Msg_GW_180.EpsCycCntr180= GW_180_EpsCycCntr180_counter;
        }
        else if(GW_180_EpsCycCntr180_wrongvalctr > 0)
        {
			GW_180_EpsCycCntr180_counter=GW_180_EpsCycCntr180_counter + GW_180_EpsCycCntr180_wrongvalctr;
			 Msg_GW_180.EpsCycCntr180= GW_180_EpsCycCntr180_counter;
            /* GW_180_EpsCycCntr180_wrongvalctr--;
             // if counter becomes zero, update panel controller to zero
             if(GW_180_EpsCycCntr180_wrongvalctr == 0)
             {
                putValue(E_pubc_GW_GW_180_EpsCycCntr180_wrongvalctr,0);
             } */
        }
        else
        {
            // do nothing
        }
	
        update_GW_180_CRC_CheckSum();
        output(Msg_GW_180);
        
    }
    //Reset Timer
    SetTimer(Tm_GW_180,Cycle_GW_180);
}
/*@@end*/

/*@@envVar:E_pubc_GW_GW_180_cycleTm:*/
on envVar E_pubc_GW_GW_180_cycleTm
{
    // update the cycle time 
    Cycle_GW_180=getvalue(this);
}
/*@@end*/
/*@@timer:Tm_GW_2BD:*/
on timer Tm_GW_2BD
{
    //cyclic message timer 
    if(getValue(E_pubc_GW_GW_2BD_Tm) == 1)
    {
        
		//update the BZ Signal
        if(GW_2BD_RRC_RollingCounter_2BD_wrongvalctr == 0)
        {
            update_GW_2BD_RRC_RollingCounter_2BD_counter();
            Msg_GW_2BD.RRC_RollingCounter_2BD= GW_2BD_RRC_RollingCounter_2BD_counter;
        }
        else if(GW_2BD_RRC_RollingCounter_2BD_wrongvalctr > 0)
        {
			GW_2BD_RRC_RollingCounter_2BD_counter=GW_2BD_RRC_RollingCounter_2BD_counter + GW_2BD_RRC_RollingCounter_2BD_wrongvalctr;
			 Msg_GW_2BD.RRC_RollingCounter_2BD= GW_2BD_RRC_RollingCounter_2BD_counter;
            /* GW_2BD_RRC_RollingCounter_2BD_wrongvalctr--;
             // if counter becomes zero, update panel controller to zero
             if(GW_2BD_RRC_RollingCounter_2BD_wrongvalctr == 0)
             {
                putValue(E_pubc_GW_GW_2BD_RRC_RollingCounter_2BD_wrongvalctr,0);
             } */
        }
        else
        {
            // do nothing
        }
	
        update_GW_2BD_CRC_CheckSum();
        output(Msg_GW_2BD);
        
    }
    //Reset Timer
    SetTimer(Tm_GW_2BD,Cycle_GW_2BD);
}
/*@@end*/

/*@@envVar:E_pubc_GW_GW_2BD_cycleTm:*/
on envVar E_pubc_GW_GW_2BD_cycleTm
{
    // update the cycle time 
    Cycle_GW_2BD=getvalue(this);
}
/*@@end*/
/*@@timer:Tm_GW_2BF:*/
on timer Tm_GW_2BF
{
    //cyclic message timer 
    if(getValue(E_pubc_GW_GW_2BF_Tm) == 1)
    {
        
		//update the BZ Signal
        if(GW_2BF_RRC_RollingCounter_2BF_wrongvalctr == 0)
        {
            update_GW_2BF_RRC_RollingCounter_2BF_counter();
            Msg_GW_2BF.RRC_RollingCounter_2BF= GW_2BF_RRC_RollingCounter_2BF_counter;
        }
        else if(GW_2BF_RRC_RollingCounter_2BF_wrongvalctr > 0)
        {
			GW_2BF_RRC_RollingCounter_2BF_counter=GW_2BF_RRC_RollingCounter_2BF_counter + GW_2BF_RRC_RollingCounter_2BF_wrongvalctr;
			 Msg_GW_2BF.RRC_RollingCounter_2BF= GW_2BF_RRC_RollingCounter_2BF_counter;
            /* GW_2BF_RRC_RollingCounter_2BF_wrongvalctr--;
             // if counter becomes zero, update panel controller to zero
             if(GW_2BF_RRC_RollingCounter_2BF_wrongvalctr == 0)
             {
                putValue(E_pubc_GW_GW_2BF_RRC_RollingCounter_2BF_wrongvalctr,0);
             } */
        }
        else
        {
            // do nothing
        }
	
        update_GW_2BF_CRC_CheckSum();
        output(Msg_GW_2BF);
        
    }
    //Reset Timer
    SetTimer(Tm_GW_2BF,Cycle_GW_2BF);
}
/*@@end*/

/*@@envVar:E_pubc_GW_GW_2BF_cycleTm:*/
on envVar E_pubc_GW_GW_2BF_cycleTm
{
    // update the cycle time 
    Cycle_GW_2BF=getvalue(this);
}
/*@@end*/
/*@@timer:Tm_GW_3BD:*/
on timer Tm_GW_3BD
{
    //cyclic message timer 
    if(getValue(E_pubc_GW_GW_3BD_Tm) == 1)
    {
        
		//update the BZ Signal
	
        output(Msg_GW_3BD);
        
    }
    //Reset Timer
    SetTimer(Tm_GW_3BD,Cycle_GW_3BD);
}
/*@@end*/

/*@@envVar:E_pubc_GW_GW_3BD_cycleTm:*/
on envVar E_pubc_GW_GW_3BD_cycleTm
{
    // update the cycle time 
    Cycle_GW_3BD=getvalue(this);
}
/*@@end*/
/*@@timer:Tm_GW_28B:*/
on timer Tm_GW_28B
{
    //cyclic message timer 
    if(getValue(E_pubc_GW_GW_28B_Tm) == 1)
    {
        
		//update the BZ Signal
        if(GW_28B_BCM_RollingCounter_28B_wrongvalctr == 0)
        {
            update_GW_28B_BCM_RollingCounter_28B_counter();
            Msg_GW_28B.BCM_RollingCounter_28B= GW_28B_BCM_RollingCounter_28B_counter;
        }
        else if(GW_28B_BCM_RollingCounter_28B_wrongvalctr > 0)
        {
			GW_28B_BCM_RollingCounter_28B_counter=GW_28B_BCM_RollingCounter_28B_counter + GW_28B_BCM_RollingCounter_28B_wrongvalctr;
			 Msg_GW_28B.BCM_RollingCounter_28B= GW_28B_BCM_RollingCounter_28B_counter;
            /* GW_28B_BCM_RollingCounter_28B_wrongvalctr--;
             // if counter becomes zero, update panel controller to zero
             if(GW_28B_BCM_RollingCounter_28B_wrongvalctr == 0)
             {
                putValue(E_pubc_GW_GW_28B_BCM_RollingCounter_28B_wrongvalctr,0);
             } */
        }
        else
        {
            // do nothing
        }
	
        update_GW_28B_CRC_CheckSum();
        output(Msg_GW_28B);
        
    }
    //Reset Timer
    SetTimer(Tm_GW_28B,Cycle_GW_28B);
}
/*@@end*/

/*@@envVar:E_pubc_GW_GW_28B_cycleTm:*/
on envVar E_pubc_GW_GW_28B_cycleTm
{
    // update the cycle time 
    Cycle_GW_28B=getvalue(this);
}
/*@@end*/

/*@@envVar:E_pubc_GW_GW_387_tx:*/
on envVar E_pubc_GW_GW_387_tx
{
    if(getValue(this))
    {       
        
        //update the BZ Signal
        if(GW_387_BCM_RollingCounter_387_wrongvalctr == 0)
        {
            update_GW_387_BCM_RollingCounter_387_counter();
            Msg_GW_387.BCM_RollingCounter_387= GW_387_BCM_RollingCounter_387_counter;
        }
        else if(GW_387_BCM_RollingCounter_387_wrongvalctr > 0)
        {
			GW_387_BCM_RollingCounter_387_counter=GW_387_BCM_RollingCounter_387_counter + GW_387_BCM_RollingCounter_387_wrongvalctr;
			 Msg_GW_387.BCM_RollingCounter_387= GW_387_BCM_RollingCounter_387_counter;
            /* GW_387_BCM_RollingCounter_387_wrongvalctr--;
              // if counter becomes zero, update panel controller to zero
             if(GW_387_BCM_RollingCounter_387_wrongvalctr == 0)
             {
                 putValue(E_pubc_GW_GW_387_BCM_RollingCounter_387_wrongvalctr,0);
             } */
        }
        else
        { 
			// do nothing
        }    
        //calculate the CRC CheckSum
        update_GW_387_CRC_CheckSum();

        output(Msg_GW_387);        
    }
}
/*@@end*/

/*@@envVar:E_pubc_GW_GW_387_Range:*/
on envVar E_pubc_GW_GW_387_Range
{
    qword rawstatus = 0ll;
    qword rawValue = 0ll;    
    
    rawstatus = getvalue(this);    
    // set all the signals with min raw /max raw /init raw
    switch (rawstatus) 
    {
     case(0) :
        rawValue= 0;
        putValue(E_pubc_GW_GW_387_BCM_RLS_Light_switch_reason_Rv, rawValue);
        rawValue= 0;
        putValue(E_pubc_GW_GW_387_BCM_RainfallLevel_Rv, rawValue);
        break;
     case(1) :
        rawValue= 255;
        putValue(E_pubc_GW_GW_387_BCM_RLS_Light_switch_reason_Rv, rawValue);
        rawValue= 15;
        putValue(E_pubc_GW_GW_387_BCM_RainfallLevel_Rv, rawValue);
        break;
     default :
        rawValue= 0;
        putValue(E_pubc_GW_GW_387_BCM_RLS_Light_switch_reason_Rv, rawValue);
        rawValue= 0;
        putValue(E_pubc_GW_GW_387_BCM_RainfallLevel_Rv, rawValue);
      break;
   }
}
/*@@end*/

/*@@envVar:E_pubc_GW_GW_387_Dlc:*/
on envVar E_pubc_GW_GW_387_Dlc
{
    if(getValue(E_pubc_GW_GW_387_enDlc))
    {
        Msg_GW_387.dlc =getValue(this);
    }
    else
    {
       Dbc_dlc = 8;
	   Msg_GW_387.dlc = Calc_Canfd_dlc(Dbc_dlc);
	   // Msg_GW_387.dlc = 8;
	   	
  }
}
/*@@end*/

/*@@envVar:E_pubc_GW_GW_387_enDlc:*/
on envVar E_pubc_GW_GW_387_enDlc
{
    //For Messages with DLC = 8, set wrong DLC to smaller than defined DLC
    //For Messages with DLC < 8 set wrong DLC to smaller/longer than defined DLC
    if(getValue(this))
    {
        Msg_GW_387.dlc =getValue(E_pubc_GW_GW_387_Dlc);
    }
    else
    {
       Dbc_dlc = 8;
	   Msg_GW_387.dlc = Calc_Canfd_dlc(Dbc_dlc);
	   // Msg_GW_387.dlc = 8;
    }
}
/*@@end*/

/*@@envVar:E_pubc_GW_GW_387_BCM_CRCCheck_387_wrongvalctr:*/
on envVar E_pubc_GW_GW_387_BCM_CRCCheck_387_wrongvalctr
{
    //update disturb count
    //disturb value range:(-1 = always send wrong value),( X>0 ,x is the number of Messages with wrong CHK sent)
    GW_387_BCM_CRCCheck_387_wrongvalctr =getValue(this);    
}
/*@@end*/
/*@@envVar:E_pubc_GW_GW_387_BCM_RollingCounter_387_wrongvalctr:*/
on envVar E_pubc_GW_GW_387_BCM_RollingCounter_387_wrongvalctr
{
    //update disturb count
    //disturb value range:(-1 = always send wrong value),( X>0 ,x is the number of Messages with wrong CHK sent)
    GW_387_BCM_RollingCounter_387_wrongvalctr =getValue(this);    
}
/*@@end*/

/*@@envVar:E_pubc_GW_GW_387_BCM_RLS_Light_switch_reason_Rv:*/
on envVar E_pubc_GW_GW_387_BCM_RLS_Light_switch_reason_Rv
{
    int64 rawValue = 0ll;
    float rawValue_float = 0.0;
    float phyValue = 0.0;        

    //set the signal with updated raw value
    {
        rawValue = getvalue(this);
        if(chgEv_GW_387_BCM_RLS_Light_switch_reason == 0)
        {
            //type conversion to float
            rawValue_float = rawValue;        
            // raw to physical conversion
            phyValue = ((rawValue_float *1)+(0));
            putValue(E_pubc_GW_GW_387_BCM_RLS_Light_switch_reason_Pv, phyValue);
            chgEv_GW_387_BCM_RLS_Light_switch_reason = 1;
        }
        else
        {
            chgEv_GW_387_BCM_RLS_Light_switch_reason = 0;
        }    
        //update the signal value
        Msg_GW_387.BCM_RLS_Light_switch_reason=rawValue;        
    }                                                                           
}
/*@@end*/

/*@@envVar:E_pubc_GW_GW_387_BCM_RLS_Light_switch_reason_Pv:*/
on envVar E_pubc_GW_GW_387_BCM_RLS_Light_switch_reason_Pv
{
    int64 rawValue = 0ll;
    float phyValue = 0.0;
    
    //update the raw value with physical value 
    {
        if(chgEv_GW_387_BCM_RLS_Light_switch_reason == 0)
        {
            phyValue = getvalue(this);
            // physical to raw conversion
            rawValue = ((phyValue -(0))/1);
            putValue(E_pubc_GW_GW_387_BCM_RLS_Light_switch_reason_Rv, rawValue);
            chgEv_GW_387_BCM_RLS_Light_switch_reason = 1;  
        }
        else
        {
            chgEv_GW_387_BCM_RLS_Light_switch_reason = 0;
        }
    }
}
/*@@end*/


 
/*@@envVar:E_pubc_GW_GW_387_BCM_RainfallLevel_Rv:*/
on envVar E_pubc_GW_GW_387_BCM_RainfallLevel_Rv
{
    int64 rawValue = 0ll;
    float rawValue_float = 0.0;
    float phyValue = 0.0;        

    //set the signal with updated raw value
    if(getValue(E_pubc_GW_GW_387_BCM_RainfallLevel_SetVt)==0)
    {
        rawValue = getvalue(this);
        if(chgEv_GW_387_BCM_RainfallLevel == 0)
        {
            //type conversion to float
            rawValue_float = rawValue;        
            // raw to physical conversion
            phyValue = ((rawValue_float *1)+(0));
            putValue(E_pubc_GW_GW_387_BCM_RainfallLevel_Pv, phyValue);
            chgEv_GW_387_BCM_RainfallLevel = 1;
        }
        else
        {
            chgEv_GW_387_BCM_RainfallLevel = 0;
        }    
        //update the signal value
        Msg_GW_387.BCM_RainfallLevel=rawValue;        
    }                                                                           
}
/*@@end*/

/*@@envVar:E_pubc_GW_GW_387_BCM_RainfallLevel_Pv:*/
on envVar E_pubc_GW_GW_387_BCM_RainfallLevel_Pv
{
    int64 rawValue = 0ll;
    float phyValue = 0.0;
    
    //update the raw value with physical value 
    if(getValue(E_pubc_GW_GW_387_BCM_RainfallLevel_SetVt)==0)
    {
        if(chgEv_GW_387_BCM_RainfallLevel == 0)
        {
            phyValue = getvalue(this);
            // physical to raw conversion
            rawValue = ((phyValue -(0))/1);
            putValue(E_pubc_GW_GW_387_BCM_RainfallLevel_Rv, rawValue);
            chgEv_GW_387_BCM_RainfallLevel = 1;  
        }
        else
        {
            chgEv_GW_387_BCM_RainfallLevel = 0;
        }
    }
}
/*@@end*/

/*@@envVar:E_pubc_GW_GW_387_BCM_RainfallLevel_Vt:*/
on envVar E_pubc_GW_GW_387_BCM_RainfallLevel_Vt
{
    qword rawValue = 0ll;
    if(getValue(E_pubc_GW_GW_387_BCM_RainfallLevel_SetVt))
    {
        //update the signal value
        Msg_GW_387.BCM_RainfallLevel=getValue(this);
    }
}
/*@@end*/

/*@@envVar:E_pubc_GW_GW_387_BCM_RainfallLevel_SetVt:*/
on envVar E_pubc_GW_GW_387_BCM_RainfallLevel_SetVt
{
    if(getValue(E_pubc_GW_GW_387_BCM_RainfallLevel_SetVt))
    {
        //update the signal value
        Msg_GW_387.BCM_RainfallLevel=getvalue(E_pubc_GW_GW_387_BCM_RainfallLevel_Vt);
    }
    else
    {
        Msg_GW_387.BCM_RainfallLevel=getValue(E_pubc_GW_GW_387_BCM_RainfallLevel_Rv);
    }
}
/*@@end*/
 
/*@@envVar:E_pubc_GW_GW_288_tx:*/
on envVar E_pubc_GW_GW_288_tx
{
    if(getValue(this))
    {       
        
        //update the BZ Signal
        if(GW_288_BcmCycCntr288_wrongvalctr == 0)
        {
            update_GW_288_BcmCycCntr288_counter();
            Msg_GW_288.BcmCycCntr288= GW_288_BcmCycCntr288_counter;
        }
        else if(GW_288_BcmCycCntr288_wrongvalctr > 0)
        {
			GW_288_BcmCycCntr288_counter=GW_288_BcmCycCntr288_counter + GW_288_BcmCycCntr288_wrongvalctr;
			 Msg_GW_288.BcmCycCntr288= GW_288_BcmCycCntr288_counter;
            /* GW_288_BcmCycCntr288_wrongvalctr--;
              // if counter becomes zero, update panel controller to zero
             if(GW_288_BcmCycCntr288_wrongvalctr == 0)
             {
                 putValue(E_pubc_GW_GW_288_BcmCycCntr288_wrongvalctr,0);
             } */
        }
        else
        { 
			// do nothing
        }    
        //calculate the CRC CheckSum
        update_GW_288_CRC_CheckSum();

        output(Msg_GW_288);        
    }
}
/*@@end*/

/*@@envVar:E_pubc_GW_GW_288_Range:*/
on envVar E_pubc_GW_GW_288_Range
{
    qword rawstatus = 0ll;
    qword rawValue = 0ll;    
    
    rawstatus = getvalue(this);    
    // set all the signals with min raw /max raw /init raw
    switch (rawstatus) 
    {
     case(0) :
        rawValue= 0;
        putValue(E_pubc_GW_GW_288_BcmRiReDoorSts_Rv, rawValue);
        rawValue= 0;
        putValue(E_pubc_GW_GW_288_BcmHoodSts_Rv, rawValue);
        rawValue= 0;
        putValue(E_pubc_GW_GW_288_BcmLoBeamSts_Rv, rawValue);
        rawValue= 0;
        putValue(E_pubc_GW_GW_288_BcmDrvrDoorSts_Rv, rawValue);
        rawValue= 0;
        putValue(E_pubc_GW_GW_288_BcmHiBeamSts_Rv, rawValue);
        rawValue= 0;
        putValue(E_pubc_GW_GW_288_BcmFrntFogLmpSts_Rv, rawValue);
        rawValue= 0;
        putValue(E_pubc_GW_GW_288_BcmTurnIndcrLe_Rv, rawValue);
        rawValue= 0;
        putValue(E_pubc_GW_GW_288_BcmPassDoorSts_Rv, rawValue);
        rawValue= 0;
        putValue(E_pubc_GW_GW_288_BcmStsRainSnsr_Rv, rawValue);
        rawValue= 0;
        putValue(E_pubc_GW_GW_288_BcmLeReDoorSts_Rv, rawValue);
        rawValue= 0;
        putValue(E_pubc_GW_GW_288_BcmReFoglmpSts_Rv, rawValue);
        rawValue= 0;
        putValue(E_pubc_GW_GW_288_BcmAutHeadLiSts_Rv, rawValue);
        rawValue= 0;
        putValue(E_pubc_GW_GW_288_BcmLiSnsrFlt_Rv, rawValue);
        rawValue= 0;
        putValue(E_pubc_GW_GW_288_BcmTurnIndcrRi_Rv, rawValue);
        rawValue= 0;
        putValue(E_pubc_GW_GW_288_BcmFrntWiperSts_Rv, rawValue);
        rawValue= 0;
        putValue(E_pubc_GW_GW_288_BcmEmgyLiSts_Rv, rawValue);
        break;
     case(1) :
        rawValue= 1;
        putValue(E_pubc_GW_GW_288_BcmRiReDoorSts_Rv, rawValue);
        rawValue= 1;
        putValue(E_pubc_GW_GW_288_BcmHoodSts_Rv, rawValue);
        rawValue= 3;
        putValue(E_pubc_GW_GW_288_BcmLoBeamSts_Rv, rawValue);
        rawValue= 1;
        putValue(E_pubc_GW_GW_288_BcmDrvrDoorSts_Rv, rawValue);
        rawValue= 3;
        putValue(E_pubc_GW_GW_288_BcmHiBeamSts_Rv, rawValue);
        rawValue= 3;
        putValue(E_pubc_GW_GW_288_BcmFrntFogLmpSts_Rv, rawValue);
        rawValue= 3;
        putValue(E_pubc_GW_GW_288_BcmTurnIndcrLe_Rv, rawValue);
        rawValue= 1;
        putValue(E_pubc_GW_GW_288_BcmPassDoorSts_Rv, rawValue);
        rawValue= 1;
        putValue(E_pubc_GW_GW_288_BcmStsRainSnsr_Rv, rawValue);
        rawValue= 1;
        putValue(E_pubc_GW_GW_288_BcmLeReDoorSts_Rv, rawValue);
        rawValue= 3;
        putValue(E_pubc_GW_GW_288_BcmReFoglmpSts_Rv, rawValue);
        rawValue= 1;
        putValue(E_pubc_GW_GW_288_BcmAutHeadLiSts_Rv, rawValue);
        rawValue= 1;
        putValue(E_pubc_GW_GW_288_BcmLiSnsrFlt_Rv, rawValue);
        rawValue= 3;
        putValue(E_pubc_GW_GW_288_BcmTurnIndcrRi_Rv, rawValue);
        rawValue= 3;
        putValue(E_pubc_GW_GW_288_BcmFrntWiperSts_Rv, rawValue);
        rawValue= 3;
        putValue(E_pubc_GW_GW_288_BcmEmgyLiSts_Rv, rawValue);
        break;
     default :
        rawValue= 0;
        putValue(E_pubc_GW_GW_288_BcmRiReDoorSts_Rv, rawValue);
        rawValue= 0;
        putValue(E_pubc_GW_GW_288_BcmHoodSts_Rv, rawValue);
        rawValue= 0;
        putValue(E_pubc_GW_GW_288_BcmLoBeamSts_Rv, rawValue);
        rawValue= 0;
        putValue(E_pubc_GW_GW_288_BcmDrvrDoorSts_Rv, rawValue);
        rawValue= 0;
        putValue(E_pubc_GW_GW_288_BcmHiBeamSts_Rv, rawValue);
        rawValue= 0;
        putValue(E_pubc_GW_GW_288_BcmFrntFogLmpSts_Rv, rawValue);
        rawValue= 0;
        putValue(E_pubc_GW_GW_288_BcmTurnIndcrLe_Rv, rawValue);
        rawValue= 0;
        putValue(E_pubc_GW_GW_288_BcmPassDoorSts_Rv, rawValue);
        rawValue= 0;
        putValue(E_pubc_GW_GW_288_BcmStsRainSnsr_Rv, rawValue);
        rawValue= 0;
        putValue(E_pubc_GW_GW_288_BcmLeReDoorSts_Rv, rawValue);
        rawValue= 0;
        putValue(E_pubc_GW_GW_288_BcmReFoglmpSts_Rv, rawValue);
        rawValue= 0;
        putValue(E_pubc_GW_GW_288_BcmAutHeadLiSts_Rv, rawValue);
        rawValue= 0;
        putValue(E_pubc_GW_GW_288_BcmLiSnsrFlt_Rv, rawValue);
        rawValue= 0;
        putValue(E_pubc_GW_GW_288_BcmTurnIndcrRi_Rv, rawValue);
        rawValue= 0;
        putValue(E_pubc_GW_GW_288_BcmFrntWiperSts_Rv, rawValue);
        rawValue= 0;
        putValue(E_pubc_GW_GW_288_BcmEmgyLiSts_Rv, rawValue);
      break;
   }
}
/*@@end*/

/*@@envVar:E_pubc_GW_GW_288_Dlc:*/
on envVar E_pubc_GW_GW_288_Dlc
{
    if(getValue(E_pubc_GW_GW_288_enDlc))
    {
        Msg_GW_288.dlc =getValue(this);
    }
    else
    {
       Dbc_dlc = 8;
	   Msg_GW_288.dlc = Calc_Canfd_dlc(Dbc_dlc);
	   // Msg_GW_288.dlc = 8;
	   	
  }
}
/*@@end*/

/*@@envVar:E_pubc_GW_GW_288_enDlc:*/
on envVar E_pubc_GW_GW_288_enDlc
{
    //For Messages with DLC = 8, set wrong DLC to smaller than defined DLC
    //For Messages with DLC < 8 set wrong DLC to smaller/longer than defined DLC
    if(getValue(this))
    {
        Msg_GW_288.dlc =getValue(E_pubc_GW_GW_288_Dlc);
    }
    else
    {
       Dbc_dlc = 8;
	   Msg_GW_288.dlc = Calc_Canfd_dlc(Dbc_dlc);
	   // Msg_GW_288.dlc = 8;
    }
}
/*@@end*/

/*@@envVar:E_pubc_GW_GW_288_BcmCrcChk288_wrongvalctr:*/
on envVar E_pubc_GW_GW_288_BcmCrcChk288_wrongvalctr
{
    //update disturb count
    //disturb value range:(-1 = always send wrong value),( X>0 ,x is the number of Messages with wrong CHK sent)
    GW_288_BcmCrcChk288_wrongvalctr =getValue(this);    
}
/*@@end*/
/*@@envVar:E_pubc_GW_GW_288_BcmCycCntr288_wrongvalctr:*/
on envVar E_pubc_GW_GW_288_BcmCycCntr288_wrongvalctr
{
    //update disturb count
    //disturb value range:(-1 = always send wrong value),( X>0 ,x is the number of Messages with wrong CHK sent)
    GW_288_BcmCycCntr288_wrongvalctr =getValue(this);    
}
/*@@end*/

/*@@envVar:E_pubc_GW_GW_288_BcmRiReDoorSts_Rv:*/
on envVar E_pubc_GW_GW_288_BcmRiReDoorSts_Rv
{
    int64 rawValue = 0ll;
    float rawValue_float = 0.0;
    float phyValue = 0.0;        

    //set the signal with updated raw value
    if(getValue(E_pubc_GW_GW_288_BcmRiReDoorSts_SetVt)==0)
    {
        rawValue = getvalue(this);
        if(chgEv_GW_288_BcmRiReDoorSts == 0)
        {
            //type conversion to float
            rawValue_float = rawValue;        
            // raw to physical conversion
            phyValue = ((rawValue_float *1)+(0));
            putValue(E_pubc_GW_GW_288_BcmRiReDoorSts_Pv, phyValue);
            chgEv_GW_288_BcmRiReDoorSts = 1;
        }
        else
        {
            chgEv_GW_288_BcmRiReDoorSts = 0;
        }    
        //update the signal value
        Msg_GW_288.BcmRiReDoorSts=rawValue;        
    }                                                                           
}
/*@@end*/

/*@@envVar:E_pubc_GW_GW_288_BcmRiReDoorSts_Pv:*/
on envVar E_pubc_GW_GW_288_BcmRiReDoorSts_Pv
{
    int64 rawValue = 0ll;
    float phyValue = 0.0;
    
    //update the raw value with physical value 
    if(getValue(E_pubc_GW_GW_288_BcmRiReDoorSts_SetVt)==0)
    {
        if(chgEv_GW_288_BcmRiReDoorSts == 0)
        {
            phyValue = getvalue(this);
            // physical to raw conversion
            rawValue = ((phyValue -(0))/1);
            putValue(E_pubc_GW_GW_288_BcmRiReDoorSts_Rv, rawValue);
            chgEv_GW_288_BcmRiReDoorSts = 1;  
        }
        else
        {
            chgEv_GW_288_BcmRiReDoorSts = 0;
        }
    }
}
/*@@end*/

/*@@envVar:E_pubc_GW_GW_288_BcmRiReDoorSts_Vt:*/
on envVar E_pubc_GW_GW_288_BcmRiReDoorSts_Vt
{
    qword rawValue = 0ll;
    if(getValue(E_pubc_GW_GW_288_BcmRiReDoorSts_SetVt))
    {
        //update the signal value
        Msg_GW_288.BcmRiReDoorSts=getValue(this);
    }
}
/*@@end*/

/*@@envVar:E_pubc_GW_GW_288_BcmRiReDoorSts_SetVt:*/
on envVar E_pubc_GW_GW_288_BcmRiReDoorSts_SetVt
{
    if(getValue(E_pubc_GW_GW_288_BcmRiReDoorSts_SetVt))
    {
        //update the signal value
        Msg_GW_288.BcmRiReDoorSts=getvalue(E_pubc_GW_GW_288_BcmRiReDoorSts_Vt);
    }
    else
    {
        Msg_GW_288.BcmRiReDoorSts=getValue(E_pubc_GW_GW_288_BcmRiReDoorSts_Rv);
    }
}
/*@@end*/
 
/*@@envVar:E_pubc_GW_GW_288_BcmHoodSts_Rv:*/
on envVar E_pubc_GW_GW_288_BcmHoodSts_Rv
{
    int64 rawValue = 0ll;
    float rawValue_float = 0.0;
    float phyValue = 0.0;        

    //set the signal with updated raw value
    if(getValue(E_pubc_GW_GW_288_BcmHoodSts_SetVt)==0)
    {
        rawValue = getvalue(this);
        if(chgEv_GW_288_BcmHoodSts == 0)
        {
            //type conversion to float
            rawValue_float = rawValue;        
            // raw to physical conversion
            phyValue = ((rawValue_float *1)+(0));
            putValue(E_pubc_GW_GW_288_BcmHoodSts_Pv, phyValue);
            chgEv_GW_288_BcmHoodSts = 1;
        }
        else
        {
            chgEv_GW_288_BcmHoodSts = 0;
        }    
        //update the signal value
        Msg_GW_288.BcmHoodSts=rawValue;        
    }                                                                           
}
/*@@end*/

/*@@envVar:E_pubc_GW_GW_288_BcmHoodSts_Pv:*/
on envVar E_pubc_GW_GW_288_BcmHoodSts_Pv
{
    int64 rawValue = 0ll;
    float phyValue = 0.0;
    
    //update the raw value with physical value 
    if(getValue(E_pubc_GW_GW_288_BcmHoodSts_SetVt)==0)
    {
        if(chgEv_GW_288_BcmHoodSts == 0)
        {
            phyValue = getvalue(this);
            // physical to raw conversion
            rawValue = ((phyValue -(0))/1);
            putValue(E_pubc_GW_GW_288_BcmHoodSts_Rv, rawValue);
            chgEv_GW_288_BcmHoodSts = 1;  
        }
        else
        {
            chgEv_GW_288_BcmHoodSts = 0;
        }
    }
}
/*@@end*/

/*@@envVar:E_pubc_GW_GW_288_BcmHoodSts_Vt:*/
on envVar E_pubc_GW_GW_288_BcmHoodSts_Vt
{
    qword rawValue = 0ll;
    if(getValue(E_pubc_GW_GW_288_BcmHoodSts_SetVt))
    {
        //update the signal value
        Msg_GW_288.BcmHoodSts=getValue(this);
    }
}
/*@@end*/

/*@@envVar:E_pubc_GW_GW_288_BcmHoodSts_SetVt:*/
on envVar E_pubc_GW_GW_288_BcmHoodSts_SetVt
{
    if(getValue(E_pubc_GW_GW_288_BcmHoodSts_SetVt))
    {
        //update the signal value
        Msg_GW_288.BcmHoodSts=getvalue(E_pubc_GW_GW_288_BcmHoodSts_Vt);
    }
    else
    {
        Msg_GW_288.BcmHoodSts=getValue(E_pubc_GW_GW_288_BcmHoodSts_Rv);
    }
}
/*@@end*/
 
/*@@envVar:E_pubc_GW_GW_288_BcmLoBeamSts_Rv:*/
on envVar E_pubc_GW_GW_288_BcmLoBeamSts_Rv
{
    int64 rawValue = 0ll;
    float rawValue_float = 0.0;
    float phyValue = 0.0;        

    //set the signal with updated raw value
    if(getValue(E_pubc_GW_GW_288_BcmLoBeamSts_SetVt)==0)
    {
        rawValue = getvalue(this);
        if(chgEv_GW_288_BcmLoBeamSts == 0)
        {
            //type conversion to float
            rawValue_float = rawValue;        
            // raw to physical conversion
            phyValue = ((rawValue_float *1)+(0));
            putValue(E_pubc_GW_GW_288_BcmLoBeamSts_Pv, phyValue);
            chgEv_GW_288_BcmLoBeamSts = 1;
        }
        else
        {
            chgEv_GW_288_BcmLoBeamSts = 0;
        }    
        //update the signal value
        Msg_GW_288.BcmLoBeamSts=rawValue;        
    }                                                                           
}
/*@@end*/

/*@@envVar:E_pubc_GW_GW_288_BcmLoBeamSts_Pv:*/
on envVar E_pubc_GW_GW_288_BcmLoBeamSts_Pv
{
    int64 rawValue = 0ll;
    float phyValue = 0.0;
    
    //update the raw value with physical value 
    if(getValue(E_pubc_GW_GW_288_BcmLoBeamSts_SetVt)==0)
    {
        if(chgEv_GW_288_BcmLoBeamSts == 0)
        {
            phyValue = getvalue(this);
            // physical to raw conversion
            rawValue = ((phyValue -(0))/1);
            putValue(E_pubc_GW_GW_288_BcmLoBeamSts_Rv, rawValue);
            chgEv_GW_288_BcmLoBeamSts = 1;  
        }
        else
        {
            chgEv_GW_288_BcmLoBeamSts = 0;
        }
    }
}
/*@@end*/

/*@@envVar:E_pubc_GW_GW_288_BcmLoBeamSts_Vt:*/
on envVar E_pubc_GW_GW_288_BcmLoBeamSts_Vt
{
    qword rawValue = 0ll;
    if(getValue(E_pubc_GW_GW_288_BcmLoBeamSts_SetVt))
    {
        //update the signal value
        Msg_GW_288.BcmLoBeamSts=getValue(this);
    }
}
/*@@end*/

/*@@envVar:E_pubc_GW_GW_288_BcmLoBeamSts_SetVt:*/
on envVar E_pubc_GW_GW_288_BcmLoBeamSts_SetVt
{
    if(getValue(E_pubc_GW_GW_288_BcmLoBeamSts_SetVt))
    {
        //update the signal value
        Msg_GW_288.BcmLoBeamSts=getvalue(E_pubc_GW_GW_288_BcmLoBeamSts_Vt);
    }
    else
    {
        Msg_GW_288.BcmLoBeamSts=getValue(E_pubc_GW_GW_288_BcmLoBeamSts_Rv);
    }
}
/*@@end*/
 
/*@@envVar:E_pubc_GW_GW_288_BcmDrvrDoorSts_Rv:*/
on envVar E_pubc_GW_GW_288_BcmDrvrDoorSts_Rv
{
    int64 rawValue = 0ll;
    float rawValue_float = 0.0;
    float phyValue = 0.0;        

    //set the signal with updated raw value
    if(getValue(E_pubc_GW_GW_288_BcmDrvrDoorSts_SetVt)==0)
    {
        rawValue = getvalue(this);
        if(chgEv_GW_288_BcmDrvrDoorSts == 0)
        {
            //type conversion to float
            rawValue_float = rawValue;        
            // raw to physical conversion
            phyValue = ((rawValue_float *1)+(0));
            putValue(E_pubc_GW_GW_288_BcmDrvrDoorSts_Pv, phyValue);
            chgEv_GW_288_BcmDrvrDoorSts = 1;
        }
        else
        {
            chgEv_GW_288_BcmDrvrDoorSts = 0;
        }    
        //update the signal value
        Msg_GW_288.BcmDrvrDoorSts=rawValue;        
    }                                                                           
}
/*@@end*/

/*@@envVar:E_pubc_GW_GW_288_BcmDrvrDoorSts_Pv:*/
on envVar E_pubc_GW_GW_288_BcmDrvrDoorSts_Pv
{
    int64 rawValue = 0ll;
    float phyValue = 0.0;
    
    //update the raw value with physical value 
    if(getValue(E_pubc_GW_GW_288_BcmDrvrDoorSts_SetVt)==0)
    {
        if(chgEv_GW_288_BcmDrvrDoorSts == 0)
        {
            phyValue = getvalue(this);
            // physical to raw conversion
            rawValue = ((phyValue -(0))/1);
            putValue(E_pubc_GW_GW_288_BcmDrvrDoorSts_Rv, rawValue);
            chgEv_GW_288_BcmDrvrDoorSts = 1;  
        }
        else
        {
            chgEv_GW_288_BcmDrvrDoorSts = 0;
        }
    }
}
/*@@end*/

/*@@envVar:E_pubc_GW_GW_288_BcmDrvrDoorSts_Vt:*/
on envVar E_pubc_GW_GW_288_BcmDrvrDoorSts_Vt
{
    qword rawValue = 0ll;
    if(getValue(E_pubc_GW_GW_288_BcmDrvrDoorSts_SetVt))
    {
        //update the signal value
        Msg_GW_288.BcmDrvrDoorSts=getValue(this);
    }
}
/*@@end*/

/*@@envVar:E_pubc_GW_GW_288_BcmDrvrDoorSts_SetVt:*/
on envVar E_pubc_GW_GW_288_BcmDrvrDoorSts_SetVt
{
    if(getValue(E_pubc_GW_GW_288_BcmDrvrDoorSts_SetVt))
    {
        //update the signal value
        Msg_GW_288.BcmDrvrDoorSts=getvalue(E_pubc_GW_GW_288_BcmDrvrDoorSts_Vt);
    }
    else
    {
        Msg_GW_288.BcmDrvrDoorSts=getValue(E_pubc_GW_GW_288_BcmDrvrDoorSts_Rv);
    }
}
/*@@end*/
 
/*@@envVar:E_pubc_GW_GW_288_BcmHiBeamSts_Rv:*/
on envVar E_pubc_GW_GW_288_BcmHiBeamSts_Rv
{
    int64 rawValue = 0ll;
    float rawValue_float = 0.0;
    float phyValue = 0.0;        

    //set the signal with updated raw value
    if(getValue(E_pubc_GW_GW_288_BcmHiBeamSts_SetVt)==0)
    {
        rawValue = getvalue(this);
        if(chgEv_GW_288_BcmHiBeamSts == 0)
        {
            //type conversion to float
            rawValue_float = rawValue;        
            // raw to physical conversion
            phyValue = ((rawValue_float *1)+(0));
            putValue(E_pubc_GW_GW_288_BcmHiBeamSts_Pv, phyValue);
            chgEv_GW_288_BcmHiBeamSts = 1;
        }
        else
        {
            chgEv_GW_288_BcmHiBeamSts = 0;
        }    
        //update the signal value
        Msg_GW_288.BcmHiBeamSts=rawValue;        
    }                                                                           
}
/*@@end*/

/*@@envVar:E_pubc_GW_GW_288_BcmHiBeamSts_Pv:*/
on envVar E_pubc_GW_GW_288_BcmHiBeamSts_Pv
{
    int64 rawValue = 0ll;
    float phyValue = 0.0;
    
    //update the raw value with physical value 
    if(getValue(E_pubc_GW_GW_288_BcmHiBeamSts_SetVt)==0)
    {
        if(chgEv_GW_288_BcmHiBeamSts == 0)
        {
            phyValue = getvalue(this);
            // physical to raw conversion
            rawValue = ((phyValue -(0))/1);
            putValue(E_pubc_GW_GW_288_BcmHiBeamSts_Rv, rawValue);
            chgEv_GW_288_BcmHiBeamSts = 1;  
        }
        else
        {
            chgEv_GW_288_BcmHiBeamSts = 0;
        }
    }
}
/*@@end*/

/*@@envVar:E_pubc_GW_GW_288_BcmHiBeamSts_Vt:*/
on envVar E_pubc_GW_GW_288_BcmHiBeamSts_Vt
{
    qword rawValue = 0ll;
    if(getValue(E_pubc_GW_GW_288_BcmHiBeamSts_SetVt))
    {
        //update the signal value
        Msg_GW_288.BcmHiBeamSts=getValue(this);
    }
}
/*@@end*/

/*@@envVar:E_pubc_GW_GW_288_BcmHiBeamSts_SetVt:*/
on envVar E_pubc_GW_GW_288_BcmHiBeamSts_SetVt
{
    if(getValue(E_pubc_GW_GW_288_BcmHiBeamSts_SetVt))
    {
        //update the signal value
        Msg_GW_288.BcmHiBeamSts=getvalue(E_pubc_GW_GW_288_BcmHiBeamSts_Vt);
    }
    else
    {
        Msg_GW_288.BcmHiBeamSts=getValue(E_pubc_GW_GW_288_BcmHiBeamSts_Rv);
    }
}
/*@@end*/
 
/*@@envVar:E_pubc_GW_GW_288_BcmFrntFogLmpSts_Rv:*/
on envVar E_pubc_GW_GW_288_BcmFrntFogLmpSts_Rv
{
    int64 rawValue = 0ll;
    float rawValue_float = 0.0;
    float phyValue = 0.0;        

    //set the signal with updated raw value
    if(getValue(E_pubc_GW_GW_288_BcmFrntFogLmpSts_SetVt)==0)
    {
        rawValue = getvalue(this);
        if(chgEv_GW_288_BcmFrntFogLmpSts == 0)
        {
            //type conversion to float
            rawValue_float = rawValue;        
            // raw to physical conversion
            phyValue = ((rawValue_float *1)+(0));
            putValue(E_pubc_GW_GW_288_BcmFrntFogLmpSts_Pv, phyValue);
            chgEv_GW_288_BcmFrntFogLmpSts = 1;
        }
        else
        {
            chgEv_GW_288_BcmFrntFogLmpSts = 0;
        }    
        //update the signal value
        Msg_GW_288.BcmFrntFogLmpSts=rawValue;        
    }                                                                           
}
/*@@end*/

/*@@envVar:E_pubc_GW_GW_288_BcmFrntFogLmpSts_Pv:*/
on envVar E_pubc_GW_GW_288_BcmFrntFogLmpSts_Pv
{
    int64 rawValue = 0ll;
    float phyValue = 0.0;
    
    //update the raw value with physical value 
    if(getValue(E_pubc_GW_GW_288_BcmFrntFogLmpSts_SetVt)==0)
    {
        if(chgEv_GW_288_BcmFrntFogLmpSts == 0)
        {
            phyValue = getvalue(this);
            // physical to raw conversion
            rawValue = ((phyValue -(0))/1);
            putValue(E_pubc_GW_GW_288_BcmFrntFogLmpSts_Rv, rawValue);
            chgEv_GW_288_BcmFrntFogLmpSts = 1;  
        }
        else
        {
            chgEv_GW_288_BcmFrntFogLmpSts = 0;
        }
    }
}
/*@@end*/

/*@@envVar:E_pubc_GW_GW_288_BcmFrntFogLmpSts_Vt:*/
on envVar E_pubc_GW_GW_288_BcmFrntFogLmpSts_Vt
{
    qword rawValue = 0ll;
    if(getValue(E_pubc_GW_GW_288_BcmFrntFogLmpSts_SetVt))
    {
        //update the signal value
        Msg_GW_288.BcmFrntFogLmpSts=getValue(this);
    }
}
/*@@end*/

/*@@envVar:E_pubc_GW_GW_288_BcmFrntFogLmpSts_SetVt:*/
on envVar E_pubc_GW_GW_288_BcmFrntFogLmpSts_SetVt
{
    if(getValue(E_pubc_GW_GW_288_BcmFrntFogLmpSts_SetVt))
    {
        //update the signal value
        Msg_GW_288.BcmFrntFogLmpSts=getvalue(E_pubc_GW_GW_288_BcmFrntFogLmpSts_Vt);
    }
    else
    {
        Msg_GW_288.BcmFrntFogLmpSts=getValue(E_pubc_GW_GW_288_BcmFrntFogLmpSts_Rv);
    }
}
/*@@end*/
 
/*@@envVar:E_pubc_GW_GW_288_BcmTurnIndcrLe_Rv:*/
on envVar E_pubc_GW_GW_288_BcmTurnIndcrLe_Rv
{
    int64 rawValue = 0ll;
    float rawValue_float = 0.0;
    float phyValue = 0.0;        

    //set the signal with updated raw value
    if(getValue(E_pubc_GW_GW_288_BcmTurnIndcrLe_SetVt)==0)
    {
        rawValue = getvalue(this);
        if(chgEv_GW_288_BcmTurnIndcrLe == 0)
        {
            //type conversion to float
            rawValue_float = rawValue;        
            // raw to physical conversion
            phyValue = ((rawValue_float *1)+(0));
            putValue(E_pubc_GW_GW_288_BcmTurnIndcrLe_Pv, phyValue);
            chgEv_GW_288_BcmTurnIndcrLe = 1;
        }
        else
        {
            chgEv_GW_288_BcmTurnIndcrLe = 0;
        }    
        //update the signal value
        Msg_GW_288.BcmTurnIndcrLe=rawValue;        
    }                                                                           
}
/*@@end*/

/*@@envVar:E_pubc_GW_GW_288_BcmTurnIndcrLe_Pv:*/
on envVar E_pubc_GW_GW_288_BcmTurnIndcrLe_Pv
{
    int64 rawValue = 0ll;
    float phyValue = 0.0;
    
    //update the raw value with physical value 
    if(getValue(E_pubc_GW_GW_288_BcmTurnIndcrLe_SetVt)==0)
    {
        if(chgEv_GW_288_BcmTurnIndcrLe == 0)
        {
            phyValue = getvalue(this);
            // physical to raw conversion
            rawValue = ((phyValue -(0))/1);
            putValue(E_pubc_GW_GW_288_BcmTurnIndcrLe_Rv, rawValue);
            chgEv_GW_288_BcmTurnIndcrLe = 1;  
        }
        else
        {
            chgEv_GW_288_BcmTurnIndcrLe = 0;
        }
    }
}
/*@@end*/

/*@@envVar:E_pubc_GW_GW_288_BcmTurnIndcrLe_Vt:*/
on envVar E_pubc_GW_GW_288_BcmTurnIndcrLe_Vt
{
    qword rawValue = 0ll;
    if(getValue(E_pubc_GW_GW_288_BcmTurnIndcrLe_SetVt))
    {
        //update the signal value
        Msg_GW_288.BcmTurnIndcrLe=getValue(this);
    }
}
/*@@end*/

/*@@envVar:E_pubc_GW_GW_288_BcmTurnIndcrLe_SetVt:*/
on envVar E_pubc_GW_GW_288_BcmTurnIndcrLe_SetVt
{
    if(getValue(E_pubc_GW_GW_288_BcmTurnIndcrLe_SetVt))
    {
        //update the signal value
        Msg_GW_288.BcmTurnIndcrLe=getvalue(E_pubc_GW_GW_288_BcmTurnIndcrLe_Vt);
    }
    else
    {
        Msg_GW_288.BcmTurnIndcrLe=getValue(E_pubc_GW_GW_288_BcmTurnIndcrLe_Rv);
    }
}
/*@@end*/
 
/*@@envVar:E_pubc_GW_GW_288_BcmPassDoorSts_Rv:*/
on envVar E_pubc_GW_GW_288_BcmPassDoorSts_Rv
{
    int64 rawValue = 0ll;
    float rawValue_float = 0.0;
    float phyValue = 0.0;        

    //set the signal with updated raw value
    if(getValue(E_pubc_GW_GW_288_BcmPassDoorSts_SetVt)==0)
    {
        rawValue = getvalue(this);
        if(chgEv_GW_288_BcmPassDoorSts == 0)
        {
            //type conversion to float
            rawValue_float = rawValue;        
            // raw to physical conversion
            phyValue = ((rawValue_float *1)+(0));
            putValue(E_pubc_GW_GW_288_BcmPassDoorSts_Pv, phyValue);
            chgEv_GW_288_BcmPassDoorSts = 1;
        }
        else
        {
            chgEv_GW_288_BcmPassDoorSts = 0;
        }    
        //update the signal value
        Msg_GW_288.BcmPassDoorSts=rawValue;        
    }                                                                           
}
/*@@end*/

/*@@envVar:E_pubc_GW_GW_288_BcmPassDoorSts_Pv:*/
on envVar E_pubc_GW_GW_288_BcmPassDoorSts_Pv
{
    int64 rawValue = 0ll;
    float phyValue = 0.0;
    
    //update the raw value with physical value 
    if(getValue(E_pubc_GW_GW_288_BcmPassDoorSts_SetVt)==0)
    {
        if(chgEv_GW_288_BcmPassDoorSts == 0)
        {
            phyValue = getvalue(this);
            // physical to raw conversion
            rawValue = ((phyValue -(0))/1);
            putValue(E_pubc_GW_GW_288_BcmPassDoorSts_Rv, rawValue);
            chgEv_GW_288_BcmPassDoorSts = 1;  
        }
        else
        {
            chgEv_GW_288_BcmPassDoorSts = 0;
        }
    }
}
/*@@end*/

/*@@envVar:E_pubc_GW_GW_288_BcmPassDoorSts_Vt:*/
on envVar E_pubc_GW_GW_288_BcmPassDoorSts_Vt
{
    qword rawValue = 0ll;
    if(getValue(E_pubc_GW_GW_288_BcmPassDoorSts_SetVt))
    {
        //update the signal value
        Msg_GW_288.BcmPassDoorSts=getValue(this);
    }
}
/*@@end*/

/*@@envVar:E_pubc_GW_GW_288_BcmPassDoorSts_SetVt:*/
on envVar E_pubc_GW_GW_288_BcmPassDoorSts_SetVt
{
    if(getValue(E_pubc_GW_GW_288_BcmPassDoorSts_SetVt))
    {
        //update the signal value
        Msg_GW_288.BcmPassDoorSts=getvalue(E_pubc_GW_GW_288_BcmPassDoorSts_Vt);
    }
    else
    {
        Msg_GW_288.BcmPassDoorSts=getValue(E_pubc_GW_GW_288_BcmPassDoorSts_Rv);
    }
}
/*@@end*/
 
/*@@envVar:E_pubc_GW_GW_288_BcmStsRainSnsr_Rv:*/
on envVar E_pubc_GW_GW_288_BcmStsRainSnsr_Rv
{
    int64 rawValue = 0ll;
    float rawValue_float = 0.0;
    float phyValue = 0.0;        

    //set the signal with updated raw value
    if(getValue(E_pubc_GW_GW_288_BcmStsRainSnsr_SetVt)==0)
    {
        rawValue = getvalue(this);
        if(chgEv_GW_288_BcmStsRainSnsr == 0)
        {
            //type conversion to float
            rawValue_float = rawValue;        
            // raw to physical conversion
            phyValue = ((rawValue_float *1)+(0));
            putValue(E_pubc_GW_GW_288_BcmStsRainSnsr_Pv, phyValue);
            chgEv_GW_288_BcmStsRainSnsr = 1;
        }
        else
        {
            chgEv_GW_288_BcmStsRainSnsr = 0;
        }    
        //update the signal value
        Msg_GW_288.BcmStsRainSnsr=rawValue;        
    }                                                                           
}
/*@@end*/

/*@@envVar:E_pubc_GW_GW_288_BcmStsRainSnsr_Pv:*/
on envVar E_pubc_GW_GW_288_BcmStsRainSnsr_Pv
{
    int64 rawValue = 0ll;
    float phyValue = 0.0;
    
    //update the raw value with physical value 
    if(getValue(E_pubc_GW_GW_288_BcmStsRainSnsr_SetVt)==0)
    {
        if(chgEv_GW_288_BcmStsRainSnsr == 0)
        {
            phyValue = getvalue(this);
            // physical to raw conversion
            rawValue = ((phyValue -(0))/1);
            putValue(E_pubc_GW_GW_288_BcmStsRainSnsr_Rv, rawValue);
            chgEv_GW_288_BcmStsRainSnsr = 1;  
        }
        else
        {
            chgEv_GW_288_BcmStsRainSnsr = 0;
        }
    }
}
/*@@end*/

/*@@envVar:E_pubc_GW_GW_288_BcmStsRainSnsr_Vt:*/
on envVar E_pubc_GW_GW_288_BcmStsRainSnsr_Vt
{
    qword rawValue = 0ll;
    if(getValue(E_pubc_GW_GW_288_BcmStsRainSnsr_SetVt))
    {
        //update the signal value
        Msg_GW_288.BcmStsRainSnsr=getValue(this);
    }
}
/*@@end*/

/*@@envVar:E_pubc_GW_GW_288_BcmStsRainSnsr_SetVt:*/
on envVar E_pubc_GW_GW_288_BcmStsRainSnsr_SetVt
{
    if(getValue(E_pubc_GW_GW_288_BcmStsRainSnsr_SetVt))
    {
        //update the signal value
        Msg_GW_288.BcmStsRainSnsr=getvalue(E_pubc_GW_GW_288_BcmStsRainSnsr_Vt);
    }
    else
    {
        Msg_GW_288.BcmStsRainSnsr=getValue(E_pubc_GW_GW_288_BcmStsRainSnsr_Rv);
    }
}
/*@@end*/
 
/*@@envVar:E_pubc_GW_GW_288_BcmLeReDoorSts_Rv:*/
on envVar E_pubc_GW_GW_288_BcmLeReDoorSts_Rv
{
    int64 rawValue = 0ll;
    float rawValue_float = 0.0;
    float phyValue = 0.0;        

    //set the signal with updated raw value
    if(getValue(E_pubc_GW_GW_288_BcmLeReDoorSts_SetVt)==0)
    {
        rawValue = getvalue(this);
        if(chgEv_GW_288_BcmLeReDoorSts == 0)
        {
            //type conversion to float
            rawValue_float = rawValue;        
            // raw to physical conversion
            phyValue = ((rawValue_float *1)+(0));
            putValue(E_pubc_GW_GW_288_BcmLeReDoorSts_Pv, phyValue);
            chgEv_GW_288_BcmLeReDoorSts = 1;
        }
        else
        {
            chgEv_GW_288_BcmLeReDoorSts = 0;
        }    
        //update the signal value
        Msg_GW_288.BcmLeReDoorSts=rawValue;        
    }                                                                           
}
/*@@end*/

/*@@envVar:E_pubc_GW_GW_288_BcmLeReDoorSts_Pv:*/
on envVar E_pubc_GW_GW_288_BcmLeReDoorSts_Pv
{
    int64 rawValue = 0ll;
    float phyValue = 0.0;
    
    //update the raw value with physical value 
    if(getValue(E_pubc_GW_GW_288_BcmLeReDoorSts_SetVt)==0)
    {
        if(chgEv_GW_288_BcmLeReDoorSts == 0)
        {
            phyValue = getvalue(this);
            // physical to raw conversion
            rawValue = ((phyValue -(0))/1);
            putValue(E_pubc_GW_GW_288_BcmLeReDoorSts_Rv, rawValue);
            chgEv_GW_288_BcmLeReDoorSts = 1;  
        }
        else
        {
            chgEv_GW_288_BcmLeReDoorSts = 0;
        }
    }
}
/*@@end*/

/*@@envVar:E_pubc_GW_GW_288_BcmLeReDoorSts_Vt:*/
on envVar E_pubc_GW_GW_288_BcmLeReDoorSts_Vt
{
    qword rawValue = 0ll;
    if(getValue(E_pubc_GW_GW_288_BcmLeReDoorSts_SetVt))
    {
        //update the signal value
        Msg_GW_288.BcmLeReDoorSts=getValue(this);
    }
}
/*@@end*/

/*@@envVar:E_pubc_GW_GW_288_BcmLeReDoorSts_SetVt:*/
on envVar E_pubc_GW_GW_288_BcmLeReDoorSts_SetVt
{
    if(getValue(E_pubc_GW_GW_288_BcmLeReDoorSts_SetVt))
    {
        //update the signal value
        Msg_GW_288.BcmLeReDoorSts=getvalue(E_pubc_GW_GW_288_BcmLeReDoorSts_Vt);
    }
    else
    {
        Msg_GW_288.BcmLeReDoorSts=getValue(E_pubc_GW_GW_288_BcmLeReDoorSts_Rv);
    }
}
/*@@end*/
 
/*@@envVar:E_pubc_GW_GW_288_BcmReFoglmpSts_Rv:*/
on envVar E_pubc_GW_GW_288_BcmReFoglmpSts_Rv
{
    int64 rawValue = 0ll;
    float rawValue_float = 0.0;
    float phyValue = 0.0;        

    //set the signal with updated raw value
    if(getValue(E_pubc_GW_GW_288_BcmReFoglmpSts_SetVt)==0)
    {
        rawValue = getvalue(this);
        if(chgEv_GW_288_BcmReFoglmpSts == 0)
        {
            //type conversion to float
            rawValue_float = rawValue;        
            // raw to physical conversion
            phyValue = ((rawValue_float *1)+(0));
            putValue(E_pubc_GW_GW_288_BcmReFoglmpSts_Pv, phyValue);
            chgEv_GW_288_BcmReFoglmpSts = 1;
        }
        else
        {
            chgEv_GW_288_BcmReFoglmpSts = 0;
        }    
        //update the signal value
        Msg_GW_288.BcmReFoglmpSts=rawValue;        
    }                                                                           
}
/*@@end*/

/*@@envVar:E_pubc_GW_GW_288_BcmReFoglmpSts_Pv:*/
on envVar E_pubc_GW_GW_288_BcmReFoglmpSts_Pv
{
    int64 rawValue = 0ll;
    float phyValue = 0.0;
    
    //update the raw value with physical value 
    if(getValue(E_pubc_GW_GW_288_BcmReFoglmpSts_SetVt)==0)
    {
        if(chgEv_GW_288_BcmReFoglmpSts == 0)
        {
            phyValue = getvalue(this);
            // physical to raw conversion
            rawValue = ((phyValue -(0))/1);
            putValue(E_pubc_GW_GW_288_BcmReFoglmpSts_Rv, rawValue);
            chgEv_GW_288_BcmReFoglmpSts = 1;  
        }
        else
        {
            chgEv_GW_288_BcmReFoglmpSts = 0;
        }
    }
}
/*@@end*/

/*@@envVar:E_pubc_GW_GW_288_BcmReFoglmpSts_Vt:*/
on envVar E_pubc_GW_GW_288_BcmReFoglmpSts_Vt
{
    qword rawValue = 0ll;
    if(getValue(E_pubc_GW_GW_288_BcmReFoglmpSts_SetVt))
    {
        //update the signal value
        Msg_GW_288.BcmReFoglmpSts=getValue(this);
    }
}
/*@@end*/

/*@@envVar:E_pubc_GW_GW_288_BcmReFoglmpSts_SetVt:*/
on envVar E_pubc_GW_GW_288_BcmReFoglmpSts_SetVt
{
    if(getValue(E_pubc_GW_GW_288_BcmReFoglmpSts_SetVt))
    {
        //update the signal value
        Msg_GW_288.BcmReFoglmpSts=getvalue(E_pubc_GW_GW_288_BcmReFoglmpSts_Vt);
    }
    else
    {
        Msg_GW_288.BcmReFoglmpSts=getValue(E_pubc_GW_GW_288_BcmReFoglmpSts_Rv);
    }
}
/*@@end*/
 
/*@@envVar:E_pubc_GW_GW_288_BcmAutHeadLiSts_Rv:*/
on envVar E_pubc_GW_GW_288_BcmAutHeadLiSts_Rv
{
    int64 rawValue = 0ll;
    float rawValue_float = 0.0;
    float phyValue = 0.0;        

    //set the signal with updated raw value
    if(getValue(E_pubc_GW_GW_288_BcmAutHeadLiSts_SetVt)==0)
    {
        rawValue = getvalue(this);
        if(chgEv_GW_288_BcmAutHeadLiSts == 0)
        {
            //type conversion to float
            rawValue_float = rawValue;        
            // raw to physical conversion
            phyValue = ((rawValue_float *1)+(0));
            putValue(E_pubc_GW_GW_288_BcmAutHeadLiSts_Pv, phyValue);
            chgEv_GW_288_BcmAutHeadLiSts = 1;
        }
        else
        {
            chgEv_GW_288_BcmAutHeadLiSts = 0;
        }    
        //update the signal value
        Msg_GW_288.BcmAutHeadLiSts=rawValue;        
    }                                                                           
}
/*@@end*/

/*@@envVar:E_pubc_GW_GW_288_BcmAutHeadLiSts_Pv:*/
on envVar E_pubc_GW_GW_288_BcmAutHeadLiSts_Pv
{
    int64 rawValue = 0ll;
    float phyValue = 0.0;
    
    //update the raw value with physical value 
    if(getValue(E_pubc_GW_GW_288_BcmAutHeadLiSts_SetVt)==0)
    {
        if(chgEv_GW_288_BcmAutHeadLiSts == 0)
        {
            phyValue = getvalue(this);
            // physical to raw conversion
            rawValue = ((phyValue -(0))/1);
            putValue(E_pubc_GW_GW_288_BcmAutHeadLiSts_Rv, rawValue);
            chgEv_GW_288_BcmAutHeadLiSts = 1;  
        }
        else
        {
            chgEv_GW_288_BcmAutHeadLiSts = 0;
        }
    }
}
/*@@end*/

/*@@envVar:E_pubc_GW_GW_288_BcmAutHeadLiSts_Vt:*/
on envVar E_pubc_GW_GW_288_BcmAutHeadLiSts_Vt
{
    qword rawValue = 0ll;
    if(getValue(E_pubc_GW_GW_288_BcmAutHeadLiSts_SetVt))
    {
        //update the signal value
        Msg_GW_288.BcmAutHeadLiSts=getValue(this);
    }
}
/*@@end*/

/*@@envVar:E_pubc_GW_GW_288_BcmAutHeadLiSts_SetVt:*/
on envVar E_pubc_GW_GW_288_BcmAutHeadLiSts_SetVt
{
    if(getValue(E_pubc_GW_GW_288_BcmAutHeadLiSts_SetVt))
    {
        //update the signal value
        Msg_GW_288.BcmAutHeadLiSts=getvalue(E_pubc_GW_GW_288_BcmAutHeadLiSts_Vt);
    }
    else
    {
        Msg_GW_288.BcmAutHeadLiSts=getValue(E_pubc_GW_GW_288_BcmAutHeadLiSts_Rv);
    }
}
/*@@end*/
 
/*@@envVar:E_pubc_GW_GW_288_BcmLiSnsrFlt_Rv:*/
on envVar E_pubc_GW_GW_288_BcmLiSnsrFlt_Rv
{
    int64 rawValue = 0ll;
    float rawValue_float = 0.0;
    float phyValue = 0.0;        

    //set the signal with updated raw value
    if(getValue(E_pubc_GW_GW_288_BcmLiSnsrFlt_SetVt)==0)
    {
        rawValue = getvalue(this);
        if(chgEv_GW_288_BcmLiSnsrFlt == 0)
        {
            //type conversion to float
            rawValue_float = rawValue;        
            // raw to physical conversion
            phyValue = ((rawValue_float *1)+(0));
            putValue(E_pubc_GW_GW_288_BcmLiSnsrFlt_Pv, phyValue);
            chgEv_GW_288_BcmLiSnsrFlt = 1;
        }
        else
        {
            chgEv_GW_288_BcmLiSnsrFlt = 0;
        }    
        //update the signal value
        Msg_GW_288.BcmLiSnsrFlt=rawValue;        
    }                                                                           
}
/*@@end*/

/*@@envVar:E_pubc_GW_GW_288_BcmLiSnsrFlt_Pv:*/
on envVar E_pubc_GW_GW_288_BcmLiSnsrFlt_Pv
{
    int64 rawValue = 0ll;
    float phyValue = 0.0;
    
    //update the raw value with physical value 
    if(getValue(E_pubc_GW_GW_288_BcmLiSnsrFlt_SetVt)==0)
    {
        if(chgEv_GW_288_BcmLiSnsrFlt == 0)
        {
            phyValue = getvalue(this);
            // physical to raw conversion
            rawValue = ((phyValue -(0))/1);
            putValue(E_pubc_GW_GW_288_BcmLiSnsrFlt_Rv, rawValue);
            chgEv_GW_288_BcmLiSnsrFlt = 1;  
        }
        else
        {
            chgEv_GW_288_BcmLiSnsrFlt = 0;
        }
    }
}
/*@@end*/

/*@@envVar:E_pubc_GW_GW_288_BcmLiSnsrFlt_Vt:*/
on envVar E_pubc_GW_GW_288_BcmLiSnsrFlt_Vt
{
    qword rawValue = 0ll;
    if(getValue(E_pubc_GW_GW_288_BcmLiSnsrFlt_SetVt))
    {
        //update the signal value
        Msg_GW_288.BcmLiSnsrFlt=getValue(this);
    }
}
/*@@end*/

/*@@envVar:E_pubc_GW_GW_288_BcmLiSnsrFlt_SetVt:*/
on envVar E_pubc_GW_GW_288_BcmLiSnsrFlt_SetVt
{
    if(getValue(E_pubc_GW_GW_288_BcmLiSnsrFlt_SetVt))
    {
        //update the signal value
        Msg_GW_288.BcmLiSnsrFlt=getvalue(E_pubc_GW_GW_288_BcmLiSnsrFlt_Vt);
    }
    else
    {
        Msg_GW_288.BcmLiSnsrFlt=getValue(E_pubc_GW_GW_288_BcmLiSnsrFlt_Rv);
    }
}
/*@@end*/
 
/*@@envVar:E_pubc_GW_GW_288_BcmTurnIndcrRi_Rv:*/
on envVar E_pubc_GW_GW_288_BcmTurnIndcrRi_Rv
{
    int64 rawValue = 0ll;
    float rawValue_float = 0.0;
    float phyValue = 0.0;        

    //set the signal with updated raw value
    if(getValue(E_pubc_GW_GW_288_BcmTurnIndcrRi_SetVt)==0)
    {
        rawValue = getvalue(this);
        if(chgEv_GW_288_BcmTurnIndcrRi == 0)
        {
            //type conversion to float
            rawValue_float = rawValue;        
            // raw to physical conversion
            phyValue = ((rawValue_float *1)+(0));
            putValue(E_pubc_GW_GW_288_BcmTurnIndcrRi_Pv, phyValue);
            chgEv_GW_288_BcmTurnIndcrRi = 1;
        }
        else
        {
            chgEv_GW_288_BcmTurnIndcrRi = 0;
        }    
        //update the signal value
        Msg_GW_288.BcmTurnIndcrRi=rawValue;        
    }                                                                           
}
/*@@end*/

/*@@envVar:E_pubc_GW_GW_288_BcmTurnIndcrRi_Pv:*/
on envVar E_pubc_GW_GW_288_BcmTurnIndcrRi_Pv
{
    int64 rawValue = 0ll;
    float phyValue = 0.0;
    
    //update the raw value with physical value 
    if(getValue(E_pubc_GW_GW_288_BcmTurnIndcrRi_SetVt)==0)
    {
        if(chgEv_GW_288_BcmTurnIndcrRi == 0)
        {
            phyValue = getvalue(this);
            // physical to raw conversion
            rawValue = ((phyValue -(0))/1);
            putValue(E_pubc_GW_GW_288_BcmTurnIndcrRi_Rv, rawValue);
            chgEv_GW_288_BcmTurnIndcrRi = 1;  
        }
        else
        {
            chgEv_GW_288_BcmTurnIndcrRi = 0;
        }
    }
}
/*@@end*/

/*@@envVar:E_pubc_GW_GW_288_BcmTurnIndcrRi_Vt:*/
on envVar E_pubc_GW_GW_288_BcmTurnIndcrRi_Vt
{
    qword rawValue = 0ll;
    if(getValue(E_pubc_GW_GW_288_BcmTurnIndcrRi_SetVt))
    {
        //update the signal value
        Msg_GW_288.BcmTurnIndcrRi=getValue(this);
    }
}
/*@@end*/

/*@@envVar:E_pubc_GW_GW_288_BcmTurnIndcrRi_SetVt:*/
on envVar E_pubc_GW_GW_288_BcmTurnIndcrRi_SetVt
{
    if(getValue(E_pubc_GW_GW_288_BcmTurnIndcrRi_SetVt))
    {
        //update the signal value
        Msg_GW_288.BcmTurnIndcrRi=getvalue(E_pubc_GW_GW_288_BcmTurnIndcrRi_Vt);
    }
    else
    {
        Msg_GW_288.BcmTurnIndcrRi=getValue(E_pubc_GW_GW_288_BcmTurnIndcrRi_Rv);
    }
}
/*@@end*/
 
/*@@envVar:E_pubc_GW_GW_288_BcmFrntWiperSts_Rv:*/
on envVar E_pubc_GW_GW_288_BcmFrntWiperSts_Rv
{
    int64 rawValue = 0ll;
    float rawValue_float = 0.0;
    float phyValue = 0.0;        

    //set the signal with updated raw value
    if(getValue(E_pubc_GW_GW_288_BcmFrntWiperSts_SetVt)==0)
    {
        rawValue = getvalue(this);
        if(chgEv_GW_288_BcmFrntWiperSts == 0)
        {
            //type conversion to float
            rawValue_float = rawValue;        
            // raw to physical conversion
            phyValue = ((rawValue_float *1)+(0));
            putValue(E_pubc_GW_GW_288_BcmFrntWiperSts_Pv, phyValue);
            chgEv_GW_288_BcmFrntWiperSts = 1;
        }
        else
        {
            chgEv_GW_288_BcmFrntWiperSts = 0;
        }    
        //update the signal value
        Msg_GW_288.BcmFrntWiperSts=rawValue;        
    }                                                                           
}
/*@@end*/

/*@@envVar:E_pubc_GW_GW_288_BcmFrntWiperSts_Pv:*/
on envVar E_pubc_GW_GW_288_BcmFrntWiperSts_Pv
{
    int64 rawValue = 0ll;
    float phyValue = 0.0;
    
    //update the raw value with physical value 
    if(getValue(E_pubc_GW_GW_288_BcmFrntWiperSts_SetVt)==0)
    {
        if(chgEv_GW_288_BcmFrntWiperSts == 0)
        {
            phyValue = getvalue(this);
            // physical to raw conversion
            rawValue = ((phyValue -(0))/1);
            putValue(E_pubc_GW_GW_288_BcmFrntWiperSts_Rv, rawValue);
            chgEv_GW_288_BcmFrntWiperSts = 1;  
        }
        else
        {
            chgEv_GW_288_BcmFrntWiperSts = 0;
        }
    }
}
/*@@end*/

/*@@envVar:E_pubc_GW_GW_288_BcmFrntWiperSts_Vt:*/
on envVar E_pubc_GW_GW_288_BcmFrntWiperSts_Vt
{
    qword rawValue = 0ll;
    if(getValue(E_pubc_GW_GW_288_BcmFrntWiperSts_SetVt))
    {
        //update the signal value
        Msg_GW_288.BcmFrntWiperSts=getValue(this);
    }
}
/*@@end*/

/*@@envVar:E_pubc_GW_GW_288_BcmFrntWiperSts_SetVt:*/
on envVar E_pubc_GW_GW_288_BcmFrntWiperSts_SetVt
{
    if(getValue(E_pubc_GW_GW_288_BcmFrntWiperSts_SetVt))
    {
        //update the signal value
        Msg_GW_288.BcmFrntWiperSts=getvalue(E_pubc_GW_GW_288_BcmFrntWiperSts_Vt);
    }
    else
    {
        Msg_GW_288.BcmFrntWiperSts=getValue(E_pubc_GW_GW_288_BcmFrntWiperSts_Rv);
    }
}
/*@@end*/
 
/*@@envVar:E_pubc_GW_GW_288_BcmEmgyLiSts_Rv:*/
on envVar E_pubc_GW_GW_288_BcmEmgyLiSts_Rv
{
    int64 rawValue = 0ll;
    float rawValue_float = 0.0;
    float phyValue = 0.0;        

    //set the signal with updated raw value
    if(getValue(E_pubc_GW_GW_288_BcmEmgyLiSts_SetVt)==0)
    {
        rawValue = getvalue(this);
        if(chgEv_GW_288_BcmEmgyLiSts == 0)
        {
            //type conversion to float
            rawValue_float = rawValue;        
            // raw to physical conversion
            phyValue = ((rawValue_float *1)+(0));
            putValue(E_pubc_GW_GW_288_BcmEmgyLiSts_Pv, phyValue);
            chgEv_GW_288_BcmEmgyLiSts = 1;
        }
        else
        {
            chgEv_GW_288_BcmEmgyLiSts = 0;
        }    
        //update the signal value
        Msg_GW_288.BcmEmgyLiSts=rawValue;        
    }                                                                           
}
/*@@end*/

/*@@envVar:E_pubc_GW_GW_288_BcmEmgyLiSts_Pv:*/
on envVar E_pubc_GW_GW_288_BcmEmgyLiSts_Pv
{
    int64 rawValue = 0ll;
    float phyValue = 0.0;
    
    //update the raw value with physical value 
    if(getValue(E_pubc_GW_GW_288_BcmEmgyLiSts_SetVt)==0)
    {
        if(chgEv_GW_288_BcmEmgyLiSts == 0)
        {
            phyValue = getvalue(this);
            // physical to raw conversion
            rawValue = ((phyValue -(0))/1);
            putValue(E_pubc_GW_GW_288_BcmEmgyLiSts_Rv, rawValue);
            chgEv_GW_288_BcmEmgyLiSts = 1;  
        }
        else
        {
            chgEv_GW_288_BcmEmgyLiSts = 0;
        }
    }
}
/*@@end*/

/*@@envVar:E_pubc_GW_GW_288_BcmEmgyLiSts_Vt:*/
on envVar E_pubc_GW_GW_288_BcmEmgyLiSts_Vt
{
    qword rawValue = 0ll;
    if(getValue(E_pubc_GW_GW_288_BcmEmgyLiSts_SetVt))
    {
        //update the signal value
        Msg_GW_288.BcmEmgyLiSts=getValue(this);
    }
}
/*@@end*/

/*@@envVar:E_pubc_GW_GW_288_BcmEmgyLiSts_SetVt:*/
on envVar E_pubc_GW_GW_288_BcmEmgyLiSts_SetVt
{
    if(getValue(E_pubc_GW_GW_288_BcmEmgyLiSts_SetVt))
    {
        //update the signal value
        Msg_GW_288.BcmEmgyLiSts=getvalue(E_pubc_GW_GW_288_BcmEmgyLiSts_Vt);
    }
    else
    {
        Msg_GW_288.BcmEmgyLiSts=getValue(E_pubc_GW_GW_288_BcmEmgyLiSts_Rv);
    }
}
/*@@end*/
 
/*@@envVar:E_pubc_GW_GW_1D2_tx:*/
on envVar E_pubc_GW_GW_1D2_tx
{
    if(getValue(this))
    {       
        
        //update the BZ Signal
        if(GW_1D2_EspCycCntr1D2_wrongvalctr == 0)
        {
            update_GW_1D2_EspCycCntr1D2_counter();
            Msg_GW_1D2.EspCycCntr1D2= GW_1D2_EspCycCntr1D2_counter;
        }
        else if(GW_1D2_EspCycCntr1D2_wrongvalctr > 0)
        {
			GW_1D2_EspCycCntr1D2_counter=GW_1D2_EspCycCntr1D2_counter + GW_1D2_EspCycCntr1D2_wrongvalctr;
			 Msg_GW_1D2.EspCycCntr1D2= GW_1D2_EspCycCntr1D2_counter;
            /* GW_1D2_EspCycCntr1D2_wrongvalctr--;
              // if counter becomes zero, update panel controller to zero
             if(GW_1D2_EspCycCntr1D2_wrongvalctr == 0)
             {
                 putValue(E_pubc_GW_GW_1D2_EspCycCntr1D2_wrongvalctr,0);
             } */
        }
        else
        { 
			// do nothing
        }    
        //calculate the CRC CheckSum
        update_GW_1D2_CRC_CheckSum();

        output(Msg_GW_1D2);        
    }
}
/*@@end*/

/*@@envVar:E_pubc_GW_GW_1D2_Range:*/
on envVar E_pubc_GW_GW_1D2_Range
{
    qword rawstatus = 0ll;
    qword rawValue = 0ll;    
    
    rawstatus = getvalue(this);    
    // set all the signals with min raw /max raw /init raw
    switch (rawstatus) 
    {
     case(0) :
        rawValue= 0;
        putValue(E_pubc_GW_GW_1D2_EspVirtMstCylTarBrkPVld_Rv, rawValue);
        rawValue= 0;
        putValue(E_pubc_GW_GW_1D2_EspEstimdWhlBrkPMax_Rv, rawValue);
        rawValue= 0;
        putValue(E_pubc_GW_GW_1D2_EspVehSpdIB_Rv, rawValue);
        rawValue= 0;
        putValue(E_pubc_GW_GW_1D2_EspVirtMstCylTarBrkP_Rv, rawValue);
        rawValue= 0;
        putValue(E_pubc_GW_GW_1D2_EspVehSpdVldIB_Rv, rawValue);
        rawValue= 0;
        putValue(E_pubc_GW_GW_1D2_EspMstCylBrkPVldIB_Rv, rawValue);
        rawValue= 0;
        putValue(E_pubc_GW_GW_1D2_EspMstCylBrkPIB_Rv, rawValue);
        break;
     case(1) :
        rawValue= 2;
        putValue(E_pubc_GW_GW_1D2_EspVirtMstCylTarBrkPVld_Rv, rawValue);
        rawValue= 250;
        putValue(E_pubc_GW_GW_1D2_EspEstimdWhlBrkPMax_Rv, rawValue);
        rawValue= 250;
        putValue(E_pubc_GW_GW_1D2_EspVehSpdIB_Rv, rawValue);
        rawValue= 1000;
        putValue(E_pubc_GW_GW_1D2_EspVirtMstCylTarBrkP_Rv, rawValue);
        rawValue= 2;
        putValue(E_pubc_GW_GW_1D2_EspVehSpdVldIB_Rv, rawValue);
        rawValue= 2;
        putValue(E_pubc_GW_GW_1D2_EspMstCylBrkPVldIB_Rv, rawValue);
        rawValue= 1022;
        putValue(E_pubc_GW_GW_1D2_EspMstCylBrkPIB_Rv, rawValue);
        break;
     default :
        rawValue= 0;
        putValue(E_pubc_GW_GW_1D2_EspVirtMstCylTarBrkPVld_Rv, rawValue);
        rawValue= 0;
        putValue(E_pubc_GW_GW_1D2_EspEstimdWhlBrkPMax_Rv, rawValue);
        rawValue= 0;
        putValue(E_pubc_GW_GW_1D2_EspVehSpdIB_Rv, rawValue);
        rawValue= 0;
        putValue(E_pubc_GW_GW_1D2_EspVirtMstCylTarBrkP_Rv, rawValue);
        rawValue= 0;
        putValue(E_pubc_GW_GW_1D2_EspVehSpdVldIB_Rv, rawValue);
        rawValue= 0;
        putValue(E_pubc_GW_GW_1D2_EspMstCylBrkPVldIB_Rv, rawValue);
        rawValue= 0;
        putValue(E_pubc_GW_GW_1D2_EspMstCylBrkPIB_Rv, rawValue);
      break;
   }
}
/*@@end*/

/*@@envVar:E_pubc_GW_GW_1D2_Dlc:*/
on envVar E_pubc_GW_GW_1D2_Dlc
{
    if(getValue(E_pubc_GW_GW_1D2_enDlc))
    {
        Msg_GW_1D2.dlc =getValue(this);
    }
    else
    {
       Dbc_dlc = 64;
	   Msg_GW_1D2.dlc = Calc_Canfd_dlc(Dbc_dlc);
	   // Msg_GW_1D2.dlc = 64;
	   	
  }
}
/*@@end*/

/*@@envVar:E_pubc_GW_GW_1D2_enDlc:*/
on envVar E_pubc_GW_GW_1D2_enDlc
{
    //For Messages with DLC = 8, set wrong DLC to smaller than defined DLC
    //For Messages with DLC < 8 set wrong DLC to smaller/longer than defined DLC
    if(getValue(this))
    {
        Msg_GW_1D2.dlc =getValue(E_pubc_GW_GW_1D2_Dlc);
    }
    else
    {
       Dbc_dlc = 64;
	   Msg_GW_1D2.dlc = Calc_Canfd_dlc(Dbc_dlc);
	   // Msg_GW_1D2.dlc = 64;
    }
}
/*@@end*/

/*@@envVar:E_pubc_GW_GW_1D2_EspCrcChk1D2_wrongvalctr:*/
on envVar E_pubc_GW_GW_1D2_EspCrcChk1D2_wrongvalctr
{
    //update disturb count
    //disturb value range:(-1 = always send wrong value),( X>0 ,x is the number of Messages with wrong CHK sent)
    GW_1D2_EspCrcChk1D2_wrongvalctr =getValue(this);    
}
/*@@end*/
/*@@envVar:E_pubc_GW_GW_1D2_EspCycCntr1D2_wrongvalctr:*/
on envVar E_pubc_GW_GW_1D2_EspCycCntr1D2_wrongvalctr
{
    //update disturb count
    //disturb value range:(-1 = always send wrong value),( X>0 ,x is the number of Messages with wrong CHK sent)
    GW_1D2_EspCycCntr1D2_wrongvalctr =getValue(this);    
}
/*@@end*/

/*@@envVar:E_pubc_GW_GW_1D2_EspVirtMstCylTarBrkPVld_Rv:*/
on envVar E_pubc_GW_GW_1D2_EspVirtMstCylTarBrkPVld_Rv
{
    int64 rawValue = 0ll;
    float rawValue_float = 0.0;
    float phyValue = 0.0;        

    //set the signal with updated raw value
    if(getValue(E_pubc_GW_GW_1D2_EspVirtMstCylTarBrkPVld_SetVt)==0)
    {
        rawValue = getvalue(this);
        if(chgEv_GW_1D2_EspVirtMstCylTarBrkPVld == 0)
        {
            //type conversion to float
            rawValue_float = rawValue;        
            // raw to physical conversion
            phyValue = ((rawValue_float *1)+(0));
            putValue(E_pubc_GW_GW_1D2_EspVirtMstCylTarBrkPVld_Pv, phyValue);
            chgEv_GW_1D2_EspVirtMstCylTarBrkPVld = 1;
        }
        else
        {
            chgEv_GW_1D2_EspVirtMstCylTarBrkPVld = 0;
        }    
        //update the signal value
        Msg_GW_1D2.EspVirtMstCylTarBrkPVld=rawValue;        
    }                                                                           
}
/*@@end*/

/*@@envVar:E_pubc_GW_GW_1D2_EspVirtMstCylTarBrkPVld_Pv:*/
on envVar E_pubc_GW_GW_1D2_EspVirtMstCylTarBrkPVld_Pv
{
    int64 rawValue = 0ll;
    float phyValue = 0.0;
    
    //update the raw value with physical value 
    if(getValue(E_pubc_GW_GW_1D2_EspVirtMstCylTarBrkPVld_SetVt)==0)
    {
        if(chgEv_GW_1D2_EspVirtMstCylTarBrkPVld == 0)
        {
            phyValue = getvalue(this);
            // physical to raw conversion
            rawValue = ((phyValue -(0))/1);
            putValue(E_pubc_GW_GW_1D2_EspVirtMstCylTarBrkPVld_Rv, rawValue);
            chgEv_GW_1D2_EspVirtMstCylTarBrkPVld = 1;  
        }
        else
        {
            chgEv_GW_1D2_EspVirtMstCylTarBrkPVld = 0;
        }
    }
}
/*@@end*/

/*@@envVar:E_pubc_GW_GW_1D2_EspVirtMstCylTarBrkPVld_Vt:*/
on envVar E_pubc_GW_GW_1D2_EspVirtMstCylTarBrkPVld_Vt
{
    qword rawValue = 0ll;
    if(getValue(E_pubc_GW_GW_1D2_EspVirtMstCylTarBrkPVld_SetVt))
    {
        //update the signal value
        Msg_GW_1D2.EspVirtMstCylTarBrkPVld=getValue(this);
    }
}
/*@@end*/

/*@@envVar:E_pubc_GW_GW_1D2_EspVirtMstCylTarBrkPVld_SetVt:*/
on envVar E_pubc_GW_GW_1D2_EspVirtMstCylTarBrkPVld_SetVt
{
    if(getValue(E_pubc_GW_GW_1D2_EspVirtMstCylTarBrkPVld_SetVt))
    {
        //update the signal value
        Msg_GW_1D2.EspVirtMstCylTarBrkPVld=getvalue(E_pubc_GW_GW_1D2_EspVirtMstCylTarBrkPVld_Vt);
    }
    else
    {
        Msg_GW_1D2.EspVirtMstCylTarBrkPVld=getValue(E_pubc_GW_GW_1D2_EspVirtMstCylTarBrkPVld_Rv);
    }
}
/*@@end*/
 
/*@@envVar:E_pubc_GW_GW_1D2_EspEstimdWhlBrkPMax_Rv:*/
on envVar E_pubc_GW_GW_1D2_EspEstimdWhlBrkPMax_Rv
{
    int64 rawValue = 0ll;
    float rawValue_float = 0.0;
    float phyValue = 0.0;        

    //set the signal with updated raw value
    {
        rawValue = getvalue(this);
        if(chgEv_GW_1D2_EspEstimdWhlBrkPMax == 0)
        {
            //type conversion to float
            rawValue_float = rawValue;        
            // raw to physical conversion
            phyValue = ((rawValue_float *1)+(0));
            putValue(E_pubc_GW_GW_1D2_EspEstimdWhlBrkPMax_Pv, phyValue);
            chgEv_GW_1D2_EspEstimdWhlBrkPMax = 1;
        }
        else
        {
            chgEv_GW_1D2_EspEstimdWhlBrkPMax = 0;
        }    
        //update the signal value
        Msg_GW_1D2.EspEstimdWhlBrkPMax=rawValue;        
    }                                                                           
}
/*@@end*/

/*@@envVar:E_pubc_GW_GW_1D2_EspEstimdWhlBrkPMax_Pv:*/
on envVar E_pubc_GW_GW_1D2_EspEstimdWhlBrkPMax_Pv
{
    int64 rawValue = 0ll;
    float phyValue = 0.0;
    
    //update the raw value with physical value 
    {
        if(chgEv_GW_1D2_EspEstimdWhlBrkPMax == 0)
        {
            phyValue = getvalue(this);
            // physical to raw conversion
            rawValue = ((phyValue -(0))/1);
            putValue(E_pubc_GW_GW_1D2_EspEstimdWhlBrkPMax_Rv, rawValue);
            chgEv_GW_1D2_EspEstimdWhlBrkPMax = 1;  
        }
        else
        {
            chgEv_GW_1D2_EspEstimdWhlBrkPMax = 0;
        }
    }
}
/*@@end*/


 
/*@@envVar:E_pubc_GW_GW_1D2_EspVehSpdIB_Rv:*/
on envVar E_pubc_GW_GW_1D2_EspVehSpdIB_Rv
{
    int64 rawValue = 0ll;
    float rawValue_float = 0.0;
    float phyValue = 0.0;        

    //set the signal with updated raw value
    {
        rawValue = getvalue(this);
        if(chgEv_GW_1D2_EspVehSpdIB == 0)
        {
            //type conversion to float
            rawValue_float = rawValue;        
            // raw to physical conversion
            phyValue = ((rawValue_float *1.44)+(0));
            putValue(E_pubc_GW_GW_1D2_EspVehSpdIB_Pv, phyValue);
            chgEv_GW_1D2_EspVehSpdIB = 1;
        }
        else
        {
            chgEv_GW_1D2_EspVehSpdIB = 0;
        }    
        //update the signal value
        Msg_GW_1D2.EspVehSpdIB=rawValue;        
    }                                                                           
}
/*@@end*/

/*@@envVar:E_pubc_GW_GW_1D2_EspVehSpdIB_Pv:*/
on envVar E_pubc_GW_GW_1D2_EspVehSpdIB_Pv
{
    int64 rawValue = 0ll;
    float phyValue = 0.0;
    
    //update the raw value with physical value 
    {
        if(chgEv_GW_1D2_EspVehSpdIB == 0)
        {
            phyValue = getvalue(this);
            // physical to raw conversion
            rawValue = ((phyValue -(0))/1.44);
            putValue(E_pubc_GW_GW_1D2_EspVehSpdIB_Rv, rawValue);
            chgEv_GW_1D2_EspVehSpdIB = 1;  
        }
        else
        {
            chgEv_GW_1D2_EspVehSpdIB = 0;
        }
    }
}
/*@@end*/


 
/*@@envVar:E_pubc_GW_GW_1D2_EspVirtMstCylTarBrkP_Rv:*/
on envVar E_pubc_GW_GW_1D2_EspVirtMstCylTarBrkP_Rv
{
    int64 rawValue = 0ll;
    float rawValue_float = 0.0;
    float phyValue = 0.0;        

    //set the signal with updated raw value
    {
        rawValue = getvalue(this);
        if(chgEv_GW_1D2_EspVirtMstCylTarBrkP == 0)
        {
            //type conversion to float
            rawValue_float = rawValue;        
            // raw to physical conversion
            phyValue = ((rawValue_float *0.25)+(0));
            putValue(E_pubc_GW_GW_1D2_EspVirtMstCylTarBrkP_Pv, phyValue);
            chgEv_GW_1D2_EspVirtMstCylTarBrkP = 1;
        }
        else
        {
            chgEv_GW_1D2_EspVirtMstCylTarBrkP = 0;
        }    
        //update the signal value
        Msg_GW_1D2.EspVirtMstCylTarBrkP=rawValue;        
    }                                                                           
}
/*@@end*/

/*@@envVar:E_pubc_GW_GW_1D2_EspVirtMstCylTarBrkP_Pv:*/
on envVar E_pubc_GW_GW_1D2_EspVirtMstCylTarBrkP_Pv
{
    int64 rawValue = 0ll;
    float phyValue = 0.0;
    
    //update the raw value with physical value 
    {
        if(chgEv_GW_1D2_EspVirtMstCylTarBrkP == 0)
        {
            phyValue = getvalue(this);
            // physical to raw conversion
            rawValue = ((phyValue -(0))/0.25);
            putValue(E_pubc_GW_GW_1D2_EspVirtMstCylTarBrkP_Rv, rawValue);
            chgEv_GW_1D2_EspVirtMstCylTarBrkP = 1;  
        }
        else
        {
            chgEv_GW_1D2_EspVirtMstCylTarBrkP = 0;
        }
    }
}
/*@@end*/


 
/*@@envVar:E_pubc_GW_GW_1D2_EspVehSpdVldIB_Rv:*/
on envVar E_pubc_GW_GW_1D2_EspVehSpdVldIB_Rv
{
    int64 rawValue = 0ll;
    float rawValue_float = 0.0;
    float phyValue = 0.0;        

    //set the signal with updated raw value
    if(getValue(E_pubc_GW_GW_1D2_EspVehSpdVldIB_SetVt)==0)
    {
        rawValue = getvalue(this);
        if(chgEv_GW_1D2_EspVehSpdVldIB == 0)
        {
            //type conversion to float
            rawValue_float = rawValue;        
            // raw to physical conversion
            phyValue = ((rawValue_float *1)+(0));
            putValue(E_pubc_GW_GW_1D2_EspVehSpdVldIB_Pv, phyValue);
            chgEv_GW_1D2_EspVehSpdVldIB = 1;
        }
        else
        {
            chgEv_GW_1D2_EspVehSpdVldIB = 0;
        }    
        //update the signal value
        Msg_GW_1D2.EspVehSpdVldIB=rawValue;        
    }                                                                           
}
/*@@end*/

/*@@envVar:E_pubc_GW_GW_1D2_EspVehSpdVldIB_Pv:*/
on envVar E_pubc_GW_GW_1D2_EspVehSpdVldIB_Pv
{
    int64 rawValue = 0ll;
    float phyValue = 0.0;
    
    //update the raw value with physical value 
    if(getValue(E_pubc_GW_GW_1D2_EspVehSpdVldIB_SetVt)==0)
    {
        if(chgEv_GW_1D2_EspVehSpdVldIB == 0)
        {
            phyValue = getvalue(this);
            // physical to raw conversion
            rawValue = ((phyValue -(0))/1);
            putValue(E_pubc_GW_GW_1D2_EspVehSpdVldIB_Rv, rawValue);
            chgEv_GW_1D2_EspVehSpdVldIB = 1;  
        }
        else
        {
            chgEv_GW_1D2_EspVehSpdVldIB = 0;
        }
    }
}
/*@@end*/

/*@@envVar:E_pubc_GW_GW_1D2_EspVehSpdVldIB_Vt:*/
on envVar E_pubc_GW_GW_1D2_EspVehSpdVldIB_Vt
{
    qword rawValue = 0ll;
    if(getValue(E_pubc_GW_GW_1D2_EspVehSpdVldIB_SetVt))
    {
        //update the signal value
        Msg_GW_1D2.EspVehSpdVldIB=getValue(this);
    }
}
/*@@end*/

/*@@envVar:E_pubc_GW_GW_1D2_EspVehSpdVldIB_SetVt:*/
on envVar E_pubc_GW_GW_1D2_EspVehSpdVldIB_SetVt
{
    if(getValue(E_pubc_GW_GW_1D2_EspVehSpdVldIB_SetVt))
    {
        //update the signal value
        Msg_GW_1D2.EspVehSpdVldIB=getvalue(E_pubc_GW_GW_1D2_EspVehSpdVldIB_Vt);
    }
    else
    {
        Msg_GW_1D2.EspVehSpdVldIB=getValue(E_pubc_GW_GW_1D2_EspVehSpdVldIB_Rv);
    }
}
/*@@end*/
 
/*@@envVar:E_pubc_GW_GW_1D2_EspMstCylBrkPVldIB_Rv:*/
on envVar E_pubc_GW_GW_1D2_EspMstCylBrkPVldIB_Rv
{
    int64 rawValue = 0ll;
    float rawValue_float = 0.0;
    float phyValue = 0.0;        

    //set the signal with updated raw value
    if(getValue(E_pubc_GW_GW_1D2_EspMstCylBrkPVldIB_SetVt)==0)
    {
        rawValue = getvalue(this);
        if(chgEv_GW_1D2_EspMstCylBrkPVldIB == 0)
        {
            //type conversion to float
            rawValue_float = rawValue;        
            // raw to physical conversion
            phyValue = ((rawValue_float *1)+(0));
            putValue(E_pubc_GW_GW_1D2_EspMstCylBrkPVldIB_Pv, phyValue);
            chgEv_GW_1D2_EspMstCylBrkPVldIB = 1;
        }
        else
        {
            chgEv_GW_1D2_EspMstCylBrkPVldIB = 0;
        }    
        //update the signal value
        Msg_GW_1D2.EspMstCylBrkPVldIB=rawValue;        
    }                                                                           
}
/*@@end*/

/*@@envVar:E_pubc_GW_GW_1D2_EspMstCylBrkPVldIB_Pv:*/
on envVar E_pubc_GW_GW_1D2_EspMstCylBrkPVldIB_Pv
{
    int64 rawValue = 0ll;
    float phyValue = 0.0;
    
    //update the raw value with physical value 
    if(getValue(E_pubc_GW_GW_1D2_EspMstCylBrkPVldIB_SetVt)==0)
    {
        if(chgEv_GW_1D2_EspMstCylBrkPVldIB == 0)
        {
            phyValue = getvalue(this);
            // physical to raw conversion
            rawValue = ((phyValue -(0))/1);
            putValue(E_pubc_GW_GW_1D2_EspMstCylBrkPVldIB_Rv, rawValue);
            chgEv_GW_1D2_EspMstCylBrkPVldIB = 1;  
        }
        else
        {
            chgEv_GW_1D2_EspMstCylBrkPVldIB = 0;
        }
    }
}
/*@@end*/

/*@@envVar:E_pubc_GW_GW_1D2_EspMstCylBrkPVldIB_Vt:*/
on envVar E_pubc_GW_GW_1D2_EspMstCylBrkPVldIB_Vt
{
    qword rawValue = 0ll;
    if(getValue(E_pubc_GW_GW_1D2_EspMstCylBrkPVldIB_SetVt))
    {
        //update the signal value
        Msg_GW_1D2.EspMstCylBrkPVldIB=getValue(this);
    }
}
/*@@end*/

/*@@envVar:E_pubc_GW_GW_1D2_EspMstCylBrkPVldIB_SetVt:*/
on envVar E_pubc_GW_GW_1D2_EspMstCylBrkPVldIB_SetVt
{
    if(getValue(E_pubc_GW_GW_1D2_EspMstCylBrkPVldIB_SetVt))
    {
        //update the signal value
        Msg_GW_1D2.EspMstCylBrkPVldIB=getvalue(E_pubc_GW_GW_1D2_EspMstCylBrkPVldIB_Vt);
    }
    else
    {
        Msg_GW_1D2.EspMstCylBrkPVldIB=getValue(E_pubc_GW_GW_1D2_EspMstCylBrkPVldIB_Rv);
    }
}
/*@@end*/
 
/*@@envVar:E_pubc_GW_GW_1D2_EspMstCylBrkPIB_Rv:*/
on envVar E_pubc_GW_GW_1D2_EspMstCylBrkPIB_Rv
{
    int64 rawValue = 0ll;
    float rawValue_float = 0.0;
    float phyValue = 0.0;        

    //set the signal with updated raw value
    {
        rawValue = getvalue(this);
        if(chgEv_GW_1D2_EspMstCylBrkPIB == 0)
        {
            //type conversion to float
            rawValue_float = rawValue;        
            // raw to physical conversion
            phyValue = ((rawValue_float *0.3)+(-30));
            putValue(E_pubc_GW_GW_1D2_EspMstCylBrkPIB_Pv, phyValue);
            chgEv_GW_1D2_EspMstCylBrkPIB = 1;
        }
        else
        {
            chgEv_GW_1D2_EspMstCylBrkPIB = 0;
        }    
        //update the signal value
        Msg_GW_1D2.EspMstCylBrkPIB=rawValue;        
    }                                                                           
}
/*@@end*/

/*@@envVar:E_pubc_GW_GW_1D2_EspMstCylBrkPIB_Pv:*/
on envVar E_pubc_GW_GW_1D2_EspMstCylBrkPIB_Pv
{
    int64 rawValue = 0ll;
    float phyValue = 0.0;
    
    //update the raw value with physical value 
    {
        if(chgEv_GW_1D2_EspMstCylBrkPIB == 0)
        {
            phyValue = getvalue(this);
            // physical to raw conversion
            rawValue = ((phyValue -(-30))/0.3);
            putValue(E_pubc_GW_GW_1D2_EspMstCylBrkPIB_Rv, rawValue);
            chgEv_GW_1D2_EspMstCylBrkPIB = 1;  
        }
        else
        {
            chgEv_GW_1D2_EspMstCylBrkPIB = 0;
        }
    }
}
/*@@end*/


 
/*@@envVar:E_pubc_GW_GW_284_tx:*/
on envVar E_pubc_GW_GW_284_tx
{
    if(getValue(this))
    {       
        

        output(Msg_GW_284);        
    }
}
/*@@end*/

/*@@envVar:E_pubc_GW_GW_284_Range:*/
on envVar E_pubc_GW_GW_284_Range
{
    qword rawstatus = 0ll;
    qword rawValue = 0ll;    
    
    rawstatus = getvalue(this);    
    // set all the signals with min raw /max raw /init raw
    switch (rawstatus) 
    {
     case(0) :
        rawValue= 0;
        putValue(E_pubc_GW_GW_284_RRC_OBJ7_RefPointLoc_Rv, rawValue);
        rawValue= 0;
        putValue(E_pubc_GW_GW_284_RRC_OBJ2_RefPointDx_Rv, rawValue);
        rawValue= 0;
        putValue(E_pubc_GW_GW_284_RRC_OBJ2_RefPointDy_Rv, rawValue);
        rawValue= 0;
        putValue(E_pubc_GW_GW_284_RRC_OBJ8_RefPointDx_Rv, rawValue);
        rawValue= 0;
        putValue(E_pubc_GW_GW_284_RRC_OBJ8_RefPointDy_Rv, rawValue);
        rawValue= 0;
        putValue(E_pubc_GW_GW_284_RRC_OBJ6_RefPointDx_Rv, rawValue);
        rawValue= 0;
        putValue(E_pubc_GW_GW_284_RRC_OBJ6_RefPointDy_Rv, rawValue);
        rawValue= 0;
        putValue(E_pubc_GW_GW_284_RRC_OBJ1_RefPointLoc_Rv, rawValue);
        rawValue= 0;
        putValue(E_pubc_GW_GW_284_RRC_OBJ1_RefPointDx_Rv, rawValue);
        rawValue= 0;
        putValue(E_pubc_GW_GW_284_RRC_OBJ5_RefPointDy_Rv, rawValue);
        rawValue= 0;
        putValue(E_pubc_GW_GW_284_RRC_OBJ5_RefPointDx_Rv, rawValue);
        rawValue= 0;
        putValue(E_pubc_GW_GW_284_RRC_OBJ7_RefPointDy_Rv, rawValue);
        rawValue= 0;
        putValue(E_pubc_GW_GW_284_RRC_OBJ7_RefPointDx_Rv, rawValue);
        rawValue= 0;
        putValue(E_pubc_GW_GW_284_RRC_OBJ10_RefPointDx_Rv, rawValue);
        rawValue= 0;
        putValue(E_pubc_GW_GW_284_RRC_OBJ10_RefPointDy_Rv, rawValue);
        rawValue= 0;
        putValue(E_pubc_GW_GW_284_RRC_OBJ5_RefPointLoc_Rv, rawValue);
        rawValue= 0;
        putValue(E_pubc_GW_GW_284_RRC_OBJ1_RefPointDy_Rv, rawValue);
        rawValue= 0;
        putValue(E_pubc_GW_GW_284_RRC_OBJ4_RefPointDx_Rv, rawValue);
        rawValue= 0;
        putValue(E_pubc_GW_GW_284_RRC_OBJ4_RefPointDy_Rv, rawValue);
        rawValue= 0;
        putValue(E_pubc_GW_GW_284_RRC_OBJ2_RefPointLoc_Rv, rawValue);
        rawValue= 0;
        putValue(E_pubc_GW_GW_284_RRC_OBJ10_RefPointLoc_Rv, rawValue);
        rawValue= 0;
        putValue(E_pubc_GW_GW_284_RRC_OBJ3_RefPointDy_Rv, rawValue);
        rawValue= 0;
        putValue(E_pubc_GW_GW_284_RRC_OBJ3_RefPointDx_Rv, rawValue);
        rawValue= 0;
        putValue(E_pubc_GW_GW_284_RRC_OBJ6_RefPointLoc_Rv, rawValue);
        rawValue= 0;
        putValue(E_pubc_GW_GW_284_RRC_OBJ9_RefPointDy_Rv, rawValue);
        rawValue= 0;
        putValue(E_pubc_GW_GW_284_RRC_OBJ9_RefPointDx_Rv, rawValue);
        rawValue= 0;
        putValue(E_pubc_GW_GW_284_RRC_OBJ3_RefPointLoc_Rv, rawValue);
        rawValue= 0;
        putValue(E_pubc_GW_GW_284_RRC_OBJ9_RefPointLoc_Rv, rawValue);
        rawValue= 0;
        putValue(E_pubc_GW_GW_284_RRC_OBJ8_RefPointLoc_Rv, rawValue);
        rawValue= 0;
        putValue(E_pubc_GW_GW_284_RRC_OBJ4_RefPointLoc_Rv, rawValue);
        break;
     case(1) :
        rawValue= 7;
        putValue(E_pubc_GW_GW_284_RRC_OBJ7_RefPointLoc_Rv, rawValue);
        rawValue= 8191;
        putValue(E_pubc_GW_GW_284_RRC_OBJ2_RefPointDx_Rv, rawValue);
        rawValue= 2047;
        putValue(E_pubc_GW_GW_284_RRC_OBJ2_RefPointDy_Rv, rawValue);
        rawValue= 8191;
        putValue(E_pubc_GW_GW_284_RRC_OBJ8_RefPointDx_Rv, rawValue);
        rawValue= 2047;
        putValue(E_pubc_GW_GW_284_RRC_OBJ8_RefPointDy_Rv, rawValue);
        rawValue= 8191;
        putValue(E_pubc_GW_GW_284_RRC_OBJ6_RefPointDx_Rv, rawValue);
        rawValue= 2047;
        putValue(E_pubc_GW_GW_284_RRC_OBJ6_RefPointDy_Rv, rawValue);
        rawValue= 7;
        putValue(E_pubc_GW_GW_284_RRC_OBJ1_RefPointLoc_Rv, rawValue);
        rawValue= 8191;
        putValue(E_pubc_GW_GW_284_RRC_OBJ1_RefPointDx_Rv, rawValue);
        rawValue= 2047;
        putValue(E_pubc_GW_GW_284_RRC_OBJ5_RefPointDy_Rv, rawValue);
        rawValue= 8191;
        putValue(E_pubc_GW_GW_284_RRC_OBJ5_RefPointDx_Rv, rawValue);
        rawValue= 2047;
        putValue(E_pubc_GW_GW_284_RRC_OBJ7_RefPointDy_Rv, rawValue);
        rawValue= 8191;
        putValue(E_pubc_GW_GW_284_RRC_OBJ7_RefPointDx_Rv, rawValue);
        rawValue= 8191;
        putValue(E_pubc_GW_GW_284_RRC_OBJ10_RefPointDx_Rv, rawValue);
        rawValue= 2047;
        putValue(E_pubc_GW_GW_284_RRC_OBJ10_RefPointDy_Rv, rawValue);
        rawValue= 7;
        putValue(E_pubc_GW_GW_284_RRC_OBJ5_RefPointLoc_Rv, rawValue);
        rawValue= 2047;
        putValue(E_pubc_GW_GW_284_RRC_OBJ1_RefPointDy_Rv, rawValue);
        rawValue= 8191;
        putValue(E_pubc_GW_GW_284_RRC_OBJ4_RefPointDx_Rv, rawValue);
        rawValue= 2047;
        putValue(E_pubc_GW_GW_284_RRC_OBJ4_RefPointDy_Rv, rawValue);
        rawValue= 7;
        putValue(E_pubc_GW_GW_284_RRC_OBJ2_RefPointLoc_Rv, rawValue);
        rawValue= 7;
        putValue(E_pubc_GW_GW_284_RRC_OBJ10_RefPointLoc_Rv, rawValue);
        rawValue= 2047;
        putValue(E_pubc_GW_GW_284_RRC_OBJ3_RefPointDy_Rv, rawValue);
        rawValue= 8191;
        putValue(E_pubc_GW_GW_284_RRC_OBJ3_RefPointDx_Rv, rawValue);
        rawValue= 7;
        putValue(E_pubc_GW_GW_284_RRC_OBJ6_RefPointLoc_Rv, rawValue);
        rawValue= 2047;
        putValue(E_pubc_GW_GW_284_RRC_OBJ9_RefPointDy_Rv, rawValue);
        rawValue= 8191;
        putValue(E_pubc_GW_GW_284_RRC_OBJ9_RefPointDx_Rv, rawValue);
        rawValue= 7;
        putValue(E_pubc_GW_GW_284_RRC_OBJ3_RefPointLoc_Rv, rawValue);
        rawValue= 7;
        putValue(E_pubc_GW_GW_284_RRC_OBJ9_RefPointLoc_Rv, rawValue);
        rawValue= 7;
        putValue(E_pubc_GW_GW_284_RRC_OBJ8_RefPointLoc_Rv, rawValue);
        rawValue= 7;
        putValue(E_pubc_GW_GW_284_RRC_OBJ4_RefPointLoc_Rv, rawValue);
        break;
     default :
        rawValue= 0;
        putValue(E_pubc_GW_GW_284_RRC_OBJ7_RefPointLoc_Rv, rawValue);
        rawValue= 0;
        putValue(E_pubc_GW_GW_284_RRC_OBJ2_RefPointDx_Rv, rawValue);
        rawValue= 0;
        putValue(E_pubc_GW_GW_284_RRC_OBJ2_RefPointDy_Rv, rawValue);
        rawValue= 0;
        putValue(E_pubc_GW_GW_284_RRC_OBJ8_RefPointDx_Rv, rawValue);
        rawValue= 0;
        putValue(E_pubc_GW_GW_284_RRC_OBJ8_RefPointDy_Rv, rawValue);
        rawValue= 0;
        putValue(E_pubc_GW_GW_284_RRC_OBJ6_RefPointDx_Rv, rawValue);
        rawValue= 0;
        putValue(E_pubc_GW_GW_284_RRC_OBJ6_RefPointDy_Rv, rawValue);
        rawValue= 0;
        putValue(E_pubc_GW_GW_284_RRC_OBJ1_RefPointLoc_Rv, rawValue);
        rawValue= 0;
        putValue(E_pubc_GW_GW_284_RRC_OBJ1_RefPointDx_Rv, rawValue);
        rawValue= 0;
        putValue(E_pubc_GW_GW_284_RRC_OBJ5_RefPointDy_Rv, rawValue);
        rawValue= 0;
        putValue(E_pubc_GW_GW_284_RRC_OBJ5_RefPointDx_Rv, rawValue);
        rawValue= 0;
        putValue(E_pubc_GW_GW_284_RRC_OBJ7_RefPointDy_Rv, rawValue);
        rawValue= 0;
        putValue(E_pubc_GW_GW_284_RRC_OBJ7_RefPointDx_Rv, rawValue);
        rawValue= 0;
        putValue(E_pubc_GW_GW_284_RRC_OBJ10_RefPointDx_Rv, rawValue);
        rawValue= 0;
        putValue(E_pubc_GW_GW_284_RRC_OBJ10_RefPointDy_Rv, rawValue);
        rawValue= 0;
        putValue(E_pubc_GW_GW_284_RRC_OBJ5_RefPointLoc_Rv, rawValue);
        rawValue= 0;
        putValue(E_pubc_GW_GW_284_RRC_OBJ1_RefPointDy_Rv, rawValue);
        rawValue= 0;
        putValue(E_pubc_GW_GW_284_RRC_OBJ4_RefPointDx_Rv, rawValue);
        rawValue= 0;
        putValue(E_pubc_GW_GW_284_RRC_OBJ4_RefPointDy_Rv, rawValue);
        rawValue= 0;
        putValue(E_pubc_GW_GW_284_RRC_OBJ2_RefPointLoc_Rv, rawValue);
        rawValue= 0;
        putValue(E_pubc_GW_GW_284_RRC_OBJ10_RefPointLoc_Rv, rawValue);
        rawValue= 0;
        putValue(E_pubc_GW_GW_284_RRC_OBJ3_RefPointDy_Rv, rawValue);
        rawValue= 0;
        putValue(E_pubc_GW_GW_284_RRC_OBJ3_RefPointDx_Rv, rawValue);
        rawValue= 0;
        putValue(E_pubc_GW_GW_284_RRC_OBJ6_RefPointLoc_Rv, rawValue);
        rawValue= 0;
        putValue(E_pubc_GW_GW_284_RRC_OBJ9_RefPointDy_Rv, rawValue);
        rawValue= 0;
        putValue(E_pubc_GW_GW_284_RRC_OBJ9_RefPointDx_Rv, rawValue);
        rawValue= 0;
        putValue(E_pubc_GW_GW_284_RRC_OBJ3_RefPointLoc_Rv, rawValue);
        rawValue= 0;
        putValue(E_pubc_GW_GW_284_RRC_OBJ9_RefPointLoc_Rv, rawValue);
        rawValue= 0;
        putValue(E_pubc_GW_GW_284_RRC_OBJ8_RefPointLoc_Rv, rawValue);
        rawValue= 0;
        putValue(E_pubc_GW_GW_284_RRC_OBJ4_RefPointLoc_Rv, rawValue);
      break;
   }
}
/*@@end*/

/*@@envVar:E_pubc_GW_GW_284_Dlc:*/
on envVar E_pubc_GW_GW_284_Dlc
{
    if(getValue(E_pubc_GW_GW_284_enDlc))
    {
        Msg_GW_284.dlc =getValue(this);
    }
    else
    {
       Dbc_dlc = 64;
	   Msg_GW_284.dlc = Calc_Canfd_dlc(Dbc_dlc);
	   // Msg_GW_284.dlc = 64;
	   	
  }
}
/*@@end*/

/*@@envVar:E_pubc_GW_GW_284_enDlc:*/
on envVar E_pubc_GW_GW_284_enDlc
{
    //For Messages with DLC = 8, set wrong DLC to smaller than defined DLC
    //For Messages with DLC < 8 set wrong DLC to smaller/longer than defined DLC
    if(getValue(this))
    {
        Msg_GW_284.dlc =getValue(E_pubc_GW_GW_284_Dlc);
    }
    else
    {
       Dbc_dlc = 64;
	   Msg_GW_284.dlc = Calc_Canfd_dlc(Dbc_dlc);
	   // Msg_GW_284.dlc = 64;
    }
}
/*@@end*/


/*@@envVar:E_pubc_GW_GW_284_RRC_OBJ7_RefPointLoc_Rv:*/
on envVar E_pubc_GW_GW_284_RRC_OBJ7_RefPointLoc_Rv
{
    int64 rawValue = 0ll;
    float rawValue_float = 0.0;
    float phyValue = 0.0;        

    //set the signal with updated raw value
    {
        rawValue = getvalue(this);
        if(chgEv_GW_284_RRC_OBJ7_RefPointLoc == 0)
        {
            //type conversion to float
            rawValue_float = rawValue;        
            // raw to physical conversion
            phyValue = ((rawValue_float *1)+(0));
            putValue(E_pubc_GW_GW_284_RRC_OBJ7_RefPointLoc_Pv, phyValue);
            chgEv_GW_284_RRC_OBJ7_RefPointLoc = 1;
        }
        else
        {
            chgEv_GW_284_RRC_OBJ7_RefPointLoc = 0;
        }    
        //update the signal value
        Msg_GW_284.RRC_OBJ7_RefPointLoc=rawValue;        
    }                                                                           
}
/*@@end*/

/*@@envVar:E_pubc_GW_GW_284_RRC_OBJ7_RefPointLoc_Pv:*/
on envVar E_pubc_GW_GW_284_RRC_OBJ7_RefPointLoc_Pv
{
    int64 rawValue = 0ll;
    float phyValue = 0.0;
    
    //update the raw value with physical value 
    {
        if(chgEv_GW_284_RRC_OBJ7_RefPointLoc == 0)
        {
            phyValue = getvalue(this);
            // physical to raw conversion
            rawValue = ((phyValue -(0))/1);
            putValue(E_pubc_GW_GW_284_RRC_OBJ7_RefPointLoc_Rv, rawValue);
            chgEv_GW_284_RRC_OBJ7_RefPointLoc = 1;  
        }
        else
        {
            chgEv_GW_284_RRC_OBJ7_RefPointLoc = 0;
        }
    }
}
/*@@end*/


 
/*@@envVar:E_pubc_GW_GW_284_RRC_OBJ2_RefPointDx_Rv:*/
on envVar E_pubc_GW_GW_284_RRC_OBJ2_RefPointDx_Rv
{
    int64 rawValue = 0ll;
    float rawValue_float = 0.0;
    float phyValue = 0.0;        

    //set the signal with updated raw value
    {
        rawValue = getvalue(this);
        if(chgEv_GW_284_RRC_OBJ2_RefPointDx == 0)
        {
            //type conversion to float
            rawValue_float = rawValue;        
            // raw to physical conversion
            phyValue = ((rawValue_float *0.0625)+(-256));
            putValue(E_pubc_GW_GW_284_RRC_OBJ2_RefPointDx_Pv, phyValue);
            chgEv_GW_284_RRC_OBJ2_RefPointDx = 1;
        }
        else
        {
            chgEv_GW_284_RRC_OBJ2_RefPointDx = 0;
        }    
        //update the signal value
        Msg_GW_284.RRC_OBJ2_RefPointDx=rawValue;        
    }                                                                           
}
/*@@end*/

/*@@envVar:E_pubc_GW_GW_284_RRC_OBJ2_RefPointDx_Pv:*/
on envVar E_pubc_GW_GW_284_RRC_OBJ2_RefPointDx_Pv
{
    int64 rawValue = 0ll;
    float phyValue = 0.0;
    
    //update the raw value with physical value 
    {
        if(chgEv_GW_284_RRC_OBJ2_RefPointDx == 0)
        {
            phyValue = getvalue(this);
            // physical to raw conversion
            rawValue = ((phyValue -(-256))/0.0625);
            putValue(E_pubc_GW_GW_284_RRC_OBJ2_RefPointDx_Rv, rawValue);
            chgEv_GW_284_RRC_OBJ2_RefPointDx = 1;  
        }
        else
        {
            chgEv_GW_284_RRC_OBJ2_RefPointDx = 0;
        }
    }
}
/*@@end*/


 
/*@@envVar:E_pubc_GW_GW_284_RRC_OBJ2_RefPointDy_Rv:*/
on envVar E_pubc_GW_GW_284_RRC_OBJ2_RefPointDy_Rv
{
    int64 rawValue = 0ll;
    float rawValue_float = 0.0;
    float phyValue = 0.0;        

    //set the signal with updated raw value
    {
        rawValue = getvalue(this);
        if(chgEv_GW_284_RRC_OBJ2_RefPointDy == 0)
        {
            //type conversion to float
            rawValue_float = rawValue;        
            // raw to physical conversion
            phyValue = ((rawValue_float *0.125)+(-128));
            putValue(E_pubc_GW_GW_284_RRC_OBJ2_RefPointDy_Pv, phyValue);
            chgEv_GW_284_RRC_OBJ2_RefPointDy = 1;
        }
        else
        {
            chgEv_GW_284_RRC_OBJ2_RefPointDy = 0;
        }    
        //update the signal value
        Msg_GW_284.RRC_OBJ2_RefPointDy=rawValue;        
    }                                                                           
}
/*@@end*/

/*@@envVar:E_pubc_GW_GW_284_RRC_OBJ2_RefPointDy_Pv:*/
on envVar E_pubc_GW_GW_284_RRC_OBJ2_RefPointDy_Pv
{
    int64 rawValue = 0ll;
    float phyValue = 0.0;
    
    //update the raw value with physical value 
    {
        if(chgEv_GW_284_RRC_OBJ2_RefPointDy == 0)
        {
            phyValue = getvalue(this);
            // physical to raw conversion
            rawValue = ((phyValue -(-128))/0.125);
            putValue(E_pubc_GW_GW_284_RRC_OBJ2_RefPointDy_Rv, rawValue);
            chgEv_GW_284_RRC_OBJ2_RefPointDy = 1;  
        }
        else
        {
            chgEv_GW_284_RRC_OBJ2_RefPointDy = 0;
        }
    }
}
/*@@end*/


 
/*@@envVar:E_pubc_GW_GW_284_RRC_OBJ8_RefPointDx_Rv:*/
on envVar E_pubc_GW_GW_284_RRC_OBJ8_RefPointDx_Rv
{
    int64 rawValue = 0ll;
    float rawValue_float = 0.0;
    float phyValue = 0.0;        

    //set the signal with updated raw value
    {
        rawValue = getvalue(this);
        if(chgEv_GW_284_RRC_OBJ8_RefPointDx == 0)
        {
            //type conversion to float
            rawValue_float = rawValue;        
            // raw to physical conversion
            phyValue = ((rawValue_float *0.0625)+(-256));
            putValue(E_pubc_GW_GW_284_RRC_OBJ8_RefPointDx_Pv, phyValue);
            chgEv_GW_284_RRC_OBJ8_RefPointDx = 1;
        }
        else
        {
            chgEv_GW_284_RRC_OBJ8_RefPointDx = 0;
        }    
        //update the signal value
        Msg_GW_284.RRC_OBJ8_RefPointDx=rawValue;        
    }                                                                           
}
/*@@end*/

/*@@envVar:E_pubc_GW_GW_284_RRC_OBJ8_RefPointDx_Pv:*/
on envVar E_pubc_GW_GW_284_RRC_OBJ8_RefPointDx_Pv
{
    int64 rawValue = 0ll;
    float phyValue = 0.0;
    
    //update the raw value with physical value 
    {
        if(chgEv_GW_284_RRC_OBJ8_RefPointDx == 0)
        {
            phyValue = getvalue(this);
            // physical to raw conversion
            rawValue = ((phyValue -(-256))/0.0625);
            putValue(E_pubc_GW_GW_284_RRC_OBJ8_RefPointDx_Rv, rawValue);
            chgEv_GW_284_RRC_OBJ8_RefPointDx = 1;  
        }
        else
        {
            chgEv_GW_284_RRC_OBJ8_RefPointDx = 0;
        }
    }
}
/*@@end*/


 
/*@@envVar:E_pubc_GW_GW_284_RRC_OBJ8_RefPointDy_Rv:*/
on envVar E_pubc_GW_GW_284_RRC_OBJ8_RefPointDy_Rv
{
    int64 rawValue = 0ll;
    float rawValue_float = 0.0;
    float phyValue = 0.0;        

    //set the signal with updated raw value
    {
        rawValue = getvalue(this);
        if(chgEv_GW_284_RRC_OBJ8_RefPointDy == 0)
        {
            //type conversion to float
            rawValue_float = rawValue;        
            // raw to physical conversion
            phyValue = ((rawValue_float *0.125)+(-128));
            putValue(E_pubc_GW_GW_284_RRC_OBJ8_RefPointDy_Pv, phyValue);
            chgEv_GW_284_RRC_OBJ8_RefPointDy = 1;
        }
        else
        {
            chgEv_GW_284_RRC_OBJ8_RefPointDy = 0;
        }    
        //update the signal value
        Msg_GW_284.RRC_OBJ8_RefPointDy=rawValue;        
    }                                                                           
}
/*@@end*/

/*@@envVar:E_pubc_GW_GW_284_RRC_OBJ8_RefPointDy_Pv:*/
on envVar E_pubc_GW_GW_284_RRC_OBJ8_RefPointDy_Pv
{
    int64 rawValue = 0ll;
    float phyValue = 0.0;
    
    //update the raw value with physical value 
    {
        if(chgEv_GW_284_RRC_OBJ8_RefPointDy == 0)
        {
            phyValue = getvalue(this);
            // physical to raw conversion
            rawValue = ((phyValue -(-128))/0.125);
            putValue(E_pubc_GW_GW_284_RRC_OBJ8_RefPointDy_Rv, rawValue);
            chgEv_GW_284_RRC_OBJ8_RefPointDy = 1;  
        }
        else
        {
            chgEv_GW_284_RRC_OBJ8_RefPointDy = 0;
        }
    }
}
/*@@end*/


 
/*@@envVar:E_pubc_GW_GW_284_RRC_OBJ6_RefPointDx_Rv:*/
on envVar E_pubc_GW_GW_284_RRC_OBJ6_RefPointDx_Rv
{
    int64 rawValue = 0ll;
    float rawValue_float = 0.0;
    float phyValue = 0.0;        

    //set the signal with updated raw value
    {
        rawValue = getvalue(this);
        if(chgEv_GW_284_RRC_OBJ6_RefPointDx == 0)
        {
            //type conversion to float
            rawValue_float = rawValue;        
            // raw to physical conversion
            phyValue = ((rawValue_float *0.0625)+(-256));
            putValue(E_pubc_GW_GW_284_RRC_OBJ6_RefPointDx_Pv, phyValue);
            chgEv_GW_284_RRC_OBJ6_RefPointDx = 1;
        }
        else
        {
            chgEv_GW_284_RRC_OBJ6_RefPointDx = 0;
        }    
        //update the signal value
        Msg_GW_284.RRC_OBJ6_RefPointDx=rawValue;        
    }                                                                           
}
/*@@end*/

/*@@envVar:E_pubc_GW_GW_284_RRC_OBJ6_RefPointDx_Pv:*/
on envVar E_pubc_GW_GW_284_RRC_OBJ6_RefPointDx_Pv
{
    int64 rawValue = 0ll;
    float phyValue = 0.0;
    
    //update the raw value with physical value 
    {
        if(chgEv_GW_284_RRC_OBJ6_RefPointDx == 0)
        {
            phyValue = getvalue(this);
            // physical to raw conversion
            rawValue = ((phyValue -(-256))/0.0625);
            putValue(E_pubc_GW_GW_284_RRC_OBJ6_RefPointDx_Rv, rawValue);
            chgEv_GW_284_RRC_OBJ6_RefPointDx = 1;  
        }
        else
        {
            chgEv_GW_284_RRC_OBJ6_RefPointDx = 0;
        }
    }
}
/*@@end*/


 
/*@@envVar:E_pubc_GW_GW_284_RRC_OBJ6_RefPointDy_Rv:*/
on envVar E_pubc_GW_GW_284_RRC_OBJ6_RefPointDy_Rv
{
    int64 rawValue = 0ll;
    float rawValue_float = 0.0;
    float phyValue = 0.0;        

    //set the signal with updated raw value
    {
        rawValue = getvalue(this);
        if(chgEv_GW_284_RRC_OBJ6_RefPointDy == 0)
        {
            //type conversion to float
            rawValue_float = rawValue;        
            // raw to physical conversion
            phyValue = ((rawValue_float *0.125)+(-128));
            putValue(E_pubc_GW_GW_284_RRC_OBJ6_RefPointDy_Pv, phyValue);
            chgEv_GW_284_RRC_OBJ6_RefPointDy = 1;
        }
        else
        {
            chgEv_GW_284_RRC_OBJ6_RefPointDy = 0;
        }    
        //update the signal value
        Msg_GW_284.RRC_OBJ6_RefPointDy=rawValue;        
    }                                                                           
}
/*@@end*/

/*@@envVar:E_pubc_GW_GW_284_RRC_OBJ6_RefPointDy_Pv:*/
on envVar E_pubc_GW_GW_284_RRC_OBJ6_RefPointDy_Pv
{
    int64 rawValue = 0ll;
    float phyValue = 0.0;
    
    //update the raw value with physical value 
    {
        if(chgEv_GW_284_RRC_OBJ6_RefPointDy == 0)
        {
            phyValue = getvalue(this);
            // physical to raw conversion
            rawValue = ((phyValue -(-128))/0.125);
            putValue(E_pubc_GW_GW_284_RRC_OBJ6_RefPointDy_Rv, rawValue);
            chgEv_GW_284_RRC_OBJ6_RefPointDy = 1;  
        }
        else
        {
            chgEv_GW_284_RRC_OBJ6_RefPointDy = 0;
        }
    }
}
/*@@end*/


 
/*@@envVar:E_pubc_GW_GW_284_RRC_OBJ1_RefPointLoc_Rv:*/
on envVar E_pubc_GW_GW_284_RRC_OBJ1_RefPointLoc_Rv
{
    int64 rawValue = 0ll;
    float rawValue_float = 0.0;
    float phyValue = 0.0;        

    //set the signal with updated raw value
    {
        rawValue = getvalue(this);
        if(chgEv_GW_284_RRC_OBJ1_RefPointLoc == 0)
        {
            //type conversion to float
            rawValue_float = rawValue;        
            // raw to physical conversion
            phyValue = ((rawValue_float *1)+(0));
            putValue(E_pubc_GW_GW_284_RRC_OBJ1_RefPointLoc_Pv, phyValue);
            chgEv_GW_284_RRC_OBJ1_RefPointLoc = 1;
        }
        else
        {
            chgEv_GW_284_RRC_OBJ1_RefPointLoc = 0;
        }    
        //update the signal value
        Msg_GW_284.RRC_OBJ1_RefPointLoc=rawValue;        
    }                                                                           
}
/*@@end*/

/*@@envVar:E_pubc_GW_GW_284_RRC_OBJ1_RefPointLoc_Pv:*/
on envVar E_pubc_GW_GW_284_RRC_OBJ1_RefPointLoc_Pv
{
    int64 rawValue = 0ll;
    float phyValue = 0.0;
    
    //update the raw value with physical value 
    {
        if(chgEv_GW_284_RRC_OBJ1_RefPointLoc == 0)
        {
            phyValue = getvalue(this);
            // physical to raw conversion
            rawValue = ((phyValue -(0))/1);
            putValue(E_pubc_GW_GW_284_RRC_OBJ1_RefPointLoc_Rv, rawValue);
            chgEv_GW_284_RRC_OBJ1_RefPointLoc = 1;  
        }
        else
        {
            chgEv_GW_284_RRC_OBJ1_RefPointLoc = 0;
        }
    }
}
/*@@end*/


 
/*@@envVar:E_pubc_GW_GW_284_RRC_OBJ1_RefPointDx_Rv:*/
on envVar E_pubc_GW_GW_284_RRC_OBJ1_RefPointDx_Rv
{
    int64 rawValue = 0ll;
    float rawValue_float = 0.0;
    float phyValue = 0.0;        

    //set the signal with updated raw value
    {
        rawValue = getvalue(this);
        if(chgEv_GW_284_RRC_OBJ1_RefPointDx == 0)
        {
            //type conversion to float
            rawValue_float = rawValue;        
            // raw to physical conversion
            phyValue = ((rawValue_float *0.0625)+(-256));
            putValue(E_pubc_GW_GW_284_RRC_OBJ1_RefPointDx_Pv, phyValue);
            chgEv_GW_284_RRC_OBJ1_RefPointDx = 1;
        }
        else
        {
            chgEv_GW_284_RRC_OBJ1_RefPointDx = 0;
        }    
        //update the signal value
        Msg_GW_284.RRC_OBJ1_RefPointDx=rawValue;        
    }                                                                           
}
/*@@end*/

/*@@envVar:E_pubc_GW_GW_284_RRC_OBJ1_RefPointDx_Pv:*/
on envVar E_pubc_GW_GW_284_RRC_OBJ1_RefPointDx_Pv
{
    int64 rawValue = 0ll;
    float phyValue = 0.0;
    
    //update the raw value with physical value 
    {
        if(chgEv_GW_284_RRC_OBJ1_RefPointDx == 0)
        {
            phyValue = getvalue(this);
            // physical to raw conversion
            rawValue = ((phyValue -(-256))/0.0625);
            putValue(E_pubc_GW_GW_284_RRC_OBJ1_RefPointDx_Rv, rawValue);
            chgEv_GW_284_RRC_OBJ1_RefPointDx = 1;  
        }
        else
        {
            chgEv_GW_284_RRC_OBJ1_RefPointDx = 0;
        }
    }
}
/*@@end*/


 
/*@@envVar:E_pubc_GW_GW_284_RRC_OBJ5_RefPointDy_Rv:*/
on envVar E_pubc_GW_GW_284_RRC_OBJ5_RefPointDy_Rv
{
    int64 rawValue = 0ll;
    float rawValue_float = 0.0;
    float phyValue = 0.0;        

    //set the signal with updated raw value
    {
        rawValue = getvalue(this);
        if(chgEv_GW_284_RRC_OBJ5_RefPointDy == 0)
        {
            //type conversion to float
            rawValue_float = rawValue;        
            // raw to physical conversion
            phyValue = ((rawValue_float *0.125)+(-128));
            putValue(E_pubc_GW_GW_284_RRC_OBJ5_RefPointDy_Pv, phyValue);
            chgEv_GW_284_RRC_OBJ5_RefPointDy = 1;
        }
        else
        {
            chgEv_GW_284_RRC_OBJ5_RefPointDy = 0;
        }    
        //update the signal value
        Msg_GW_284.RRC_OBJ5_RefPointDy=rawValue;        
    }                                                                           
}
/*@@end*/

/*@@envVar:E_pubc_GW_GW_284_RRC_OBJ5_RefPointDy_Pv:*/
on envVar E_pubc_GW_GW_284_RRC_OBJ5_RefPointDy_Pv
{
    int64 rawValue = 0ll;
    float phyValue = 0.0;
    
    //update the raw value with physical value 
    {
        if(chgEv_GW_284_RRC_OBJ5_RefPointDy == 0)
        {
            phyValue = getvalue(this);
            // physical to raw conversion
            rawValue = ((phyValue -(-128))/0.125);
            putValue(E_pubc_GW_GW_284_RRC_OBJ5_RefPointDy_Rv, rawValue);
            chgEv_GW_284_RRC_OBJ5_RefPointDy = 1;  
        }
        else
        {
            chgEv_GW_284_RRC_OBJ5_RefPointDy = 0;
        }
    }
}
/*@@end*/


 
/*@@envVar:E_pubc_GW_GW_284_RRC_OBJ5_RefPointDx_Rv:*/
on envVar E_pubc_GW_GW_284_RRC_OBJ5_RefPointDx_Rv
{
    int64 rawValue = 0ll;
    float rawValue_float = 0.0;
    float phyValue = 0.0;        

    //set the signal with updated raw value
    {
        rawValue = getvalue(this);
        if(chgEv_GW_284_RRC_OBJ5_RefPointDx == 0)
        {
            //type conversion to float
            rawValue_float = rawValue;        
            // raw to physical conversion
            phyValue = ((rawValue_float *0.0625)+(-256));
            putValue(E_pubc_GW_GW_284_RRC_OBJ5_RefPointDx_Pv, phyValue);
            chgEv_GW_284_RRC_OBJ5_RefPointDx = 1;
        }
        else
        {
            chgEv_GW_284_RRC_OBJ5_RefPointDx = 0;
        }    
        //update the signal value
        Msg_GW_284.RRC_OBJ5_RefPointDx=rawValue;        
    }                                                                           
}
/*@@end*/

/*@@envVar:E_pubc_GW_GW_284_RRC_OBJ5_RefPointDx_Pv:*/
on envVar E_pubc_GW_GW_284_RRC_OBJ5_RefPointDx_Pv
{
    int64 rawValue = 0ll;
    float phyValue = 0.0;
    
    //update the raw value with physical value 
    {
        if(chgEv_GW_284_RRC_OBJ5_RefPointDx == 0)
        {
            phyValue = getvalue(this);
            // physical to raw conversion
            rawValue = ((phyValue -(-256))/0.0625);
            putValue(E_pubc_GW_GW_284_RRC_OBJ5_RefPointDx_Rv, rawValue);
            chgEv_GW_284_RRC_OBJ5_RefPointDx = 1;  
        }
        else
        {
            chgEv_GW_284_RRC_OBJ5_RefPointDx = 0;
        }
    }
}
/*@@end*/


 
/*@@envVar:E_pubc_GW_GW_284_RRC_OBJ7_RefPointDy_Rv:*/
on envVar E_pubc_GW_GW_284_RRC_OBJ7_RefPointDy_Rv
{
    int64 rawValue = 0ll;
    float rawValue_float = 0.0;
    float phyValue = 0.0;        

    //set the signal with updated raw value
    {
        rawValue = getvalue(this);
        if(chgEv_GW_284_RRC_OBJ7_RefPointDy == 0)
        {
            //type conversion to float
            rawValue_float = rawValue;        
            // raw to physical conversion
            phyValue = ((rawValue_float *0.125)+(-128));
            putValue(E_pubc_GW_GW_284_RRC_OBJ7_RefPointDy_Pv, phyValue);
            chgEv_GW_284_RRC_OBJ7_RefPointDy = 1;
        }
        else
        {
            chgEv_GW_284_RRC_OBJ7_RefPointDy = 0;
        }    
        //update the signal value
        Msg_GW_284.RRC_OBJ7_RefPointDy=rawValue;        
    }                                                                           
}
/*@@end*/

/*@@envVar:E_pubc_GW_GW_284_RRC_OBJ7_RefPointDy_Pv:*/
on envVar E_pubc_GW_GW_284_RRC_OBJ7_RefPointDy_Pv
{
    int64 rawValue = 0ll;
    float phyValue = 0.0;
    
    //update the raw value with physical value 
    {
        if(chgEv_GW_284_RRC_OBJ7_RefPointDy == 0)
        {
            phyValue = getvalue(this);
            // physical to raw conversion
            rawValue = ((phyValue -(-128))/0.125);
            putValue(E_pubc_GW_GW_284_RRC_OBJ7_RefPointDy_Rv, rawValue);
            chgEv_GW_284_RRC_OBJ7_RefPointDy = 1;  
        }
        else
        {
            chgEv_GW_284_RRC_OBJ7_RefPointDy = 0;
        }
    }
}
/*@@end*/


 
/*@@envVar:E_pubc_GW_GW_284_RRC_OBJ7_RefPointDx_Rv:*/
on envVar E_pubc_GW_GW_284_RRC_OBJ7_RefPointDx_Rv
{
    int64 rawValue = 0ll;
    float rawValue_float = 0.0;
    float phyValue = 0.0;        

    //set the signal with updated raw value
    {
        rawValue = getvalue(this);
        if(chgEv_GW_284_RRC_OBJ7_RefPointDx == 0)
        {
            //type conversion to float
            rawValue_float = rawValue;        
            // raw to physical conversion
            phyValue = ((rawValue_float *0.0625)+(-256));
            putValue(E_pubc_GW_GW_284_RRC_OBJ7_RefPointDx_Pv, phyValue);
            chgEv_GW_284_RRC_OBJ7_RefPointDx = 1;
        }
        else
        {
            chgEv_GW_284_RRC_OBJ7_RefPointDx = 0;
        }    
        //update the signal value
        Msg_GW_284.RRC_OBJ7_RefPointDx=rawValue;        
    }                                                                           
}
/*@@end*/

/*@@envVar:E_pubc_GW_GW_284_RRC_OBJ7_RefPointDx_Pv:*/
on envVar E_pubc_GW_GW_284_RRC_OBJ7_RefPointDx_Pv
{
    int64 rawValue = 0ll;
    float phyValue = 0.0;
    
    //update the raw value with physical value 
    {
        if(chgEv_GW_284_RRC_OBJ7_RefPointDx == 0)
        {
            phyValue = getvalue(this);
            // physical to raw conversion
            rawValue = ((phyValue -(-256))/0.0625);
            putValue(E_pubc_GW_GW_284_RRC_OBJ7_RefPointDx_Rv, rawValue);
            chgEv_GW_284_RRC_OBJ7_RefPointDx = 1;  
        }
        else
        {
            chgEv_GW_284_RRC_OBJ7_RefPointDx = 0;
        }
    }
}
/*@@end*/


 
/*@@envVar:E_pubc_GW_GW_284_RRC_OBJ10_RefPointDx_Rv:*/
on envVar E_pubc_GW_GW_284_RRC_OBJ10_RefPointDx_Rv
{
    int64 rawValue = 0ll;
    float rawValue_float = 0.0;
    float phyValue = 0.0;        

    //set the signal with updated raw value
    {
        rawValue = getvalue(this);
        if(chgEv_GW_284_RRC_OBJ10_RefPointDx == 0)
        {
            //type conversion to float
            rawValue_float = rawValue;        
            // raw to physical conversion
            phyValue = ((rawValue_float *0.0625)+(-256));
            putValue(E_pubc_GW_GW_284_RRC_OBJ10_RefPointDx_Pv, phyValue);
            chgEv_GW_284_RRC_OBJ10_RefPointDx = 1;
        }
        else
        {
            chgEv_GW_284_RRC_OBJ10_RefPointDx = 0;
        }    
        //update the signal value
        Msg_GW_284.RRC_OBJ10_RefPointDx=rawValue;        
    }                                                                           
}
/*@@end*/

/*@@envVar:E_pubc_GW_GW_284_RRC_OBJ10_RefPointDx_Pv:*/
on envVar E_pubc_GW_GW_284_RRC_OBJ10_RefPointDx_Pv
{
    int64 rawValue = 0ll;
    float phyValue = 0.0;
    
    //update the raw value with physical value 
    {
        if(chgEv_GW_284_RRC_OBJ10_RefPointDx == 0)
        {
            phyValue = getvalue(this);
            // physical to raw conversion
            rawValue = ((phyValue -(-256))/0.0625);
            putValue(E_pubc_GW_GW_284_RRC_OBJ10_RefPointDx_Rv, rawValue);
            chgEv_GW_284_RRC_OBJ10_RefPointDx = 1;  
        }
        else
        {
            chgEv_GW_284_RRC_OBJ10_RefPointDx = 0;
        }
    }
}
/*@@end*/


 
/*@@envVar:E_pubc_GW_GW_284_RRC_OBJ10_RefPointDy_Rv:*/
on envVar E_pubc_GW_GW_284_RRC_OBJ10_RefPointDy_Rv
{
    int64 rawValue = 0ll;
    float rawValue_float = 0.0;
    float phyValue = 0.0;        

    //set the signal with updated raw value
    {
        rawValue = getvalue(this);
        if(chgEv_GW_284_RRC_OBJ10_RefPointDy == 0)
        {
            //type conversion to float
            rawValue_float = rawValue;        
            // raw to physical conversion
            phyValue = ((rawValue_float *0.125)+(-128));
            putValue(E_pubc_GW_GW_284_RRC_OBJ10_RefPointDy_Pv, phyValue);
            chgEv_GW_284_RRC_OBJ10_RefPointDy = 1;
        }
        else
        {
            chgEv_GW_284_RRC_OBJ10_RefPointDy = 0;
        }    
        //update the signal value
        Msg_GW_284.RRC_OBJ10_RefPointDy=rawValue;        
    }                                                                           
}
/*@@end*/

/*@@envVar:E_pubc_GW_GW_284_RRC_OBJ10_RefPointDy_Pv:*/
on envVar E_pubc_GW_GW_284_RRC_OBJ10_RefPointDy_Pv
{
    int64 rawValue = 0ll;
    float phyValue = 0.0;
    
    //update the raw value with physical value 
    {
        if(chgEv_GW_284_RRC_OBJ10_RefPointDy == 0)
        {
            phyValue = getvalue(this);
            // physical to raw conversion
            rawValue = ((phyValue -(-128))/0.125);
            putValue(E_pubc_GW_GW_284_RRC_OBJ10_RefPointDy_Rv, rawValue);
            chgEv_GW_284_RRC_OBJ10_RefPointDy = 1;  
        }
        else
        {
            chgEv_GW_284_RRC_OBJ10_RefPointDy = 0;
        }
    }
}
/*@@end*/


 
/*@@envVar:E_pubc_GW_GW_284_RRC_OBJ5_RefPointLoc_Rv:*/
on envVar E_pubc_GW_GW_284_RRC_OBJ5_RefPointLoc_Rv
{
    int64 rawValue = 0ll;
    float rawValue_float = 0.0;
    float phyValue = 0.0;        

    //set the signal with updated raw value
    {
        rawValue = getvalue(this);
        if(chgEv_GW_284_RRC_OBJ5_RefPointLoc == 0)
        {
            //type conversion to float
            rawValue_float = rawValue;        
            // raw to physical conversion
            phyValue = ((rawValue_float *1)+(0));
            putValue(E_pubc_GW_GW_284_RRC_OBJ5_RefPointLoc_Pv, phyValue);
            chgEv_GW_284_RRC_OBJ5_RefPointLoc = 1;
        }
        else
        {
            chgEv_GW_284_RRC_OBJ5_RefPointLoc = 0;
        }    
        //update the signal value
        Msg_GW_284.RRC_OBJ5_RefPointLoc=rawValue;        
    }                                                                           
}
/*@@end*/

/*@@envVar:E_pubc_GW_GW_284_RRC_OBJ5_RefPointLoc_Pv:*/
on envVar E_pubc_GW_GW_284_RRC_OBJ5_RefPointLoc_Pv
{
    int64 rawValue = 0ll;
    float phyValue = 0.0;
    
    //update the raw value with physical value 
    {
        if(chgEv_GW_284_RRC_OBJ5_RefPointLoc == 0)
        {
            phyValue = getvalue(this);
            // physical to raw conversion
            rawValue = ((phyValue -(0))/1);
            putValue(E_pubc_GW_GW_284_RRC_OBJ5_RefPointLoc_Rv, rawValue);
            chgEv_GW_284_RRC_OBJ5_RefPointLoc = 1;  
        }
        else
        {
            chgEv_GW_284_RRC_OBJ5_RefPointLoc = 0;
        }
    }
}
/*@@end*/


 
/*@@envVar:E_pubc_GW_GW_284_RRC_OBJ1_RefPointDy_Rv:*/
on envVar E_pubc_GW_GW_284_RRC_OBJ1_RefPointDy_Rv
{
    int64 rawValue = 0ll;
    float rawValue_float = 0.0;
    float phyValue = 0.0;        

    //set the signal with updated raw value
    {
        rawValue = getvalue(this);
        if(chgEv_GW_284_RRC_OBJ1_RefPointDy == 0)
        {
            //type conversion to float
            rawValue_float = rawValue;        
            // raw to physical conversion
            phyValue = ((rawValue_float *0.125)+(-128));
            putValue(E_pubc_GW_GW_284_RRC_OBJ1_RefPointDy_Pv, phyValue);
            chgEv_GW_284_RRC_OBJ1_RefPointDy = 1;
        }
        else
        {
            chgEv_GW_284_RRC_OBJ1_RefPointDy = 0;
        }    
        //update the signal value
        Msg_GW_284.RRC_OBJ1_RefPointDy=rawValue;        
    }                                                                           
}
/*@@end*/

/*@@envVar:E_pubc_GW_GW_284_RRC_OBJ1_RefPointDy_Pv:*/
on envVar E_pubc_GW_GW_284_RRC_OBJ1_RefPointDy_Pv
{
    int64 rawValue = 0ll;
    float phyValue = 0.0;
    
    //update the raw value with physical value 
    {
        if(chgEv_GW_284_RRC_OBJ1_RefPointDy == 0)
        {
            phyValue = getvalue(this);
            // physical to raw conversion
            rawValue = ((phyValue -(-128))/0.125);
            putValue(E_pubc_GW_GW_284_RRC_OBJ1_RefPointDy_Rv, rawValue);
            chgEv_GW_284_RRC_OBJ1_RefPointDy = 1;  
        }
        else
        {
            chgEv_GW_284_RRC_OBJ1_RefPointDy = 0;
        }
    }
}
/*@@end*/


 
/*@@envVar:E_pubc_GW_GW_284_RRC_OBJ4_RefPointDx_Rv:*/
on envVar E_pubc_GW_GW_284_RRC_OBJ4_RefPointDx_Rv
{
    int64 rawValue = 0ll;
    float rawValue_float = 0.0;
    float phyValue = 0.0;        

    //set the signal with updated raw value
    {
        rawValue = getvalue(this);
        if(chgEv_GW_284_RRC_OBJ4_RefPointDx == 0)
        {
            //type conversion to float
            rawValue_float = rawValue;        
            // raw to physical conversion
            phyValue = ((rawValue_float *0.0625)+(-256));
            putValue(E_pubc_GW_GW_284_RRC_OBJ4_RefPointDx_Pv, phyValue);
            chgEv_GW_284_RRC_OBJ4_RefPointDx = 1;
        }
        else
        {
            chgEv_GW_284_RRC_OBJ4_RefPointDx = 0;
        }    
        //update the signal value
        Msg_GW_284.RRC_OBJ4_RefPointDx=rawValue;        
    }                                                                           
}
/*@@end*/

/*@@envVar:E_pubc_GW_GW_284_RRC_OBJ4_RefPointDx_Pv:*/
on envVar E_pubc_GW_GW_284_RRC_OBJ4_RefPointDx_Pv
{
    int64 rawValue = 0ll;
    float phyValue = 0.0;
    
    //update the raw value with physical value 
    {
        if(chgEv_GW_284_RRC_OBJ4_RefPointDx == 0)
        {
            phyValue = getvalue(this);
            // physical to raw conversion
            rawValue = ((phyValue -(-256))/0.0625);
            putValue(E_pubc_GW_GW_284_RRC_OBJ4_RefPointDx_Rv, rawValue);
            chgEv_GW_284_RRC_OBJ4_RefPointDx = 1;  
        }
        else
        {
            chgEv_GW_284_RRC_OBJ4_RefPointDx = 0;
        }
    }
}
/*@@end*/


 
/*@@envVar:E_pubc_GW_GW_284_RRC_OBJ4_RefPointDy_Rv:*/
on envVar E_pubc_GW_GW_284_RRC_OBJ4_RefPointDy_Rv
{
    int64 rawValue = 0ll;
    float rawValue_float = 0.0;
    float phyValue = 0.0;        

    //set the signal with updated raw value
    {
        rawValue = getvalue(this);
        if(chgEv_GW_284_RRC_OBJ4_RefPointDy == 0)
        {
            //type conversion to float
            rawValue_float = rawValue;        
            // raw to physical conversion
            phyValue = ((rawValue_float *0.125)+(-128));
            putValue(E_pubc_GW_GW_284_RRC_OBJ4_RefPointDy_Pv, phyValue);
            chgEv_GW_284_RRC_OBJ4_RefPointDy = 1;
        }
        else
        {
            chgEv_GW_284_RRC_OBJ4_RefPointDy = 0;
        }    
        //update the signal value
        Msg_GW_284.RRC_OBJ4_RefPointDy=rawValue;        
    }                                                                           
}
/*@@end*/

/*@@envVar:E_pubc_GW_GW_284_RRC_OBJ4_RefPointDy_Pv:*/
on envVar E_pubc_GW_GW_284_RRC_OBJ4_RefPointDy_Pv
{
    int64 rawValue = 0ll;
    float phyValue = 0.0;
    
    //update the raw value with physical value 
    {
        if(chgEv_GW_284_RRC_OBJ4_RefPointDy == 0)
        {
            phyValue = getvalue(this);
            // physical to raw conversion
            rawValue = ((phyValue -(-128))/0.125);
            putValue(E_pubc_GW_GW_284_RRC_OBJ4_RefPointDy_Rv, rawValue);
            chgEv_GW_284_RRC_OBJ4_RefPointDy = 1;  
        }
        else
        {
            chgEv_GW_284_RRC_OBJ4_RefPointDy = 0;
        }
    }
}
/*@@end*/


 
/*@@envVar:E_pubc_GW_GW_284_RRC_OBJ2_RefPointLoc_Rv:*/
on envVar E_pubc_GW_GW_284_RRC_OBJ2_RefPointLoc_Rv
{
    int64 rawValue = 0ll;
    float rawValue_float = 0.0;
    float phyValue = 0.0;        

    //set the signal with updated raw value
    {
        rawValue = getvalue(this);
        if(chgEv_GW_284_RRC_OBJ2_RefPointLoc == 0)
        {
            //type conversion to float
            rawValue_float = rawValue;        
            // raw to physical conversion
            phyValue = ((rawValue_float *1)+(0));
            putValue(E_pubc_GW_GW_284_RRC_OBJ2_RefPointLoc_Pv, phyValue);
            chgEv_GW_284_RRC_OBJ2_RefPointLoc = 1;
        }
        else
        {
            chgEv_GW_284_RRC_OBJ2_RefPointLoc = 0;
        }    
        //update the signal value
        Msg_GW_284.RRC_OBJ2_RefPointLoc=rawValue;        
    }                                                                           
}
/*@@end*/

/*@@envVar:E_pubc_GW_GW_284_RRC_OBJ2_RefPointLoc_Pv:*/
on envVar E_pubc_GW_GW_284_RRC_OBJ2_RefPointLoc_Pv
{
    int64 rawValue = 0ll;
    float phyValue = 0.0;
    
    //update the raw value with physical value 
    {
        if(chgEv_GW_284_RRC_OBJ2_RefPointLoc == 0)
        {
            phyValue = getvalue(this);
            // physical to raw conversion
            rawValue = ((phyValue -(0))/1);
            putValue(E_pubc_GW_GW_284_RRC_OBJ2_RefPointLoc_Rv, rawValue);
            chgEv_GW_284_RRC_OBJ2_RefPointLoc = 1;  
        }
        else
        {
            chgEv_GW_284_RRC_OBJ2_RefPointLoc = 0;
        }
    }
}
/*@@end*/


 
/*@@envVar:E_pubc_GW_GW_284_RRC_OBJ10_RefPointLoc_Rv:*/
on envVar E_pubc_GW_GW_284_RRC_OBJ10_RefPointLoc_Rv
{
    int64 rawValue = 0ll;
    float rawValue_float = 0.0;
    float phyValue = 0.0;        

    //set the signal with updated raw value
    {
        rawValue = getvalue(this);
        if(chgEv_GW_284_RRC_OBJ10_RefPointLoc == 0)
        {
            //type conversion to float
            rawValue_float = rawValue;        
            // raw to physical conversion
            phyValue = ((rawValue_float *1)+(0));
            putValue(E_pubc_GW_GW_284_RRC_OBJ10_RefPointLoc_Pv, phyValue);
            chgEv_GW_284_RRC_OBJ10_RefPointLoc = 1;
        }
        else
        {
            chgEv_GW_284_RRC_OBJ10_RefPointLoc = 0;
        }    
        //update the signal value
        Msg_GW_284.RRC_OBJ10_RefPointLoc=rawValue;        
    }                                                                           
}
/*@@end*/

/*@@envVar:E_pubc_GW_GW_284_RRC_OBJ10_RefPointLoc_Pv:*/
on envVar E_pubc_GW_GW_284_RRC_OBJ10_RefPointLoc_Pv
{
    int64 rawValue = 0ll;
    float phyValue = 0.0;
    
    //update the raw value with physical value 
    {
        if(chgEv_GW_284_RRC_OBJ10_RefPointLoc == 0)
        {
            phyValue = getvalue(this);
            // physical to raw conversion
            rawValue = ((phyValue -(0))/1);
            putValue(E_pubc_GW_GW_284_RRC_OBJ10_RefPointLoc_Rv, rawValue);
            chgEv_GW_284_RRC_OBJ10_RefPointLoc = 1;  
        }
        else
        {
            chgEv_GW_284_RRC_OBJ10_RefPointLoc = 0;
        }
    }
}
/*@@end*/


 
/*@@envVar:E_pubc_GW_GW_284_RRC_OBJ3_RefPointDy_Rv:*/
on envVar E_pubc_GW_GW_284_RRC_OBJ3_RefPointDy_Rv
{
    int64 rawValue = 0ll;
    float rawValue_float = 0.0;
    float phyValue = 0.0;        

    //set the signal with updated raw value
    {
        rawValue = getvalue(this);
        if(chgEv_GW_284_RRC_OBJ3_RefPointDy == 0)
        {
            //type conversion to float
            rawValue_float = rawValue;        
            // raw to physical conversion
            phyValue = ((rawValue_float *0.125)+(-128));
            putValue(E_pubc_GW_GW_284_RRC_OBJ3_RefPointDy_Pv, phyValue);
            chgEv_GW_284_RRC_OBJ3_RefPointDy = 1;
        }
        else
        {
            chgEv_GW_284_RRC_OBJ3_RefPointDy = 0;
        }    
        //update the signal value
        Msg_GW_284.RRC_OBJ3_RefPointDy=rawValue;        
    }                                                                           
}
/*@@end*/

/*@@envVar:E_pubc_GW_GW_284_RRC_OBJ3_RefPointDy_Pv:*/
on envVar E_pubc_GW_GW_284_RRC_OBJ3_RefPointDy_Pv
{
    int64 rawValue = 0ll;
    float phyValue = 0.0;
    
    //update the raw value with physical value 
    {
        if(chgEv_GW_284_RRC_OBJ3_RefPointDy == 0)
        {
            phyValue = getvalue(this);
            // physical to raw conversion
            rawValue = ((phyValue -(-128))/0.125);
            putValue(E_pubc_GW_GW_284_RRC_OBJ3_RefPointDy_Rv, rawValue);
            chgEv_GW_284_RRC_OBJ3_RefPointDy = 1;  
        }
        else
        {
            chgEv_GW_284_RRC_OBJ3_RefPointDy = 0;
        }
    }
}
/*@@end*/


 
/*@@envVar:E_pubc_GW_GW_284_RRC_OBJ3_RefPointDx_Rv:*/
on envVar E_pubc_GW_GW_284_RRC_OBJ3_RefPointDx_Rv
{
    int64 rawValue = 0ll;
    float rawValue_float = 0.0;
    float phyValue = 0.0;        

    //set the signal with updated raw value
    {
        rawValue = getvalue(this);
        if(chgEv_GW_284_RRC_OBJ3_RefPointDx == 0)
        {
            //type conversion to float
            rawValue_float = rawValue;        
            // raw to physical conversion
            phyValue = ((rawValue_float *0.0625)+(-256));
            putValue(E_pubc_GW_GW_284_RRC_OBJ3_RefPointDx_Pv, phyValue);
            chgEv_GW_284_RRC_OBJ3_RefPointDx = 1;
        }
        else
        {
            chgEv_GW_284_RRC_OBJ3_RefPointDx = 0;
        }    
        //update the signal value
        Msg_GW_284.RRC_OBJ3_RefPointDx=rawValue;        
    }                                                                           
}
/*@@end*/

/*@@envVar:E_pubc_GW_GW_284_RRC_OBJ3_RefPointDx_Pv:*/
on envVar E_pubc_GW_GW_284_RRC_OBJ3_RefPointDx_Pv
{
    int64 rawValue = 0ll;
    float phyValue = 0.0;
    
    //update the raw value with physical value 
    {
        if(chgEv_GW_284_RRC_OBJ3_RefPointDx == 0)
        {
            phyValue = getvalue(this);
            // physical to raw conversion
            rawValue = ((phyValue -(-256))/0.0625);
            putValue(E_pubc_GW_GW_284_RRC_OBJ3_RefPointDx_Rv, rawValue);
            chgEv_GW_284_RRC_OBJ3_RefPointDx = 1;  
        }
        else
        {
            chgEv_GW_284_RRC_OBJ3_RefPointDx = 0;
        }
    }
}
/*@@end*/


 
/*@@envVar:E_pubc_GW_GW_284_RRC_OBJ6_RefPointLoc_Rv:*/
on envVar E_pubc_GW_GW_284_RRC_OBJ6_RefPointLoc_Rv
{
    int64 rawValue = 0ll;
    float rawValue_float = 0.0;
    float phyValue = 0.0;        

    //set the signal with updated raw value
    {
        rawValue = getvalue(this);
        if(chgEv_GW_284_RRC_OBJ6_RefPointLoc == 0)
        {
            //type conversion to float
            rawValue_float = rawValue;        
            // raw to physical conversion
            phyValue = ((rawValue_float *1)+(0));
            putValue(E_pubc_GW_GW_284_RRC_OBJ6_RefPointLoc_Pv, phyValue);
            chgEv_GW_284_RRC_OBJ6_RefPointLoc = 1;
        }
        else
        {
            chgEv_GW_284_RRC_OBJ6_RefPointLoc = 0;
        }    
        //update the signal value
        Msg_GW_284.RRC_OBJ6_RefPointLoc=rawValue;        
    }                                                                           
}
/*@@end*/

/*@@envVar:E_pubc_GW_GW_284_RRC_OBJ6_RefPointLoc_Pv:*/
on envVar E_pubc_GW_GW_284_RRC_OBJ6_RefPointLoc_Pv
{
    int64 rawValue = 0ll;
    float phyValue = 0.0;
    
    //update the raw value with physical value 
    {
        if(chgEv_GW_284_RRC_OBJ6_RefPointLoc == 0)
        {
            phyValue = getvalue(this);
            // physical to raw conversion
            rawValue = ((phyValue -(0))/1);
            putValue(E_pubc_GW_GW_284_RRC_OBJ6_RefPointLoc_Rv, rawValue);
            chgEv_GW_284_RRC_OBJ6_RefPointLoc = 1;  
        }
        else
        {
            chgEv_GW_284_RRC_OBJ6_RefPointLoc = 0;
        }
    }
}
/*@@end*/


 
/*@@envVar:E_pubc_GW_GW_284_RRC_OBJ9_RefPointDy_Rv:*/
on envVar E_pubc_GW_GW_284_RRC_OBJ9_RefPointDy_Rv
{
    int64 rawValue = 0ll;
    float rawValue_float = 0.0;
    float phyValue = 0.0;        

    //set the signal with updated raw value
    {
        rawValue = getvalue(this);
        if(chgEv_GW_284_RRC_OBJ9_RefPointDy == 0)
        {
            //type conversion to float
            rawValue_float = rawValue;        
            // raw to physical conversion
            phyValue = ((rawValue_float *0.125)+(-128));
            putValue(E_pubc_GW_GW_284_RRC_OBJ9_RefPointDy_Pv, phyValue);
            chgEv_GW_284_RRC_OBJ9_RefPointDy = 1;
        }
        else
        {
            chgEv_GW_284_RRC_OBJ9_RefPointDy = 0;
        }    
        //update the signal value
        Msg_GW_284.RRC_OBJ9_RefPointDy=rawValue;        
    }                                                                           
}
/*@@end*/

/*@@envVar:E_pubc_GW_GW_284_RRC_OBJ9_RefPointDy_Pv:*/
on envVar E_pubc_GW_GW_284_RRC_OBJ9_RefPointDy_Pv
{
    int64 rawValue = 0ll;
    float phyValue = 0.0;
    
    //update the raw value with physical value 
    {
        if(chgEv_GW_284_RRC_OBJ9_RefPointDy == 0)
        {
            phyValue = getvalue(this);
            // physical to raw conversion
            rawValue = ((phyValue -(-128))/0.125);
            putValue(E_pubc_GW_GW_284_RRC_OBJ9_RefPointDy_Rv, rawValue);
            chgEv_GW_284_RRC_OBJ9_RefPointDy = 1;  
        }
        else
        {
            chgEv_GW_284_RRC_OBJ9_RefPointDy = 0;
        }
    }
}
/*@@end*/


 
/*@@envVar:E_pubc_GW_GW_284_RRC_OBJ9_RefPointDx_Rv:*/
on envVar E_pubc_GW_GW_284_RRC_OBJ9_RefPointDx_Rv
{
    int64 rawValue = 0ll;
    float rawValue_float = 0.0;
    float phyValue = 0.0;        

    //set the signal with updated raw value
    {
        rawValue = getvalue(this);
        if(chgEv_GW_284_RRC_OBJ9_RefPointDx == 0)
        {
            //type conversion to float
            rawValue_float = rawValue;        
            // raw to physical conversion
            phyValue = ((rawValue_float *0.0625)+(-256));
            putValue(E_pubc_GW_GW_284_RRC_OBJ9_RefPointDx_Pv, phyValue);
            chgEv_GW_284_RRC_OBJ9_RefPointDx = 1;
        }
        else
        {
            chgEv_GW_284_RRC_OBJ9_RefPointDx = 0;
        }    
        //update the signal value
        Msg_GW_284.RRC_OBJ9_RefPointDx=rawValue;        
    }                                                                           
}
/*@@end*/

/*@@envVar:E_pubc_GW_GW_284_RRC_OBJ9_RefPointDx_Pv:*/
on envVar E_pubc_GW_GW_284_RRC_OBJ9_RefPointDx_Pv
{
    int64 rawValue = 0ll;
    float phyValue = 0.0;
    
    //update the raw value with physical value 
    {
        if(chgEv_GW_284_RRC_OBJ9_RefPointDx == 0)
        {
            phyValue = getvalue(this);
            // physical to raw conversion
            rawValue = ((phyValue -(-256))/0.0625);
            putValue(E_pubc_GW_GW_284_RRC_OBJ9_RefPointDx_Rv, rawValue);
            chgEv_GW_284_RRC_OBJ9_RefPointDx = 1;  
        }
        else
        {
            chgEv_GW_284_RRC_OBJ9_RefPointDx = 0;
        }
    }
}
/*@@end*/


 
/*@@envVar:E_pubc_GW_GW_284_RRC_OBJ3_RefPointLoc_Rv:*/
on envVar E_pubc_GW_GW_284_RRC_OBJ3_RefPointLoc_Rv
{
    int64 rawValue = 0ll;
    float rawValue_float = 0.0;
    float phyValue = 0.0;        

    //set the signal with updated raw value
    {
        rawValue = getvalue(this);
        if(chgEv_GW_284_RRC_OBJ3_RefPointLoc == 0)
        {
            //type conversion to float
            rawValue_float = rawValue;        
            // raw to physical conversion
            phyValue = ((rawValue_float *1)+(0));
            putValue(E_pubc_GW_GW_284_RRC_OBJ3_RefPointLoc_Pv, phyValue);
            chgEv_GW_284_RRC_OBJ3_RefPointLoc = 1;
        }
        else
        {
            chgEv_GW_284_RRC_OBJ3_RefPointLoc = 0;
        }    
        //update the signal value
        Msg_GW_284.RRC_OBJ3_RefPointLoc=rawValue;        
    }                                                                           
}
/*@@end*/

/*@@envVar:E_pubc_GW_GW_284_RRC_OBJ3_RefPointLoc_Pv:*/
on envVar E_pubc_GW_GW_284_RRC_OBJ3_RefPointLoc_Pv
{
    int64 rawValue = 0ll;
    float phyValue = 0.0;
    
    //update the raw value with physical value 
    {
        if(chgEv_GW_284_RRC_OBJ3_RefPointLoc == 0)
        {
            phyValue = getvalue(this);
            // physical to raw conversion
            rawValue = ((phyValue -(0))/1);
            putValue(E_pubc_GW_GW_284_RRC_OBJ3_RefPointLoc_Rv, rawValue);
            chgEv_GW_284_RRC_OBJ3_RefPointLoc = 1;  
        }
        else
        {
            chgEv_GW_284_RRC_OBJ3_RefPointLoc = 0;
        }
    }
}
/*@@end*/


 
/*@@envVar:E_pubc_GW_GW_284_RRC_OBJ9_RefPointLoc_Rv:*/
on envVar E_pubc_GW_GW_284_RRC_OBJ9_RefPointLoc_Rv
{
    int64 rawValue = 0ll;
    float rawValue_float = 0.0;
    float phyValue = 0.0;        

    //set the signal with updated raw value
    {
        rawValue = getvalue(this);
        if(chgEv_GW_284_RRC_OBJ9_RefPointLoc == 0)
        {
            //type conversion to float
            rawValue_float = rawValue;        
            // raw to physical conversion
            phyValue = ((rawValue_float *1)+(0));
            putValue(E_pubc_GW_GW_284_RRC_OBJ9_RefPointLoc_Pv, phyValue);
            chgEv_GW_284_RRC_OBJ9_RefPointLoc = 1;
        }
        else
        {
            chgEv_GW_284_RRC_OBJ9_RefPointLoc = 0;
        }    
        //update the signal value
        Msg_GW_284.RRC_OBJ9_RefPointLoc=rawValue;        
    }                                                                           
}
/*@@end*/

/*@@envVar:E_pubc_GW_GW_284_RRC_OBJ9_RefPointLoc_Pv:*/
on envVar E_pubc_GW_GW_284_RRC_OBJ9_RefPointLoc_Pv
{
    int64 rawValue = 0ll;
    float phyValue = 0.0;
    
    //update the raw value with physical value 
    {
        if(chgEv_GW_284_RRC_OBJ9_RefPointLoc == 0)
        {
            phyValue = getvalue(this);
            // physical to raw conversion
            rawValue = ((phyValue -(0))/1);
            putValue(E_pubc_GW_GW_284_RRC_OBJ9_RefPointLoc_Rv, rawValue);
            chgEv_GW_284_RRC_OBJ9_RefPointLoc = 1;  
        }
        else
        {
            chgEv_GW_284_RRC_OBJ9_RefPointLoc = 0;
        }
    }
}
/*@@end*/


 
/*@@envVar:E_pubc_GW_GW_284_RRC_OBJ8_RefPointLoc_Rv:*/
on envVar E_pubc_GW_GW_284_RRC_OBJ8_RefPointLoc_Rv
{
    int64 rawValue = 0ll;
    float rawValue_float = 0.0;
    float phyValue = 0.0;        

    //set the signal with updated raw value
    {
        rawValue = getvalue(this);
        if(chgEv_GW_284_RRC_OBJ8_RefPointLoc == 0)
        {
            //type conversion to float
            rawValue_float = rawValue;        
            // raw to physical conversion
            phyValue = ((rawValue_float *1)+(0));
            putValue(E_pubc_GW_GW_284_RRC_OBJ8_RefPointLoc_Pv, phyValue);
            chgEv_GW_284_RRC_OBJ8_RefPointLoc = 1;
        }
        else
        {
            chgEv_GW_284_RRC_OBJ8_RefPointLoc = 0;
        }    
        //update the signal value
        Msg_GW_284.RRC_OBJ8_RefPointLoc=rawValue;        
    }                                                                           
}
/*@@end*/

/*@@envVar:E_pubc_GW_GW_284_RRC_OBJ8_RefPointLoc_Pv:*/
on envVar E_pubc_GW_GW_284_RRC_OBJ8_RefPointLoc_Pv
{
    int64 rawValue = 0ll;
    float phyValue = 0.0;
    
    //update the raw value with physical value 
    {
        if(chgEv_GW_284_RRC_OBJ8_RefPointLoc == 0)
        {
            phyValue = getvalue(this);
            // physical to raw conversion
            rawValue = ((phyValue -(0))/1);
            putValue(E_pubc_GW_GW_284_RRC_OBJ8_RefPointLoc_Rv, rawValue);
            chgEv_GW_284_RRC_OBJ8_RefPointLoc = 1;  
        }
        else
        {
            chgEv_GW_284_RRC_OBJ8_RefPointLoc = 0;
        }
    }
}
/*@@end*/


 
/*@@envVar:E_pubc_GW_GW_284_RRC_OBJ4_RefPointLoc_Rv:*/
on envVar E_pubc_GW_GW_284_RRC_OBJ4_RefPointLoc_Rv
{
    int64 rawValue = 0ll;
    float rawValue_float = 0.0;
    float phyValue = 0.0;        

    //set the signal with updated raw value
    {
        rawValue = getvalue(this);
        if(chgEv_GW_284_RRC_OBJ4_RefPointLoc == 0)
        {
            //type conversion to float
            rawValue_float = rawValue;        
            // raw to physical conversion
            phyValue = ((rawValue_float *1)+(0));
            putValue(E_pubc_GW_GW_284_RRC_OBJ4_RefPointLoc_Pv, phyValue);
            chgEv_GW_284_RRC_OBJ4_RefPointLoc = 1;
        }
        else
        {
            chgEv_GW_284_RRC_OBJ4_RefPointLoc = 0;
        }    
        //update the signal value
        Msg_GW_284.RRC_OBJ4_RefPointLoc=rawValue;        
    }                                                                           
}
/*@@end*/

/*@@envVar:E_pubc_GW_GW_284_RRC_OBJ4_RefPointLoc_Pv:*/
on envVar E_pubc_GW_GW_284_RRC_OBJ4_RefPointLoc_Pv
{
    int64 rawValue = 0ll;
    float phyValue = 0.0;
    
    //update the raw value with physical value 
    {
        if(chgEv_GW_284_RRC_OBJ4_RefPointLoc == 0)
        {
            phyValue = getvalue(this);
            // physical to raw conversion
            rawValue = ((phyValue -(0))/1);
            putValue(E_pubc_GW_GW_284_RRC_OBJ4_RefPointLoc_Rv, rawValue);
            chgEv_GW_284_RRC_OBJ4_RefPointLoc = 1;  
        }
        else
        {
            chgEv_GW_284_RRC_OBJ4_RefPointLoc = 0;
        }
    }
}
/*@@end*/


 
/*@@envVar:E_pubc_GW_GW_2DE_tx:*/
on envVar E_pubc_GW_GW_2DE_tx
{
    if(getValue(this))
    {       
        
        //update the BZ Signal
        if(GW_2DE_IP_RollingCounter_2DE_wrongvalctr == 0)
        {
            update_GW_2DE_IP_RollingCounter_2DE_counter();
            Msg_GW_2DE.IP_RollingCounter_2DE= GW_2DE_IP_RollingCounter_2DE_counter;
        }
        else if(GW_2DE_IP_RollingCounter_2DE_wrongvalctr > 0)
        {
			GW_2DE_IP_RollingCounter_2DE_counter=GW_2DE_IP_RollingCounter_2DE_counter + GW_2DE_IP_RollingCounter_2DE_wrongvalctr;
			 Msg_GW_2DE.IP_RollingCounter_2DE= GW_2DE_IP_RollingCounter_2DE_counter;
            /* GW_2DE_IP_RollingCounter_2DE_wrongvalctr--;
              // if counter becomes zero, update panel controller to zero
             if(GW_2DE_IP_RollingCounter_2DE_wrongvalctr == 0)
             {
                 putValue(E_pubc_GW_GW_2DE_IP_RollingCounter_2DE_wrongvalctr,0);
             } */
        }
        else
        { 
			// do nothing
        }    
        //calculate the CRC CheckSum
        update_GW_2DE_CRC_CheckSum();

        output(Msg_GW_2DE);        
    }
}
/*@@end*/

/*@@envVar:E_pubc_GW_GW_2DE_Range:*/
on envVar E_pubc_GW_GW_2DE_Range
{
    qword rawstatus = 0ll;
    qword rawValue = 0ll;    
    
    rawstatus = getvalue(this);    
    // set all the signals with min raw /max raw /init raw
    switch (rawstatus) 
    {
     case(0) :
        rawValue= 0;
        putValue(E_pubc_GW_GW_2DE_IP_DISFail_Rv, rawValue);
        rawValue= 0;
        putValue(E_pubc_GW_GW_2DE_IP_QDashACCFail_Rv, rawValue);
        break;
     case(1) :
        rawValue= 1;
        putValue(E_pubc_GW_GW_2DE_IP_DISFail_Rv, rawValue);
        rawValue= 3;
        putValue(E_pubc_GW_GW_2DE_IP_QDashACCFail_Rv, rawValue);
        break;
     default :
        rawValue= 0;
        putValue(E_pubc_GW_GW_2DE_IP_DISFail_Rv, rawValue);
        rawValue= 0;
        putValue(E_pubc_GW_GW_2DE_IP_QDashACCFail_Rv, rawValue);
      break;
   }
}
/*@@end*/

/*@@envVar:E_pubc_GW_GW_2DE_Dlc:*/
on envVar E_pubc_GW_GW_2DE_Dlc
{
    if(getValue(E_pubc_GW_GW_2DE_enDlc))
    {
        Msg_GW_2DE.dlc =getValue(this);
    }
    else
    {
       Dbc_dlc = 8;
	   Msg_GW_2DE.dlc = Calc_Canfd_dlc(Dbc_dlc);
	   // Msg_GW_2DE.dlc = 8;
	   	
  }
}
/*@@end*/

/*@@envVar:E_pubc_GW_GW_2DE_enDlc:*/
on envVar E_pubc_GW_GW_2DE_enDlc
{
    //For Messages with DLC = 8, set wrong DLC to smaller than defined DLC
    //For Messages with DLC < 8 set wrong DLC to smaller/longer than defined DLC
    if(getValue(this))
    {
        Msg_GW_2DE.dlc =getValue(E_pubc_GW_GW_2DE_Dlc);
    }
    else
    {
       Dbc_dlc = 8;
	   Msg_GW_2DE.dlc = Calc_Canfd_dlc(Dbc_dlc);
	   // Msg_GW_2DE.dlc = 8;
    }
}
/*@@end*/

/*@@envVar:E_pubc_GW_GW_2DE_IP_CRCCheck_2DE_wrongvalctr:*/
on envVar E_pubc_GW_GW_2DE_IP_CRCCheck_2DE_wrongvalctr
{
    //update disturb count
    //disturb value range:(-1 = always send wrong value),( X>0 ,x is the number of Messages with wrong CHK sent)
    GW_2DE_IP_CRCCheck_2DE_wrongvalctr =getValue(this);    
}
/*@@end*/
/*@@envVar:E_pubc_GW_GW_2DE_IP_RollingCounter_2DE_wrongvalctr:*/
on envVar E_pubc_GW_GW_2DE_IP_RollingCounter_2DE_wrongvalctr
{
    //update disturb count
    //disturb value range:(-1 = always send wrong value),( X>0 ,x is the number of Messages with wrong CHK sent)
    GW_2DE_IP_RollingCounter_2DE_wrongvalctr =getValue(this);    
}
/*@@end*/

/*@@envVar:E_pubc_GW_GW_2DE_IP_DISFail_Rv:*/
on envVar E_pubc_GW_GW_2DE_IP_DISFail_Rv
{
    int64 rawValue = 0ll;
    float rawValue_float = 0.0;
    float phyValue = 0.0;        

    //set the signal with updated raw value
    if(getValue(E_pubc_GW_GW_2DE_IP_DISFail_SetVt)==0)
    {
        rawValue = getvalue(this);
        if(chgEv_GW_2DE_IP_DISFail == 0)
        {
            //type conversion to float
            rawValue_float = rawValue;        
            // raw to physical conversion
            phyValue = ((rawValue_float *1)+(0));
            putValue(E_pubc_GW_GW_2DE_IP_DISFail_Pv, phyValue);
            chgEv_GW_2DE_IP_DISFail = 1;
        }
        else
        {
            chgEv_GW_2DE_IP_DISFail = 0;
        }    
        //update the signal value
        Msg_GW_2DE.IP_DISFail=rawValue;        
    }                                                                           
}
/*@@end*/

/*@@envVar:E_pubc_GW_GW_2DE_IP_DISFail_Pv:*/
on envVar E_pubc_GW_GW_2DE_IP_DISFail_Pv
{
    int64 rawValue = 0ll;
    float phyValue = 0.0;
    
    //update the raw value with physical value 
    if(getValue(E_pubc_GW_GW_2DE_IP_DISFail_SetVt)==0)
    {
        if(chgEv_GW_2DE_IP_DISFail == 0)
        {
            phyValue = getvalue(this);
            // physical to raw conversion
            rawValue = ((phyValue -(0))/1);
            putValue(E_pubc_GW_GW_2DE_IP_DISFail_Rv, rawValue);
            chgEv_GW_2DE_IP_DISFail = 1;  
        }
        else
        {
            chgEv_GW_2DE_IP_DISFail = 0;
        }
    }
}
/*@@end*/

/*@@envVar:E_pubc_GW_GW_2DE_IP_DISFail_Vt:*/
on envVar E_pubc_GW_GW_2DE_IP_DISFail_Vt
{
    qword rawValue = 0ll;
    if(getValue(E_pubc_GW_GW_2DE_IP_DISFail_SetVt))
    {
        //update the signal value
        Msg_GW_2DE.IP_DISFail=getValue(this);
    }
}
/*@@end*/

/*@@envVar:E_pubc_GW_GW_2DE_IP_DISFail_SetVt:*/
on envVar E_pubc_GW_GW_2DE_IP_DISFail_SetVt
{
    if(getValue(E_pubc_GW_GW_2DE_IP_DISFail_SetVt))
    {
        //update the signal value
        Msg_GW_2DE.IP_DISFail=getvalue(E_pubc_GW_GW_2DE_IP_DISFail_Vt);
    }
    else
    {
        Msg_GW_2DE.IP_DISFail=getValue(E_pubc_GW_GW_2DE_IP_DISFail_Rv);
    }
}
/*@@end*/
 
/*@@envVar:E_pubc_GW_GW_2DE_IP_QDashACCFail_Rv:*/
on envVar E_pubc_GW_GW_2DE_IP_QDashACCFail_Rv
{
    int64 rawValue = 0ll;
    float rawValue_float = 0.0;
    float phyValue = 0.0;        

    //set the signal with updated raw value
    if(getValue(E_pubc_GW_GW_2DE_IP_QDashACCFail_SetVt)==0)
    {
        rawValue = getvalue(this);
        if(chgEv_GW_2DE_IP_QDashACCFail == 0)
        {
            //type conversion to float
            rawValue_float = rawValue;        
            // raw to physical conversion
            phyValue = ((rawValue_float *1)+(0));
            putValue(E_pubc_GW_GW_2DE_IP_QDashACCFail_Pv, phyValue);
            chgEv_GW_2DE_IP_QDashACCFail = 1;
        }
        else
        {
            chgEv_GW_2DE_IP_QDashACCFail = 0;
        }    
        //update the signal value
        Msg_GW_2DE.IP_QDashACCFail=rawValue;        
    }                                                                           
}
/*@@end*/

/*@@envVar:E_pubc_GW_GW_2DE_IP_QDashACCFail_Pv:*/
on envVar E_pubc_GW_GW_2DE_IP_QDashACCFail_Pv
{
    int64 rawValue = 0ll;
    float phyValue = 0.0;
    
    //update the raw value with physical value 
    if(getValue(E_pubc_GW_GW_2DE_IP_QDashACCFail_SetVt)==0)
    {
        if(chgEv_GW_2DE_IP_QDashACCFail == 0)
        {
            phyValue = getvalue(this);
            // physical to raw conversion
            rawValue = ((phyValue -(0))/1);
            putValue(E_pubc_GW_GW_2DE_IP_QDashACCFail_Rv, rawValue);
            chgEv_GW_2DE_IP_QDashACCFail = 1;  
        }
        else
        {
            chgEv_GW_2DE_IP_QDashACCFail = 0;
        }
    }
}
/*@@end*/

/*@@envVar:E_pubc_GW_GW_2DE_IP_QDashACCFail_Vt:*/
on envVar E_pubc_GW_GW_2DE_IP_QDashACCFail_Vt
{
    qword rawValue = 0ll;
    if(getValue(E_pubc_GW_GW_2DE_IP_QDashACCFail_SetVt))
    {
        //update the signal value
        Msg_GW_2DE.IP_QDashACCFail=getValue(this);
    }
}
/*@@end*/

/*@@envVar:E_pubc_GW_GW_2DE_IP_QDashACCFail_SetVt:*/
on envVar E_pubc_GW_GW_2DE_IP_QDashACCFail_SetVt
{
    if(getValue(E_pubc_GW_GW_2DE_IP_QDashACCFail_SetVt))
    {
        //update the signal value
        Msg_GW_2DE.IP_QDashACCFail=getvalue(E_pubc_GW_GW_2DE_IP_QDashACCFail_Vt);
    }
    else
    {
        Msg_GW_2DE.IP_QDashACCFail=getValue(E_pubc_GW_GW_2DE_IP_QDashACCFail_Rv);
    }
}
/*@@end*/
 
/*@@envVar:E_pubc_GW_GW_50_tx:*/
on envVar E_pubc_GW_GW_50_tx
{
    if(getValue(this))
    {       
        
        //update the BZ Signal
        if(GW_50_SrsCycCntr050_wrongvalctr == 0)
        {
            update_GW_50_SrsCycCntr050_counter();
            Msg_GW_50.SrsCycCntr050= GW_50_SrsCycCntr050_counter;
        }
        else if(GW_50_SrsCycCntr050_wrongvalctr > 0)
        {
			GW_50_SrsCycCntr050_counter=GW_50_SrsCycCntr050_counter + GW_50_SrsCycCntr050_wrongvalctr;
			 Msg_GW_50.SrsCycCntr050= GW_50_SrsCycCntr050_counter;
            /* GW_50_SrsCycCntr050_wrongvalctr--;
              // if counter becomes zero, update panel controller to zero
             if(GW_50_SrsCycCntr050_wrongvalctr == 0)
             {
                 putValue(E_pubc_GW_GW_50_SrsCycCntr050_wrongvalctr,0);
             } */
        }
        else
        { 
			// do nothing
        }    
        //calculate the CRC CheckSum
        update_GW_50_CRC_CheckSum();

        output(Msg_GW_50);        
    }
}
/*@@end*/

/*@@envVar:E_pubc_GW_GW_50_Range:*/
on envVar E_pubc_GW_GW_50_Range
{
    qword rawstatus = 0ll;
    qword rawValue = 0ll;    
    
    rawstatus = getvalue(this);    
    // set all the signals with min raw /max raw /init raw
    switch (rawstatus) 
    {
     case(0) :
        rawValue= 0;
        putValue(E_pubc_GW_GW_50_SrsCrashOutpStsChks_Rv, rawValue);
        rawValue= 0;
        putValue(E_pubc_GW_GW_50_SrsPassBucSwtSts_Rv, rawValue);
        rawValue= 0;
        putValue(E_pubc_GW_GW_50_SrsCrashOutpSts_Rv, rawValue);
        rawValue= 0;
        putValue(E_pubc_GW_GW_50_SrsDrvrBucSwtSts_Rv, rawValue);
        rawValue= 0;
        putValue(E_pubc_GW_GW_50_SrsWarnLampSts_Rv, rawValue);
        break;
     case(1) :
        rawValue= 15;
        putValue(E_pubc_GW_GW_50_SrsCrashOutpStsChks_Rv, rawValue);
        rawValue= 3;
        putValue(E_pubc_GW_GW_50_SrsPassBucSwtSts_Rv, rawValue);
        rawValue= 15;
        putValue(E_pubc_GW_GW_50_SrsCrashOutpSts_Rv, rawValue);
        rawValue= 3;
        putValue(E_pubc_GW_GW_50_SrsDrvrBucSwtSts_Rv, rawValue);
        rawValue= 3;
        putValue(E_pubc_GW_GW_50_SrsWarnLampSts_Rv, rawValue);
        break;
     default :
        rawValue= 0;
        putValue(E_pubc_GW_GW_50_SrsCrashOutpStsChks_Rv, rawValue);
        rawValue= 0;
        putValue(E_pubc_GW_GW_50_SrsPassBucSwtSts_Rv, rawValue);
        rawValue= 0;
        putValue(E_pubc_GW_GW_50_SrsCrashOutpSts_Rv, rawValue);
        rawValue= 0;
        putValue(E_pubc_GW_GW_50_SrsDrvrBucSwtSts_Rv, rawValue);
        rawValue= 0;
        putValue(E_pubc_GW_GW_50_SrsWarnLampSts_Rv, rawValue);
      break;
   }
}
/*@@end*/

/*@@envVar:E_pubc_GW_GW_50_Dlc:*/
on envVar E_pubc_GW_GW_50_Dlc
{
    if(getValue(E_pubc_GW_GW_50_enDlc))
    {
        Msg_GW_50.dlc =getValue(this);
    }
    else
    {
       Dbc_dlc = 8;
	   Msg_GW_50.dlc = Calc_Canfd_dlc(Dbc_dlc);
	   // Msg_GW_50.dlc = 8;
	   	
  }
}
/*@@end*/

/*@@envVar:E_pubc_GW_GW_50_enDlc:*/
on envVar E_pubc_GW_GW_50_enDlc
{
    //For Messages with DLC = 8, set wrong DLC to smaller than defined DLC
    //For Messages with DLC < 8 set wrong DLC to smaller/longer than defined DLC
    if(getValue(this))
    {
        Msg_GW_50.dlc =getValue(E_pubc_GW_GW_50_Dlc);
    }
    else
    {
       Dbc_dlc = 8;
	   Msg_GW_50.dlc = Calc_Canfd_dlc(Dbc_dlc);
	   // Msg_GW_50.dlc = 8;
    }
}
/*@@end*/

/*@@envVar:E_pubc_GW_GW_50_SrsCrcChk050_wrongvalctr:*/
on envVar E_pubc_GW_GW_50_SrsCrcChk050_wrongvalctr
{
    //update disturb count
    //disturb value range:(-1 = always send wrong value),( X>0 ,x is the number of Messages with wrong CHK sent)
    GW_50_SrsCrcChk050_wrongvalctr =getValue(this);    
}
/*@@end*/
/*@@envVar:E_pubc_GW_GW_50_SrsCycCntr050_wrongvalctr:*/
on envVar E_pubc_GW_GW_50_SrsCycCntr050_wrongvalctr
{
    //update disturb count
    //disturb value range:(-1 = always send wrong value),( X>0 ,x is the number of Messages with wrong CHK sent)
    GW_50_SrsCycCntr050_wrongvalctr =getValue(this);    
}
/*@@end*/

/*@@envVar:E_pubc_GW_GW_50_SrsCrashOutpStsChks_Rv:*/
on envVar E_pubc_GW_GW_50_SrsCrashOutpStsChks_Rv
{
    int64 rawValue = 0ll;
    float rawValue_float = 0.0;
    float phyValue = 0.0;        

    //set the signal with updated raw value
    {
        rawValue = getvalue(this);
        if(chgEv_GW_50_SrsCrashOutpStsChks == 0)
        {
            //type conversion to float
            rawValue_float = rawValue;        
            // raw to physical conversion
            phyValue = ((rawValue_float *1)+(0));
            putValue(E_pubc_GW_GW_50_SrsCrashOutpStsChks_Pv, phyValue);
            chgEv_GW_50_SrsCrashOutpStsChks = 1;
        }
        else
        {
            chgEv_GW_50_SrsCrashOutpStsChks = 0;
        }    
        //update the signal value
        Msg_GW_50.SrsCrashOutpStsChks=rawValue;        
    }                                                                           
}
/*@@end*/

/*@@envVar:E_pubc_GW_GW_50_SrsCrashOutpStsChks_Pv:*/
on envVar E_pubc_GW_GW_50_SrsCrashOutpStsChks_Pv
{
    int64 rawValue = 0ll;
    float phyValue = 0.0;
    
    //update the raw value with physical value 
    {
        if(chgEv_GW_50_SrsCrashOutpStsChks == 0)
        {
            phyValue = getvalue(this);
            // physical to raw conversion
            rawValue = ((phyValue -(0))/1);
            putValue(E_pubc_GW_GW_50_SrsCrashOutpStsChks_Rv, rawValue);
            chgEv_GW_50_SrsCrashOutpStsChks = 1;  
        }
        else
        {
            chgEv_GW_50_SrsCrashOutpStsChks = 0;
        }
    }
}
/*@@end*/


 
/*@@envVar:E_pubc_GW_GW_50_SrsPassBucSwtSts_Rv:*/
on envVar E_pubc_GW_GW_50_SrsPassBucSwtSts_Rv
{
    int64 rawValue = 0ll;
    float rawValue_float = 0.0;
    float phyValue = 0.0;        

    //set the signal with updated raw value
    if(getValue(E_pubc_GW_GW_50_SrsPassBucSwtSts_SetVt)==0)
    {
        rawValue = getvalue(this);
        if(chgEv_GW_50_SrsPassBucSwtSts == 0)
        {
            //type conversion to float
            rawValue_float = rawValue;        
            // raw to physical conversion
            phyValue = ((rawValue_float *1)+(0));
            putValue(E_pubc_GW_GW_50_SrsPassBucSwtSts_Pv, phyValue);
            chgEv_GW_50_SrsPassBucSwtSts = 1;
        }
        else
        {
            chgEv_GW_50_SrsPassBucSwtSts = 0;
        }    
        //update the signal value
        Msg_GW_50.SrsPassBucSwtSts=rawValue;        
    }                                                                           
}
/*@@end*/

/*@@envVar:E_pubc_GW_GW_50_SrsPassBucSwtSts_Pv:*/
on envVar E_pubc_GW_GW_50_SrsPassBucSwtSts_Pv
{
    int64 rawValue = 0ll;
    float phyValue = 0.0;
    
    //update the raw value with physical value 
    if(getValue(E_pubc_GW_GW_50_SrsPassBucSwtSts_SetVt)==0)
    {
        if(chgEv_GW_50_SrsPassBucSwtSts == 0)
        {
            phyValue = getvalue(this);
            // physical to raw conversion
            rawValue = ((phyValue -(0))/1);
            putValue(E_pubc_GW_GW_50_SrsPassBucSwtSts_Rv, rawValue);
            chgEv_GW_50_SrsPassBucSwtSts = 1;  
        }
        else
        {
            chgEv_GW_50_SrsPassBucSwtSts = 0;
        }
    }
}
/*@@end*/

/*@@envVar:E_pubc_GW_GW_50_SrsPassBucSwtSts_Vt:*/
on envVar E_pubc_GW_GW_50_SrsPassBucSwtSts_Vt
{
    qword rawValue = 0ll;
    if(getValue(E_pubc_GW_GW_50_SrsPassBucSwtSts_SetVt))
    {
        //update the signal value
        Msg_GW_50.SrsPassBucSwtSts=getValue(this);
    }
}
/*@@end*/

/*@@envVar:E_pubc_GW_GW_50_SrsPassBucSwtSts_SetVt:*/
on envVar E_pubc_GW_GW_50_SrsPassBucSwtSts_SetVt
{
    if(getValue(E_pubc_GW_GW_50_SrsPassBucSwtSts_SetVt))
    {
        //update the signal value
        Msg_GW_50.SrsPassBucSwtSts=getvalue(E_pubc_GW_GW_50_SrsPassBucSwtSts_Vt);
    }
    else
    {
        Msg_GW_50.SrsPassBucSwtSts=getValue(E_pubc_GW_GW_50_SrsPassBucSwtSts_Rv);
    }
}
/*@@end*/
 
/*@@envVar:E_pubc_GW_GW_50_SrsCrashOutpSts_Rv:*/
on envVar E_pubc_GW_GW_50_SrsCrashOutpSts_Rv
{
    int64 rawValue = 0ll;
    float rawValue_float = 0.0;
    float phyValue = 0.0;        

    //set the signal with updated raw value
    if(getValue(E_pubc_GW_GW_50_SrsCrashOutpSts_SetVt)==0)
    {
        rawValue = getvalue(this);
        if(chgEv_GW_50_SrsCrashOutpSts == 0)
        {
            //type conversion to float
            rawValue_float = rawValue;        
            // raw to physical conversion
            phyValue = ((rawValue_float *1)+(0));
            putValue(E_pubc_GW_GW_50_SrsCrashOutpSts_Pv, phyValue);
            chgEv_GW_50_SrsCrashOutpSts = 1;
        }
        else
        {
            chgEv_GW_50_SrsCrashOutpSts = 0;
        }    
        //update the signal value
        Msg_GW_50.SrsCrashOutpSts=rawValue;        
    }                                                                           
}
/*@@end*/

/*@@envVar:E_pubc_GW_GW_50_SrsCrashOutpSts_Pv:*/
on envVar E_pubc_GW_GW_50_SrsCrashOutpSts_Pv
{
    int64 rawValue = 0ll;
    float phyValue = 0.0;
    
    //update the raw value with physical value 
    if(getValue(E_pubc_GW_GW_50_SrsCrashOutpSts_SetVt)==0)
    {
        if(chgEv_GW_50_SrsCrashOutpSts == 0)
        {
            phyValue = getvalue(this);
            // physical to raw conversion
            rawValue = ((phyValue -(0))/1);
            putValue(E_pubc_GW_GW_50_SrsCrashOutpSts_Rv, rawValue);
            chgEv_GW_50_SrsCrashOutpSts = 1;  
        }
        else
        {
            chgEv_GW_50_SrsCrashOutpSts = 0;
        }
    }
}
/*@@end*/

/*@@envVar:E_pubc_GW_GW_50_SrsCrashOutpSts_Vt:*/
on envVar E_pubc_GW_GW_50_SrsCrashOutpSts_Vt
{
    qword rawValue = 0ll;
    if(getValue(E_pubc_GW_GW_50_SrsCrashOutpSts_SetVt))
    {
        //update the signal value
        Msg_GW_50.SrsCrashOutpSts=getValue(this);
    }
}
/*@@end*/

/*@@envVar:E_pubc_GW_GW_50_SrsCrashOutpSts_SetVt:*/
on envVar E_pubc_GW_GW_50_SrsCrashOutpSts_SetVt
{
    if(getValue(E_pubc_GW_GW_50_SrsCrashOutpSts_SetVt))
    {
        //update the signal value
        Msg_GW_50.SrsCrashOutpSts=getvalue(E_pubc_GW_GW_50_SrsCrashOutpSts_Vt);
    }
    else
    {
        Msg_GW_50.SrsCrashOutpSts=getValue(E_pubc_GW_GW_50_SrsCrashOutpSts_Rv);
    }
}
/*@@end*/
 
/*@@envVar:E_pubc_GW_GW_50_SrsDrvrBucSwtSts_Rv:*/
on envVar E_pubc_GW_GW_50_SrsDrvrBucSwtSts_Rv
{
    int64 rawValue = 0ll;
    float rawValue_float = 0.0;
    float phyValue = 0.0;        

    //set the signal with updated raw value
    if(getValue(E_pubc_GW_GW_50_SrsDrvrBucSwtSts_SetVt)==0)
    {
        rawValue = getvalue(this);
        if(chgEv_GW_50_SrsDrvrBucSwtSts == 0)
        {
            //type conversion to float
            rawValue_float = rawValue;        
            // raw to physical conversion
            phyValue = ((rawValue_float *1)+(0));
            putValue(E_pubc_GW_GW_50_SrsDrvrBucSwtSts_Pv, phyValue);
            chgEv_GW_50_SrsDrvrBucSwtSts = 1;
        }
        else
        {
            chgEv_GW_50_SrsDrvrBucSwtSts = 0;
        }    
        //update the signal value
        Msg_GW_50.SrsDrvrBucSwtSts=rawValue;        
    }                                                                           
}
/*@@end*/

/*@@envVar:E_pubc_GW_GW_50_SrsDrvrBucSwtSts_Pv:*/
on envVar E_pubc_GW_GW_50_SrsDrvrBucSwtSts_Pv
{
    int64 rawValue = 0ll;
    float phyValue = 0.0;
    
    //update the raw value with physical value 
    if(getValue(E_pubc_GW_GW_50_SrsDrvrBucSwtSts_SetVt)==0)
    {
        if(chgEv_GW_50_SrsDrvrBucSwtSts == 0)
        {
            phyValue = getvalue(this);
            // physical to raw conversion
            rawValue = ((phyValue -(0))/1);
            putValue(E_pubc_GW_GW_50_SrsDrvrBucSwtSts_Rv, rawValue);
            chgEv_GW_50_SrsDrvrBucSwtSts = 1;  
        }
        else
        {
            chgEv_GW_50_SrsDrvrBucSwtSts = 0;
        }
    }
}
/*@@end*/

/*@@envVar:E_pubc_GW_GW_50_SrsDrvrBucSwtSts_Vt:*/
on envVar E_pubc_GW_GW_50_SrsDrvrBucSwtSts_Vt
{
    qword rawValue = 0ll;
    if(getValue(E_pubc_GW_GW_50_SrsDrvrBucSwtSts_SetVt))
    {
        //update the signal value
        Msg_GW_50.SrsDrvrBucSwtSts=getValue(this);
    }
}
/*@@end*/

/*@@envVar:E_pubc_GW_GW_50_SrsDrvrBucSwtSts_SetVt:*/
on envVar E_pubc_GW_GW_50_SrsDrvrBucSwtSts_SetVt
{
    if(getValue(E_pubc_GW_GW_50_SrsDrvrBucSwtSts_SetVt))
    {
        //update the signal value
        Msg_GW_50.SrsDrvrBucSwtSts=getvalue(E_pubc_GW_GW_50_SrsDrvrBucSwtSts_Vt);
    }
    else
    {
        Msg_GW_50.SrsDrvrBucSwtSts=getValue(E_pubc_GW_GW_50_SrsDrvrBucSwtSts_Rv);
    }
}
/*@@end*/
 
/*@@envVar:E_pubc_GW_GW_50_SrsWarnLampSts_Rv:*/
on envVar E_pubc_GW_GW_50_SrsWarnLampSts_Rv
{
    int64 rawValue = 0ll;
    float rawValue_float = 0.0;
    float phyValue = 0.0;        

    //set the signal with updated raw value
    if(getValue(E_pubc_GW_GW_50_SrsWarnLampSts_SetVt)==0)
    {
        rawValue = getvalue(this);
        if(chgEv_GW_50_SrsWarnLampSts == 0)
        {
            //type conversion to float
            rawValue_float = rawValue;        
            // raw to physical conversion
            phyValue = ((rawValue_float *1)+(0));
            putValue(E_pubc_GW_GW_50_SrsWarnLampSts_Pv, phyValue);
            chgEv_GW_50_SrsWarnLampSts = 1;
        }
        else
        {
            chgEv_GW_50_SrsWarnLampSts = 0;
        }    
        //update the signal value
        Msg_GW_50.SrsWarnLampSts=rawValue;        
    }                                                                           
}
/*@@end*/

/*@@envVar:E_pubc_GW_GW_50_SrsWarnLampSts_Pv:*/
on envVar E_pubc_GW_GW_50_SrsWarnLampSts_Pv
{
    int64 rawValue = 0ll;
    float phyValue = 0.0;
    
    //update the raw value with physical value 
    if(getValue(E_pubc_GW_GW_50_SrsWarnLampSts_SetVt)==0)
    {
        if(chgEv_GW_50_SrsWarnLampSts == 0)
        {
            phyValue = getvalue(this);
            // physical to raw conversion
            rawValue = ((phyValue -(0))/1);
            putValue(E_pubc_GW_GW_50_SrsWarnLampSts_Rv, rawValue);
            chgEv_GW_50_SrsWarnLampSts = 1;  
        }
        else
        {
            chgEv_GW_50_SrsWarnLampSts = 0;
        }
    }
}
/*@@end*/

/*@@envVar:E_pubc_GW_GW_50_SrsWarnLampSts_Vt:*/
on envVar E_pubc_GW_GW_50_SrsWarnLampSts_Vt
{
    qword rawValue = 0ll;
    if(getValue(E_pubc_GW_GW_50_SrsWarnLampSts_SetVt))
    {
        //update the signal value
        Msg_GW_50.SrsWarnLampSts=getValue(this);
    }
}
/*@@end*/

/*@@envVar:E_pubc_GW_GW_50_SrsWarnLampSts_SetVt:*/
on envVar E_pubc_GW_GW_50_SrsWarnLampSts_SetVt
{
    if(getValue(E_pubc_GW_GW_50_SrsWarnLampSts_SetVt))
    {
        //update the signal value
        Msg_GW_50.SrsWarnLampSts=getvalue(E_pubc_GW_GW_50_SrsWarnLampSts_Vt);
    }
    else
    {
        Msg_GW_50.SrsWarnLampSts=getValue(E_pubc_GW_GW_50_SrsWarnLampSts_Rv);
    }
}
/*@@end*/
 
/*@@envVar:E_pubc_GW_GW_20B_tx:*/
on envVar E_pubc_GW_GW_20B_tx
{
    if(getValue(this))
    {       
        
        //update the BZ Signal
        if(GW_20B_EspCycCntr20B_wrongvalctr == 0)
        {
            update_GW_20B_EspCycCntr20B_counter();
            Msg_GW_20B.EspCycCntr20B= GW_20B_EspCycCntr20B_counter;
        }
        else if(GW_20B_EspCycCntr20B_wrongvalctr > 0)
        {
			GW_20B_EspCycCntr20B_counter=GW_20B_EspCycCntr20B_counter + GW_20B_EspCycCntr20B_wrongvalctr;
			 Msg_GW_20B.EspCycCntr20B= GW_20B_EspCycCntr20B_counter;
            /* GW_20B_EspCycCntr20B_wrongvalctr--;
              // if counter becomes zero, update panel controller to zero
             if(GW_20B_EspCycCntr20B_wrongvalctr == 0)
             {
                 putValue(E_pubc_GW_GW_20B_EspCycCntr20B_wrongvalctr,0);
             } */
        }
        else
        { 
			// do nothing
        }    
        //calculate the CRC CheckSum
        update_GW_20B_CRC_CheckSum();

        output(Msg_GW_20B);        
    }
}
/*@@end*/

/*@@envVar:E_pubc_GW_GW_20B_Range:*/
on envVar E_pubc_GW_GW_20B_Range
{
    qword rawstatus = 0ll;
    qword rawValue = 0ll;    
    
    rawstatus = getvalue(this);    
    // set all the signals with min raw /max raw /init raw
    switch (rawstatus) 
    {
     case(0) :
        rawValue= 0;
        putValue(E_pubc_GW_GW_20B_ESP_AWBavailable_Rv, rawValue);
        rawValue= 0;
        putValue(E_pubc_GW_GW_20B_ESP_AWBactive_Rv, rawValue);
        rawValue= 0;
        putValue(E_pubc_GW_GW_20B_ESP_PrefillActive_Rv, rawValue);
        rawValue= 0;
        putValue(E_pubc_GW_GW_20B_ESP_QDCACC_Rv, rawValue);
        rawValue= 0;
        putValue(E_pubc_GW_GW_20B_ESP_PrefillAvailable_Rv, rawValue);
        rawValue= 0;
        putValue(E_pubc_GW_GW_20B_ESP_BrakeOverHeatBrakeDiscTemp_Rv, rawValue);
        rawValue= 0;
        putValue(E_pubc_GW_GW_20B_ESP_CDD_Active_Rv, rawValue);
        rawValue= 0;
        putValue(E_pubc_GW_GW_20B_ESP_ABAavailable_Rv, rawValue);
        rawValue= 0;
        putValue(E_pubc_GW_GW_20B_ESP_AEBdecActive_Rv, rawValue);
        rawValue= 0;
        putValue(E_pubc_GW_GW_20B_ESP_BrakeForce_Rv, rawValue);
        rawValue= 0;
        putValue(E_pubc_GW_GW_20B_ESP_ABAactive_Rv, rawValue);
        rawValue= 0;
        putValue(E_pubc_GW_GW_20B_ESP_AEBAvailable_Rv, rawValue);
        rawValue= 0;
        putValue(E_pubc_GW_GW_20B_ESP_CDD_Available_Rv, rawValue);
        break;
     case(1) :
        rawValue= 1;
        putValue(E_pubc_GW_GW_20B_ESP_AWBavailable_Rv, rawValue);
        rawValue= 1;
        putValue(E_pubc_GW_GW_20B_ESP_AWBactive_Rv, rawValue);
        rawValue= 1;
        putValue(E_pubc_GW_GW_20B_ESP_PrefillActive_Rv, rawValue);
        rawValue= 3;
        putValue(E_pubc_GW_GW_20B_ESP_QDCACC_Rv, rawValue);
        rawValue= 1;
        putValue(E_pubc_GW_GW_20B_ESP_PrefillAvailable_Rv, rawValue);
        rawValue= 1;
        putValue(E_pubc_GW_GW_20B_ESP_BrakeOverHeatBrakeDiscTemp_Rv, rawValue);
        rawValue= 1;
        putValue(E_pubc_GW_GW_20B_ESP_CDD_Active_Rv, rawValue);
        rawValue= 1;
        putValue(E_pubc_GW_GW_20B_ESP_ABAavailable_Rv, rawValue);
        rawValue= 1;
        putValue(E_pubc_GW_GW_20B_ESP_AEBdecActive_Rv, rawValue);
        rawValue= 1;
        putValue(E_pubc_GW_GW_20B_ESP_BrakeForce_Rv, rawValue);
        rawValue= 1;
        putValue(E_pubc_GW_GW_20B_ESP_ABAactive_Rv, rawValue);
        rawValue= 1;
        putValue(E_pubc_GW_GW_20B_ESP_AEBAvailable_Rv, rawValue);
        rawValue= 1;
        putValue(E_pubc_GW_GW_20B_ESP_CDD_Available_Rv, rawValue);
        break;
     default :
        rawValue= 0;
        putValue(E_pubc_GW_GW_20B_ESP_AWBavailable_Rv, rawValue);
        rawValue= 0;
        putValue(E_pubc_GW_GW_20B_ESP_AWBactive_Rv, rawValue);
        rawValue= 0;
        putValue(E_pubc_GW_GW_20B_ESP_PrefillActive_Rv, rawValue);
        rawValue= 0;
        putValue(E_pubc_GW_GW_20B_ESP_QDCACC_Rv, rawValue);
        rawValue= 0;
        putValue(E_pubc_GW_GW_20B_ESP_PrefillAvailable_Rv, rawValue);
        rawValue= 0;
        putValue(E_pubc_GW_GW_20B_ESP_BrakeOverHeatBrakeDiscTemp_Rv, rawValue);
        rawValue= 0;
        putValue(E_pubc_GW_GW_20B_ESP_CDD_Active_Rv, rawValue);
        rawValue= 0;
        putValue(E_pubc_GW_GW_20B_ESP_ABAavailable_Rv, rawValue);
        rawValue= 0;
        putValue(E_pubc_GW_GW_20B_ESP_AEBdecActive_Rv, rawValue);
        rawValue= 0;
        putValue(E_pubc_GW_GW_20B_ESP_BrakeForce_Rv, rawValue);
        rawValue= 0;
        putValue(E_pubc_GW_GW_20B_ESP_ABAactive_Rv, rawValue);
        rawValue= 0;
        putValue(E_pubc_GW_GW_20B_ESP_AEBAvailable_Rv, rawValue);
        rawValue= 0;
        putValue(E_pubc_GW_GW_20B_ESP_CDD_Available_Rv, rawValue);
      break;
   }
}
/*@@end*/

/*@@envVar:E_pubc_GW_GW_20B_Dlc:*/
on envVar E_pubc_GW_GW_20B_Dlc
{
    if(getValue(E_pubc_GW_GW_20B_enDlc))
    {
        Msg_GW_20B.dlc =getValue(this);
    }
    else
    {
       Dbc_dlc = 48;
	   Msg_GW_20B.dlc = Calc_Canfd_dlc(Dbc_dlc);
	   // Msg_GW_20B.dlc = 48;
	   	
  }
}
/*@@end*/

/*@@envVar:E_pubc_GW_GW_20B_enDlc:*/
on envVar E_pubc_GW_GW_20B_enDlc
{
    //For Messages with DLC = 8, set wrong DLC to smaller than defined DLC
    //For Messages with DLC < 8 set wrong DLC to smaller/longer than defined DLC
    if(getValue(this))
    {
        Msg_GW_20B.dlc =getValue(E_pubc_GW_GW_20B_Dlc);
    }
    else
    {
       Dbc_dlc = 48;
	   Msg_GW_20B.dlc = Calc_Canfd_dlc(Dbc_dlc);
	   // Msg_GW_20B.dlc = 48;
    }
}
/*@@end*/

/*@@envVar:E_pubc_GW_GW_20B_EspCrcChk20B_wrongvalctr:*/
on envVar E_pubc_GW_GW_20B_EspCrcChk20B_wrongvalctr
{
    //update disturb count
    //disturb value range:(-1 = always send wrong value),( X>0 ,x is the number of Messages with wrong CHK sent)
    GW_20B_EspCrcChk20B_wrongvalctr =getValue(this);    
}
/*@@end*/
/*@@envVar:E_pubc_GW_GW_20B_EspCycCntr20B_wrongvalctr:*/
on envVar E_pubc_GW_GW_20B_EspCycCntr20B_wrongvalctr
{
    //update disturb count
    //disturb value range:(-1 = always send wrong value),( X>0 ,x is the number of Messages with wrong CHK sent)
    GW_20B_EspCycCntr20B_wrongvalctr =getValue(this);    
}
/*@@end*/

/*@@envVar:E_pubc_GW_GW_20B_ESP_AWBavailable_Rv:*/
on envVar E_pubc_GW_GW_20B_ESP_AWBavailable_Rv
{
    int64 rawValue = 0ll;
    float rawValue_float = 0.0;
    float phyValue = 0.0;        

    //set the signal with updated raw value
    if(getValue(E_pubc_GW_GW_20B_ESP_AWBavailable_SetVt)==0)
    {
        rawValue = getvalue(this);
        if(chgEv_GW_20B_ESP_AWBavailable == 0)
        {
            //type conversion to float
            rawValue_float = rawValue;        
            // raw to physical conversion
            phyValue = ((rawValue_float *1)+(0));
            putValue(E_pubc_GW_GW_20B_ESP_AWBavailable_Pv, phyValue);
            chgEv_GW_20B_ESP_AWBavailable = 1;
        }
        else
        {
            chgEv_GW_20B_ESP_AWBavailable = 0;
        }    
        //update the signal value
        Msg_GW_20B.ESP_AWBavailable=rawValue;        
    }                                                                           
}
/*@@end*/

/*@@envVar:E_pubc_GW_GW_20B_ESP_AWBavailable_Pv:*/
on envVar E_pubc_GW_GW_20B_ESP_AWBavailable_Pv
{
    int64 rawValue = 0ll;
    float phyValue = 0.0;
    
    //update the raw value with physical value 
    if(getValue(E_pubc_GW_GW_20B_ESP_AWBavailable_SetVt)==0)
    {
        if(chgEv_GW_20B_ESP_AWBavailable == 0)
        {
            phyValue = getvalue(this);
            // physical to raw conversion
            rawValue = ((phyValue -(0))/1);
            putValue(E_pubc_GW_GW_20B_ESP_AWBavailable_Rv, rawValue);
            chgEv_GW_20B_ESP_AWBavailable = 1;  
        }
        else
        {
            chgEv_GW_20B_ESP_AWBavailable = 0;
        }
    }
}
/*@@end*/

/*@@envVar:E_pubc_GW_GW_20B_ESP_AWBavailable_Vt:*/
on envVar E_pubc_GW_GW_20B_ESP_AWBavailable_Vt
{
    qword rawValue = 0ll;
    if(getValue(E_pubc_GW_GW_20B_ESP_AWBavailable_SetVt))
    {
        //update the signal value
        Msg_GW_20B.ESP_AWBavailable=getValue(this);
    }
}
/*@@end*/

/*@@envVar:E_pubc_GW_GW_20B_ESP_AWBavailable_SetVt:*/
on envVar E_pubc_GW_GW_20B_ESP_AWBavailable_SetVt
{
    if(getValue(E_pubc_GW_GW_20B_ESP_AWBavailable_SetVt))
    {
        //update the signal value
        Msg_GW_20B.ESP_AWBavailable=getvalue(E_pubc_GW_GW_20B_ESP_AWBavailable_Vt);
    }
    else
    {
        Msg_GW_20B.ESP_AWBavailable=getValue(E_pubc_GW_GW_20B_ESP_AWBavailable_Rv);
    }
}
/*@@end*/
 
/*@@envVar:E_pubc_GW_GW_20B_ESP_AWBactive_Rv:*/
on envVar E_pubc_GW_GW_20B_ESP_AWBactive_Rv
{
    int64 rawValue = 0ll;
    float rawValue_float = 0.0;
    float phyValue = 0.0;        

    //set the signal with updated raw value
    if(getValue(E_pubc_GW_GW_20B_ESP_AWBactive_SetVt)==0)
    {
        rawValue = getvalue(this);
        if(chgEv_GW_20B_ESP_AWBactive == 0)
        {
            //type conversion to float
            rawValue_float = rawValue;        
            // raw to physical conversion
            phyValue = ((rawValue_float *1)+(0));
            putValue(E_pubc_GW_GW_20B_ESP_AWBactive_Pv, phyValue);
            chgEv_GW_20B_ESP_AWBactive = 1;
        }
        else
        {
            chgEv_GW_20B_ESP_AWBactive = 0;
        }    
        //update the signal value
        Msg_GW_20B.ESP_AWBactive=rawValue;        
    }                                                                           
}
/*@@end*/

/*@@envVar:E_pubc_GW_GW_20B_ESP_AWBactive_Pv:*/
on envVar E_pubc_GW_GW_20B_ESP_AWBactive_Pv
{
    int64 rawValue = 0ll;
    float phyValue = 0.0;
    
    //update the raw value with physical value 
    if(getValue(E_pubc_GW_GW_20B_ESP_AWBactive_SetVt)==0)
    {
        if(chgEv_GW_20B_ESP_AWBactive == 0)
        {
            phyValue = getvalue(this);
            // physical to raw conversion
            rawValue = ((phyValue -(0))/1);
            putValue(E_pubc_GW_GW_20B_ESP_AWBactive_Rv, rawValue);
            chgEv_GW_20B_ESP_AWBactive = 1;  
        }
        else
        {
            chgEv_GW_20B_ESP_AWBactive = 0;
        }
    }
}
/*@@end*/

/*@@envVar:E_pubc_GW_GW_20B_ESP_AWBactive_Vt:*/
on envVar E_pubc_GW_GW_20B_ESP_AWBactive_Vt
{
    qword rawValue = 0ll;
    if(getValue(E_pubc_GW_GW_20B_ESP_AWBactive_SetVt))
    {
        //update the signal value
        Msg_GW_20B.ESP_AWBactive=getValue(this);
    }
}
/*@@end*/

/*@@envVar:E_pubc_GW_GW_20B_ESP_AWBactive_SetVt:*/
on envVar E_pubc_GW_GW_20B_ESP_AWBactive_SetVt
{
    if(getValue(E_pubc_GW_GW_20B_ESP_AWBactive_SetVt))
    {
        //update the signal value
        Msg_GW_20B.ESP_AWBactive=getvalue(E_pubc_GW_GW_20B_ESP_AWBactive_Vt);
    }
    else
    {
        Msg_GW_20B.ESP_AWBactive=getValue(E_pubc_GW_GW_20B_ESP_AWBactive_Rv);
    }
}
/*@@end*/
 
/*@@envVar:E_pubc_GW_GW_20B_ESP_PrefillActive_Rv:*/
on envVar E_pubc_GW_GW_20B_ESP_PrefillActive_Rv
{
    int64 rawValue = 0ll;
    float rawValue_float = 0.0;
    float phyValue = 0.0;        

    //set the signal with updated raw value
    if(getValue(E_pubc_GW_GW_20B_ESP_PrefillActive_SetVt)==0)
    {
        rawValue = getvalue(this);
        if(chgEv_GW_20B_ESP_PrefillActive == 0)
        {
            //type conversion to float
            rawValue_float = rawValue;        
            // raw to physical conversion
            phyValue = ((rawValue_float *1)+(0));
            putValue(E_pubc_GW_GW_20B_ESP_PrefillActive_Pv, phyValue);
            chgEv_GW_20B_ESP_PrefillActive = 1;
        }
        else
        {
            chgEv_GW_20B_ESP_PrefillActive = 0;
        }    
        //update the signal value
        Msg_GW_20B.ESP_PrefillActive=rawValue;        
    }                                                                           
}
/*@@end*/

/*@@envVar:E_pubc_GW_GW_20B_ESP_PrefillActive_Pv:*/
on envVar E_pubc_GW_GW_20B_ESP_PrefillActive_Pv
{
    int64 rawValue = 0ll;
    float phyValue = 0.0;
    
    //update the raw value with physical value 
    if(getValue(E_pubc_GW_GW_20B_ESP_PrefillActive_SetVt)==0)
    {
        if(chgEv_GW_20B_ESP_PrefillActive == 0)
        {
            phyValue = getvalue(this);
            // physical to raw conversion
            rawValue = ((phyValue -(0))/1);
            putValue(E_pubc_GW_GW_20B_ESP_PrefillActive_Rv, rawValue);
            chgEv_GW_20B_ESP_PrefillActive = 1;  
        }
        else
        {
            chgEv_GW_20B_ESP_PrefillActive = 0;
        }
    }
}
/*@@end*/

/*@@envVar:E_pubc_GW_GW_20B_ESP_PrefillActive_Vt:*/
on envVar E_pubc_GW_GW_20B_ESP_PrefillActive_Vt
{
    qword rawValue = 0ll;
    if(getValue(E_pubc_GW_GW_20B_ESP_PrefillActive_SetVt))
    {
        //update the signal value
        Msg_GW_20B.ESP_PrefillActive=getValue(this);
    }
}
/*@@end*/

/*@@envVar:E_pubc_GW_GW_20B_ESP_PrefillActive_SetVt:*/
on envVar E_pubc_GW_GW_20B_ESP_PrefillActive_SetVt
{
    if(getValue(E_pubc_GW_GW_20B_ESP_PrefillActive_SetVt))
    {
        //update the signal value
        Msg_GW_20B.ESP_PrefillActive=getvalue(E_pubc_GW_GW_20B_ESP_PrefillActive_Vt);
    }
    else
    {
        Msg_GW_20B.ESP_PrefillActive=getValue(E_pubc_GW_GW_20B_ESP_PrefillActive_Rv);
    }
}
/*@@end*/
 
/*@@envVar:E_pubc_GW_GW_20B_ESP_QDCACC_Rv:*/
on envVar E_pubc_GW_GW_20B_ESP_QDCACC_Rv
{
    int64 rawValue = 0ll;
    float rawValue_float = 0.0;
    float phyValue = 0.0;        

    //set the signal with updated raw value
    if(getValue(E_pubc_GW_GW_20B_ESP_QDCACC_SetVt)==0)
    {
        rawValue = getvalue(this);
        if(chgEv_GW_20B_ESP_QDCACC == 0)
        {
            //type conversion to float
            rawValue_float = rawValue;        
            // raw to physical conversion
            phyValue = ((rawValue_float *1)+(0));
            putValue(E_pubc_GW_GW_20B_ESP_QDCACC_Pv, phyValue);
            chgEv_GW_20B_ESP_QDCACC = 1;
        }
        else
        {
            chgEv_GW_20B_ESP_QDCACC = 0;
        }    
        //update the signal value
        Msg_GW_20B.ESP_QDCACC=rawValue;        
    }                                                                           
}
/*@@end*/

/*@@envVar:E_pubc_GW_GW_20B_ESP_QDCACC_Pv:*/
on envVar E_pubc_GW_GW_20B_ESP_QDCACC_Pv
{
    int64 rawValue = 0ll;
    float phyValue = 0.0;
    
    //update the raw value with physical value 
    if(getValue(E_pubc_GW_GW_20B_ESP_QDCACC_SetVt)==0)
    {
        if(chgEv_GW_20B_ESP_QDCACC == 0)
        {
            phyValue = getvalue(this);
            // physical to raw conversion
            rawValue = ((phyValue -(0))/1);
            putValue(E_pubc_GW_GW_20B_ESP_QDCACC_Rv, rawValue);
            chgEv_GW_20B_ESP_QDCACC = 1;  
        }
        else
        {
            chgEv_GW_20B_ESP_QDCACC = 0;
        }
    }
}
/*@@end*/

/*@@envVar:E_pubc_GW_GW_20B_ESP_QDCACC_Vt:*/
on envVar E_pubc_GW_GW_20B_ESP_QDCACC_Vt
{
    qword rawValue = 0ll;
    if(getValue(E_pubc_GW_GW_20B_ESP_QDCACC_SetVt))
    {
        //update the signal value
        Msg_GW_20B.ESP_QDCACC=getValue(this);
    }
}
/*@@end*/

/*@@envVar:E_pubc_GW_GW_20B_ESP_QDCACC_SetVt:*/
on envVar E_pubc_GW_GW_20B_ESP_QDCACC_SetVt
{
    if(getValue(E_pubc_GW_GW_20B_ESP_QDCACC_SetVt))
    {
        //update the signal value
        Msg_GW_20B.ESP_QDCACC=getvalue(E_pubc_GW_GW_20B_ESP_QDCACC_Vt);
    }
    else
    {
        Msg_GW_20B.ESP_QDCACC=getValue(E_pubc_GW_GW_20B_ESP_QDCACC_Rv);
    }
}
/*@@end*/
 
/*@@envVar:E_pubc_GW_GW_20B_ESP_PrefillAvailable_Rv:*/
on envVar E_pubc_GW_GW_20B_ESP_PrefillAvailable_Rv
{
    int64 rawValue = 0ll;
    float rawValue_float = 0.0;
    float phyValue = 0.0;        

    //set the signal with updated raw value
    if(getValue(E_pubc_GW_GW_20B_ESP_PrefillAvailable_SetVt)==0)
    {
        rawValue = getvalue(this);
        if(chgEv_GW_20B_ESP_PrefillAvailable == 0)
        {
            //type conversion to float
            rawValue_float = rawValue;        
            // raw to physical conversion
            phyValue = ((rawValue_float *1)+(0));
            putValue(E_pubc_GW_GW_20B_ESP_PrefillAvailable_Pv, phyValue);
            chgEv_GW_20B_ESP_PrefillAvailable = 1;
        }
        else
        {
            chgEv_GW_20B_ESP_PrefillAvailable = 0;
        }    
        //update the signal value
        Msg_GW_20B.ESP_PrefillAvailable=rawValue;        
    }                                                                           
}
/*@@end*/

/*@@envVar:E_pubc_GW_GW_20B_ESP_PrefillAvailable_Pv:*/
on envVar E_pubc_GW_GW_20B_ESP_PrefillAvailable_Pv
{
    int64 rawValue = 0ll;
    float phyValue = 0.0;
    
    //update the raw value with physical value 
    if(getValue(E_pubc_GW_GW_20B_ESP_PrefillAvailable_SetVt)==0)
    {
        if(chgEv_GW_20B_ESP_PrefillAvailable == 0)
        {
            phyValue = getvalue(this);
            // physical to raw conversion
            rawValue = ((phyValue -(0))/1);
            putValue(E_pubc_GW_GW_20B_ESP_PrefillAvailable_Rv, rawValue);
            chgEv_GW_20B_ESP_PrefillAvailable = 1;  
        }
        else
        {
            chgEv_GW_20B_ESP_PrefillAvailable = 0;
        }
    }
}
/*@@end*/

/*@@envVar:E_pubc_GW_GW_20B_ESP_PrefillAvailable_Vt:*/
on envVar E_pubc_GW_GW_20B_ESP_PrefillAvailable_Vt
{
    qword rawValue = 0ll;
    if(getValue(E_pubc_GW_GW_20B_ESP_PrefillAvailable_SetVt))
    {
        //update the signal value
        Msg_GW_20B.ESP_PrefillAvailable=getValue(this);
    }
}
/*@@end*/

/*@@envVar:E_pubc_GW_GW_20B_ESP_PrefillAvailable_SetVt:*/
on envVar E_pubc_GW_GW_20B_ESP_PrefillAvailable_SetVt
{
    if(getValue(E_pubc_GW_GW_20B_ESP_PrefillAvailable_SetVt))
    {
        //update the signal value
        Msg_GW_20B.ESP_PrefillAvailable=getvalue(E_pubc_GW_GW_20B_ESP_PrefillAvailable_Vt);
    }
    else
    {
        Msg_GW_20B.ESP_PrefillAvailable=getValue(E_pubc_GW_GW_20B_ESP_PrefillAvailable_Rv);
    }
}
/*@@end*/
 
/*@@envVar:E_pubc_GW_GW_20B_ESP_BrakeOverHeatBrakeDiscTemp_Rv:*/
on envVar E_pubc_GW_GW_20B_ESP_BrakeOverHeatBrakeDiscTemp_Rv
{
    int64 rawValue = 0ll;
    float rawValue_float = 0.0;
    float phyValue = 0.0;        

    //set the signal with updated raw value
    if(getValue(E_pubc_GW_GW_20B_ESP_BrakeOverHeatBrakeDiscTemp_SetVt)==0)
    {
        rawValue = getvalue(this);
        if(chgEv_GW_20B_ESP_BrakeOverHeatBrakeDiscTemp == 0)
        {
            //type conversion to float
            rawValue_float = rawValue;        
            // raw to physical conversion
            phyValue = ((rawValue_float *1)+(0));
            putValue(E_pubc_GW_GW_20B_ESP_BrakeOverHeatBrakeDiscTemp_Pv, phyValue);
            chgEv_GW_20B_ESP_BrakeOverHeatBrakeDiscTemp = 1;
        }
        else
        {
            chgEv_GW_20B_ESP_BrakeOverHeatBrakeDiscTemp = 0;
        }    
        //update the signal value
        Msg_GW_20B.ESP_BrakeOverHeatBrakeDiscTemp=rawValue;        
    }                                                                           
}
/*@@end*/

/*@@envVar:E_pubc_GW_GW_20B_ESP_BrakeOverHeatBrakeDiscTemp_Pv:*/
on envVar E_pubc_GW_GW_20B_ESP_BrakeOverHeatBrakeDiscTemp_Pv
{
    int64 rawValue = 0ll;
    float phyValue = 0.0;
    
    //update the raw value with physical value 
    if(getValue(E_pubc_GW_GW_20B_ESP_BrakeOverHeatBrakeDiscTemp_SetVt)==0)
    {
        if(chgEv_GW_20B_ESP_BrakeOverHeatBrakeDiscTemp == 0)
        {
            phyValue = getvalue(this);
            // physical to raw conversion
            rawValue = ((phyValue -(0))/1);
            putValue(E_pubc_GW_GW_20B_ESP_BrakeOverHeatBrakeDiscTemp_Rv, rawValue);
            chgEv_GW_20B_ESP_BrakeOverHeatBrakeDiscTemp = 1;  
        }
        else
        {
            chgEv_GW_20B_ESP_BrakeOverHeatBrakeDiscTemp = 0;
        }
    }
}
/*@@end*/

/*@@envVar:E_pubc_GW_GW_20B_ESP_BrakeOverHeatBrakeDiscTemp_Vt:*/
on envVar E_pubc_GW_GW_20B_ESP_BrakeOverHeatBrakeDiscTemp_Vt
{
    qword rawValue = 0ll;
    if(getValue(E_pubc_GW_GW_20B_ESP_BrakeOverHeatBrakeDiscTemp_SetVt))
    {
        //update the signal value
        Msg_GW_20B.ESP_BrakeOverHeatBrakeDiscTemp=getValue(this);
    }
}
/*@@end*/

/*@@envVar:E_pubc_GW_GW_20B_ESP_BrakeOverHeatBrakeDiscTemp_SetVt:*/
on envVar E_pubc_GW_GW_20B_ESP_BrakeOverHeatBrakeDiscTemp_SetVt
{
    if(getValue(E_pubc_GW_GW_20B_ESP_BrakeOverHeatBrakeDiscTemp_SetVt))
    {
        //update the signal value
        Msg_GW_20B.ESP_BrakeOverHeatBrakeDiscTemp=getvalue(E_pubc_GW_GW_20B_ESP_BrakeOverHeatBrakeDiscTemp_Vt);
    }
    else
    {
        Msg_GW_20B.ESP_BrakeOverHeatBrakeDiscTemp=getValue(E_pubc_GW_GW_20B_ESP_BrakeOverHeatBrakeDiscTemp_Rv);
    }
}
/*@@end*/
 
/*@@envVar:E_pubc_GW_GW_20B_ESP_CDD_Active_Rv:*/
on envVar E_pubc_GW_GW_20B_ESP_CDD_Active_Rv
{
    int64 rawValue = 0ll;
    float rawValue_float = 0.0;
    float phyValue = 0.0;        

    //set the signal with updated raw value
    if(getValue(E_pubc_GW_GW_20B_ESP_CDD_Active_SetVt)==0)
    {
        rawValue = getvalue(this);
        if(chgEv_GW_20B_ESP_CDD_Active == 0)
        {
            //type conversion to float
            rawValue_float = rawValue;        
            // raw to physical conversion
            phyValue = ((rawValue_float *1)+(0));
            putValue(E_pubc_GW_GW_20B_ESP_CDD_Active_Pv, phyValue);
            chgEv_GW_20B_ESP_CDD_Active = 1;
        }
        else
        {
            chgEv_GW_20B_ESP_CDD_Active = 0;
        }    
        //update the signal value
        Msg_GW_20B.ESP_CDD_Active=rawValue;        
    }                                                                           
}
/*@@end*/

/*@@envVar:E_pubc_GW_GW_20B_ESP_CDD_Active_Pv:*/
on envVar E_pubc_GW_GW_20B_ESP_CDD_Active_Pv
{
    int64 rawValue = 0ll;
    float phyValue = 0.0;
    
    //update the raw value with physical value 
    if(getValue(E_pubc_GW_GW_20B_ESP_CDD_Active_SetVt)==0)
    {
        if(chgEv_GW_20B_ESP_CDD_Active == 0)
        {
            phyValue = getvalue(this);
            // physical to raw conversion
            rawValue = ((phyValue -(0))/1);
            putValue(E_pubc_GW_GW_20B_ESP_CDD_Active_Rv, rawValue);
            chgEv_GW_20B_ESP_CDD_Active = 1;  
        }
        else
        {
            chgEv_GW_20B_ESP_CDD_Active = 0;
        }
    }
}
/*@@end*/

/*@@envVar:E_pubc_GW_GW_20B_ESP_CDD_Active_Vt:*/
on envVar E_pubc_GW_GW_20B_ESP_CDD_Active_Vt
{
    qword rawValue = 0ll;
    if(getValue(E_pubc_GW_GW_20B_ESP_CDD_Active_SetVt))
    {
        //update the signal value
        Msg_GW_20B.ESP_CDD_Active=getValue(this);
    }
}
/*@@end*/

/*@@envVar:E_pubc_GW_GW_20B_ESP_CDD_Active_SetVt:*/
on envVar E_pubc_GW_GW_20B_ESP_CDD_Active_SetVt
{
    if(getValue(E_pubc_GW_GW_20B_ESP_CDD_Active_SetVt))
    {
        //update the signal value
        Msg_GW_20B.ESP_CDD_Active=getvalue(E_pubc_GW_GW_20B_ESP_CDD_Active_Vt);
    }
    else
    {
        Msg_GW_20B.ESP_CDD_Active=getValue(E_pubc_GW_GW_20B_ESP_CDD_Active_Rv);
    }
}
/*@@end*/
 
/*@@envVar:E_pubc_GW_GW_20B_ESP_ABAavailable_Rv:*/
on envVar E_pubc_GW_GW_20B_ESP_ABAavailable_Rv
{
    int64 rawValue = 0ll;
    float rawValue_float = 0.0;
    float phyValue = 0.0;        

    //set the signal with updated raw value
    if(getValue(E_pubc_GW_GW_20B_ESP_ABAavailable_SetVt)==0)
    {
        rawValue = getvalue(this);
        if(chgEv_GW_20B_ESP_ABAavailable == 0)
        {
            //type conversion to float
            rawValue_float = rawValue;        
            // raw to physical conversion
            phyValue = ((rawValue_float *1)+(0));
            putValue(E_pubc_GW_GW_20B_ESP_ABAavailable_Pv, phyValue);
            chgEv_GW_20B_ESP_ABAavailable = 1;
        }
        else
        {
            chgEv_GW_20B_ESP_ABAavailable = 0;
        }    
        //update the signal value
        Msg_GW_20B.ESP_ABAavailable=rawValue;        
    }                                                                           
}
/*@@end*/

/*@@envVar:E_pubc_GW_GW_20B_ESP_ABAavailable_Pv:*/
on envVar E_pubc_GW_GW_20B_ESP_ABAavailable_Pv
{
    int64 rawValue = 0ll;
    float phyValue = 0.0;
    
    //update the raw value with physical value 
    if(getValue(E_pubc_GW_GW_20B_ESP_ABAavailable_SetVt)==0)
    {
        if(chgEv_GW_20B_ESP_ABAavailable == 0)
        {
            phyValue = getvalue(this);
            // physical to raw conversion
            rawValue = ((phyValue -(0))/1);
            putValue(E_pubc_GW_GW_20B_ESP_ABAavailable_Rv, rawValue);
            chgEv_GW_20B_ESP_ABAavailable = 1;  
        }
        else
        {
            chgEv_GW_20B_ESP_ABAavailable = 0;
        }
    }
}
/*@@end*/

/*@@envVar:E_pubc_GW_GW_20B_ESP_ABAavailable_Vt:*/
on envVar E_pubc_GW_GW_20B_ESP_ABAavailable_Vt
{
    qword rawValue = 0ll;
    if(getValue(E_pubc_GW_GW_20B_ESP_ABAavailable_SetVt))
    {
        //update the signal value
        Msg_GW_20B.ESP_ABAavailable=getValue(this);
    }
}
/*@@end*/

/*@@envVar:E_pubc_GW_GW_20B_ESP_ABAavailable_SetVt:*/
on envVar E_pubc_GW_GW_20B_ESP_ABAavailable_SetVt
{
    if(getValue(E_pubc_GW_GW_20B_ESP_ABAavailable_SetVt))
    {
        //update the signal value
        Msg_GW_20B.ESP_ABAavailable=getvalue(E_pubc_GW_GW_20B_ESP_ABAavailable_Vt);
    }
    else
    {
        Msg_GW_20B.ESP_ABAavailable=getValue(E_pubc_GW_GW_20B_ESP_ABAavailable_Rv);
    }
}
/*@@end*/
 
/*@@envVar:E_pubc_GW_GW_20B_ESP_AEBdecActive_Rv:*/
on envVar E_pubc_GW_GW_20B_ESP_AEBdecActive_Rv
{
    int64 rawValue = 0ll;
    float rawValue_float = 0.0;
    float phyValue = 0.0;        

    //set the signal with updated raw value
    if(getValue(E_pubc_GW_GW_20B_ESP_AEBdecActive_SetVt)==0)
    {
        rawValue = getvalue(this);
        if(chgEv_GW_20B_ESP_AEBdecActive == 0)
        {
            //type conversion to float
            rawValue_float = rawValue;        
            // raw to physical conversion
            phyValue = ((rawValue_float *1)+(0));
            putValue(E_pubc_GW_GW_20B_ESP_AEBdecActive_Pv, phyValue);
            chgEv_GW_20B_ESP_AEBdecActive = 1;
        }
        else
        {
            chgEv_GW_20B_ESP_AEBdecActive = 0;
        }    
        //update the signal value
        Msg_GW_20B.ESP_AEBdecActive=rawValue;        
    }                                                                           
}
/*@@end*/

/*@@envVar:E_pubc_GW_GW_20B_ESP_AEBdecActive_Pv:*/
on envVar E_pubc_GW_GW_20B_ESP_AEBdecActive_Pv
{
    int64 rawValue = 0ll;
    float phyValue = 0.0;
    
    //update the raw value with physical value 
    if(getValue(E_pubc_GW_GW_20B_ESP_AEBdecActive_SetVt)==0)
    {
        if(chgEv_GW_20B_ESP_AEBdecActive == 0)
        {
            phyValue = getvalue(this);
            // physical to raw conversion
            rawValue = ((phyValue -(0))/1);
            putValue(E_pubc_GW_GW_20B_ESP_AEBdecActive_Rv, rawValue);
            chgEv_GW_20B_ESP_AEBdecActive = 1;  
        }
        else
        {
            chgEv_GW_20B_ESP_AEBdecActive = 0;
        }
    }
}
/*@@end*/

/*@@envVar:E_pubc_GW_GW_20B_ESP_AEBdecActive_Vt:*/
on envVar E_pubc_GW_GW_20B_ESP_AEBdecActive_Vt
{
    qword rawValue = 0ll;
    if(getValue(E_pubc_GW_GW_20B_ESP_AEBdecActive_SetVt))
    {
        //update the signal value
        Msg_GW_20B.ESP_AEBdecActive=getValue(this);
    }
}
/*@@end*/

/*@@envVar:E_pubc_GW_GW_20B_ESP_AEBdecActive_SetVt:*/
on envVar E_pubc_GW_GW_20B_ESP_AEBdecActive_SetVt
{
    if(getValue(E_pubc_GW_GW_20B_ESP_AEBdecActive_SetVt))
    {
        //update the signal value
        Msg_GW_20B.ESP_AEBdecActive=getvalue(E_pubc_GW_GW_20B_ESP_AEBdecActive_Vt);
    }
    else
    {
        Msg_GW_20B.ESP_AEBdecActive=getValue(E_pubc_GW_GW_20B_ESP_AEBdecActive_Rv);
    }
}
/*@@end*/
 
/*@@envVar:E_pubc_GW_GW_20B_ESP_BrakeForce_Rv:*/
on envVar E_pubc_GW_GW_20B_ESP_BrakeForce_Rv
{
    int64 rawValue = 0ll;
    float rawValue_float = 0.0;
    float phyValue = 0.0;        

    //set the signal with updated raw value
    if(getValue(E_pubc_GW_GW_20B_ESP_BrakeForce_SetVt)==0)
    {
        rawValue = getvalue(this);
        if(chgEv_GW_20B_ESP_BrakeForce == 0)
        {
            //type conversion to float
            rawValue_float = rawValue;        
            // raw to physical conversion
            phyValue = ((rawValue_float *1)+(0));
            putValue(E_pubc_GW_GW_20B_ESP_BrakeForce_Pv, phyValue);
            chgEv_GW_20B_ESP_BrakeForce = 1;
        }
        else
        {
            chgEv_GW_20B_ESP_BrakeForce = 0;
        }    
        //update the signal value
        Msg_GW_20B.ESP_BrakeForce=rawValue;        
    }                                                                           
}
/*@@end*/

/*@@envVar:E_pubc_GW_GW_20B_ESP_BrakeForce_Pv:*/
on envVar E_pubc_GW_GW_20B_ESP_BrakeForce_Pv
{
    int64 rawValue = 0ll;
    float phyValue = 0.0;
    
    //update the raw value with physical value 
    if(getValue(E_pubc_GW_GW_20B_ESP_BrakeForce_SetVt)==0)
    {
        if(chgEv_GW_20B_ESP_BrakeForce == 0)
        {
            phyValue = getvalue(this);
            // physical to raw conversion
            rawValue = ((phyValue -(0))/1);
            putValue(E_pubc_GW_GW_20B_ESP_BrakeForce_Rv, rawValue);
            chgEv_GW_20B_ESP_BrakeForce = 1;  
        }
        else
        {
            chgEv_GW_20B_ESP_BrakeForce = 0;
        }
    }
}
/*@@end*/

/*@@envVar:E_pubc_GW_GW_20B_ESP_BrakeForce_Vt:*/
on envVar E_pubc_GW_GW_20B_ESP_BrakeForce_Vt
{
    qword rawValue = 0ll;
    if(getValue(E_pubc_GW_GW_20B_ESP_BrakeForce_SetVt))
    {
        //update the signal value
        Msg_GW_20B.ESP_BrakeForce=getValue(this);
    }
}
/*@@end*/

/*@@envVar:E_pubc_GW_GW_20B_ESP_BrakeForce_SetVt:*/
on envVar E_pubc_GW_GW_20B_ESP_BrakeForce_SetVt
{
    if(getValue(E_pubc_GW_GW_20B_ESP_BrakeForce_SetVt))
    {
        //update the signal value
        Msg_GW_20B.ESP_BrakeForce=getvalue(E_pubc_GW_GW_20B_ESP_BrakeForce_Vt);
    }
    else
    {
        Msg_GW_20B.ESP_BrakeForce=getValue(E_pubc_GW_GW_20B_ESP_BrakeForce_Rv);
    }
}
/*@@end*/
 
/*@@envVar:E_pubc_GW_GW_20B_ESP_ABAactive_Rv:*/
on envVar E_pubc_GW_GW_20B_ESP_ABAactive_Rv
{
    int64 rawValue = 0ll;
    float rawValue_float = 0.0;
    float phyValue = 0.0;        

    //set the signal with updated raw value
    if(getValue(E_pubc_GW_GW_20B_ESP_ABAactive_SetVt)==0)
    {
        rawValue = getvalue(this);
        if(chgEv_GW_20B_ESP_ABAactive == 0)
        {
            //type conversion to float
            rawValue_float = rawValue;        
            // raw to physical conversion
            phyValue = ((rawValue_float *1)+(0));
            putValue(E_pubc_GW_GW_20B_ESP_ABAactive_Pv, phyValue);
            chgEv_GW_20B_ESP_ABAactive = 1;
        }
        else
        {
            chgEv_GW_20B_ESP_ABAactive = 0;
        }    
        //update the signal value
        Msg_GW_20B.ESP_ABAactive=rawValue;        
    }                                                                           
}
/*@@end*/

/*@@envVar:E_pubc_GW_GW_20B_ESP_ABAactive_Pv:*/
on envVar E_pubc_GW_GW_20B_ESP_ABAactive_Pv
{
    int64 rawValue = 0ll;
    float phyValue = 0.0;
    
    //update the raw value with physical value 
    if(getValue(E_pubc_GW_GW_20B_ESP_ABAactive_SetVt)==0)
    {
        if(chgEv_GW_20B_ESP_ABAactive == 0)
        {
            phyValue = getvalue(this);
            // physical to raw conversion
            rawValue = ((phyValue -(0))/1);
            putValue(E_pubc_GW_GW_20B_ESP_ABAactive_Rv, rawValue);
            chgEv_GW_20B_ESP_ABAactive = 1;  
        }
        else
        {
            chgEv_GW_20B_ESP_ABAactive = 0;
        }
    }
}
/*@@end*/

/*@@envVar:E_pubc_GW_GW_20B_ESP_ABAactive_Vt:*/
on envVar E_pubc_GW_GW_20B_ESP_ABAactive_Vt
{
    qword rawValue = 0ll;
    if(getValue(E_pubc_GW_GW_20B_ESP_ABAactive_SetVt))
    {
        //update the signal value
        Msg_GW_20B.ESP_ABAactive=getValue(this);
    }
}
/*@@end*/

/*@@envVar:E_pubc_GW_GW_20B_ESP_ABAactive_SetVt:*/
on envVar E_pubc_GW_GW_20B_ESP_ABAactive_SetVt
{
    if(getValue(E_pubc_GW_GW_20B_ESP_ABAactive_SetVt))
    {
        //update the signal value
        Msg_GW_20B.ESP_ABAactive=getvalue(E_pubc_GW_GW_20B_ESP_ABAactive_Vt);
    }
    else
    {
        Msg_GW_20B.ESP_ABAactive=getValue(E_pubc_GW_GW_20B_ESP_ABAactive_Rv);
    }
}
/*@@end*/
 
/*@@envVar:E_pubc_GW_GW_20B_ESP_AEBAvailable_Rv:*/
on envVar E_pubc_GW_GW_20B_ESP_AEBAvailable_Rv
{
    int64 rawValue = 0ll;
    float rawValue_float = 0.0;
    float phyValue = 0.0;        

    //set the signal with updated raw value
    if(getValue(E_pubc_GW_GW_20B_ESP_AEBAvailable_SetVt)==0)
    {
        rawValue = getvalue(this);
        if(chgEv_GW_20B_ESP_AEBAvailable == 0)
        {
            //type conversion to float
            rawValue_float = rawValue;        
            // raw to physical conversion
            phyValue = ((rawValue_float *1)+(0));
            putValue(E_pubc_GW_GW_20B_ESP_AEBAvailable_Pv, phyValue);
            chgEv_GW_20B_ESP_AEBAvailable = 1;
        }
        else
        {
            chgEv_GW_20B_ESP_AEBAvailable = 0;
        }    
        //update the signal value
        Msg_GW_20B.ESP_AEBAvailable=rawValue;        
    }                                                                           
}
/*@@end*/

/*@@envVar:E_pubc_GW_GW_20B_ESP_AEBAvailable_Pv:*/
on envVar E_pubc_GW_GW_20B_ESP_AEBAvailable_Pv
{
    int64 rawValue = 0ll;
    float phyValue = 0.0;
    
    //update the raw value with physical value 
    if(getValue(E_pubc_GW_GW_20B_ESP_AEBAvailable_SetVt)==0)
    {
        if(chgEv_GW_20B_ESP_AEBAvailable == 0)
        {
            phyValue = getvalue(this);
            // physical to raw conversion
            rawValue = ((phyValue -(0))/1);
            putValue(E_pubc_GW_GW_20B_ESP_AEBAvailable_Rv, rawValue);
            chgEv_GW_20B_ESP_AEBAvailable = 1;  
        }
        else
        {
            chgEv_GW_20B_ESP_AEBAvailable = 0;
        }
    }
}
/*@@end*/

/*@@envVar:E_pubc_GW_GW_20B_ESP_AEBAvailable_Vt:*/
on envVar E_pubc_GW_GW_20B_ESP_AEBAvailable_Vt
{
    qword rawValue = 0ll;
    if(getValue(E_pubc_GW_GW_20B_ESP_AEBAvailable_SetVt))
    {
        //update the signal value
        Msg_GW_20B.ESP_AEBAvailable=getValue(this);
    }
}
/*@@end*/

/*@@envVar:E_pubc_GW_GW_20B_ESP_AEBAvailable_SetVt:*/
on envVar E_pubc_GW_GW_20B_ESP_AEBAvailable_SetVt
{
    if(getValue(E_pubc_GW_GW_20B_ESP_AEBAvailable_SetVt))
    {
        //update the signal value
        Msg_GW_20B.ESP_AEBAvailable=getvalue(E_pubc_GW_GW_20B_ESP_AEBAvailable_Vt);
    }
    else
    {
        Msg_GW_20B.ESP_AEBAvailable=getValue(E_pubc_GW_GW_20B_ESP_AEBAvailable_Rv);
    }
}
/*@@end*/
 
/*@@envVar:E_pubc_GW_GW_20B_ESP_CDD_Available_Rv:*/
on envVar E_pubc_GW_GW_20B_ESP_CDD_Available_Rv
{
    int64 rawValue = 0ll;
    float rawValue_float = 0.0;
    float phyValue = 0.0;        

    //set the signal with updated raw value
    if(getValue(E_pubc_GW_GW_20B_ESP_CDD_Available_SetVt)==0)
    {
        rawValue = getvalue(this);
        if(chgEv_GW_20B_ESP_CDD_Available == 0)
        {
            //type conversion to float
            rawValue_float = rawValue;        
            // raw to physical conversion
            phyValue = ((rawValue_float *1)+(0));
            putValue(E_pubc_GW_GW_20B_ESP_CDD_Available_Pv, phyValue);
            chgEv_GW_20B_ESP_CDD_Available = 1;
        }
        else
        {
            chgEv_GW_20B_ESP_CDD_Available = 0;
        }    
        //update the signal value
        Msg_GW_20B.ESP_CDD_Available=rawValue;        
    }                                                                           
}
/*@@end*/

/*@@envVar:E_pubc_GW_GW_20B_ESP_CDD_Available_Pv:*/
on envVar E_pubc_GW_GW_20B_ESP_CDD_Available_Pv
{
    int64 rawValue = 0ll;
    float phyValue = 0.0;
    
    //update the raw value with physical value 
    if(getValue(E_pubc_GW_GW_20B_ESP_CDD_Available_SetVt)==0)
    {
        if(chgEv_GW_20B_ESP_CDD_Available == 0)
        {
            phyValue = getvalue(this);
            // physical to raw conversion
            rawValue = ((phyValue -(0))/1);
            putValue(E_pubc_GW_GW_20B_ESP_CDD_Available_Rv, rawValue);
            chgEv_GW_20B_ESP_CDD_Available = 1;  
        }
        else
        {
            chgEv_GW_20B_ESP_CDD_Available = 0;
        }
    }
}
/*@@end*/

/*@@envVar:E_pubc_GW_GW_20B_ESP_CDD_Available_Vt:*/
on envVar E_pubc_GW_GW_20B_ESP_CDD_Available_Vt
{
    qword rawValue = 0ll;
    if(getValue(E_pubc_GW_GW_20B_ESP_CDD_Available_SetVt))
    {
        //update the signal value
        Msg_GW_20B.ESP_CDD_Available=getValue(this);
    }
}
/*@@end*/

/*@@envVar:E_pubc_GW_GW_20B_ESP_CDD_Available_SetVt:*/
on envVar E_pubc_GW_GW_20B_ESP_CDD_Available_SetVt
{
    if(getValue(E_pubc_GW_GW_20B_ESP_CDD_Available_SetVt))
    {
        //update the signal value
        Msg_GW_20B.ESP_CDD_Available=getvalue(E_pubc_GW_GW_20B_ESP_CDD_Available_Vt);
    }
    else
    {
        Msg_GW_20B.ESP_CDD_Available=getValue(E_pubc_GW_GW_20B_ESP_CDD_Available_Rv);
    }
}
/*@@end*/
 
/*@@envVar:E_pubc_GW_GW_1C2_tx:*/
on envVar E_pubc_GW_GW_1C2_tx
{
    if(getValue(this))
    {       
        
        //update the BZ Signal
        if(GW_1C2_EspCycCntr1C2_wrongvalctr == 0)
        {
            update_GW_1C2_EspCycCntr1C2_counter();
            Msg_GW_1C2.EspCycCntr1C2= GW_1C2_EspCycCntr1C2_counter;
        }
        else if(GW_1C2_EspCycCntr1C2_wrongvalctr > 0)
        {
			GW_1C2_EspCycCntr1C2_counter=GW_1C2_EspCycCntr1C2_counter + GW_1C2_EspCycCntr1C2_wrongvalctr;
			 Msg_GW_1C2.EspCycCntr1C2= GW_1C2_EspCycCntr1C2_counter;
            /* GW_1C2_EspCycCntr1C2_wrongvalctr--;
              // if counter becomes zero, update panel controller to zero
             if(GW_1C2_EspCycCntr1C2_wrongvalctr == 0)
             {
                 putValue(E_pubc_GW_GW_1C2_EspCycCntr1C2_wrongvalctr,0);
             } */
        }
        else
        { 
			// do nothing
        }    
        //calculate the CRC CheckSum
        update_GW_1C2_CRC_CheckSum();

        output(Msg_GW_1C2);        
    }
}
/*@@end*/

/*@@envVar:E_pubc_GW_GW_1C2_Range:*/
on envVar E_pubc_GW_GW_1C2_Range
{
    qword rawstatus = 0ll;
    qword rawValue = 0ll;    
    
    rawstatus = getvalue(this);    
    // set all the signals with min raw /max raw /init raw
    switch (rawstatus) 
    {
     case(0) :
        rawValue= 0;
        putValue(E_pubc_GW_GW_1C2_EspVehStandstill_Rv, rawValue);
        rawValue= 0;
        putValue(E_pubc_GW_GW_1C2_WhlSpdRiReDir_Rv, rawValue);
        rawValue= 0;
        putValue(E_pubc_GW_GW_1C2_WhlSpdRiReDataVld_Rv, rawValue);
        rawValue= 0;
        putValue(E_pubc_GW_GW_1C2_WhlSpdLeReDataVld_Rv, rawValue);
        rawValue= 0;
        putValue(E_pubc_GW_GW_1C2_WhlSpdRiFrntDir_Rv, rawValue);
        rawValue= 0;
        putValue(E_pubc_GW_GW_1C2_WhlSpdRiFrntData_Rv, rawValue);
        rawValue= 0;
        putValue(E_pubc_GW_GW_1C2_WhlSpdFrntRiPls_Rv, rawValue);
        rawValue= 0;
        putValue(E_pubc_GW_GW_1C2_EspMstCylBrkPVld_Rv, rawValue);
        rawValue= 0;
        putValue(E_pubc_GW_GW_1C2_EspLgtAccel_Rv, rawValue);
        rawValue= 0;
        putValue(E_pubc_GW_GW_1C2_EspTcsActvSts_Rv, rawValue);
        rawValue= 0;
        putValue(E_pubc_GW_GW_1C2_EspLatAccel_Rv, rawValue);
        rawValue= 0;
        putValue(E_pubc_GW_GW_1C2_WhlSpdFrntLePls_Rv, rawValue);
        rawValue= 0;
        putValue(E_pubc_GW_GW_1C2_WhlSpdRiReData_Rv, rawValue);
        rawValue= 0;
        putValue(E_pubc_GW_GW_1C2_MbRgnTarWhlQlfr_Rv, rawValue);
        rawValue= 0;
        putValue(E_pubc_GW_GW_1C2_EspLatAccelVld_Rv, rawValue);
        rawValue= 0;
        putValue(E_pubc_GW_GW_1C2_WhlSpdLeFrntData_Rv, rawValue);
        rawValue= 0;
        putValue(E_pubc_GW_GW_1C2_EspAbsActv_Rv, rawValue);
        rawValue= 0;
        putValue(E_pubc_GW_GW_1C2_EspVdcActvSts_Rv, rawValue);
        rawValue= 0;
        putValue(E_pubc_GW_GW_1C2_WhlSpdLeFrntDataVld_Rv, rawValue);
        rawValue= 0;
        putValue(E_pubc_GW_GW_1C2_EspAutoHoldActvSts_Rv, rawValue);
        rawValue= 0;
        putValue(E_pubc_GW_GW_1C2_MbRgnTarWhl_Rv, rawValue);
        rawValue= 0;
        putValue(E_pubc_GW_GW_1C2_EspYawAgSpdVld_Rv, rawValue);
        rawValue= 0;
        putValue(E_pubc_GW_GW_1C2_EspReWhlDecTarTqActv_Rv, rawValue);
        rawValue= 0;
        putValue(E_pubc_GW_GW_1C2_WhlSpdReRiPls_Rv, rawValue);
        rawValue= 0;
        putValue(E_pubc_GW_GW_1C2_EspReWhlDecTarTq_Rv, rawValue);
        rawValue= 0;
        putValue(E_pubc_GW_GW_1C2_WhlSpdRiFrntDataVld_Rv, rawValue);
        rawValue= 0;
        putValue(E_pubc_GW_GW_1C2_EspReWhlIncTarTqActv_Rv, rawValue);
        rawValue= 0;
        putValue(E_pubc_GW_GW_1C2_EspLgtAccelVld_Rv, rawValue);
        rawValue= 0;
        putValue(E_pubc_GW_GW_1C2_WhlSpdReLePls_Rv, rawValue);
        rawValue= 0;
        putValue(E_pubc_GW_GW_1C2_EspTcsFailr_Rv, rawValue);
        rawValue= 0;
        putValue(E_pubc_GW_GW_1C2_EspAbsFailr_Rv, rawValue);
        rawValue= 0;
        putValue(E_pubc_GW_GW_1C2_EspMstCylBrkP_Rv, rawValue);
        rawValue= 0;
        putValue(E_pubc_GW_GW_1C2_EspFctOpenSts_Rv, rawValue);
        rawValue= 0;
        putValue(E_pubc_GW_GW_1C2_EspReWhlIncTarTq_Rv, rawValue);
        rawValue= 0;
        putValue(E_pubc_GW_GW_1C2_EspYawAgSpd_Rv, rawValue);
        rawValue= 0;
        putValue(E_pubc_GW_GW_1C2_EspActvSts_Rv, rawValue);
        rawValue= 0;
        putValue(E_pubc_GW_GW_1C2_EspVehSpd_Rv, rawValue);
        rawValue= 0;
        putValue(E_pubc_GW_GW_1C2_EspVehSpdVld_Rv, rawValue);
        rawValue= 0;
        putValue(E_pubc_GW_GW_1C2_WhlSpdLeReDir_Rv, rawValue);
        rawValue= 0;
        putValue(E_pubc_GW_GW_1C2_WhlSpdLeFrntDir_Rv, rawValue);
        rawValue= 0;
        putValue(E_pubc_GW_GW_1C2_WhlSpdLeReData_Rv, rawValue);
        break;
     case(1) :
        rawValue= 1;
        putValue(E_pubc_GW_GW_1C2_EspVehStandstill_Rv, rawValue);
        rawValue= 3;
        putValue(E_pubc_GW_GW_1C2_WhlSpdRiReDir_Rv, rawValue);
        rawValue= 1;
        putValue(E_pubc_GW_GW_1C2_WhlSpdRiReDataVld_Rv, rawValue);
        rawValue= 1;
        putValue(E_pubc_GW_GW_1C2_WhlSpdLeReDataVld_Rv, rawValue);
        rawValue= 3;
        putValue(E_pubc_GW_GW_1C2_WhlSpdRiFrntDir_Rv, rawValue);
        rawValue= 8190;
        putValue(E_pubc_GW_GW_1C2_WhlSpdRiFrntData_Rv, rawValue);
        rawValue= 255;
        putValue(E_pubc_GW_GW_1C2_WhlSpdFrntRiPls_Rv, rawValue);
        rawValue= 1;
        putValue(E_pubc_GW_GW_1C2_EspMstCylBrkPVld_Rv, rawValue);
        rawValue= 8190;
        putValue(E_pubc_GW_GW_1C2_EspLgtAccel_Rv, rawValue);
        rawValue= 1;
        putValue(E_pubc_GW_GW_1C2_EspTcsActvSts_Rv, rawValue);
        rawValue= 8190;
        putValue(E_pubc_GW_GW_1C2_EspLatAccel_Rv, rawValue);
        rawValue= 255;
        putValue(E_pubc_GW_GW_1C2_WhlSpdFrntLePls_Rv, rawValue);
        rawValue= 8190;
        putValue(E_pubc_GW_GW_1C2_WhlSpdRiReData_Rv, rawValue);
        rawValue= 3;
        putValue(E_pubc_GW_GW_1C2_MbRgnTarWhlQlfr_Rv, rawValue);
        rawValue= 1;
        putValue(E_pubc_GW_GW_1C2_EspLatAccelVld_Rv, rawValue);
        rawValue= 8190;
        putValue(E_pubc_GW_GW_1C2_WhlSpdLeFrntData_Rv, rawValue);
        rawValue= 1;
        putValue(E_pubc_GW_GW_1C2_EspAbsActv_Rv, rawValue);
        rawValue= 1;
        putValue(E_pubc_GW_GW_1C2_EspVdcActvSts_Rv, rawValue);
        rawValue= 1;
        putValue(E_pubc_GW_GW_1C2_WhlSpdLeFrntDataVld_Rv, rawValue);
        rawValue= 3;
        putValue(E_pubc_GW_GW_1C2_EspAutoHoldActvSts_Rv, rawValue);
        rawValue= 65534;
        putValue(E_pubc_GW_GW_1C2_MbRgnTarWhl_Rv, rawValue);
        rawValue= 1;
        putValue(E_pubc_GW_GW_1C2_EspYawAgSpdVld_Rv, rawValue);
        rawValue= 1;
        putValue(E_pubc_GW_GW_1C2_EspReWhlDecTarTqActv_Rv, rawValue);
        rawValue= 255;
        putValue(E_pubc_GW_GW_1C2_WhlSpdReRiPls_Rv, rawValue);
        rawValue= 65535;
        putValue(E_pubc_GW_GW_1C2_EspReWhlDecTarTq_Rv, rawValue);
        rawValue= 1;
        putValue(E_pubc_GW_GW_1C2_WhlSpdRiFrntDataVld_Rv, rawValue);
        rawValue= 1;
        putValue(E_pubc_GW_GW_1C2_EspReWhlIncTarTqActv_Rv, rawValue);
        rawValue= 1;
        putValue(E_pubc_GW_GW_1C2_EspLgtAccelVld_Rv, rawValue);
        rawValue= 255;
        putValue(E_pubc_GW_GW_1C2_WhlSpdReLePls_Rv, rawValue);
        rawValue= 1;
        putValue(E_pubc_GW_GW_1C2_EspTcsFailr_Rv, rawValue);
        rawValue= 1;
        putValue(E_pubc_GW_GW_1C2_EspAbsFailr_Rv, rawValue);
        rawValue= 4095;
        putValue(E_pubc_GW_GW_1C2_EspMstCylBrkP_Rv, rawValue);
        rawValue= 1;
        putValue(E_pubc_GW_GW_1C2_EspFctOpenSts_Rv, rawValue);
        rawValue= 65535;
        putValue(E_pubc_GW_GW_1C2_EspReWhlIncTarTq_Rv, rawValue);
        rawValue= 16382;
        putValue(E_pubc_GW_GW_1C2_EspYawAgSpd_Rv, rawValue);
        rawValue= 1;
        putValue(E_pubc_GW_GW_1C2_EspActvSts_Rv, rawValue);
        rawValue= 8190;
        putValue(E_pubc_GW_GW_1C2_EspVehSpd_Rv, rawValue);
        rawValue= 1;
        putValue(E_pubc_GW_GW_1C2_EspVehSpdVld_Rv, rawValue);
        rawValue= 3;
        putValue(E_pubc_GW_GW_1C2_WhlSpdLeReDir_Rv, rawValue);
        rawValue= 3;
        putValue(E_pubc_GW_GW_1C2_WhlSpdLeFrntDir_Rv, rawValue);
        rawValue= 8190;
        putValue(E_pubc_GW_GW_1C2_WhlSpdLeReData_Rv, rawValue);
        break;
     default :
        rawValue= 0;
        putValue(E_pubc_GW_GW_1C2_EspVehStandstill_Rv, rawValue);
        rawValue= 0;
        putValue(E_pubc_GW_GW_1C2_WhlSpdRiReDir_Rv, rawValue);
        rawValue= 0;
        putValue(E_pubc_GW_GW_1C2_WhlSpdRiReDataVld_Rv, rawValue);
        rawValue= 0;
        putValue(E_pubc_GW_GW_1C2_WhlSpdLeReDataVld_Rv, rawValue);
        rawValue= 0;
        putValue(E_pubc_GW_GW_1C2_WhlSpdRiFrntDir_Rv, rawValue);
        rawValue= 0;
        putValue(E_pubc_GW_GW_1C2_WhlSpdRiFrntData_Rv, rawValue);
        rawValue= 0;
        putValue(E_pubc_GW_GW_1C2_WhlSpdFrntRiPls_Rv, rawValue);
        rawValue= 0;
        putValue(E_pubc_GW_GW_1C2_EspMstCylBrkPVld_Rv, rawValue);
        rawValue= 0;
        putValue(E_pubc_GW_GW_1C2_EspLgtAccel_Rv, rawValue);
        rawValue= 0;
        putValue(E_pubc_GW_GW_1C2_EspTcsActvSts_Rv, rawValue);
        rawValue= 0;
        putValue(E_pubc_GW_GW_1C2_EspLatAccel_Rv, rawValue);
        rawValue= 0;
        putValue(E_pubc_GW_GW_1C2_WhlSpdFrntLePls_Rv, rawValue);
        rawValue= 0;
        putValue(E_pubc_GW_GW_1C2_WhlSpdRiReData_Rv, rawValue);
        rawValue= 0;
        putValue(E_pubc_GW_GW_1C2_MbRgnTarWhlQlfr_Rv, rawValue);
        rawValue= 0;
        putValue(E_pubc_GW_GW_1C2_EspLatAccelVld_Rv, rawValue);
        rawValue= 0;
        putValue(E_pubc_GW_GW_1C2_WhlSpdLeFrntData_Rv, rawValue);
        rawValue= 0;
        putValue(E_pubc_GW_GW_1C2_EspAbsActv_Rv, rawValue);
        rawValue= 0;
        putValue(E_pubc_GW_GW_1C2_EspVdcActvSts_Rv, rawValue);
        rawValue= 0;
        putValue(E_pubc_GW_GW_1C2_WhlSpdLeFrntDataVld_Rv, rawValue);
        rawValue= 0;
        putValue(E_pubc_GW_GW_1C2_EspAutoHoldActvSts_Rv, rawValue);
        rawValue= 0;
        putValue(E_pubc_GW_GW_1C2_MbRgnTarWhl_Rv, rawValue);
        rawValue= 0;
        putValue(E_pubc_GW_GW_1C2_EspYawAgSpdVld_Rv, rawValue);
        rawValue= 0;
        putValue(E_pubc_GW_GW_1C2_EspReWhlDecTarTqActv_Rv, rawValue);
        rawValue= 0;
        putValue(E_pubc_GW_GW_1C2_WhlSpdReRiPls_Rv, rawValue);
        rawValue= 0;
        putValue(E_pubc_GW_GW_1C2_EspReWhlDecTarTq_Rv, rawValue);
        rawValue= 0;
        putValue(E_pubc_GW_GW_1C2_WhlSpdRiFrntDataVld_Rv, rawValue);
        rawValue= 0;
        putValue(E_pubc_GW_GW_1C2_EspReWhlIncTarTqActv_Rv, rawValue);
        rawValue= 0;
        putValue(E_pubc_GW_GW_1C2_EspLgtAccelVld_Rv, rawValue);
        rawValue= 0;
        putValue(E_pubc_GW_GW_1C2_WhlSpdReLePls_Rv, rawValue);
        rawValue= 0;
        putValue(E_pubc_GW_GW_1C2_EspTcsFailr_Rv, rawValue);
        rawValue= 0;
        putValue(E_pubc_GW_GW_1C2_EspAbsFailr_Rv, rawValue);
        rawValue= 0;
        putValue(E_pubc_GW_GW_1C2_EspMstCylBrkP_Rv, rawValue);
        rawValue= 0;
        putValue(E_pubc_GW_GW_1C2_EspFctOpenSts_Rv, rawValue);
        rawValue= 0;
        putValue(E_pubc_GW_GW_1C2_EspReWhlIncTarTq_Rv, rawValue);
        rawValue= 0;
        putValue(E_pubc_GW_GW_1C2_EspYawAgSpd_Rv, rawValue);
        rawValue= 0;
        putValue(E_pubc_GW_GW_1C2_EspActvSts_Rv, rawValue);
        rawValue= 0;
        putValue(E_pubc_GW_GW_1C2_EspVehSpd_Rv, rawValue);
        rawValue= 0;
        putValue(E_pubc_GW_GW_1C2_EspVehSpdVld_Rv, rawValue);
        rawValue= 0;
        putValue(E_pubc_GW_GW_1C2_WhlSpdLeReDir_Rv, rawValue);
        rawValue= 0;
        putValue(E_pubc_GW_GW_1C2_WhlSpdLeFrntDir_Rv, rawValue);
        rawValue= 0;
        putValue(E_pubc_GW_GW_1C2_WhlSpdLeReData_Rv, rawValue);
      break;
   }
}
/*@@end*/

/*@@envVar:E_pubc_GW_GW_1C2_Dlc:*/
on envVar E_pubc_GW_GW_1C2_Dlc
{
    if(getValue(E_pubc_GW_GW_1C2_enDlc))
    {
        Msg_GW_1C2.dlc =getValue(this);
    }
    else
    {
       Dbc_dlc = 64;
	   Msg_GW_1C2.dlc = Calc_Canfd_dlc(Dbc_dlc);
	   // Msg_GW_1C2.dlc = 64;
	   	
  }
}
/*@@end*/

/*@@envVar:E_pubc_GW_GW_1C2_enDlc:*/
on envVar E_pubc_GW_GW_1C2_enDlc
{
    //For Messages with DLC = 8, set wrong DLC to smaller than defined DLC
    //For Messages with DLC < 8 set wrong DLC to smaller/longer than defined DLC
    if(getValue(this))
    {
        Msg_GW_1C2.dlc =getValue(E_pubc_GW_GW_1C2_Dlc);
    }
    else
    {
       Dbc_dlc = 64;
	   Msg_GW_1C2.dlc = Calc_Canfd_dlc(Dbc_dlc);
	   // Msg_GW_1C2.dlc = 64;
    }
}
/*@@end*/

/*@@envVar:E_pubc_GW_GW_1C2_EspCrcChk1C2_wrongvalctr:*/
on envVar E_pubc_GW_GW_1C2_EspCrcChk1C2_wrongvalctr
{
    //update disturb count
    //disturb value range:(-1 = always send wrong value),( X>0 ,x is the number of Messages with wrong CHK sent)
    GW_1C2_EspCrcChk1C2_wrongvalctr =getValue(this);    
}
/*@@end*/
/*@@envVar:E_pubc_GW_GW_1C2_EspCycCntr1C2_wrongvalctr:*/
on envVar E_pubc_GW_GW_1C2_EspCycCntr1C2_wrongvalctr
{
    //update disturb count
    //disturb value range:(-1 = always send wrong value),( X>0 ,x is the number of Messages with wrong CHK sent)
    GW_1C2_EspCycCntr1C2_wrongvalctr =getValue(this);    
}
/*@@end*/

/*@@envVar:E_pubc_GW_GW_1C2_EspVehStandstill_Rv:*/
on envVar E_pubc_GW_GW_1C2_EspVehStandstill_Rv
{
    int64 rawValue = 0ll;
    float rawValue_float = 0.0;
    float phyValue = 0.0;        

    //set the signal with updated raw value
    if(getValue(E_pubc_GW_GW_1C2_EspVehStandstill_SetVt)==0)
    {
        rawValue = getvalue(this);
        if(chgEv_GW_1C2_EspVehStandstill == 0)
        {
            //type conversion to float
            rawValue_float = rawValue;        
            // raw to physical conversion
            phyValue = ((rawValue_float *1)+(0));
            putValue(E_pubc_GW_GW_1C2_EspVehStandstill_Pv, phyValue);
            chgEv_GW_1C2_EspVehStandstill = 1;
        }
        else
        {
            chgEv_GW_1C2_EspVehStandstill = 0;
        }    
        //update the signal value
        Msg_GW_1C2.EspVehStandstill=rawValue;        
    }                                                                           
}
/*@@end*/

/*@@envVar:E_pubc_GW_GW_1C2_EspVehStandstill_Pv:*/
on envVar E_pubc_GW_GW_1C2_EspVehStandstill_Pv
{
    int64 rawValue = 0ll;
    float phyValue = 0.0;
    
    //update the raw value with physical value 
    if(getValue(E_pubc_GW_GW_1C2_EspVehStandstill_SetVt)==0)
    {
        if(chgEv_GW_1C2_EspVehStandstill == 0)
        {
            phyValue = getvalue(this);
            // physical to raw conversion
            rawValue = ((phyValue -(0))/1);
            putValue(E_pubc_GW_GW_1C2_EspVehStandstill_Rv, rawValue);
            chgEv_GW_1C2_EspVehStandstill = 1;  
        }
        else
        {
            chgEv_GW_1C2_EspVehStandstill = 0;
        }
    }
}
/*@@end*/

/*@@envVar:E_pubc_GW_GW_1C2_EspVehStandstill_Vt:*/
on envVar E_pubc_GW_GW_1C2_EspVehStandstill_Vt
{
    qword rawValue = 0ll;
    if(getValue(E_pubc_GW_GW_1C2_EspVehStandstill_SetVt))
    {
        //update the signal value
        Msg_GW_1C2.EspVehStandstill=getValue(this);
    }
}
/*@@end*/

/*@@envVar:E_pubc_GW_GW_1C2_EspVehStandstill_SetVt:*/
on envVar E_pubc_GW_GW_1C2_EspVehStandstill_SetVt
{
    if(getValue(E_pubc_GW_GW_1C2_EspVehStandstill_SetVt))
    {
        //update the signal value
        Msg_GW_1C2.EspVehStandstill=getvalue(E_pubc_GW_GW_1C2_EspVehStandstill_Vt);
    }
    else
    {
        Msg_GW_1C2.EspVehStandstill=getValue(E_pubc_GW_GW_1C2_EspVehStandstill_Rv);
    }
}
/*@@end*/
 
/*@@envVar:E_pubc_GW_GW_1C2_WhlSpdRiReDir_Rv:*/
on envVar E_pubc_GW_GW_1C2_WhlSpdRiReDir_Rv
{
    int64 rawValue = 0ll;
    float rawValue_float = 0.0;
    float phyValue = 0.0;        

    //set the signal with updated raw value
    if(getValue(E_pubc_GW_GW_1C2_WhlSpdRiReDir_SetVt)==0)
    {
        rawValue = getvalue(this);
        if(chgEv_GW_1C2_WhlSpdRiReDir == 0)
        {
            //type conversion to float
            rawValue_float = rawValue;        
            // raw to physical conversion
            phyValue = ((rawValue_float *1)+(0));
            putValue(E_pubc_GW_GW_1C2_WhlSpdRiReDir_Pv, phyValue);
            chgEv_GW_1C2_WhlSpdRiReDir = 1;
        }
        else
        {
            chgEv_GW_1C2_WhlSpdRiReDir = 0;
        }    
        //update the signal value
        Msg_GW_1C2.WhlSpdRiReDir=rawValue;        
    }                                                                           
}
/*@@end*/

/*@@envVar:E_pubc_GW_GW_1C2_WhlSpdRiReDir_Pv:*/
on envVar E_pubc_GW_GW_1C2_WhlSpdRiReDir_Pv
{
    int64 rawValue = 0ll;
    float phyValue = 0.0;
    
    //update the raw value with physical value 
    if(getValue(E_pubc_GW_GW_1C2_WhlSpdRiReDir_SetVt)==0)
    {
        if(chgEv_GW_1C2_WhlSpdRiReDir == 0)
        {
            phyValue = getvalue(this);
            // physical to raw conversion
            rawValue = ((phyValue -(0))/1);
            putValue(E_pubc_GW_GW_1C2_WhlSpdRiReDir_Rv, rawValue);
            chgEv_GW_1C2_WhlSpdRiReDir = 1;  
        }
        else
        {
            chgEv_GW_1C2_WhlSpdRiReDir = 0;
        }
    }
}
/*@@end*/

/*@@envVar:E_pubc_GW_GW_1C2_WhlSpdRiReDir_Vt:*/
on envVar E_pubc_GW_GW_1C2_WhlSpdRiReDir_Vt
{
    qword rawValue = 0ll;
    if(getValue(E_pubc_GW_GW_1C2_WhlSpdRiReDir_SetVt))
    {
        //update the signal value
        Msg_GW_1C2.WhlSpdRiReDir=getValue(this);
    }
}
/*@@end*/

/*@@envVar:E_pubc_GW_GW_1C2_WhlSpdRiReDir_SetVt:*/
on envVar E_pubc_GW_GW_1C2_WhlSpdRiReDir_SetVt
{
    if(getValue(E_pubc_GW_GW_1C2_WhlSpdRiReDir_SetVt))
    {
        //update the signal value
        Msg_GW_1C2.WhlSpdRiReDir=getvalue(E_pubc_GW_GW_1C2_WhlSpdRiReDir_Vt);
    }
    else
    {
        Msg_GW_1C2.WhlSpdRiReDir=getValue(E_pubc_GW_GW_1C2_WhlSpdRiReDir_Rv);
    }
}
/*@@end*/
 
/*@@envVar:E_pubc_GW_GW_1C2_WhlSpdRiReDataVld_Rv:*/
on envVar E_pubc_GW_GW_1C2_WhlSpdRiReDataVld_Rv
{
    int64 rawValue = 0ll;
    float rawValue_float = 0.0;
    float phyValue = 0.0;        

    //set the signal with updated raw value
    if(getValue(E_pubc_GW_GW_1C2_WhlSpdRiReDataVld_SetVt)==0)
    {
        rawValue = getvalue(this);
        if(chgEv_GW_1C2_WhlSpdRiReDataVld == 0)
        {
            //type conversion to float
            rawValue_float = rawValue;        
            // raw to physical conversion
            phyValue = ((rawValue_float *1)+(0));
            putValue(E_pubc_GW_GW_1C2_WhlSpdRiReDataVld_Pv, phyValue);
            chgEv_GW_1C2_WhlSpdRiReDataVld = 1;
        }
        else
        {
            chgEv_GW_1C2_WhlSpdRiReDataVld = 0;
        }    
        //update the signal value
        Msg_GW_1C2.WhlSpdRiReDataVld=rawValue;        
    }                                                                           
}
/*@@end*/

/*@@envVar:E_pubc_GW_GW_1C2_WhlSpdRiReDataVld_Pv:*/
on envVar E_pubc_GW_GW_1C2_WhlSpdRiReDataVld_Pv
{
    int64 rawValue = 0ll;
    float phyValue = 0.0;
    
    //update the raw value with physical value 
    if(getValue(E_pubc_GW_GW_1C2_WhlSpdRiReDataVld_SetVt)==0)
    {
        if(chgEv_GW_1C2_WhlSpdRiReDataVld == 0)
        {
            phyValue = getvalue(this);
            // physical to raw conversion
            rawValue = ((phyValue -(0))/1);
            putValue(E_pubc_GW_GW_1C2_WhlSpdRiReDataVld_Rv, rawValue);
            chgEv_GW_1C2_WhlSpdRiReDataVld = 1;  
        }
        else
        {
            chgEv_GW_1C2_WhlSpdRiReDataVld = 0;
        }
    }
}
/*@@end*/

/*@@envVar:E_pubc_GW_GW_1C2_WhlSpdRiReDataVld_Vt:*/
on envVar E_pubc_GW_GW_1C2_WhlSpdRiReDataVld_Vt
{
    qword rawValue = 0ll;
    if(getValue(E_pubc_GW_GW_1C2_WhlSpdRiReDataVld_SetVt))
    {
        //update the signal value
        Msg_GW_1C2.WhlSpdRiReDataVld=getValue(this);
    }
}
/*@@end*/

/*@@envVar:E_pubc_GW_GW_1C2_WhlSpdRiReDataVld_SetVt:*/
on envVar E_pubc_GW_GW_1C2_WhlSpdRiReDataVld_SetVt
{
    if(getValue(E_pubc_GW_GW_1C2_WhlSpdRiReDataVld_SetVt))
    {
        //update the signal value
        Msg_GW_1C2.WhlSpdRiReDataVld=getvalue(E_pubc_GW_GW_1C2_WhlSpdRiReDataVld_Vt);
    }
    else
    {
        Msg_GW_1C2.WhlSpdRiReDataVld=getValue(E_pubc_GW_GW_1C2_WhlSpdRiReDataVld_Rv);
    }
}
/*@@end*/
 
/*@@envVar:E_pubc_GW_GW_1C2_WhlSpdLeReDataVld_Rv:*/
on envVar E_pubc_GW_GW_1C2_WhlSpdLeReDataVld_Rv
{
    int64 rawValue = 0ll;
    float rawValue_float = 0.0;
    float phyValue = 0.0;        

    //set the signal with updated raw value
    if(getValue(E_pubc_GW_GW_1C2_WhlSpdLeReDataVld_SetVt)==0)
    {
        rawValue = getvalue(this);
        if(chgEv_GW_1C2_WhlSpdLeReDataVld == 0)
        {
            //type conversion to float
            rawValue_float = rawValue;        
            // raw to physical conversion
            phyValue = ((rawValue_float *1)+(0));
            putValue(E_pubc_GW_GW_1C2_WhlSpdLeReDataVld_Pv, phyValue);
            chgEv_GW_1C2_WhlSpdLeReDataVld = 1;
        }
        else
        {
            chgEv_GW_1C2_WhlSpdLeReDataVld = 0;
        }    
        //update the signal value
        Msg_GW_1C2.WhlSpdLeReDataVld=rawValue;        
    }                                                                           
}
/*@@end*/

/*@@envVar:E_pubc_GW_GW_1C2_WhlSpdLeReDataVld_Pv:*/
on envVar E_pubc_GW_GW_1C2_WhlSpdLeReDataVld_Pv
{
    int64 rawValue = 0ll;
    float phyValue = 0.0;
    
    //update the raw value with physical value 
    if(getValue(E_pubc_GW_GW_1C2_WhlSpdLeReDataVld_SetVt)==0)
    {
        if(chgEv_GW_1C2_WhlSpdLeReDataVld == 0)
        {
            phyValue = getvalue(this);
            // physical to raw conversion
            rawValue = ((phyValue -(0))/1);
            putValue(E_pubc_GW_GW_1C2_WhlSpdLeReDataVld_Rv, rawValue);
            chgEv_GW_1C2_WhlSpdLeReDataVld = 1;  
        }
        else
        {
            chgEv_GW_1C2_WhlSpdLeReDataVld = 0;
        }
    }
}
/*@@end*/

/*@@envVar:E_pubc_GW_GW_1C2_WhlSpdLeReDataVld_Vt:*/
on envVar E_pubc_GW_GW_1C2_WhlSpdLeReDataVld_Vt
{
    qword rawValue = 0ll;
    if(getValue(E_pubc_GW_GW_1C2_WhlSpdLeReDataVld_SetVt))
    {
        //update the signal value
        Msg_GW_1C2.WhlSpdLeReDataVld=getValue(this);
    }
}
/*@@end*/

/*@@envVar:E_pubc_GW_GW_1C2_WhlSpdLeReDataVld_SetVt:*/
on envVar E_pubc_GW_GW_1C2_WhlSpdLeReDataVld_SetVt
{
    if(getValue(E_pubc_GW_GW_1C2_WhlSpdLeReDataVld_SetVt))
    {
        //update the signal value
        Msg_GW_1C2.WhlSpdLeReDataVld=getvalue(E_pubc_GW_GW_1C2_WhlSpdLeReDataVld_Vt);
    }
    else
    {
        Msg_GW_1C2.WhlSpdLeReDataVld=getValue(E_pubc_GW_GW_1C2_WhlSpdLeReDataVld_Rv);
    }
}
/*@@end*/
 
/*@@envVar:E_pubc_GW_GW_1C2_WhlSpdRiFrntDir_Rv:*/
on envVar E_pubc_GW_GW_1C2_WhlSpdRiFrntDir_Rv
{
    int64 rawValue = 0ll;
    float rawValue_float = 0.0;
    float phyValue = 0.0;        

    //set the signal with updated raw value
    if(getValue(E_pubc_GW_GW_1C2_WhlSpdRiFrntDir_SetVt)==0)
    {
        rawValue = getvalue(this);
        if(chgEv_GW_1C2_WhlSpdRiFrntDir == 0)
        {
            //type conversion to float
            rawValue_float = rawValue;        
            // raw to physical conversion
            phyValue = ((rawValue_float *1)+(0));
            putValue(E_pubc_GW_GW_1C2_WhlSpdRiFrntDir_Pv, phyValue);
            chgEv_GW_1C2_WhlSpdRiFrntDir = 1;
        }
        else
        {
            chgEv_GW_1C2_WhlSpdRiFrntDir = 0;
        }    
        //update the signal value
        Msg_GW_1C2.WhlSpdRiFrntDir=rawValue;        
    }                                                                           
}
/*@@end*/

/*@@envVar:E_pubc_GW_GW_1C2_WhlSpdRiFrntDir_Pv:*/
on envVar E_pubc_GW_GW_1C2_WhlSpdRiFrntDir_Pv
{
    int64 rawValue = 0ll;
    float phyValue = 0.0;
    
    //update the raw value with physical value 
    if(getValue(E_pubc_GW_GW_1C2_WhlSpdRiFrntDir_SetVt)==0)
    {
        if(chgEv_GW_1C2_WhlSpdRiFrntDir == 0)
        {
            phyValue = getvalue(this);
            // physical to raw conversion
            rawValue = ((phyValue -(0))/1);
            putValue(E_pubc_GW_GW_1C2_WhlSpdRiFrntDir_Rv, rawValue);
            chgEv_GW_1C2_WhlSpdRiFrntDir = 1;  
        }
        else
        {
            chgEv_GW_1C2_WhlSpdRiFrntDir = 0;
        }
    }
}
/*@@end*/

/*@@envVar:E_pubc_GW_GW_1C2_WhlSpdRiFrntDir_Vt:*/
on envVar E_pubc_GW_GW_1C2_WhlSpdRiFrntDir_Vt
{
    qword rawValue = 0ll;
    if(getValue(E_pubc_GW_GW_1C2_WhlSpdRiFrntDir_SetVt))
    {
        //update the signal value
        Msg_GW_1C2.WhlSpdRiFrntDir=getValue(this);
    }
}
/*@@end*/

/*@@envVar:E_pubc_GW_GW_1C2_WhlSpdRiFrntDir_SetVt:*/
on envVar E_pubc_GW_GW_1C2_WhlSpdRiFrntDir_SetVt
{
    if(getValue(E_pubc_GW_GW_1C2_WhlSpdRiFrntDir_SetVt))
    {
        //update the signal value
        Msg_GW_1C2.WhlSpdRiFrntDir=getvalue(E_pubc_GW_GW_1C2_WhlSpdRiFrntDir_Vt);
    }
    else
    {
        Msg_GW_1C2.WhlSpdRiFrntDir=getValue(E_pubc_GW_GW_1C2_WhlSpdRiFrntDir_Rv);
    }
}
/*@@end*/
 
/*@@envVar:E_pubc_GW_GW_1C2_WhlSpdRiFrntData_Rv:*/
on envVar E_pubc_GW_GW_1C2_WhlSpdRiFrntData_Rv
{
    int64 rawValue = 0ll;
    float rawValue_float = 0.0;
    float phyValue = 0.0;        

    //set the signal with updated raw value
    {
        rawValue = getvalue(this);
        if(chgEv_GW_1C2_WhlSpdRiFrntData == 0)
        {
            //type conversion to float
            rawValue_float = rawValue;        
            // raw to physical conversion
            phyValue = ((rawValue_float *0.05625)+(0));
            putValue(E_pubc_GW_GW_1C2_WhlSpdRiFrntData_Pv, phyValue);
            chgEv_GW_1C2_WhlSpdRiFrntData = 1;
        }
        else
        {
            chgEv_GW_1C2_WhlSpdRiFrntData = 0;
        }    
        //update the signal value
        Msg_GW_1C2.WhlSpdRiFrntData=rawValue;        
    }                                                                           
}
/*@@end*/

/*@@envVar:E_pubc_GW_GW_1C2_WhlSpdRiFrntData_Pv:*/
on envVar E_pubc_GW_GW_1C2_WhlSpdRiFrntData_Pv
{
    int64 rawValue = 0ll;
    float phyValue = 0.0;
    
    //update the raw value with physical value 
    {
        if(chgEv_GW_1C2_WhlSpdRiFrntData == 0)
        {
            phyValue = getvalue(this);
            // physical to raw conversion
            rawValue = ((phyValue -(0))/0.05625);
            putValue(E_pubc_GW_GW_1C2_WhlSpdRiFrntData_Rv, rawValue);
            chgEv_GW_1C2_WhlSpdRiFrntData = 1;  
        }
        else
        {
            chgEv_GW_1C2_WhlSpdRiFrntData = 0;
        }
    }
}
/*@@end*/


 
/*@@envVar:E_pubc_GW_GW_1C2_WhlSpdFrntRiPls_Rv:*/
on envVar E_pubc_GW_GW_1C2_WhlSpdFrntRiPls_Rv
{
    int64 rawValue = 0ll;
    float rawValue_float = 0.0;
    float phyValue = 0.0;        

    //set the signal with updated raw value
    {
        rawValue = getvalue(this);
        if(chgEv_GW_1C2_WhlSpdFrntRiPls == 0)
        {
            //type conversion to float
            rawValue_float = rawValue;        
            // raw to physical conversion
            phyValue = ((rawValue_float *1)+(0));
            putValue(E_pubc_GW_GW_1C2_WhlSpdFrntRiPls_Pv, phyValue);
            chgEv_GW_1C2_WhlSpdFrntRiPls = 1;
        }
        else
        {
            chgEv_GW_1C2_WhlSpdFrntRiPls = 0;
        }    
        //update the signal value
        Msg_GW_1C2.WhlSpdFrntRiPls=rawValue;        
    }                                                                           
}
/*@@end*/

/*@@envVar:E_pubc_GW_GW_1C2_WhlSpdFrntRiPls_Pv:*/
on envVar E_pubc_GW_GW_1C2_WhlSpdFrntRiPls_Pv
{
    int64 rawValue = 0ll;
    float phyValue = 0.0;
    
    //update the raw value with physical value 
    {
        if(chgEv_GW_1C2_WhlSpdFrntRiPls == 0)
        {
            phyValue = getvalue(this);
            // physical to raw conversion
            rawValue = ((phyValue -(0))/1);
            putValue(E_pubc_GW_GW_1C2_WhlSpdFrntRiPls_Rv, rawValue);
            chgEv_GW_1C2_WhlSpdFrntRiPls = 1;  
        }
        else
        {
            chgEv_GW_1C2_WhlSpdFrntRiPls = 0;
        }
    }
}
/*@@end*/


 
/*@@envVar:E_pubc_GW_GW_1C2_EspMstCylBrkPVld_Rv:*/
on envVar E_pubc_GW_GW_1C2_EspMstCylBrkPVld_Rv
{
    int64 rawValue = 0ll;
    float rawValue_float = 0.0;
    float phyValue = 0.0;        

    //set the signal with updated raw value
    if(getValue(E_pubc_GW_GW_1C2_EspMstCylBrkPVld_SetVt)==0)
    {
        rawValue = getvalue(this);
        if(chgEv_GW_1C2_EspMstCylBrkPVld == 0)
        {
            //type conversion to float
            rawValue_float = rawValue;        
            // raw to physical conversion
            phyValue = ((rawValue_float *1)+(0));
            putValue(E_pubc_GW_GW_1C2_EspMstCylBrkPVld_Pv, phyValue);
            chgEv_GW_1C2_EspMstCylBrkPVld = 1;
        }
        else
        {
            chgEv_GW_1C2_EspMstCylBrkPVld = 0;
        }    
        //update the signal value
        Msg_GW_1C2.EspMstCylBrkPVld=rawValue;        
    }                                                                           
}
/*@@end*/

/*@@envVar:E_pubc_GW_GW_1C2_EspMstCylBrkPVld_Pv:*/
on envVar E_pubc_GW_GW_1C2_EspMstCylBrkPVld_Pv
{
    int64 rawValue = 0ll;
    float phyValue = 0.0;
    
    //update the raw value with physical value 
    if(getValue(E_pubc_GW_GW_1C2_EspMstCylBrkPVld_SetVt)==0)
    {
        if(chgEv_GW_1C2_EspMstCylBrkPVld == 0)
        {
            phyValue = getvalue(this);
            // physical to raw conversion
            rawValue = ((phyValue -(0))/1);
            putValue(E_pubc_GW_GW_1C2_EspMstCylBrkPVld_Rv, rawValue);
            chgEv_GW_1C2_EspMstCylBrkPVld = 1;  
        }
        else
        {
            chgEv_GW_1C2_EspMstCylBrkPVld = 0;
        }
    }
}
/*@@end*/

/*@@envVar:E_pubc_GW_GW_1C2_EspMstCylBrkPVld_Vt:*/
on envVar E_pubc_GW_GW_1C2_EspMstCylBrkPVld_Vt
{
    qword rawValue = 0ll;
    if(getValue(E_pubc_GW_GW_1C2_EspMstCylBrkPVld_SetVt))
    {
        //update the signal value
        Msg_GW_1C2.EspMstCylBrkPVld=getValue(this);
    }
}
/*@@end*/

/*@@envVar:E_pubc_GW_GW_1C2_EspMstCylBrkPVld_SetVt:*/
on envVar E_pubc_GW_GW_1C2_EspMstCylBrkPVld_SetVt
{
    if(getValue(E_pubc_GW_GW_1C2_EspMstCylBrkPVld_SetVt))
    {
        //update the signal value
        Msg_GW_1C2.EspMstCylBrkPVld=getvalue(E_pubc_GW_GW_1C2_EspMstCylBrkPVld_Vt);
    }
    else
    {
        Msg_GW_1C2.EspMstCylBrkPVld=getValue(E_pubc_GW_GW_1C2_EspMstCylBrkPVld_Rv);
    }
}
/*@@end*/
 
/*@@envVar:E_pubc_GW_GW_1C2_EspLgtAccel_Rv:*/
on envVar E_pubc_GW_GW_1C2_EspLgtAccel_Rv
{
    int64 rawValue = 0ll;
    float rawValue_float = 0.0;
    float phyValue = 0.0;        

    //set the signal with updated raw value
    {
        rawValue = getvalue(this);
        if(chgEv_GW_1C2_EspLgtAccel == 0)
        {
            //type conversion to float
            rawValue_float = rawValue;        
            // raw to physical conversion
            phyValue = ((rawValue_float *0.01)+(-32));
            putValue(E_pubc_GW_GW_1C2_EspLgtAccel_Pv, phyValue);
            chgEv_GW_1C2_EspLgtAccel = 1;
        }
        else
        {
            chgEv_GW_1C2_EspLgtAccel = 0;
        }    
        //update the signal value
        Msg_GW_1C2.EspLgtAccel=rawValue;        
    }                                                                           
}
/*@@end*/

/*@@envVar:E_pubc_GW_GW_1C2_EspLgtAccel_Pv:*/
on envVar E_pubc_GW_GW_1C2_EspLgtAccel_Pv
{
    int64 rawValue = 0ll;
    float phyValue = 0.0;
    
    //update the raw value with physical value 
    {
        if(chgEv_GW_1C2_EspLgtAccel == 0)
        {
            phyValue = getvalue(this);
            // physical to raw conversion
            rawValue = ((phyValue -(-32))/0.01);
            putValue(E_pubc_GW_GW_1C2_EspLgtAccel_Rv, rawValue);
            chgEv_GW_1C2_EspLgtAccel = 1;  
        }
        else
        {
            chgEv_GW_1C2_EspLgtAccel = 0;
        }
    }
}
/*@@end*/


 
/*@@envVar:E_pubc_GW_GW_1C2_EspTcsActvSts_Rv:*/
on envVar E_pubc_GW_GW_1C2_EspTcsActvSts_Rv
{
    int64 rawValue = 0ll;
    float rawValue_float = 0.0;
    float phyValue = 0.0;        

    //set the signal with updated raw value
    if(getValue(E_pubc_GW_GW_1C2_EspTcsActvSts_SetVt)==0)
    {
        rawValue = getvalue(this);
        if(chgEv_GW_1C2_EspTcsActvSts == 0)
        {
            //type conversion to float
            rawValue_float = rawValue;        
            // raw to physical conversion
            phyValue = ((rawValue_float *1)+(0));
            putValue(E_pubc_GW_GW_1C2_EspTcsActvSts_Pv, phyValue);
            chgEv_GW_1C2_EspTcsActvSts = 1;
        }
        else
        {
            chgEv_GW_1C2_EspTcsActvSts = 0;
        }    
        //update the signal value
        Msg_GW_1C2.EspTcsActvSts=rawValue;        
    }                                                                           
}
/*@@end*/

/*@@envVar:E_pubc_GW_GW_1C2_EspTcsActvSts_Pv:*/
on envVar E_pubc_GW_GW_1C2_EspTcsActvSts_Pv
{
    int64 rawValue = 0ll;
    float phyValue = 0.0;
    
    //update the raw value with physical value 
    if(getValue(E_pubc_GW_GW_1C2_EspTcsActvSts_SetVt)==0)
    {
        if(chgEv_GW_1C2_EspTcsActvSts == 0)
        {
            phyValue = getvalue(this);
            // physical to raw conversion
            rawValue = ((phyValue -(0))/1);
            putValue(E_pubc_GW_GW_1C2_EspTcsActvSts_Rv, rawValue);
            chgEv_GW_1C2_EspTcsActvSts = 1;  
        }
        else
        {
            chgEv_GW_1C2_EspTcsActvSts = 0;
        }
    }
}
/*@@end*/

/*@@envVar:E_pubc_GW_GW_1C2_EspTcsActvSts_Vt:*/
on envVar E_pubc_GW_GW_1C2_EspTcsActvSts_Vt
{
    qword rawValue = 0ll;
    if(getValue(E_pubc_GW_GW_1C2_EspTcsActvSts_SetVt))
    {
        //update the signal value
        Msg_GW_1C2.EspTcsActvSts=getValue(this);
    }
}
/*@@end*/

/*@@envVar:E_pubc_GW_GW_1C2_EspTcsActvSts_SetVt:*/
on envVar E_pubc_GW_GW_1C2_EspTcsActvSts_SetVt
{
    if(getValue(E_pubc_GW_GW_1C2_EspTcsActvSts_SetVt))
    {
        //update the signal value
        Msg_GW_1C2.EspTcsActvSts=getvalue(E_pubc_GW_GW_1C2_EspTcsActvSts_Vt);
    }
    else
    {
        Msg_GW_1C2.EspTcsActvSts=getValue(E_pubc_GW_GW_1C2_EspTcsActvSts_Rv);
    }
}
/*@@end*/
 
/*@@envVar:E_pubc_GW_GW_1C2_EspLatAccel_Rv:*/
on envVar E_pubc_GW_GW_1C2_EspLatAccel_Rv
{
    int64 rawValue = 0ll;
    float rawValue_float = 0.0;
    float phyValue = 0.0;        

    //set the signal with updated raw value
    {
        rawValue = getvalue(this);
        if(chgEv_GW_1C2_EspLatAccel == 0)
        {
            //type conversion to float
            rawValue_float = rawValue;        
            // raw to physical conversion
            phyValue = ((rawValue_float *0.01)+(-32));
            putValue(E_pubc_GW_GW_1C2_EspLatAccel_Pv, phyValue);
            chgEv_GW_1C2_EspLatAccel = 1;
        }
        else
        {
            chgEv_GW_1C2_EspLatAccel = 0;
        }    
        //update the signal value
        Msg_GW_1C2.EspLatAccel=rawValue;        
    }                                                                           
}
/*@@end*/

/*@@envVar:E_pubc_GW_GW_1C2_EspLatAccel_Pv:*/
on envVar E_pubc_GW_GW_1C2_EspLatAccel_Pv
{
    int64 rawValue = 0ll;
    float phyValue = 0.0;
    
    //update the raw value with physical value 
    {
        if(chgEv_GW_1C2_EspLatAccel == 0)
        {
            phyValue = getvalue(this);
            // physical to raw conversion
            rawValue = ((phyValue -(-32))/0.01);
            putValue(E_pubc_GW_GW_1C2_EspLatAccel_Rv, rawValue);
            chgEv_GW_1C2_EspLatAccel = 1;  
        }
        else
        {
            chgEv_GW_1C2_EspLatAccel = 0;
        }
    }
}
/*@@end*/


 
/*@@envVar:E_pubc_GW_GW_1C2_WhlSpdFrntLePls_Rv:*/
on envVar E_pubc_GW_GW_1C2_WhlSpdFrntLePls_Rv
{
    int64 rawValue = 0ll;
    float rawValue_float = 0.0;
    float phyValue = 0.0;        

    //set the signal with updated raw value
    {
        rawValue = getvalue(this);
        if(chgEv_GW_1C2_WhlSpdFrntLePls == 0)
        {
            //type conversion to float
            rawValue_float = rawValue;        
            // raw to physical conversion
            phyValue = ((rawValue_float *1)+(0));
            putValue(E_pubc_GW_GW_1C2_WhlSpdFrntLePls_Pv, phyValue);
            chgEv_GW_1C2_WhlSpdFrntLePls = 1;
        }
        else
        {
            chgEv_GW_1C2_WhlSpdFrntLePls = 0;
        }    
        //update the signal value
        Msg_GW_1C2.WhlSpdFrntLePls=rawValue;        
    }                                                                           
}
/*@@end*/

/*@@envVar:E_pubc_GW_GW_1C2_WhlSpdFrntLePls_Pv:*/
on envVar E_pubc_GW_GW_1C2_WhlSpdFrntLePls_Pv
{
    int64 rawValue = 0ll;
    float phyValue = 0.0;
    
    //update the raw value with physical value 
    {
        if(chgEv_GW_1C2_WhlSpdFrntLePls == 0)
        {
            phyValue = getvalue(this);
            // physical to raw conversion
            rawValue = ((phyValue -(0))/1);
            putValue(E_pubc_GW_GW_1C2_WhlSpdFrntLePls_Rv, rawValue);
            chgEv_GW_1C2_WhlSpdFrntLePls = 1;  
        }
        else
        {
            chgEv_GW_1C2_WhlSpdFrntLePls = 0;
        }
    }
}
/*@@end*/


 
/*@@envVar:E_pubc_GW_GW_1C2_WhlSpdRiReData_Rv:*/
on envVar E_pubc_GW_GW_1C2_WhlSpdRiReData_Rv
{
    int64 rawValue = 0ll;
    float rawValue_float = 0.0;
    float phyValue = 0.0;        

    //set the signal with updated raw value
    {
        rawValue = getvalue(this);
        if(chgEv_GW_1C2_WhlSpdRiReData == 0)
        {
            //type conversion to float
            rawValue_float = rawValue;        
            // raw to physical conversion
            phyValue = ((rawValue_float *0.05625)+(0));
            putValue(E_pubc_GW_GW_1C2_WhlSpdRiReData_Pv, phyValue);
            chgEv_GW_1C2_WhlSpdRiReData = 1;
        }
        else
        {
            chgEv_GW_1C2_WhlSpdRiReData = 0;
        }    
        //update the signal value
        Msg_GW_1C2.WhlSpdRiReData=rawValue;        
    }                                                                           
}
/*@@end*/

/*@@envVar:E_pubc_GW_GW_1C2_WhlSpdRiReData_Pv:*/
on envVar E_pubc_GW_GW_1C2_WhlSpdRiReData_Pv
{
    int64 rawValue = 0ll;
    float phyValue = 0.0;
    
    //update the raw value with physical value 
    {
        if(chgEv_GW_1C2_WhlSpdRiReData == 0)
        {
            phyValue = getvalue(this);
            // physical to raw conversion
            rawValue = ((phyValue -(0))/0.05625);
            putValue(E_pubc_GW_GW_1C2_WhlSpdRiReData_Rv, rawValue);
            chgEv_GW_1C2_WhlSpdRiReData = 1;  
        }
        else
        {
            chgEv_GW_1C2_WhlSpdRiReData = 0;
        }
    }
}
/*@@end*/


 
/*@@envVar:E_pubc_GW_GW_1C2_MbRgnTarWhlQlfr_Rv:*/
on envVar E_pubc_GW_GW_1C2_MbRgnTarWhlQlfr_Rv
{
    int64 rawValue = 0ll;
    float rawValue_float = 0.0;
    float phyValue = 0.0;        

    //set the signal with updated raw value
    if(getValue(E_pubc_GW_GW_1C2_MbRgnTarWhlQlfr_SetVt)==0)
    {
        rawValue = getvalue(this);
        if(chgEv_GW_1C2_MbRgnTarWhlQlfr == 0)
        {
            //type conversion to float
            rawValue_float = rawValue;        
            // raw to physical conversion
            phyValue = ((rawValue_float *1)+(0));
            putValue(E_pubc_GW_GW_1C2_MbRgnTarWhlQlfr_Pv, phyValue);
            chgEv_GW_1C2_MbRgnTarWhlQlfr = 1;
        }
        else
        {
            chgEv_GW_1C2_MbRgnTarWhlQlfr = 0;
        }    
        //update the signal value
        Msg_GW_1C2.MbRgnTarWhlQlfr=rawValue;        
    }                                                                           
}
/*@@end*/

/*@@envVar:E_pubc_GW_GW_1C2_MbRgnTarWhlQlfr_Pv:*/
on envVar E_pubc_GW_GW_1C2_MbRgnTarWhlQlfr_Pv
{
    int64 rawValue = 0ll;
    float phyValue = 0.0;
    
    //update the raw value with physical value 
    if(getValue(E_pubc_GW_GW_1C2_MbRgnTarWhlQlfr_SetVt)==0)
    {
        if(chgEv_GW_1C2_MbRgnTarWhlQlfr == 0)
        {
            phyValue = getvalue(this);
            // physical to raw conversion
            rawValue = ((phyValue -(0))/1);
            putValue(E_pubc_GW_GW_1C2_MbRgnTarWhlQlfr_Rv, rawValue);
            chgEv_GW_1C2_MbRgnTarWhlQlfr = 1;  
        }
        else
        {
            chgEv_GW_1C2_MbRgnTarWhlQlfr = 0;
        }
    }
}
/*@@end*/

/*@@envVar:E_pubc_GW_GW_1C2_MbRgnTarWhlQlfr_Vt:*/
on envVar E_pubc_GW_GW_1C2_MbRgnTarWhlQlfr_Vt
{
    qword rawValue = 0ll;
    if(getValue(E_pubc_GW_GW_1C2_MbRgnTarWhlQlfr_SetVt))
    {
        //update the signal value
        Msg_GW_1C2.MbRgnTarWhlQlfr=getValue(this);
    }
}
/*@@end*/

/*@@envVar:E_pubc_GW_GW_1C2_MbRgnTarWhlQlfr_SetVt:*/
on envVar E_pubc_GW_GW_1C2_MbRgnTarWhlQlfr_SetVt
{
    if(getValue(E_pubc_GW_GW_1C2_MbRgnTarWhlQlfr_SetVt))
    {
        //update the signal value
        Msg_GW_1C2.MbRgnTarWhlQlfr=getvalue(E_pubc_GW_GW_1C2_MbRgnTarWhlQlfr_Vt);
    }
    else
    {
        Msg_GW_1C2.MbRgnTarWhlQlfr=getValue(E_pubc_GW_GW_1C2_MbRgnTarWhlQlfr_Rv);
    }
}
/*@@end*/
 
/*@@envVar:E_pubc_GW_GW_1C2_EspLatAccelVld_Rv:*/
on envVar E_pubc_GW_GW_1C2_EspLatAccelVld_Rv
{
    int64 rawValue = 0ll;
    float rawValue_float = 0.0;
    float phyValue = 0.0;        

    //set the signal with updated raw value
    if(getValue(E_pubc_GW_GW_1C2_EspLatAccelVld_SetVt)==0)
    {
        rawValue = getvalue(this);
        if(chgEv_GW_1C2_EspLatAccelVld == 0)
        {
            //type conversion to float
            rawValue_float = rawValue;        
            // raw to physical conversion
            phyValue = ((rawValue_float *1)+(0));
            putValue(E_pubc_GW_GW_1C2_EspLatAccelVld_Pv, phyValue);
            chgEv_GW_1C2_EspLatAccelVld = 1;
        }
        else
        {
            chgEv_GW_1C2_EspLatAccelVld = 0;
        }    
        //update the signal value
        Msg_GW_1C2.EspLatAccelVld=rawValue;        
    }                                                                           
}
/*@@end*/

/*@@envVar:E_pubc_GW_GW_1C2_EspLatAccelVld_Pv:*/
on envVar E_pubc_GW_GW_1C2_EspLatAccelVld_Pv
{
    int64 rawValue = 0ll;
    float phyValue = 0.0;
    
    //update the raw value with physical value 
    if(getValue(E_pubc_GW_GW_1C2_EspLatAccelVld_SetVt)==0)
    {
        if(chgEv_GW_1C2_EspLatAccelVld == 0)
        {
            phyValue = getvalue(this);
            // physical to raw conversion
            rawValue = ((phyValue -(0))/1);
            putValue(E_pubc_GW_GW_1C2_EspLatAccelVld_Rv, rawValue);
            chgEv_GW_1C2_EspLatAccelVld = 1;  
        }
        else
        {
            chgEv_GW_1C2_EspLatAccelVld = 0;
        }
    }
}
/*@@end*/

/*@@envVar:E_pubc_GW_GW_1C2_EspLatAccelVld_Vt:*/
on envVar E_pubc_GW_GW_1C2_EspLatAccelVld_Vt
{
    qword rawValue = 0ll;
    if(getValue(E_pubc_GW_GW_1C2_EspLatAccelVld_SetVt))
    {
        //update the signal value
        Msg_GW_1C2.EspLatAccelVld=getValue(this);
    }
}
/*@@end*/

/*@@envVar:E_pubc_GW_GW_1C2_EspLatAccelVld_SetVt:*/
on envVar E_pubc_GW_GW_1C2_EspLatAccelVld_SetVt
{
    if(getValue(E_pubc_GW_GW_1C2_EspLatAccelVld_SetVt))
    {
        //update the signal value
        Msg_GW_1C2.EspLatAccelVld=getvalue(E_pubc_GW_GW_1C2_EspLatAccelVld_Vt);
    }
    else
    {
        Msg_GW_1C2.EspLatAccelVld=getValue(E_pubc_GW_GW_1C2_EspLatAccelVld_Rv);
    }
}
/*@@end*/
 
/*@@envVar:E_pubc_GW_GW_1C2_WhlSpdLeFrntData_Rv:*/
on envVar E_pubc_GW_GW_1C2_WhlSpdLeFrntData_Rv
{
    int64 rawValue = 0ll;
    float rawValue_float = 0.0;
    float phyValue = 0.0;        

    //set the signal with updated raw value
    {
        rawValue = getvalue(this);
        if(chgEv_GW_1C2_WhlSpdLeFrntData == 0)
        {
            //type conversion to float
            rawValue_float = rawValue;        
            // raw to physical conversion
            phyValue = ((rawValue_float *0.05625)+(0));
            putValue(E_pubc_GW_GW_1C2_WhlSpdLeFrntData_Pv, phyValue);
            chgEv_GW_1C2_WhlSpdLeFrntData = 1;
        }
        else
        {
            chgEv_GW_1C2_WhlSpdLeFrntData = 0;
        }    
        //update the signal value
        Msg_GW_1C2.WhlSpdLeFrntData=rawValue;        
    }                                                                           
}
/*@@end*/

/*@@envVar:E_pubc_GW_GW_1C2_WhlSpdLeFrntData_Pv:*/
on envVar E_pubc_GW_GW_1C2_WhlSpdLeFrntData_Pv
{
    int64 rawValue = 0ll;
    float phyValue = 0.0;
    
    //update the raw value with physical value 
    {
        if(chgEv_GW_1C2_WhlSpdLeFrntData == 0)
        {
            phyValue = getvalue(this);
            // physical to raw conversion
            rawValue = ((phyValue -(0))/0.05625);
            putValue(E_pubc_GW_GW_1C2_WhlSpdLeFrntData_Rv, rawValue);
            chgEv_GW_1C2_WhlSpdLeFrntData = 1;  
        }
        else
        {
            chgEv_GW_1C2_WhlSpdLeFrntData = 0;
        }
    }
}
/*@@end*/


 
/*@@envVar:E_pubc_GW_GW_1C2_EspAbsActv_Rv:*/
on envVar E_pubc_GW_GW_1C2_EspAbsActv_Rv
{
    int64 rawValue = 0ll;
    float rawValue_float = 0.0;
    float phyValue = 0.0;        

    //set the signal with updated raw value
    if(getValue(E_pubc_GW_GW_1C2_EspAbsActv_SetVt)==0)
    {
        rawValue = getvalue(this);
        if(chgEv_GW_1C2_EspAbsActv == 0)
        {
            //type conversion to float
            rawValue_float = rawValue;        
            // raw to physical conversion
            phyValue = ((rawValue_float *1)+(0));
            putValue(E_pubc_GW_GW_1C2_EspAbsActv_Pv, phyValue);
            chgEv_GW_1C2_EspAbsActv = 1;
        }
        else
        {
            chgEv_GW_1C2_EspAbsActv = 0;
        }    
        //update the signal value
        Msg_GW_1C2.EspAbsActv=rawValue;        
    }                                                                           
}
/*@@end*/

/*@@envVar:E_pubc_GW_GW_1C2_EspAbsActv_Pv:*/
on envVar E_pubc_GW_GW_1C2_EspAbsActv_Pv
{
    int64 rawValue = 0ll;
    float phyValue = 0.0;
    
    //update the raw value with physical value 
    if(getValue(E_pubc_GW_GW_1C2_EspAbsActv_SetVt)==0)
    {
        if(chgEv_GW_1C2_EspAbsActv == 0)
        {
            phyValue = getvalue(this);
            // physical to raw conversion
            rawValue = ((phyValue -(0))/1);
            putValue(E_pubc_GW_GW_1C2_EspAbsActv_Rv, rawValue);
            chgEv_GW_1C2_EspAbsActv = 1;  
        }
        else
        {
            chgEv_GW_1C2_EspAbsActv = 0;
        }
    }
}
/*@@end*/

/*@@envVar:E_pubc_GW_GW_1C2_EspAbsActv_Vt:*/
on envVar E_pubc_GW_GW_1C2_EspAbsActv_Vt
{
    qword rawValue = 0ll;
    if(getValue(E_pubc_GW_GW_1C2_EspAbsActv_SetVt))
    {
        //update the signal value
        Msg_GW_1C2.EspAbsActv=getValue(this);
    }
}
/*@@end*/

/*@@envVar:E_pubc_GW_GW_1C2_EspAbsActv_SetVt:*/
on envVar E_pubc_GW_GW_1C2_EspAbsActv_SetVt
{
    if(getValue(E_pubc_GW_GW_1C2_EspAbsActv_SetVt))
    {
        //update the signal value
        Msg_GW_1C2.EspAbsActv=getvalue(E_pubc_GW_GW_1C2_EspAbsActv_Vt);
    }
    else
    {
        Msg_GW_1C2.EspAbsActv=getValue(E_pubc_GW_GW_1C2_EspAbsActv_Rv);
    }
}
/*@@end*/
 
/*@@envVar:E_pubc_GW_GW_1C2_EspVdcActvSts_Rv:*/
on envVar E_pubc_GW_GW_1C2_EspVdcActvSts_Rv
{
    int64 rawValue = 0ll;
    float rawValue_float = 0.0;
    float phyValue = 0.0;        

    //set the signal with updated raw value
    if(getValue(E_pubc_GW_GW_1C2_EspVdcActvSts_SetVt)==0)
    {
        rawValue = getvalue(this);
        if(chgEv_GW_1C2_EspVdcActvSts == 0)
        {
            //type conversion to float
            rawValue_float = rawValue;        
            // raw to physical conversion
            phyValue = ((rawValue_float *1)+(0));
            putValue(E_pubc_GW_GW_1C2_EspVdcActvSts_Pv, phyValue);
            chgEv_GW_1C2_EspVdcActvSts = 1;
        }
        else
        {
            chgEv_GW_1C2_EspVdcActvSts = 0;
        }    
        //update the signal value
        Msg_GW_1C2.EspVdcActvSts=rawValue;        
    }                                                                           
}
/*@@end*/

/*@@envVar:E_pubc_GW_GW_1C2_EspVdcActvSts_Pv:*/
on envVar E_pubc_GW_GW_1C2_EspVdcActvSts_Pv
{
    int64 rawValue = 0ll;
    float phyValue = 0.0;
    
    //update the raw value with physical value 
    if(getValue(E_pubc_GW_GW_1C2_EspVdcActvSts_SetVt)==0)
    {
        if(chgEv_GW_1C2_EspVdcActvSts == 0)
        {
            phyValue = getvalue(this);
            // physical to raw conversion
            rawValue = ((phyValue -(0))/1);
            putValue(E_pubc_GW_GW_1C2_EspVdcActvSts_Rv, rawValue);
            chgEv_GW_1C2_EspVdcActvSts = 1;  
        }
        else
        {
            chgEv_GW_1C2_EspVdcActvSts = 0;
        }
    }
}
/*@@end*/

/*@@envVar:E_pubc_GW_GW_1C2_EspVdcActvSts_Vt:*/
on envVar E_pubc_GW_GW_1C2_EspVdcActvSts_Vt
{
    qword rawValue = 0ll;
    if(getValue(E_pubc_GW_GW_1C2_EspVdcActvSts_SetVt))
    {
        //update the signal value
        Msg_GW_1C2.EspVdcActvSts=getValue(this);
    }
}
/*@@end*/

/*@@envVar:E_pubc_GW_GW_1C2_EspVdcActvSts_SetVt:*/
on envVar E_pubc_GW_GW_1C2_EspVdcActvSts_SetVt
{
    if(getValue(E_pubc_GW_GW_1C2_EspVdcActvSts_SetVt))
    {
        //update the signal value
        Msg_GW_1C2.EspVdcActvSts=getvalue(E_pubc_GW_GW_1C2_EspVdcActvSts_Vt);
    }
    else
    {
        Msg_GW_1C2.EspVdcActvSts=getValue(E_pubc_GW_GW_1C2_EspVdcActvSts_Rv);
    }
}
/*@@end*/
 
/*@@envVar:E_pubc_GW_GW_1C2_WhlSpdLeFrntDataVld_Rv:*/
on envVar E_pubc_GW_GW_1C2_WhlSpdLeFrntDataVld_Rv
{
    int64 rawValue = 0ll;
    float rawValue_float = 0.0;
    float phyValue = 0.0;        

    //set the signal with updated raw value
    if(getValue(E_pubc_GW_GW_1C2_WhlSpdLeFrntDataVld_SetVt)==0)
    {
        rawValue = getvalue(this);
        if(chgEv_GW_1C2_WhlSpdLeFrntDataVld == 0)
        {
            //type conversion to float
            rawValue_float = rawValue;        
            // raw to physical conversion
            phyValue = ((rawValue_float *1)+(0));
            putValue(E_pubc_GW_GW_1C2_WhlSpdLeFrntDataVld_Pv, phyValue);
            chgEv_GW_1C2_WhlSpdLeFrntDataVld = 1;
        }
        else
        {
            chgEv_GW_1C2_WhlSpdLeFrntDataVld = 0;
        }    
        //update the signal value
        Msg_GW_1C2.WhlSpdLeFrntDataVld=rawValue;        
    }                                                                           
}
/*@@end*/

/*@@envVar:E_pubc_GW_GW_1C2_WhlSpdLeFrntDataVld_Pv:*/
on envVar E_pubc_GW_GW_1C2_WhlSpdLeFrntDataVld_Pv
{
    int64 rawValue = 0ll;
    float phyValue = 0.0;
    
    //update the raw value with physical value 
    if(getValue(E_pubc_GW_GW_1C2_WhlSpdLeFrntDataVld_SetVt)==0)
    {
        if(chgEv_GW_1C2_WhlSpdLeFrntDataVld == 0)
        {
            phyValue = getvalue(this);
            // physical to raw conversion
            rawValue = ((phyValue -(0))/1);
            putValue(E_pubc_GW_GW_1C2_WhlSpdLeFrntDataVld_Rv, rawValue);
            chgEv_GW_1C2_WhlSpdLeFrntDataVld = 1;  
        }
        else
        {
            chgEv_GW_1C2_WhlSpdLeFrntDataVld = 0;
        }
    }
}
/*@@end*/

/*@@envVar:E_pubc_GW_GW_1C2_WhlSpdLeFrntDataVld_Vt:*/
on envVar E_pubc_GW_GW_1C2_WhlSpdLeFrntDataVld_Vt
{
    qword rawValue = 0ll;
    if(getValue(E_pubc_GW_GW_1C2_WhlSpdLeFrntDataVld_SetVt))
    {
        //update the signal value
        Msg_GW_1C2.WhlSpdLeFrntDataVld=getValue(this);
    }
}
/*@@end*/

/*@@envVar:E_pubc_GW_GW_1C2_WhlSpdLeFrntDataVld_SetVt:*/
on envVar E_pubc_GW_GW_1C2_WhlSpdLeFrntDataVld_SetVt
{
    if(getValue(E_pubc_GW_GW_1C2_WhlSpdLeFrntDataVld_SetVt))
    {
        //update the signal value
        Msg_GW_1C2.WhlSpdLeFrntDataVld=getvalue(E_pubc_GW_GW_1C2_WhlSpdLeFrntDataVld_Vt);
    }
    else
    {
        Msg_GW_1C2.WhlSpdLeFrntDataVld=getValue(E_pubc_GW_GW_1C2_WhlSpdLeFrntDataVld_Rv);
    }
}
/*@@end*/
 
/*@@envVar:E_pubc_GW_GW_1C2_EspAutoHoldActvSts_Rv:*/
on envVar E_pubc_GW_GW_1C2_EspAutoHoldActvSts_Rv
{
    int64 rawValue = 0ll;
    float rawValue_float = 0.0;
    float phyValue = 0.0;        

    //set the signal with updated raw value
    if(getValue(E_pubc_GW_GW_1C2_EspAutoHoldActvSts_SetVt)==0)
    {
        rawValue = getvalue(this);
        if(chgEv_GW_1C2_EspAutoHoldActvSts == 0)
        {
            //type conversion to float
            rawValue_float = rawValue;        
            // raw to physical conversion
            phyValue = ((rawValue_float *1)+(0));
            putValue(E_pubc_GW_GW_1C2_EspAutoHoldActvSts_Pv, phyValue);
            chgEv_GW_1C2_EspAutoHoldActvSts = 1;
        }
        else
        {
            chgEv_GW_1C2_EspAutoHoldActvSts = 0;
        }    
        //update the signal value
        Msg_GW_1C2.EspAutoHoldActvSts=rawValue;        
    }                                                                           
}
/*@@end*/

/*@@envVar:E_pubc_GW_GW_1C2_EspAutoHoldActvSts_Pv:*/
on envVar E_pubc_GW_GW_1C2_EspAutoHoldActvSts_Pv
{
    int64 rawValue = 0ll;
    float phyValue = 0.0;
    
    //update the raw value with physical value 
    if(getValue(E_pubc_GW_GW_1C2_EspAutoHoldActvSts_SetVt)==0)
    {
        if(chgEv_GW_1C2_EspAutoHoldActvSts == 0)
        {
            phyValue = getvalue(this);
            // physical to raw conversion
            rawValue = ((phyValue -(0))/1);
            putValue(E_pubc_GW_GW_1C2_EspAutoHoldActvSts_Rv, rawValue);
            chgEv_GW_1C2_EspAutoHoldActvSts = 1;  
        }
        else
        {
            chgEv_GW_1C2_EspAutoHoldActvSts = 0;
        }
    }
}
/*@@end*/

/*@@envVar:E_pubc_GW_GW_1C2_EspAutoHoldActvSts_Vt:*/
on envVar E_pubc_GW_GW_1C2_EspAutoHoldActvSts_Vt
{
    qword rawValue = 0ll;
    if(getValue(E_pubc_GW_GW_1C2_EspAutoHoldActvSts_SetVt))
    {
        //update the signal value
        Msg_GW_1C2.EspAutoHoldActvSts=getValue(this);
    }
}
/*@@end*/

/*@@envVar:E_pubc_GW_GW_1C2_EspAutoHoldActvSts_SetVt:*/
on envVar E_pubc_GW_GW_1C2_EspAutoHoldActvSts_SetVt
{
    if(getValue(E_pubc_GW_GW_1C2_EspAutoHoldActvSts_SetVt))
    {
        //update the signal value
        Msg_GW_1C2.EspAutoHoldActvSts=getvalue(E_pubc_GW_GW_1C2_EspAutoHoldActvSts_Vt);
    }
    else
    {
        Msg_GW_1C2.EspAutoHoldActvSts=getValue(E_pubc_GW_GW_1C2_EspAutoHoldActvSts_Rv);
    }
}
/*@@end*/
 
/*@@envVar:E_pubc_GW_GW_1C2_MbRgnTarWhl_Rv:*/
on envVar E_pubc_GW_GW_1C2_MbRgnTarWhl_Rv
{
    int64 rawValue = 0ll;
    float rawValue_float = 0.0;
    float phyValue = 0.0;        

    //set the signal with updated raw value
    {
        rawValue = getvalue(this);
        if(chgEv_GW_1C2_MbRgnTarWhl == 0)
        {
            //type conversion to float
            rawValue_float = rawValue;        
            // raw to physical conversion
            phyValue = ((rawValue_float *1)+(-32768));
            putValue(E_pubc_GW_GW_1C2_MbRgnTarWhl_Pv, phyValue);
            chgEv_GW_1C2_MbRgnTarWhl = 1;
        }
        else
        {
            chgEv_GW_1C2_MbRgnTarWhl = 0;
        }    
        //update the signal value
        Msg_GW_1C2.MbRgnTarWhl=rawValue;        
    }                                                                           
}
/*@@end*/

/*@@envVar:E_pubc_GW_GW_1C2_MbRgnTarWhl_Pv:*/
on envVar E_pubc_GW_GW_1C2_MbRgnTarWhl_Pv
{
    int64 rawValue = 0ll;
    float phyValue = 0.0;
    
    //update the raw value with physical value 
    {
        if(chgEv_GW_1C2_MbRgnTarWhl == 0)
        {
            phyValue = getvalue(this);
            // physical to raw conversion
            rawValue = ((phyValue -(-32768))/1);
            putValue(E_pubc_GW_GW_1C2_MbRgnTarWhl_Rv, rawValue);
            chgEv_GW_1C2_MbRgnTarWhl = 1;  
        }
        else
        {
            chgEv_GW_1C2_MbRgnTarWhl = 0;
        }
    }
}
/*@@end*/


 
/*@@envVar:E_pubc_GW_GW_1C2_EspYawAgSpdVld_Rv:*/
on envVar E_pubc_GW_GW_1C2_EspYawAgSpdVld_Rv
{
    int64 rawValue = 0ll;
    float rawValue_float = 0.0;
    float phyValue = 0.0;        

    //set the signal with updated raw value
    if(getValue(E_pubc_GW_GW_1C2_EspYawAgSpdVld_SetVt)==0)
    {
        rawValue = getvalue(this);
        if(chgEv_GW_1C2_EspYawAgSpdVld == 0)
        {
            //type conversion to float
            rawValue_float = rawValue;        
            // raw to physical conversion
            phyValue = ((rawValue_float *1)+(0));
            putValue(E_pubc_GW_GW_1C2_EspYawAgSpdVld_Pv, phyValue);
            chgEv_GW_1C2_EspYawAgSpdVld = 1;
        }
        else
        {
            chgEv_GW_1C2_EspYawAgSpdVld = 0;
        }    
        //update the signal value
        Msg_GW_1C2.EspYawAgSpdVld=rawValue;        
    }                                                                           
}
/*@@end*/

/*@@envVar:E_pubc_GW_GW_1C2_EspYawAgSpdVld_Pv:*/
on envVar E_pubc_GW_GW_1C2_EspYawAgSpdVld_Pv
{
    int64 rawValue = 0ll;
    float phyValue = 0.0;
    
    //update the raw value with physical value 
    if(getValue(E_pubc_GW_GW_1C2_EspYawAgSpdVld_SetVt)==0)
    {
        if(chgEv_GW_1C2_EspYawAgSpdVld == 0)
        {
            phyValue = getvalue(this);
            // physical to raw conversion
            rawValue = ((phyValue -(0))/1);
            putValue(E_pubc_GW_GW_1C2_EspYawAgSpdVld_Rv, rawValue);
            chgEv_GW_1C2_EspYawAgSpdVld = 1;  
        }
        else
        {
            chgEv_GW_1C2_EspYawAgSpdVld = 0;
        }
    }
}
/*@@end*/

/*@@envVar:E_pubc_GW_GW_1C2_EspYawAgSpdVld_Vt:*/
on envVar E_pubc_GW_GW_1C2_EspYawAgSpdVld_Vt
{
    qword rawValue = 0ll;
    if(getValue(E_pubc_GW_GW_1C2_EspYawAgSpdVld_SetVt))
    {
        //update the signal value
        Msg_GW_1C2.EspYawAgSpdVld=getValue(this);
    }
}
/*@@end*/

/*@@envVar:E_pubc_GW_GW_1C2_EspYawAgSpdVld_SetVt:*/
on envVar E_pubc_GW_GW_1C2_EspYawAgSpdVld_SetVt
{
    if(getValue(E_pubc_GW_GW_1C2_EspYawAgSpdVld_SetVt))
    {
        //update the signal value
        Msg_GW_1C2.EspYawAgSpdVld=getvalue(E_pubc_GW_GW_1C2_EspYawAgSpdVld_Vt);
    }
    else
    {
        Msg_GW_1C2.EspYawAgSpdVld=getValue(E_pubc_GW_GW_1C2_EspYawAgSpdVld_Rv);
    }
}
/*@@end*/
 
/*@@envVar:E_pubc_GW_GW_1C2_EspReWhlDecTarTqActv_Rv:*/
on envVar E_pubc_GW_GW_1C2_EspReWhlDecTarTqActv_Rv
{
    int64 rawValue = 0ll;
    float rawValue_float = 0.0;
    float phyValue = 0.0;        

    //set the signal with updated raw value
    if(getValue(E_pubc_GW_GW_1C2_EspReWhlDecTarTqActv_SetVt)==0)
    {
        rawValue = getvalue(this);
        if(chgEv_GW_1C2_EspReWhlDecTarTqActv == 0)
        {
            //type conversion to float
            rawValue_float = rawValue;        
            // raw to physical conversion
            phyValue = ((rawValue_float *1)+(0));
            putValue(E_pubc_GW_GW_1C2_EspReWhlDecTarTqActv_Pv, phyValue);
            chgEv_GW_1C2_EspReWhlDecTarTqActv = 1;
        }
        else
        {
            chgEv_GW_1C2_EspReWhlDecTarTqActv = 0;
        }    
        //update the signal value
        Msg_GW_1C2.EspReWhlDecTarTqActv=rawValue;        
    }                                                                           
}
/*@@end*/

/*@@envVar:E_pubc_GW_GW_1C2_EspReWhlDecTarTqActv_Pv:*/
on envVar E_pubc_GW_GW_1C2_EspReWhlDecTarTqActv_Pv
{
    int64 rawValue = 0ll;
    float phyValue = 0.0;
    
    //update the raw value with physical value 
    if(getValue(E_pubc_GW_GW_1C2_EspReWhlDecTarTqActv_SetVt)==0)
    {
        if(chgEv_GW_1C2_EspReWhlDecTarTqActv == 0)
        {
            phyValue = getvalue(this);
            // physical to raw conversion
            rawValue = ((phyValue -(0))/1);
            putValue(E_pubc_GW_GW_1C2_EspReWhlDecTarTqActv_Rv, rawValue);
            chgEv_GW_1C2_EspReWhlDecTarTqActv = 1;  
        }
        else
        {
            chgEv_GW_1C2_EspReWhlDecTarTqActv = 0;
        }
    }
}
/*@@end*/

/*@@envVar:E_pubc_GW_GW_1C2_EspReWhlDecTarTqActv_Vt:*/
on envVar E_pubc_GW_GW_1C2_EspReWhlDecTarTqActv_Vt
{
    qword rawValue = 0ll;
    if(getValue(E_pubc_GW_GW_1C2_EspReWhlDecTarTqActv_SetVt))
    {
        //update the signal value
        Msg_GW_1C2.EspReWhlDecTarTqActv=getValue(this);
    }
}
/*@@end*/

/*@@envVar:E_pubc_GW_GW_1C2_EspReWhlDecTarTqActv_SetVt:*/
on envVar E_pubc_GW_GW_1C2_EspReWhlDecTarTqActv_SetVt
{
    if(getValue(E_pubc_GW_GW_1C2_EspReWhlDecTarTqActv_SetVt))
    {
        //update the signal value
        Msg_GW_1C2.EspReWhlDecTarTqActv=getvalue(E_pubc_GW_GW_1C2_EspReWhlDecTarTqActv_Vt);
    }
    else
    {
        Msg_GW_1C2.EspReWhlDecTarTqActv=getValue(E_pubc_GW_GW_1C2_EspReWhlDecTarTqActv_Rv);
    }
}
/*@@end*/
 
/*@@envVar:E_pubc_GW_GW_1C2_WhlSpdReRiPls_Rv:*/
on envVar E_pubc_GW_GW_1C2_WhlSpdReRiPls_Rv
{
    int64 rawValue = 0ll;
    float rawValue_float = 0.0;
    float phyValue = 0.0;        

    //set the signal with updated raw value
    {
        rawValue = getvalue(this);
        if(chgEv_GW_1C2_WhlSpdReRiPls == 0)
        {
            //type conversion to float
            rawValue_float = rawValue;        
            // raw to physical conversion
            phyValue = ((rawValue_float *1)+(0));
            putValue(E_pubc_GW_GW_1C2_WhlSpdReRiPls_Pv, phyValue);
            chgEv_GW_1C2_WhlSpdReRiPls = 1;
        }
        else
        {
            chgEv_GW_1C2_WhlSpdReRiPls = 0;
        }    
        //update the signal value
        Msg_GW_1C2.WhlSpdReRiPls=rawValue;        
    }                                                                           
}
/*@@end*/

/*@@envVar:E_pubc_GW_GW_1C2_WhlSpdReRiPls_Pv:*/
on envVar E_pubc_GW_GW_1C2_WhlSpdReRiPls_Pv
{
    int64 rawValue = 0ll;
    float phyValue = 0.0;
    
    //update the raw value with physical value 
    {
        if(chgEv_GW_1C2_WhlSpdReRiPls == 0)
        {
            phyValue = getvalue(this);
            // physical to raw conversion
            rawValue = ((phyValue -(0))/1);
            putValue(E_pubc_GW_GW_1C2_WhlSpdReRiPls_Rv, rawValue);
            chgEv_GW_1C2_WhlSpdReRiPls = 1;  
        }
        else
        {
            chgEv_GW_1C2_WhlSpdReRiPls = 0;
        }
    }
}
/*@@end*/


 
/*@@envVar:E_pubc_GW_GW_1C2_EspReWhlDecTarTq_Rv:*/
on envVar E_pubc_GW_GW_1C2_EspReWhlDecTarTq_Rv
{
    int64 rawValue = 0ll;
    float rawValue_float = 0.0;
    float phyValue = 0.0;        

    //set the signal with updated raw value
    {
        rawValue = getvalue(this);
        if(chgEv_GW_1C2_EspReWhlDecTarTq == 0)
        {
            //type conversion to float
            rawValue_float = rawValue;        
            // raw to physical conversion
            phyValue = ((rawValue_float *1)+(-32768));
            putValue(E_pubc_GW_GW_1C2_EspReWhlDecTarTq_Pv, phyValue);
            chgEv_GW_1C2_EspReWhlDecTarTq = 1;
        }
        else
        {
            chgEv_GW_1C2_EspReWhlDecTarTq = 0;
        }    
        //update the signal value
        Msg_GW_1C2.EspReWhlDecTarTq=rawValue;        
    }                                                                           
}
/*@@end*/

/*@@envVar:E_pubc_GW_GW_1C2_EspReWhlDecTarTq_Pv:*/
on envVar E_pubc_GW_GW_1C2_EspReWhlDecTarTq_Pv
{
    int64 rawValue = 0ll;
    float phyValue = 0.0;
    
    //update the raw value with physical value 
    {
        if(chgEv_GW_1C2_EspReWhlDecTarTq == 0)
        {
            phyValue = getvalue(this);
            // physical to raw conversion
            rawValue = ((phyValue -(-32768))/1);
            putValue(E_pubc_GW_GW_1C2_EspReWhlDecTarTq_Rv, rawValue);
            chgEv_GW_1C2_EspReWhlDecTarTq = 1;  
        }
        else
        {
            chgEv_GW_1C2_EspReWhlDecTarTq = 0;
        }
    }
}
/*@@end*/


 
/*@@envVar:E_pubc_GW_GW_1C2_WhlSpdRiFrntDataVld_Rv:*/
on envVar E_pubc_GW_GW_1C2_WhlSpdRiFrntDataVld_Rv
{
    int64 rawValue = 0ll;
    float rawValue_float = 0.0;
    float phyValue = 0.0;        

    //set the signal with updated raw value
    if(getValue(E_pubc_GW_GW_1C2_WhlSpdRiFrntDataVld_SetVt)==0)
    {
        rawValue = getvalue(this);
        if(chgEv_GW_1C2_WhlSpdRiFrntDataVld == 0)
        {
            //type conversion to float
            rawValue_float = rawValue;        
            // raw to physical conversion
            phyValue = ((rawValue_float *1)+(0));
            putValue(E_pubc_GW_GW_1C2_WhlSpdRiFrntDataVld_Pv, phyValue);
            chgEv_GW_1C2_WhlSpdRiFrntDataVld = 1;
        }
        else
        {
            chgEv_GW_1C2_WhlSpdRiFrntDataVld = 0;
        }    
        //update the signal value
        Msg_GW_1C2.WhlSpdRiFrntDataVld=rawValue;        
    }                                                                           
}
/*@@end*/

/*@@envVar:E_pubc_GW_GW_1C2_WhlSpdRiFrntDataVld_Pv:*/
on envVar E_pubc_GW_GW_1C2_WhlSpdRiFrntDataVld_Pv
{
    int64 rawValue = 0ll;
    float phyValue = 0.0;
    
    //update the raw value with physical value 
    if(getValue(E_pubc_GW_GW_1C2_WhlSpdRiFrntDataVld_SetVt)==0)
    {
        if(chgEv_GW_1C2_WhlSpdRiFrntDataVld == 0)
        {
            phyValue = getvalue(this);
            // physical to raw conversion
            rawValue = ((phyValue -(0))/1);
            putValue(E_pubc_GW_GW_1C2_WhlSpdRiFrntDataVld_Rv, rawValue);
            chgEv_GW_1C2_WhlSpdRiFrntDataVld = 1;  
        }
        else
        {
            chgEv_GW_1C2_WhlSpdRiFrntDataVld = 0;
        }
    }
}
/*@@end*/

/*@@envVar:E_pubc_GW_GW_1C2_WhlSpdRiFrntDataVld_Vt:*/
on envVar E_pubc_GW_GW_1C2_WhlSpdRiFrntDataVld_Vt
{
    qword rawValue = 0ll;
    if(getValue(E_pubc_GW_GW_1C2_WhlSpdRiFrntDataVld_SetVt))
    {
        //update the signal value
        Msg_GW_1C2.WhlSpdRiFrntDataVld=getValue(this);
    }
}
/*@@end*/

/*@@envVar:E_pubc_GW_GW_1C2_WhlSpdRiFrntDataVld_SetVt:*/
on envVar E_pubc_GW_GW_1C2_WhlSpdRiFrntDataVld_SetVt
{
    if(getValue(E_pubc_GW_GW_1C2_WhlSpdRiFrntDataVld_SetVt))
    {
        //update the signal value
        Msg_GW_1C2.WhlSpdRiFrntDataVld=getvalue(E_pubc_GW_GW_1C2_WhlSpdRiFrntDataVld_Vt);
    }
    else
    {
        Msg_GW_1C2.WhlSpdRiFrntDataVld=getValue(E_pubc_GW_GW_1C2_WhlSpdRiFrntDataVld_Rv);
    }
}
/*@@end*/
 
/*@@envVar:E_pubc_GW_GW_1C2_EspReWhlIncTarTqActv_Rv:*/
on envVar E_pubc_GW_GW_1C2_EspReWhlIncTarTqActv_Rv
{
    int64 rawValue = 0ll;
    float rawValue_float = 0.0;
    float phyValue = 0.0;        

    //set the signal with updated raw value
    if(getValue(E_pubc_GW_GW_1C2_EspReWhlIncTarTqActv_SetVt)==0)
    {
        rawValue = getvalue(this);
        if(chgEv_GW_1C2_EspReWhlIncTarTqActv == 0)
        {
            //type conversion to float
            rawValue_float = rawValue;        
            // raw to physical conversion
            phyValue = ((rawValue_float *1)+(0));
            putValue(E_pubc_GW_GW_1C2_EspReWhlIncTarTqActv_Pv, phyValue);
            chgEv_GW_1C2_EspReWhlIncTarTqActv = 1;
        }
        else
        {
            chgEv_GW_1C2_EspReWhlIncTarTqActv = 0;
        }    
        //update the signal value
        Msg_GW_1C2.EspReWhlIncTarTqActv=rawValue;        
    }                                                                           
}
/*@@end*/

/*@@envVar:E_pubc_GW_GW_1C2_EspReWhlIncTarTqActv_Pv:*/
on envVar E_pubc_GW_GW_1C2_EspReWhlIncTarTqActv_Pv
{
    int64 rawValue = 0ll;
    float phyValue = 0.0;
    
    //update the raw value with physical value 
    if(getValue(E_pubc_GW_GW_1C2_EspReWhlIncTarTqActv_SetVt)==0)
    {
        if(chgEv_GW_1C2_EspReWhlIncTarTqActv == 0)
        {
            phyValue = getvalue(this);
            // physical to raw conversion
            rawValue = ((phyValue -(0))/1);
            putValue(E_pubc_GW_GW_1C2_EspReWhlIncTarTqActv_Rv, rawValue);
            chgEv_GW_1C2_EspReWhlIncTarTqActv = 1;  
        }
        else
        {
            chgEv_GW_1C2_EspReWhlIncTarTqActv = 0;
        }
    }
}
/*@@end*/

/*@@envVar:E_pubc_GW_GW_1C2_EspReWhlIncTarTqActv_Vt:*/
on envVar E_pubc_GW_GW_1C2_EspReWhlIncTarTqActv_Vt
{
    qword rawValue = 0ll;
    if(getValue(E_pubc_GW_GW_1C2_EspReWhlIncTarTqActv_SetVt))
    {
        //update the signal value
        Msg_GW_1C2.EspReWhlIncTarTqActv=getValue(this);
    }
}
/*@@end*/

/*@@envVar:E_pubc_GW_GW_1C2_EspReWhlIncTarTqActv_SetVt:*/
on envVar E_pubc_GW_GW_1C2_EspReWhlIncTarTqActv_SetVt
{
    if(getValue(E_pubc_GW_GW_1C2_EspReWhlIncTarTqActv_SetVt))
    {
        //update the signal value
        Msg_GW_1C2.EspReWhlIncTarTqActv=getvalue(E_pubc_GW_GW_1C2_EspReWhlIncTarTqActv_Vt);
    }
    else
    {
        Msg_GW_1C2.EspReWhlIncTarTqActv=getValue(E_pubc_GW_GW_1C2_EspReWhlIncTarTqActv_Rv);
    }
}
/*@@end*/
 
/*@@envVar:E_pubc_GW_GW_1C2_EspLgtAccelVld_Rv:*/
on envVar E_pubc_GW_GW_1C2_EspLgtAccelVld_Rv
{
    int64 rawValue = 0ll;
    float rawValue_float = 0.0;
    float phyValue = 0.0;        

    //set the signal with updated raw value
    if(getValue(E_pubc_GW_GW_1C2_EspLgtAccelVld_SetVt)==0)
    {
        rawValue = getvalue(this);
        if(chgEv_GW_1C2_EspLgtAccelVld == 0)
        {
            //type conversion to float
            rawValue_float = rawValue;        
            // raw to physical conversion
            phyValue = ((rawValue_float *1)+(0));
            putValue(E_pubc_GW_GW_1C2_EspLgtAccelVld_Pv, phyValue);
            chgEv_GW_1C2_EspLgtAccelVld = 1;
        }
        else
        {
            chgEv_GW_1C2_EspLgtAccelVld = 0;
        }    
        //update the signal value
        Msg_GW_1C2.EspLgtAccelVld=rawValue;        
    }                                                                           
}
/*@@end*/

/*@@envVar:E_pubc_GW_GW_1C2_EspLgtAccelVld_Pv:*/
on envVar E_pubc_GW_GW_1C2_EspLgtAccelVld_Pv
{
    int64 rawValue = 0ll;
    float phyValue = 0.0;
    
    //update the raw value with physical value 
    if(getValue(E_pubc_GW_GW_1C2_EspLgtAccelVld_SetVt)==0)
    {
        if(chgEv_GW_1C2_EspLgtAccelVld == 0)
        {
            phyValue = getvalue(this);
            // physical to raw conversion
            rawValue = ((phyValue -(0))/1);
            putValue(E_pubc_GW_GW_1C2_EspLgtAccelVld_Rv, rawValue);
            chgEv_GW_1C2_EspLgtAccelVld = 1;  
        }
        else
        {
            chgEv_GW_1C2_EspLgtAccelVld = 0;
        }
    }
}
/*@@end*/

/*@@envVar:E_pubc_GW_GW_1C2_EspLgtAccelVld_Vt:*/
on envVar E_pubc_GW_GW_1C2_EspLgtAccelVld_Vt
{
    qword rawValue = 0ll;
    if(getValue(E_pubc_GW_GW_1C2_EspLgtAccelVld_SetVt))
    {
        //update the signal value
        Msg_GW_1C2.EspLgtAccelVld=getValue(this);
    }
}
/*@@end*/

/*@@envVar:E_pubc_GW_GW_1C2_EspLgtAccelVld_SetVt:*/
on envVar E_pubc_GW_GW_1C2_EspLgtAccelVld_SetVt
{
    if(getValue(E_pubc_GW_GW_1C2_EspLgtAccelVld_SetVt))
    {
        //update the signal value
        Msg_GW_1C2.EspLgtAccelVld=getvalue(E_pubc_GW_GW_1C2_EspLgtAccelVld_Vt);
    }
    else
    {
        Msg_GW_1C2.EspLgtAccelVld=getValue(E_pubc_GW_GW_1C2_EspLgtAccelVld_Rv);
    }
}
/*@@end*/
 
/*@@envVar:E_pubc_GW_GW_1C2_WhlSpdReLePls_Rv:*/
on envVar E_pubc_GW_GW_1C2_WhlSpdReLePls_Rv
{
    int64 rawValue = 0ll;
    float rawValue_float = 0.0;
    float phyValue = 0.0;        

    //set the signal with updated raw value
    {
        rawValue = getvalue(this);
        if(chgEv_GW_1C2_WhlSpdReLePls == 0)
        {
            //type conversion to float
            rawValue_float = rawValue;        
            // raw to physical conversion
            phyValue = ((rawValue_float *1)+(0));
            putValue(E_pubc_GW_GW_1C2_WhlSpdReLePls_Pv, phyValue);
            chgEv_GW_1C2_WhlSpdReLePls = 1;
        }
        else
        {
            chgEv_GW_1C2_WhlSpdReLePls = 0;
        }    
        //update the signal value
        Msg_GW_1C2.WhlSpdReLePls=rawValue;        
    }                                                                           
}
/*@@end*/

/*@@envVar:E_pubc_GW_GW_1C2_WhlSpdReLePls_Pv:*/
on envVar E_pubc_GW_GW_1C2_WhlSpdReLePls_Pv
{
    int64 rawValue = 0ll;
    float phyValue = 0.0;
    
    //update the raw value with physical value 
    {
        if(chgEv_GW_1C2_WhlSpdReLePls == 0)
        {
            phyValue = getvalue(this);
            // physical to raw conversion
            rawValue = ((phyValue -(0))/1);
            putValue(E_pubc_GW_GW_1C2_WhlSpdReLePls_Rv, rawValue);
            chgEv_GW_1C2_WhlSpdReLePls = 1;  
        }
        else
        {
            chgEv_GW_1C2_WhlSpdReLePls = 0;
        }
    }
}
/*@@end*/


 
/*@@envVar:E_pubc_GW_GW_1C2_EspTcsFailr_Rv:*/
on envVar E_pubc_GW_GW_1C2_EspTcsFailr_Rv
{
    int64 rawValue = 0ll;
    float rawValue_float = 0.0;
    float phyValue = 0.0;        

    //set the signal with updated raw value
    if(getValue(E_pubc_GW_GW_1C2_EspTcsFailr_SetVt)==0)
    {
        rawValue = getvalue(this);
        if(chgEv_GW_1C2_EspTcsFailr == 0)
        {
            //type conversion to float
            rawValue_float = rawValue;        
            // raw to physical conversion
            phyValue = ((rawValue_float *1)+(0));
            putValue(E_pubc_GW_GW_1C2_EspTcsFailr_Pv, phyValue);
            chgEv_GW_1C2_EspTcsFailr = 1;
        }
        else
        {
            chgEv_GW_1C2_EspTcsFailr = 0;
        }    
        //update the signal value
        Msg_GW_1C2.EspTcsFailr=rawValue;        
    }                                                                           
}
/*@@end*/

/*@@envVar:E_pubc_GW_GW_1C2_EspTcsFailr_Pv:*/
on envVar E_pubc_GW_GW_1C2_EspTcsFailr_Pv
{
    int64 rawValue = 0ll;
    float phyValue = 0.0;
    
    //update the raw value with physical value 
    if(getValue(E_pubc_GW_GW_1C2_EspTcsFailr_SetVt)==0)
    {
        if(chgEv_GW_1C2_EspTcsFailr == 0)
        {
            phyValue = getvalue(this);
            // physical to raw conversion
            rawValue = ((phyValue -(0))/1);
            putValue(E_pubc_GW_GW_1C2_EspTcsFailr_Rv, rawValue);
            chgEv_GW_1C2_EspTcsFailr = 1;  
        }
        else
        {
            chgEv_GW_1C2_EspTcsFailr = 0;
        }
    }
}
/*@@end*/

/*@@envVar:E_pubc_GW_GW_1C2_EspTcsFailr_Vt:*/
on envVar E_pubc_GW_GW_1C2_EspTcsFailr_Vt
{
    qword rawValue = 0ll;
    if(getValue(E_pubc_GW_GW_1C2_EspTcsFailr_SetVt))
    {
        //update the signal value
        Msg_GW_1C2.EspTcsFailr=getValue(this);
    }
}
/*@@end*/

/*@@envVar:E_pubc_GW_GW_1C2_EspTcsFailr_SetVt:*/
on envVar E_pubc_GW_GW_1C2_EspTcsFailr_SetVt
{
    if(getValue(E_pubc_GW_GW_1C2_EspTcsFailr_SetVt))
    {
        //update the signal value
        Msg_GW_1C2.EspTcsFailr=getvalue(E_pubc_GW_GW_1C2_EspTcsFailr_Vt);
    }
    else
    {
        Msg_GW_1C2.EspTcsFailr=getValue(E_pubc_GW_GW_1C2_EspTcsFailr_Rv);
    }
}
/*@@end*/
 
/*@@envVar:E_pubc_GW_GW_1C2_EspAbsFailr_Rv:*/
on envVar E_pubc_GW_GW_1C2_EspAbsFailr_Rv
{
    int64 rawValue = 0ll;
    float rawValue_float = 0.0;
    float phyValue = 0.0;        

    //set the signal with updated raw value
    if(getValue(E_pubc_GW_GW_1C2_EspAbsFailr_SetVt)==0)
    {
        rawValue = getvalue(this);
        if(chgEv_GW_1C2_EspAbsFailr == 0)
        {
            //type conversion to float
            rawValue_float = rawValue;        
            // raw to physical conversion
            phyValue = ((rawValue_float *1)+(0));
            putValue(E_pubc_GW_GW_1C2_EspAbsFailr_Pv, phyValue);
            chgEv_GW_1C2_EspAbsFailr = 1;
        }
        else
        {
            chgEv_GW_1C2_EspAbsFailr = 0;
        }    
        //update the signal value
        Msg_GW_1C2.EspAbsFailr=rawValue;        
    }                                                                           
}
/*@@end*/

/*@@envVar:E_pubc_GW_GW_1C2_EspAbsFailr_Pv:*/
on envVar E_pubc_GW_GW_1C2_EspAbsFailr_Pv
{
    int64 rawValue = 0ll;
    float phyValue = 0.0;
    
    //update the raw value with physical value 
    if(getValue(E_pubc_GW_GW_1C2_EspAbsFailr_SetVt)==0)
    {
        if(chgEv_GW_1C2_EspAbsFailr == 0)
        {
            phyValue = getvalue(this);
            // physical to raw conversion
            rawValue = ((phyValue -(0))/1);
            putValue(E_pubc_GW_GW_1C2_EspAbsFailr_Rv, rawValue);
            chgEv_GW_1C2_EspAbsFailr = 1;  
        }
        else
        {
            chgEv_GW_1C2_EspAbsFailr = 0;
        }
    }
}
/*@@end*/

/*@@envVar:E_pubc_GW_GW_1C2_EspAbsFailr_Vt:*/
on envVar E_pubc_GW_GW_1C2_EspAbsFailr_Vt
{
    qword rawValue = 0ll;
    if(getValue(E_pubc_GW_GW_1C2_EspAbsFailr_SetVt))
    {
        //update the signal value
        Msg_GW_1C2.EspAbsFailr=getValue(this);
    }
}
/*@@end*/

/*@@envVar:E_pubc_GW_GW_1C2_EspAbsFailr_SetVt:*/
on envVar E_pubc_GW_GW_1C2_EspAbsFailr_SetVt
{
    if(getValue(E_pubc_GW_GW_1C2_EspAbsFailr_SetVt))
    {
        //update the signal value
        Msg_GW_1C2.EspAbsFailr=getvalue(E_pubc_GW_GW_1C2_EspAbsFailr_Vt);
    }
    else
    {
        Msg_GW_1C2.EspAbsFailr=getValue(E_pubc_GW_GW_1C2_EspAbsFailr_Rv);
    }
}
/*@@end*/
 
/*@@envVar:E_pubc_GW_GW_1C2_EspMstCylBrkP_Rv:*/
on envVar E_pubc_GW_GW_1C2_EspMstCylBrkP_Rv
{
    int64 rawValue = 0ll;
    float rawValue_float = 0.0;
    float phyValue = 0.0;        

    //set the signal with updated raw value
    {
        rawValue = getvalue(this);
        if(chgEv_GW_1C2_EspMstCylBrkP == 0)
        {
            //type conversion to float
            rawValue_float = rawValue;        
            // raw to physical conversion
            phyValue = ((rawValue_float *0.1)+(0));
            putValue(E_pubc_GW_GW_1C2_EspMstCylBrkP_Pv, phyValue);
            chgEv_GW_1C2_EspMstCylBrkP = 1;
        }
        else
        {
            chgEv_GW_1C2_EspMstCylBrkP = 0;
        }    
        //update the signal value
        Msg_GW_1C2.EspMstCylBrkP=rawValue;        
    }                                                                           
}
/*@@end*/

/*@@envVar:E_pubc_GW_GW_1C2_EspMstCylBrkP_Pv:*/
on envVar E_pubc_GW_GW_1C2_EspMstCylBrkP_Pv
{
    int64 rawValue = 0ll;
    float phyValue = 0.0;
    
    //update the raw value with physical value 
    {
        if(chgEv_GW_1C2_EspMstCylBrkP == 0)
        {
            phyValue = getvalue(this);
            // physical to raw conversion
            rawValue = ((phyValue -(0))/0.1);
            putValue(E_pubc_GW_GW_1C2_EspMstCylBrkP_Rv, rawValue);
            chgEv_GW_1C2_EspMstCylBrkP = 1;  
        }
        else
        {
            chgEv_GW_1C2_EspMstCylBrkP = 0;
        }
    }
}
/*@@end*/


 
/*@@envVar:E_pubc_GW_GW_1C2_EspFctOpenSts_Rv:*/
on envVar E_pubc_GW_GW_1C2_EspFctOpenSts_Rv
{
    int64 rawValue = 0ll;
    float rawValue_float = 0.0;
    float phyValue = 0.0;        

    //set the signal with updated raw value
    if(getValue(E_pubc_GW_GW_1C2_EspFctOpenSts_SetVt)==0)
    {
        rawValue = getvalue(this);
        if(chgEv_GW_1C2_EspFctOpenSts == 0)
        {
            //type conversion to float
            rawValue_float = rawValue;        
            // raw to physical conversion
            phyValue = ((rawValue_float *1)+(0));
            putValue(E_pubc_GW_GW_1C2_EspFctOpenSts_Pv, phyValue);
            chgEv_GW_1C2_EspFctOpenSts = 1;
        }
        else
        {
            chgEv_GW_1C2_EspFctOpenSts = 0;
        }    
        //update the signal value
        Msg_GW_1C2.EspFctOpenSts=rawValue;        
    }                                                                           
}
/*@@end*/

/*@@envVar:E_pubc_GW_GW_1C2_EspFctOpenSts_Pv:*/
on envVar E_pubc_GW_GW_1C2_EspFctOpenSts_Pv
{
    int64 rawValue = 0ll;
    float phyValue = 0.0;
    
    //update the raw value with physical value 
    if(getValue(E_pubc_GW_GW_1C2_EspFctOpenSts_SetVt)==0)
    {
        if(chgEv_GW_1C2_EspFctOpenSts == 0)
        {
            phyValue = getvalue(this);
            // physical to raw conversion
            rawValue = ((phyValue -(0))/1);
            putValue(E_pubc_GW_GW_1C2_EspFctOpenSts_Rv, rawValue);
            chgEv_GW_1C2_EspFctOpenSts = 1;  
        }
        else
        {
            chgEv_GW_1C2_EspFctOpenSts = 0;
        }
    }
}
/*@@end*/

/*@@envVar:E_pubc_GW_GW_1C2_EspFctOpenSts_Vt:*/
on envVar E_pubc_GW_GW_1C2_EspFctOpenSts_Vt
{
    qword rawValue = 0ll;
    if(getValue(E_pubc_GW_GW_1C2_EspFctOpenSts_SetVt))
    {
        //update the signal value
        Msg_GW_1C2.EspFctOpenSts=getValue(this);
    }
}
/*@@end*/

/*@@envVar:E_pubc_GW_GW_1C2_EspFctOpenSts_SetVt:*/
on envVar E_pubc_GW_GW_1C2_EspFctOpenSts_SetVt
{
    if(getValue(E_pubc_GW_GW_1C2_EspFctOpenSts_SetVt))
    {
        //update the signal value
        Msg_GW_1C2.EspFctOpenSts=getvalue(E_pubc_GW_GW_1C2_EspFctOpenSts_Vt);
    }
    else
    {
        Msg_GW_1C2.EspFctOpenSts=getValue(E_pubc_GW_GW_1C2_EspFctOpenSts_Rv);
    }
}
/*@@end*/
 
/*@@envVar:E_pubc_GW_GW_1C2_EspReWhlIncTarTq_Rv:*/
on envVar E_pubc_GW_GW_1C2_EspReWhlIncTarTq_Rv
{
    int64 rawValue = 0ll;
    float rawValue_float = 0.0;
    float phyValue = 0.0;        

    //set the signal with updated raw value
    {
        rawValue = getvalue(this);
        if(chgEv_GW_1C2_EspReWhlIncTarTq == 0)
        {
            //type conversion to float
            rawValue_float = rawValue;        
            // raw to physical conversion
            phyValue = ((rawValue_float *1)+(-32768));
            putValue(E_pubc_GW_GW_1C2_EspReWhlIncTarTq_Pv, phyValue);
            chgEv_GW_1C2_EspReWhlIncTarTq = 1;
        }
        else
        {
            chgEv_GW_1C2_EspReWhlIncTarTq = 0;
        }    
        //update the signal value
        Msg_GW_1C2.EspReWhlIncTarTq=rawValue;        
    }                                                                           
}
/*@@end*/

/*@@envVar:E_pubc_GW_GW_1C2_EspReWhlIncTarTq_Pv:*/
on envVar E_pubc_GW_GW_1C2_EspReWhlIncTarTq_Pv
{
    int64 rawValue = 0ll;
    float phyValue = 0.0;
    
    //update the raw value with physical value 
    {
        if(chgEv_GW_1C2_EspReWhlIncTarTq == 0)
        {
            phyValue = getvalue(this);
            // physical to raw conversion
            rawValue = ((phyValue -(-32768))/1);
            putValue(E_pubc_GW_GW_1C2_EspReWhlIncTarTq_Rv, rawValue);
            chgEv_GW_1C2_EspReWhlIncTarTq = 1;  
        }
        else
        {
            chgEv_GW_1C2_EspReWhlIncTarTq = 0;
        }
    }
}
/*@@end*/


 
/*@@envVar:E_pubc_GW_GW_1C2_EspYawAgSpd_Rv:*/
on envVar E_pubc_GW_GW_1C2_EspYawAgSpd_Rv
{
    int64 rawValue = 0ll;
    float rawValue_float = 0.0;
    float phyValue = 0.0;        

    //set the signal with updated raw value
    {
        rawValue = getvalue(this);
        if(chgEv_GW_1C2_EspYawAgSpd == 0)
        {
            //type conversion to float
            rawValue_float = rawValue;        
            // raw to physical conversion
            phyValue = ((rawValue_float *0.01)+(-81.91));
            putValue(E_pubc_GW_GW_1C2_EspYawAgSpd_Pv, phyValue);
            chgEv_GW_1C2_EspYawAgSpd = 1;
        }
        else
        {
            chgEv_GW_1C2_EspYawAgSpd = 0;
        }    
        //update the signal value
        Msg_GW_1C2.EspYawAgSpd=rawValue;        
    }                                                                           
}
/*@@end*/

/*@@envVar:E_pubc_GW_GW_1C2_EspYawAgSpd_Pv:*/
on envVar E_pubc_GW_GW_1C2_EspYawAgSpd_Pv
{
    int64 rawValue = 0ll;
    float phyValue = 0.0;
    
    //update the raw value with physical value 
    {
        if(chgEv_GW_1C2_EspYawAgSpd == 0)
        {
            phyValue = getvalue(this);
            // physical to raw conversion
            rawValue = ((phyValue -(-81.91))/0.01);
            putValue(E_pubc_GW_GW_1C2_EspYawAgSpd_Rv, rawValue);
            chgEv_GW_1C2_EspYawAgSpd = 1;  
        }
        else
        {
            chgEv_GW_1C2_EspYawAgSpd = 0;
        }
    }
}
/*@@end*/


 
/*@@envVar:E_pubc_GW_GW_1C2_EspActvSts_Rv:*/
on envVar E_pubc_GW_GW_1C2_EspActvSts_Rv
{
    int64 rawValue = 0ll;
    float rawValue_float = 0.0;
    float phyValue = 0.0;        

    //set the signal with updated raw value
    if(getValue(E_pubc_GW_GW_1C2_EspActvSts_SetVt)==0)
    {
        rawValue = getvalue(this);
        if(chgEv_GW_1C2_EspActvSts == 0)
        {
            //type conversion to float
            rawValue_float = rawValue;        
            // raw to physical conversion
            phyValue = ((rawValue_float *1)+(0));
            putValue(E_pubc_GW_GW_1C2_EspActvSts_Pv, phyValue);
            chgEv_GW_1C2_EspActvSts = 1;
        }
        else
        {
            chgEv_GW_1C2_EspActvSts = 0;
        }    
        //update the signal value
        Msg_GW_1C2.EspActvSts=rawValue;        
    }                                                                           
}
/*@@end*/

/*@@envVar:E_pubc_GW_GW_1C2_EspActvSts_Pv:*/
on envVar E_pubc_GW_GW_1C2_EspActvSts_Pv
{
    int64 rawValue = 0ll;
    float phyValue = 0.0;
    
    //update the raw value with physical value 
    if(getValue(E_pubc_GW_GW_1C2_EspActvSts_SetVt)==0)
    {
        if(chgEv_GW_1C2_EspActvSts == 0)
        {
            phyValue = getvalue(this);
            // physical to raw conversion
            rawValue = ((phyValue -(0))/1);
            putValue(E_pubc_GW_GW_1C2_EspActvSts_Rv, rawValue);
            chgEv_GW_1C2_EspActvSts = 1;  
        }
        else
        {
            chgEv_GW_1C2_EspActvSts = 0;
        }
    }
}
/*@@end*/

/*@@envVar:E_pubc_GW_GW_1C2_EspActvSts_Vt:*/
on envVar E_pubc_GW_GW_1C2_EspActvSts_Vt
{
    qword rawValue = 0ll;
    if(getValue(E_pubc_GW_GW_1C2_EspActvSts_SetVt))
    {
        //update the signal value
        Msg_GW_1C2.EspActvSts=getValue(this);
    }
}
/*@@end*/

/*@@envVar:E_pubc_GW_GW_1C2_EspActvSts_SetVt:*/
on envVar E_pubc_GW_GW_1C2_EspActvSts_SetVt
{
    if(getValue(E_pubc_GW_GW_1C2_EspActvSts_SetVt))
    {
        //update the signal value
        Msg_GW_1C2.EspActvSts=getvalue(E_pubc_GW_GW_1C2_EspActvSts_Vt);
    }
    else
    {
        Msg_GW_1C2.EspActvSts=getValue(E_pubc_GW_GW_1C2_EspActvSts_Rv);
    }
}
/*@@end*/
 
/*@@envVar:E_pubc_GW_GW_1C2_EspVehSpd_Rv:*/
on envVar E_pubc_GW_GW_1C2_EspVehSpd_Rv
{
    int64 rawValue = 0ll;
    float rawValue_float = 0.0;
    float phyValue = 0.0;        

    //set the signal with updated raw value
    {
        rawValue = getvalue(this);
        if(chgEv_GW_1C2_EspVehSpd == 0)
        {
            //type conversion to float
            rawValue_float = rawValue;        
            // raw to physical conversion
            phyValue = ((rawValue_float *0.05625)+(0));
            putValue(E_pubc_GW_GW_1C2_EspVehSpd_Pv, phyValue);
            chgEv_GW_1C2_EspVehSpd = 1;
        }
        else
        {
            chgEv_GW_1C2_EspVehSpd = 0;
        }    
        //update the signal value
        Msg_GW_1C2.EspVehSpd=rawValue;        
    }                                                                           
}
/*@@end*/

/*@@envVar:E_pubc_GW_GW_1C2_EspVehSpd_Pv:*/
on envVar E_pubc_GW_GW_1C2_EspVehSpd_Pv
{
    int64 rawValue = 0ll;
    float phyValue = 0.0;
    
    //update the raw value with physical value 
    {
        if(chgEv_GW_1C2_EspVehSpd == 0)
        {
            phyValue = getvalue(this);
            // physical to raw conversion
            rawValue = ((phyValue -(0))/0.05625);
            putValue(E_pubc_GW_GW_1C2_EspVehSpd_Rv, rawValue);
            chgEv_GW_1C2_EspVehSpd = 1;  
        }
        else
        {
            chgEv_GW_1C2_EspVehSpd = 0;
        }
    }
}
/*@@end*/


 
/*@@envVar:E_pubc_GW_GW_1C2_EspVehSpdVld_Rv:*/
on envVar E_pubc_GW_GW_1C2_EspVehSpdVld_Rv
{
    int64 rawValue = 0ll;
    float rawValue_float = 0.0;
    float phyValue = 0.0;        

    //set the signal with updated raw value
    if(getValue(E_pubc_GW_GW_1C2_EspVehSpdVld_SetVt)==0)
    {
        rawValue = getvalue(this);
        if(chgEv_GW_1C2_EspVehSpdVld == 0)
        {
            //type conversion to float
            rawValue_float = rawValue;        
            // raw to physical conversion
            phyValue = ((rawValue_float *1)+(0));
            putValue(E_pubc_GW_GW_1C2_EspVehSpdVld_Pv, phyValue);
            chgEv_GW_1C2_EspVehSpdVld = 1;
        }
        else
        {
            chgEv_GW_1C2_EspVehSpdVld = 0;
        }    
        //update the signal value
        Msg_GW_1C2.EspVehSpdVld=rawValue;        
    }                                                                           
}
/*@@end*/

/*@@envVar:E_pubc_GW_GW_1C2_EspVehSpdVld_Pv:*/
on envVar E_pubc_GW_GW_1C2_EspVehSpdVld_Pv
{
    int64 rawValue = 0ll;
    float phyValue = 0.0;
    
    //update the raw value with physical value 
    if(getValue(E_pubc_GW_GW_1C2_EspVehSpdVld_SetVt)==0)
    {
        if(chgEv_GW_1C2_EspVehSpdVld == 0)
        {
            phyValue = getvalue(this);
            // physical to raw conversion
            rawValue = ((phyValue -(0))/1);
            putValue(E_pubc_GW_GW_1C2_EspVehSpdVld_Rv, rawValue);
            chgEv_GW_1C2_EspVehSpdVld = 1;  
        }
        else
        {
            chgEv_GW_1C2_EspVehSpdVld = 0;
        }
    }
}
/*@@end*/

/*@@envVar:E_pubc_GW_GW_1C2_EspVehSpdVld_Vt:*/
on envVar E_pubc_GW_GW_1C2_EspVehSpdVld_Vt
{
    qword rawValue = 0ll;
    if(getValue(E_pubc_GW_GW_1C2_EspVehSpdVld_SetVt))
    {
        //update the signal value
        Msg_GW_1C2.EspVehSpdVld=getValue(this);
    }
}
/*@@end*/

/*@@envVar:E_pubc_GW_GW_1C2_EspVehSpdVld_SetVt:*/
on envVar E_pubc_GW_GW_1C2_EspVehSpdVld_SetVt
{
    if(getValue(E_pubc_GW_GW_1C2_EspVehSpdVld_SetVt))
    {
        //update the signal value
        Msg_GW_1C2.EspVehSpdVld=getvalue(E_pubc_GW_GW_1C2_EspVehSpdVld_Vt);
    }
    else
    {
        Msg_GW_1C2.EspVehSpdVld=getValue(E_pubc_GW_GW_1C2_EspVehSpdVld_Rv);
    }
}
/*@@end*/
 
/*@@envVar:E_pubc_GW_GW_1C2_WhlSpdLeReDir_Rv:*/
on envVar E_pubc_GW_GW_1C2_WhlSpdLeReDir_Rv
{
    int64 rawValue = 0ll;
    float rawValue_float = 0.0;
    float phyValue = 0.0;        

    //set the signal with updated raw value
    if(getValue(E_pubc_GW_GW_1C2_WhlSpdLeReDir_SetVt)==0)
    {
        rawValue = getvalue(this);
        if(chgEv_GW_1C2_WhlSpdLeReDir == 0)
        {
            //type conversion to float
            rawValue_float = rawValue;        
            // raw to physical conversion
            phyValue = ((rawValue_float *1)+(0));
            putValue(E_pubc_GW_GW_1C2_WhlSpdLeReDir_Pv, phyValue);
            chgEv_GW_1C2_WhlSpdLeReDir = 1;
        }
        else
        {
            chgEv_GW_1C2_WhlSpdLeReDir = 0;
        }    
        //update the signal value
        Msg_GW_1C2.WhlSpdLeReDir=rawValue;        
    }                                                                           
}
/*@@end*/

/*@@envVar:E_pubc_GW_GW_1C2_WhlSpdLeReDir_Pv:*/
on envVar E_pubc_GW_GW_1C2_WhlSpdLeReDir_Pv
{
    int64 rawValue = 0ll;
    float phyValue = 0.0;
    
    //update the raw value with physical value 
    if(getValue(E_pubc_GW_GW_1C2_WhlSpdLeReDir_SetVt)==0)
    {
        if(chgEv_GW_1C2_WhlSpdLeReDir == 0)
        {
            phyValue = getvalue(this);
            // physical to raw conversion
            rawValue = ((phyValue -(0))/1);
            putValue(E_pubc_GW_GW_1C2_WhlSpdLeReDir_Rv, rawValue);
            chgEv_GW_1C2_WhlSpdLeReDir = 1;  
        }
        else
        {
            chgEv_GW_1C2_WhlSpdLeReDir = 0;
        }
    }
}
/*@@end*/

/*@@envVar:E_pubc_GW_GW_1C2_WhlSpdLeReDir_Vt:*/
on envVar E_pubc_GW_GW_1C2_WhlSpdLeReDir_Vt
{
    qword rawValue = 0ll;
    if(getValue(E_pubc_GW_GW_1C2_WhlSpdLeReDir_SetVt))
    {
        //update the signal value
        Msg_GW_1C2.WhlSpdLeReDir=getValue(this);
    }
}
/*@@end*/

/*@@envVar:E_pubc_GW_GW_1C2_WhlSpdLeReDir_SetVt:*/
on envVar E_pubc_GW_GW_1C2_WhlSpdLeReDir_SetVt
{
    if(getValue(E_pubc_GW_GW_1C2_WhlSpdLeReDir_SetVt))
    {
        //update the signal value
        Msg_GW_1C2.WhlSpdLeReDir=getvalue(E_pubc_GW_GW_1C2_WhlSpdLeReDir_Vt);
    }
    else
    {
        Msg_GW_1C2.WhlSpdLeReDir=getValue(E_pubc_GW_GW_1C2_WhlSpdLeReDir_Rv);
    }
}
/*@@end*/
 
/*@@envVar:E_pubc_GW_GW_1C2_WhlSpdLeFrntDir_Rv:*/
on envVar E_pubc_GW_GW_1C2_WhlSpdLeFrntDir_Rv
{
    int64 rawValue = 0ll;
    float rawValue_float = 0.0;
    float phyValue = 0.0;        

    //set the signal with updated raw value
    if(getValue(E_pubc_GW_GW_1C2_WhlSpdLeFrntDir_SetVt)==0)
    {
        rawValue = getvalue(this);
        if(chgEv_GW_1C2_WhlSpdLeFrntDir == 0)
        {
            //type conversion to float
            rawValue_float = rawValue;        
            // raw to physical conversion
            phyValue = ((rawValue_float *1)+(0));
            putValue(E_pubc_GW_GW_1C2_WhlSpdLeFrntDir_Pv, phyValue);
            chgEv_GW_1C2_WhlSpdLeFrntDir = 1;
        }
        else
        {
            chgEv_GW_1C2_WhlSpdLeFrntDir = 0;
        }    
        //update the signal value
        Msg_GW_1C2.WhlSpdLeFrntDir=rawValue;        
    }                                                                           
}
/*@@end*/

/*@@envVar:E_pubc_GW_GW_1C2_WhlSpdLeFrntDir_Pv:*/
on envVar E_pubc_GW_GW_1C2_WhlSpdLeFrntDir_Pv
{
    int64 rawValue = 0ll;
    float phyValue = 0.0;
    
    //update the raw value with physical value 
    if(getValue(E_pubc_GW_GW_1C2_WhlSpdLeFrntDir_SetVt)==0)
    {
        if(chgEv_GW_1C2_WhlSpdLeFrntDir == 0)
        {
            phyValue = getvalue(this);
            // physical to raw conversion
            rawValue = ((phyValue -(0))/1);
            putValue(E_pubc_GW_GW_1C2_WhlSpdLeFrntDir_Rv, rawValue);
            chgEv_GW_1C2_WhlSpdLeFrntDir = 1;  
        }
        else
        {
            chgEv_GW_1C2_WhlSpdLeFrntDir = 0;
        }
    }
}
/*@@end*/

/*@@envVar:E_pubc_GW_GW_1C2_WhlSpdLeFrntDir_Vt:*/
on envVar E_pubc_GW_GW_1C2_WhlSpdLeFrntDir_Vt
{
    qword rawValue = 0ll;
    if(getValue(E_pubc_GW_GW_1C2_WhlSpdLeFrntDir_SetVt))
    {
        //update the signal value
        Msg_GW_1C2.WhlSpdLeFrntDir=getValue(this);
    }
}
/*@@end*/

/*@@envVar:E_pubc_GW_GW_1C2_WhlSpdLeFrntDir_SetVt:*/
on envVar E_pubc_GW_GW_1C2_WhlSpdLeFrntDir_SetVt
{
    if(getValue(E_pubc_GW_GW_1C2_WhlSpdLeFrntDir_SetVt))
    {
        //update the signal value
        Msg_GW_1C2.WhlSpdLeFrntDir=getvalue(E_pubc_GW_GW_1C2_WhlSpdLeFrntDir_Vt);
    }
    else
    {
        Msg_GW_1C2.WhlSpdLeFrntDir=getValue(E_pubc_GW_GW_1C2_WhlSpdLeFrntDir_Rv);
    }
}
/*@@end*/
 
/*@@envVar:E_pubc_GW_GW_1C2_WhlSpdLeReData_Rv:*/
on envVar E_pubc_GW_GW_1C2_WhlSpdLeReData_Rv
{
    int64 rawValue = 0ll;
    float rawValue_float = 0.0;
    float phyValue = 0.0;        

    //set the signal with updated raw value
    {
        rawValue = getvalue(this);
        if(chgEv_GW_1C2_WhlSpdLeReData == 0)
        {
            //type conversion to float
            rawValue_float = rawValue;        
            // raw to physical conversion
            phyValue = ((rawValue_float *0.05625)+(0));
            putValue(E_pubc_GW_GW_1C2_WhlSpdLeReData_Pv, phyValue);
            chgEv_GW_1C2_WhlSpdLeReData = 1;
        }
        else
        {
            chgEv_GW_1C2_WhlSpdLeReData = 0;
        }    
        //update the signal value
        Msg_GW_1C2.WhlSpdLeReData=rawValue;        
    }                                                                           
}
/*@@end*/

/*@@envVar:E_pubc_GW_GW_1C2_WhlSpdLeReData_Pv:*/
on envVar E_pubc_GW_GW_1C2_WhlSpdLeReData_Pv
{
    int64 rawValue = 0ll;
    float phyValue = 0.0;
    
    //update the raw value with physical value 
    {
        if(chgEv_GW_1C2_WhlSpdLeReData == 0)
        {
            phyValue = getvalue(this);
            // physical to raw conversion
            rawValue = ((phyValue -(0))/0.05625);
            putValue(E_pubc_GW_GW_1C2_WhlSpdLeReData_Rv, rawValue);
            chgEv_GW_1C2_WhlSpdLeReData = 1;  
        }
        else
        {
            chgEv_GW_1C2_WhlSpdLeReData = 0;
        }
    }
}
/*@@end*/


 
/*@@envVar:E_pubc_GW_GW_24F_tx:*/
on envVar E_pubc_GW_GW_24F_tx
{
    if(getValue(this))
    {       
        
        //update the BZ Signal
        if(GW_24F_EPS_RollingCounter_24F_wrongvalctr == 0)
        {
            update_GW_24F_EPS_RollingCounter_24F_counter();
            Msg_GW_24F.EPS_RollingCounter_24F= GW_24F_EPS_RollingCounter_24F_counter;
        }
        else if(GW_24F_EPS_RollingCounter_24F_wrongvalctr > 0)
        {
			GW_24F_EPS_RollingCounter_24F_counter=GW_24F_EPS_RollingCounter_24F_counter + GW_24F_EPS_RollingCounter_24F_wrongvalctr;
			 Msg_GW_24F.EPS_RollingCounter_24F= GW_24F_EPS_RollingCounter_24F_counter;
            /* GW_24F_EPS_RollingCounter_24F_wrongvalctr--;
              // if counter becomes zero, update panel controller to zero
             if(GW_24F_EPS_RollingCounter_24F_wrongvalctr == 0)
             {
                 putValue(E_pubc_GW_GW_24F_EPS_RollingCounter_24F_wrongvalctr,0);
             } */
        }
        else
        { 
			// do nothing
        }    
        //calculate the CRC CheckSum
        update_GW_24F_CRC_CheckSum();

        output(Msg_GW_24F);        
    }
}
/*@@end*/

/*@@envVar:E_pubc_GW_GW_24F_Range:*/
on envVar E_pubc_GW_GW_24F_Range
{
    qword rawstatus = 0ll;
    qword rawValue = 0ll;    
    
    rawstatus = getvalue(this);    
    // set all the signals with min raw /max raw /init raw
    switch (rawstatus) 
    {
     case(0) :
        rawValue= 0;
        putValue(E_pubc_GW_GW_24F_EPS_TorqSensorStatus_Rv, rawValue);
        rawValue= 0;
        putValue(E_pubc_GW_GW_24F_EpsSteerModFb_Rv, rawValue);
        rawValue= 0;
        putValue(E_pubc_GW_GW_24F_EPS_SteeringTorque_Rv, rawValue);
        rawValue= 0;
        putValue(E_pubc_GW_GW_24F_EPS_IACC_abortreason_Rv, rawValue);
        rawValue= 0;
        putValue(E_pubc_GW_GW_24F_EpsFaild_Rv, rawValue);
        rawValue= 0;
        putValue(E_pubc_GW_GW_24F_EPS_ConcussAvailabilityStatus_Rv, rawValue);
        break;
     case(1) :
        rawValue= 1;
        putValue(E_pubc_GW_GW_24F_EPS_TorqSensorStatus_Rv, rawValue);
        rawValue= 3;
        putValue(E_pubc_GW_GW_24F_EpsSteerModFb_Rv, rawValue);
        rawValue= 253;
        putValue(E_pubc_GW_GW_24F_EPS_SteeringTorque_Rv, rawValue);
        rawValue= 7;
        putValue(E_pubc_GW_GW_24F_EPS_IACC_abortreason_Rv, rawValue);
        rawValue= 1;
        putValue(E_pubc_GW_GW_24F_EpsFaild_Rv, rawValue);
        rawValue= 3;
        putValue(E_pubc_GW_GW_24F_EPS_ConcussAvailabilityStatus_Rv, rawValue);
        break;
     default :
        rawValue= 0;
        putValue(E_pubc_GW_GW_24F_EPS_TorqSensorStatus_Rv, rawValue);
        rawValue= 0;
        putValue(E_pubc_GW_GW_24F_EpsSteerModFb_Rv, rawValue);
        rawValue= 0;
        putValue(E_pubc_GW_GW_24F_EPS_SteeringTorque_Rv, rawValue);
        rawValue= 0;
        putValue(E_pubc_GW_GW_24F_EPS_IACC_abortreason_Rv, rawValue);
        rawValue= 0;
        putValue(E_pubc_GW_GW_24F_EpsFaild_Rv, rawValue);
        rawValue= 0;
        putValue(E_pubc_GW_GW_24F_EPS_ConcussAvailabilityStatus_Rv, rawValue);
      break;
   }
}
/*@@end*/

/*@@envVar:E_pubc_GW_GW_24F_Dlc:*/
on envVar E_pubc_GW_GW_24F_Dlc
{
    if(getValue(E_pubc_GW_GW_24F_enDlc))
    {
        Msg_GW_24F.dlc =getValue(this);
    }
    else
    {
       Dbc_dlc = 8;
	   Msg_GW_24F.dlc = Calc_Canfd_dlc(Dbc_dlc);
	   // Msg_GW_24F.dlc = 8;
	   	
  }
}
/*@@end*/

/*@@envVar:E_pubc_GW_GW_24F_enDlc:*/
on envVar E_pubc_GW_GW_24F_enDlc
{
    //For Messages with DLC = 8, set wrong DLC to smaller than defined DLC
    //For Messages with DLC < 8 set wrong DLC to smaller/longer than defined DLC
    if(getValue(this))
    {
        Msg_GW_24F.dlc =getValue(E_pubc_GW_GW_24F_Dlc);
    }
    else
    {
       Dbc_dlc = 8;
	   Msg_GW_24F.dlc = Calc_Canfd_dlc(Dbc_dlc);
	   // Msg_GW_24F.dlc = 8;
    }
}
/*@@end*/

/*@@envVar:E_pubc_GW_GW_24F_EPS_CRCCheck_24F_wrongvalctr:*/
on envVar E_pubc_GW_GW_24F_EPS_CRCCheck_24F_wrongvalctr
{
    //update disturb count
    //disturb value range:(-1 = always send wrong value),( X>0 ,x is the number of Messages with wrong CHK sent)
    GW_24F_EPS_CRCCheck_24F_wrongvalctr =getValue(this);    
}
/*@@end*/
/*@@envVar:E_pubc_GW_GW_24F_EPS_RollingCounter_24F_wrongvalctr:*/
on envVar E_pubc_GW_GW_24F_EPS_RollingCounter_24F_wrongvalctr
{
    //update disturb count
    //disturb value range:(-1 = always send wrong value),( X>0 ,x is the number of Messages with wrong CHK sent)
    GW_24F_EPS_RollingCounter_24F_wrongvalctr =getValue(this);    
}
/*@@end*/

/*@@envVar:E_pubc_GW_GW_24F_EPS_TorqSensorStatus_Rv:*/
on envVar E_pubc_GW_GW_24F_EPS_TorqSensorStatus_Rv
{
    int64 rawValue = 0ll;
    float rawValue_float = 0.0;
    float phyValue = 0.0;        

    //set the signal with updated raw value
    if(getValue(E_pubc_GW_GW_24F_EPS_TorqSensorStatus_SetVt)==0)
    {
        rawValue = getvalue(this);
        if(chgEv_GW_24F_EPS_TorqSensorStatus == 0)
        {
            //type conversion to float
            rawValue_float = rawValue;        
            // raw to physical conversion
            phyValue = ((rawValue_float *1)+(0));
            putValue(E_pubc_GW_GW_24F_EPS_TorqSensorStatus_Pv, phyValue);
            chgEv_GW_24F_EPS_TorqSensorStatus = 1;
        }
        else
        {
            chgEv_GW_24F_EPS_TorqSensorStatus = 0;
        }    
        //update the signal value
        Msg_GW_24F.EPS_TorqSensorStatus=rawValue;        
    }                                                                           
}
/*@@end*/

/*@@envVar:E_pubc_GW_GW_24F_EPS_TorqSensorStatus_Pv:*/
on envVar E_pubc_GW_GW_24F_EPS_TorqSensorStatus_Pv
{
    int64 rawValue = 0ll;
    float phyValue = 0.0;
    
    //update the raw value with physical value 
    if(getValue(E_pubc_GW_GW_24F_EPS_TorqSensorStatus_SetVt)==0)
    {
        if(chgEv_GW_24F_EPS_TorqSensorStatus == 0)
        {
            phyValue = getvalue(this);
            // physical to raw conversion
            rawValue = ((phyValue -(0))/1);
            putValue(E_pubc_GW_GW_24F_EPS_TorqSensorStatus_Rv, rawValue);
            chgEv_GW_24F_EPS_TorqSensorStatus = 1;  
        }
        else
        {
            chgEv_GW_24F_EPS_TorqSensorStatus = 0;
        }
    }
}
/*@@end*/

/*@@envVar:E_pubc_GW_GW_24F_EPS_TorqSensorStatus_Vt:*/
on envVar E_pubc_GW_GW_24F_EPS_TorqSensorStatus_Vt
{
    qword rawValue = 0ll;
    if(getValue(E_pubc_GW_GW_24F_EPS_TorqSensorStatus_SetVt))
    {
        //update the signal value
        Msg_GW_24F.EPS_TorqSensorStatus=getValue(this);
    }
}
/*@@end*/

/*@@envVar:E_pubc_GW_GW_24F_EPS_TorqSensorStatus_SetVt:*/
on envVar E_pubc_GW_GW_24F_EPS_TorqSensorStatus_SetVt
{
    if(getValue(E_pubc_GW_GW_24F_EPS_TorqSensorStatus_SetVt))
    {
        //update the signal value
        Msg_GW_24F.EPS_TorqSensorStatus=getvalue(E_pubc_GW_GW_24F_EPS_TorqSensorStatus_Vt);
    }
    else
    {
        Msg_GW_24F.EPS_TorqSensorStatus=getValue(E_pubc_GW_GW_24F_EPS_TorqSensorStatus_Rv);
    }
}
/*@@end*/
 
/*@@envVar:E_pubc_GW_GW_24F_EpsSteerModFb_Rv:*/
on envVar E_pubc_GW_GW_24F_EpsSteerModFb_Rv
{
    int64 rawValue = 0ll;
    float rawValue_float = 0.0;
    float phyValue = 0.0;        

    //set the signal with updated raw value
    if(getValue(E_pubc_GW_GW_24F_EpsSteerModFb_SetVt)==0)
    {
        rawValue = getvalue(this);
        if(chgEv_GW_24F_EpsSteerModFb == 0)
        {
            //type conversion to float
            rawValue_float = rawValue;        
            // raw to physical conversion
            phyValue = ((rawValue_float *1)+(0));
            putValue(E_pubc_GW_GW_24F_EpsSteerModFb_Pv, phyValue);
            chgEv_GW_24F_EpsSteerModFb = 1;
        }
        else
        {
            chgEv_GW_24F_EpsSteerModFb = 0;
        }    
        //update the signal value
        Msg_GW_24F.EpsSteerModFb=rawValue;        
    }                                                                           
}
/*@@end*/

/*@@envVar:E_pubc_GW_GW_24F_EpsSteerModFb_Pv:*/
on envVar E_pubc_GW_GW_24F_EpsSteerModFb_Pv
{
    int64 rawValue = 0ll;
    float phyValue = 0.0;
    
    //update the raw value with physical value 
    if(getValue(E_pubc_GW_GW_24F_EpsSteerModFb_SetVt)==0)
    {
        if(chgEv_GW_24F_EpsSteerModFb == 0)
        {
            phyValue = getvalue(this);
            // physical to raw conversion
            rawValue = ((phyValue -(0))/1);
            putValue(E_pubc_GW_GW_24F_EpsSteerModFb_Rv, rawValue);
            chgEv_GW_24F_EpsSteerModFb = 1;  
        }
        else
        {
            chgEv_GW_24F_EpsSteerModFb = 0;
        }
    }
}
/*@@end*/

/*@@envVar:E_pubc_GW_GW_24F_EpsSteerModFb_Vt:*/
on envVar E_pubc_GW_GW_24F_EpsSteerModFb_Vt
{
    qword rawValue = 0ll;
    if(getValue(E_pubc_GW_GW_24F_EpsSteerModFb_SetVt))
    {
        //update the signal value
        Msg_GW_24F.EpsSteerModFb=getValue(this);
    }
}
/*@@end*/

/*@@envVar:E_pubc_GW_GW_24F_EpsSteerModFb_SetVt:*/
on envVar E_pubc_GW_GW_24F_EpsSteerModFb_SetVt
{
    if(getValue(E_pubc_GW_GW_24F_EpsSteerModFb_SetVt))
    {
        //update the signal value
        Msg_GW_24F.EpsSteerModFb=getvalue(E_pubc_GW_GW_24F_EpsSteerModFb_Vt);
    }
    else
    {
        Msg_GW_24F.EpsSteerModFb=getValue(E_pubc_GW_GW_24F_EpsSteerModFb_Rv);
    }
}
/*@@end*/
 
/*@@envVar:E_pubc_GW_GW_24F_EPS_SteeringTorque_Rv:*/
on envVar E_pubc_GW_GW_24F_EPS_SteeringTorque_Rv
{
    int64 rawValue = 0ll;
    float rawValue_float = 0.0;
    float phyValue = 0.0;        

    //set the signal with updated raw value
    {
        rawValue = getvalue(this);
        if(chgEv_GW_24F_EPS_SteeringTorque == 0)
        {
            //type conversion to float
            rawValue_float = rawValue;        
            // raw to physical conversion
            phyValue = ((rawValue_float *0.1794)+(-22.78));
            putValue(E_pubc_GW_GW_24F_EPS_SteeringTorque_Pv, phyValue);
            chgEv_GW_24F_EPS_SteeringTorque = 1;
        }
        else
        {
            chgEv_GW_24F_EPS_SteeringTorque = 0;
        }    
        //update the signal value
        Msg_GW_24F.EPS_SteeringTorque=rawValue;        
    }                                                                           
}
/*@@end*/

/*@@envVar:E_pubc_GW_GW_24F_EPS_SteeringTorque_Pv:*/
on envVar E_pubc_GW_GW_24F_EPS_SteeringTorque_Pv
{
    int64 rawValue = 0ll;
    float phyValue = 0.0;
    
    //update the raw value with physical value 
    {
        if(chgEv_GW_24F_EPS_SteeringTorque == 0)
        {
            phyValue = getvalue(this);
            // physical to raw conversion
            rawValue = ((phyValue -(-22.78))/0.1794);
            putValue(E_pubc_GW_GW_24F_EPS_SteeringTorque_Rv, rawValue);
            chgEv_GW_24F_EPS_SteeringTorque = 1;  
        }
        else
        {
            chgEv_GW_24F_EPS_SteeringTorque = 0;
        }
    }
}
/*@@end*/


 
/*@@envVar:E_pubc_GW_GW_24F_EPS_IACC_abortreason_Rv:*/
on envVar E_pubc_GW_GW_24F_EPS_IACC_abortreason_Rv
{
    int64 rawValue = 0ll;
    float rawValue_float = 0.0;
    float phyValue = 0.0;        

    //set the signal with updated raw value
    if(getValue(E_pubc_GW_GW_24F_EPS_IACC_abortreason_SetVt)==0)
    {
        rawValue = getvalue(this);
        if(chgEv_GW_24F_EPS_IACC_abortreason == 0)
        {
            //type conversion to float
            rawValue_float = rawValue;        
            // raw to physical conversion
            phyValue = ((rawValue_float *1)+(0));
            putValue(E_pubc_GW_GW_24F_EPS_IACC_abortreason_Pv, phyValue);
            chgEv_GW_24F_EPS_IACC_abortreason = 1;
        }
        else
        {
            chgEv_GW_24F_EPS_IACC_abortreason = 0;
        }    
        //update the signal value
        Msg_GW_24F.EPS_IACC_abortreason=rawValue;        
    }                                                                           
}
/*@@end*/

/*@@envVar:E_pubc_GW_GW_24F_EPS_IACC_abortreason_Pv:*/
on envVar E_pubc_GW_GW_24F_EPS_IACC_abortreason_Pv
{
    int64 rawValue = 0ll;
    float phyValue = 0.0;
    
    //update the raw value with physical value 
    if(getValue(E_pubc_GW_GW_24F_EPS_IACC_abortreason_SetVt)==0)
    {
        if(chgEv_GW_24F_EPS_IACC_abortreason == 0)
        {
            phyValue = getvalue(this);
            // physical to raw conversion
            rawValue = ((phyValue -(0))/1);
            putValue(E_pubc_GW_GW_24F_EPS_IACC_abortreason_Rv, rawValue);
            chgEv_GW_24F_EPS_IACC_abortreason = 1;  
        }
        else
        {
            chgEv_GW_24F_EPS_IACC_abortreason = 0;
        }
    }
}
/*@@end*/

/*@@envVar:E_pubc_GW_GW_24F_EPS_IACC_abortreason_Vt:*/
on envVar E_pubc_GW_GW_24F_EPS_IACC_abortreason_Vt
{
    qword rawValue = 0ll;
    if(getValue(E_pubc_GW_GW_24F_EPS_IACC_abortreason_SetVt))
    {
        //update the signal value
        Msg_GW_24F.EPS_IACC_abortreason=getValue(this);
    }
}
/*@@end*/

/*@@envVar:E_pubc_GW_GW_24F_EPS_IACC_abortreason_SetVt:*/
on envVar E_pubc_GW_GW_24F_EPS_IACC_abortreason_SetVt
{
    if(getValue(E_pubc_GW_GW_24F_EPS_IACC_abortreason_SetVt))
    {
        //update the signal value
        Msg_GW_24F.EPS_IACC_abortreason=getvalue(E_pubc_GW_GW_24F_EPS_IACC_abortreason_Vt);
    }
    else
    {
        Msg_GW_24F.EPS_IACC_abortreason=getValue(E_pubc_GW_GW_24F_EPS_IACC_abortreason_Rv);
    }
}
/*@@end*/
 
/*@@envVar:E_pubc_GW_GW_24F_EpsFaild_Rv:*/
on envVar E_pubc_GW_GW_24F_EpsFaild_Rv
{
    int64 rawValue = 0ll;
    float rawValue_float = 0.0;
    float phyValue = 0.0;        

    //set the signal with updated raw value
    if(getValue(E_pubc_GW_GW_24F_EpsFaild_SetVt)==0)
    {
        rawValue = getvalue(this);
        if(chgEv_GW_24F_EpsFaild == 0)
        {
            //type conversion to float
            rawValue_float = rawValue;        
            // raw to physical conversion
            phyValue = ((rawValue_float *1)+(0));
            putValue(E_pubc_GW_GW_24F_EpsFaild_Pv, phyValue);
            chgEv_GW_24F_EpsFaild = 1;
        }
        else
        {
            chgEv_GW_24F_EpsFaild = 0;
        }    
        //update the signal value
        Msg_GW_24F.EpsFaild=rawValue;        
    }                                                                           
}
/*@@end*/

/*@@envVar:E_pubc_GW_GW_24F_EpsFaild_Pv:*/
on envVar E_pubc_GW_GW_24F_EpsFaild_Pv
{
    int64 rawValue = 0ll;
    float phyValue = 0.0;
    
    //update the raw value with physical value 
    if(getValue(E_pubc_GW_GW_24F_EpsFaild_SetVt)==0)
    {
        if(chgEv_GW_24F_EpsFaild == 0)
        {
            phyValue = getvalue(this);
            // physical to raw conversion
            rawValue = ((phyValue -(0))/1);
            putValue(E_pubc_GW_GW_24F_EpsFaild_Rv, rawValue);
            chgEv_GW_24F_EpsFaild = 1;  
        }
        else
        {
            chgEv_GW_24F_EpsFaild = 0;
        }
    }
}
/*@@end*/

/*@@envVar:E_pubc_GW_GW_24F_EpsFaild_Vt:*/
on envVar E_pubc_GW_GW_24F_EpsFaild_Vt
{
    qword rawValue = 0ll;
    if(getValue(E_pubc_GW_GW_24F_EpsFaild_SetVt))
    {
        //update the signal value
        Msg_GW_24F.EpsFaild=getValue(this);
    }
}
/*@@end*/

/*@@envVar:E_pubc_GW_GW_24F_EpsFaild_SetVt:*/
on envVar E_pubc_GW_GW_24F_EpsFaild_SetVt
{
    if(getValue(E_pubc_GW_GW_24F_EpsFaild_SetVt))
    {
        //update the signal value
        Msg_GW_24F.EpsFaild=getvalue(E_pubc_GW_GW_24F_EpsFaild_Vt);
    }
    else
    {
        Msg_GW_24F.EpsFaild=getValue(E_pubc_GW_GW_24F_EpsFaild_Rv);
    }
}
/*@@end*/
 
/*@@envVar:E_pubc_GW_GW_24F_EPS_ConcussAvailabilityStatus_Rv:*/
on envVar E_pubc_GW_GW_24F_EPS_ConcussAvailabilityStatus_Rv
{
    int64 rawValue = 0ll;
    float rawValue_float = 0.0;
    float phyValue = 0.0;        

    //set the signal with updated raw value
    if(getValue(E_pubc_GW_GW_24F_EPS_ConcussAvailabilityStatus_SetVt)==0)
    {
        rawValue = getvalue(this);
        if(chgEv_GW_24F_EPS_ConcussAvailabilityStatus == 0)
        {
            //type conversion to float
            rawValue_float = rawValue;        
            // raw to physical conversion
            phyValue = ((rawValue_float *1)+(0));
            putValue(E_pubc_GW_GW_24F_EPS_ConcussAvailabilityStatus_Pv, phyValue);
            chgEv_GW_24F_EPS_ConcussAvailabilityStatus = 1;
        }
        else
        {
            chgEv_GW_24F_EPS_ConcussAvailabilityStatus = 0;
        }    
        //update the signal value
        Msg_GW_24F.EPS_ConcussAvailabilityStatus=rawValue;        
    }                                                                           
}
/*@@end*/

/*@@envVar:E_pubc_GW_GW_24F_EPS_ConcussAvailabilityStatus_Pv:*/
on envVar E_pubc_GW_GW_24F_EPS_ConcussAvailabilityStatus_Pv
{
    int64 rawValue = 0ll;
    float phyValue = 0.0;
    
    //update the raw value with physical value 
    if(getValue(E_pubc_GW_GW_24F_EPS_ConcussAvailabilityStatus_SetVt)==0)
    {
        if(chgEv_GW_24F_EPS_ConcussAvailabilityStatus == 0)
        {
            phyValue = getvalue(this);
            // physical to raw conversion
            rawValue = ((phyValue -(0))/1);
            putValue(E_pubc_GW_GW_24F_EPS_ConcussAvailabilityStatus_Rv, rawValue);
            chgEv_GW_24F_EPS_ConcussAvailabilityStatus = 1;  
        }
        else
        {
            chgEv_GW_24F_EPS_ConcussAvailabilityStatus = 0;
        }
    }
}
/*@@end*/

/*@@envVar:E_pubc_GW_GW_24F_EPS_ConcussAvailabilityStatus_Vt:*/
on envVar E_pubc_GW_GW_24F_EPS_ConcussAvailabilityStatus_Vt
{
    qword rawValue = 0ll;
    if(getValue(E_pubc_GW_GW_24F_EPS_ConcussAvailabilityStatus_SetVt))
    {
        //update the signal value
        Msg_GW_24F.EPS_ConcussAvailabilityStatus=getValue(this);
    }
}
/*@@end*/

/*@@envVar:E_pubc_GW_GW_24F_EPS_ConcussAvailabilityStatus_SetVt:*/
on envVar E_pubc_GW_GW_24F_EPS_ConcussAvailabilityStatus_SetVt
{
    if(getValue(E_pubc_GW_GW_24F_EPS_ConcussAvailabilityStatus_SetVt))
    {
        //update the signal value
        Msg_GW_24F.EPS_ConcussAvailabilityStatus=getvalue(E_pubc_GW_GW_24F_EPS_ConcussAvailabilityStatus_Vt);
    }
    else
    {
        Msg_GW_24F.EPS_ConcussAvailabilityStatus=getValue(E_pubc_GW_GW_24F_EPS_ConcussAvailabilityStatus_Rv);
    }
}
/*@@end*/
 
/*@@envVar:E_pubc_GW_GW_356_tx:*/
on envVar E_pubc_GW_GW_356_tx
{
    if(getValue(this))
    {       
        
        //update the BZ Signal
        if(GW_356_IMS_RollingCounter_356_wrongvalctr == 0)
        {
            update_GW_356_IMS_RollingCounter_356_counter();
            Msg_GW_356.IMS_RollingCounter_356= GW_356_IMS_RollingCounter_356_counter;
        }
        else if(GW_356_IMS_RollingCounter_356_wrongvalctr > 0)
        {
			GW_356_IMS_RollingCounter_356_counter=GW_356_IMS_RollingCounter_356_counter + GW_356_IMS_RollingCounter_356_wrongvalctr;
			 Msg_GW_356.IMS_RollingCounter_356= GW_356_IMS_RollingCounter_356_counter;
            /* GW_356_IMS_RollingCounter_356_wrongvalctr--;
              // if counter becomes zero, update panel controller to zero
             if(GW_356_IMS_RollingCounter_356_wrongvalctr == 0)
             {
                 putValue(E_pubc_GW_GW_356_IMS_RollingCounter_356_wrongvalctr,0);
             } */
        }
        else
        { 
			// do nothing
        }    
        //update the BZ Signal
        if(GW_356_IMS_RollingCounter_360_wrongvalctr == 0)
        {
            update_GW_356_IMS_RollingCounter_360_counter();
            Msg_GW_356.IMS_RollingCounter_360= GW_356_IMS_RollingCounter_360_counter;
        }
        else if(GW_356_IMS_RollingCounter_360_wrongvalctr > 0)
        {
			GW_356_IMS_RollingCounter_360_counter=GW_356_IMS_RollingCounter_360_counter + GW_356_IMS_RollingCounter_360_wrongvalctr;
			 Msg_GW_356.IMS_RollingCounter_360= GW_356_IMS_RollingCounter_360_counter;
            /* GW_356_IMS_RollingCounter_360_wrongvalctr--;
              // if counter becomes zero, update panel controller to zero
             if(GW_356_IMS_RollingCounter_360_wrongvalctr == 0)
             {
                 putValue(E_pubc_GW_GW_356_IMS_RollingCounter_360_wrongvalctr,0);
             } */
        }
        else
        { 
			// do nothing
        }    
        //calculate the CRC CheckSum
        update_GW_356_CRC_CheckSum();

        output(Msg_GW_356);        
    }
}
/*@@end*/

/*@@envVar:E_pubc_GW_GW_356_Range:*/
on envVar E_pubc_GW_GW_356_Range
{
    qword rawstatus = 0ll;
    qword rawValue = 0ll;    
    
    rawstatus = getvalue(this);    
    // set all the signals with min raw /max raw /init raw
    switch (rawstatus) 
    {
     case(0) :
        rawValue= 0;
        putValue(E_pubc_GW_GW_356_IMS_EyeGazeStatus_Rv, rawValue);
        rawValue= 0;
        putValue(E_pubc_GW_GW_356_IMS_BrowOffsetValue_Rv, rawValue);
        rawValue= 0;
        putValue(E_pubc_GW_GW_356_IMS_DistractionStatus_Rv, rawValue);
        rawValue= 0;
        putValue(E_pubc_GW_GW_356_IMS_HeadDetectSts_Pitch_Rv, rawValue);
        rawValue= 0;
        putValue(E_pubc_GW_GW_356_IMS_IMSStatus_Rv, rawValue);
        rawValue= 0;
        putValue(E_pubc_GW_GW_356_IMS_DriverEyesFovArea_Rv, rawValue);
        rawValue= 0;
        putValue(E_pubc_GW_GW_356_IMS_EyeDetectSatus_Rv, rawValue);
        rawValue= 0;
        putValue(E_pubc_GW_GW_356_IMS_JawOffsetValue_Rv, rawValue);
        rawValue= 0;
        putValue(E_pubc_GW_GW_356_IMS_HeadDetectSts_Roll_Rv, rawValue);
        rawValue= 0;
        putValue(E_pubc_GW_GW_356_IMS_DriverEyeConfidence_Rv, rawValue);
        rawValue= 0;
        putValue(E_pubc_GW_GW_356_IMS_PhoneCallSts_Rv, rawValue);
        rawValue= 0;
        putValue(E_pubc_GW_GW_356_IMS_DriverEyeDetect_Rv, rawValue);
        rawValue= 0;
        putValue(E_pubc_GW_GW_356_IMS_DrowsinessStatus_Rv, rawValue);
        rawValue= 0;
        putValue(E_pubc_GW_GW_356_IMS_DriverEyeClosestatus_Rv, rawValue);
        rawValue= 0;
        putValue(E_pubc_GW_GW_356_IMS_HeadDetectSts_Yaw_Rv, rawValue);
        rawValue= 0;
        putValue(E_pubc_GW_GW_356_IMS_DriverHeadDetect_Rv, rawValue);
        break;
     case(1) :
        rawValue= 150;
        putValue(E_pubc_GW_GW_356_IMS_EyeGazeStatus_Rv, rawValue);
        rawValue= 15;
        putValue(E_pubc_GW_GW_356_IMS_BrowOffsetValue_Rv, rawValue);
        rawValue= 3;
        putValue(E_pubc_GW_GW_356_IMS_DistractionStatus_Rv, rawValue);
        rawValue= 70;
        putValue(E_pubc_GW_GW_356_IMS_HeadDetectSts_Pitch_Rv, rawValue);
        rawValue= 7;
        putValue(E_pubc_GW_GW_356_IMS_IMSStatus_Rv, rawValue);
        rawValue= 15;
        putValue(E_pubc_GW_GW_356_IMS_DriverEyesFovArea_Rv, rawValue);
        rawValue= 100;
        putValue(E_pubc_GW_GW_356_IMS_EyeDetectSatus_Rv, rawValue);
        rawValue= 15;
        putValue(E_pubc_GW_GW_356_IMS_JawOffsetValue_Rv, rawValue);
        rawValue= 90;
        putValue(E_pubc_GW_GW_356_IMS_HeadDetectSts_Roll_Rv, rawValue);
        rawValue= 255;
        putValue(E_pubc_GW_GW_356_IMS_DriverEyeConfidence_Rv, rawValue);
        rawValue= 1;
        putValue(E_pubc_GW_GW_356_IMS_PhoneCallSts_Rv, rawValue);
        rawValue= 3;
        putValue(E_pubc_GW_GW_356_IMS_DriverEyeDetect_Rv, rawValue);
        rawValue= 7;
        putValue(E_pubc_GW_GW_356_IMS_DrowsinessStatus_Rv, rawValue);
        rawValue= 7;
        putValue(E_pubc_GW_GW_356_IMS_DriverEyeClosestatus_Rv, rawValue);
        rawValue= 150;
        putValue(E_pubc_GW_GW_356_IMS_HeadDetectSts_Yaw_Rv, rawValue);
        rawValue= 3;
        putValue(E_pubc_GW_GW_356_IMS_DriverHeadDetect_Rv, rawValue);
        break;
     default :
        rawValue= 0;
        putValue(E_pubc_GW_GW_356_IMS_EyeGazeStatus_Rv, rawValue);
        rawValue= 0;
        putValue(E_pubc_GW_GW_356_IMS_BrowOffsetValue_Rv, rawValue);
        rawValue= 0;
        putValue(E_pubc_GW_GW_356_IMS_DistractionStatus_Rv, rawValue);
        rawValue= 0;
        putValue(E_pubc_GW_GW_356_IMS_HeadDetectSts_Pitch_Rv, rawValue);
        rawValue= 0;
        putValue(E_pubc_GW_GW_356_IMS_IMSStatus_Rv, rawValue);
        rawValue= 0;
        putValue(E_pubc_GW_GW_356_IMS_DriverEyesFovArea_Rv, rawValue);
        rawValue= 0;
        putValue(E_pubc_GW_GW_356_IMS_EyeDetectSatus_Rv, rawValue);
        rawValue= 0;
        putValue(E_pubc_GW_GW_356_IMS_JawOffsetValue_Rv, rawValue);
        rawValue= 0;
        putValue(E_pubc_GW_GW_356_IMS_HeadDetectSts_Roll_Rv, rawValue);
        rawValue= 0;
        putValue(E_pubc_GW_GW_356_IMS_DriverEyeConfidence_Rv, rawValue);
        rawValue= 0;
        putValue(E_pubc_GW_GW_356_IMS_PhoneCallSts_Rv, rawValue);
        rawValue= 0;
        putValue(E_pubc_GW_GW_356_IMS_DriverEyeDetect_Rv, rawValue);
        rawValue= 0;
        putValue(E_pubc_GW_GW_356_IMS_DrowsinessStatus_Rv, rawValue);
        rawValue= 0;
        putValue(E_pubc_GW_GW_356_IMS_DriverEyeClosestatus_Rv, rawValue);
        rawValue= 0;
        putValue(E_pubc_GW_GW_356_IMS_HeadDetectSts_Yaw_Rv, rawValue);
        rawValue= 0;
        putValue(E_pubc_GW_GW_356_IMS_DriverHeadDetect_Rv, rawValue);
      break;
   }
}
/*@@end*/

/*@@envVar:E_pubc_GW_GW_356_Dlc:*/
on envVar E_pubc_GW_GW_356_Dlc
{
    if(getValue(E_pubc_GW_GW_356_enDlc))
    {
        Msg_GW_356.dlc =getValue(this);
    }
    else
    {
       Dbc_dlc = 64;
	   Msg_GW_356.dlc = Calc_Canfd_dlc(Dbc_dlc);
	   // Msg_GW_356.dlc = 64;
	   	
  }
}
/*@@end*/

/*@@envVar:E_pubc_GW_GW_356_enDlc:*/
on envVar E_pubc_GW_GW_356_enDlc
{
    //For Messages with DLC = 8, set wrong DLC to smaller than defined DLC
    //For Messages with DLC < 8 set wrong DLC to smaller/longer than defined DLC
    if(getValue(this))
    {
        Msg_GW_356.dlc =getValue(E_pubc_GW_GW_356_Dlc);
    }
    else
    {
       Dbc_dlc = 64;
	   Msg_GW_356.dlc = Calc_Canfd_dlc(Dbc_dlc);
	   // Msg_GW_356.dlc = 64;
    }
}
/*@@end*/

/*@@envVar:E_pubc_GW_GW_356_IMS_CRCCheck_356_wrongvalctr:*/
on envVar E_pubc_GW_GW_356_IMS_CRCCheck_356_wrongvalctr
{
    //update disturb count
    //disturb value range:(-1 = always send wrong value),( X>0 ,x is the number of Messages with wrong CHK sent)
    GW_356_IMS_CRCCheck_356_wrongvalctr =getValue(this);    
}
/*@@end*/
/*@@envVar:E_pubc_GW_GW_356_IMS_CRCCheck_360_wrongvalctr:*/
on envVar E_pubc_GW_GW_356_IMS_CRCCheck_360_wrongvalctr
{
    //update disturb count
    //disturb value range:(-1 = always send wrong value),( X>0 ,x is the number of Messages with wrong CHK sent)
    GW_356_IMS_CRCCheck_360_wrongvalctr =getValue(this);    
}
/*@@end*/
/*@@envVar:E_pubc_GW_GW_356_IMS_RollingCounter_356_wrongvalctr:*/
on envVar E_pubc_GW_GW_356_IMS_RollingCounter_356_wrongvalctr
{
    //update disturb count
    //disturb value range:(-1 = always send wrong value),( X>0 ,x is the number of Messages with wrong CHK sent)
    GW_356_IMS_RollingCounter_356_wrongvalctr =getValue(this);    
}
/*@@end*/
/*@@envVar:E_pubc_GW_GW_356_IMS_RollingCounter_360_wrongvalctr:*/
on envVar E_pubc_GW_GW_356_IMS_RollingCounter_360_wrongvalctr
{
    //update disturb count
    //disturb value range:(-1 = always send wrong value),( X>0 ,x is the number of Messages with wrong CHK sent)
    GW_356_IMS_RollingCounter_360_wrongvalctr =getValue(this);    
}
/*@@end*/

/*@@envVar:E_pubc_GW_GW_356_IMS_EyeGazeStatus_Rv:*/
on envVar E_pubc_GW_GW_356_IMS_EyeGazeStatus_Rv
{
    int64 rawValue = 0ll;
    float rawValue_float = 0.0;
    float phyValue = 0.0;        

    //set the signal with updated raw value
    {
        rawValue = getvalue(this);
        if(chgEv_GW_356_IMS_EyeGazeStatus == 0)
        {
            //type conversion to float
            rawValue_float = rawValue;        
            // raw to physical conversion
            phyValue = ((rawValue_float *1)+(-75));
            putValue(E_pubc_GW_GW_356_IMS_EyeGazeStatus_Pv, phyValue);
            chgEv_GW_356_IMS_EyeGazeStatus = 1;
        }
        else
        {
            chgEv_GW_356_IMS_EyeGazeStatus = 0;
        }    
        //update the signal value
        Msg_GW_356.IMS_EyeGazeStatus=rawValue;        
    }                                                                           
}
/*@@end*/

/*@@envVar:E_pubc_GW_GW_356_IMS_EyeGazeStatus_Pv:*/
on envVar E_pubc_GW_GW_356_IMS_EyeGazeStatus_Pv
{
    int64 rawValue = 0ll;
    float phyValue = 0.0;
    
    //update the raw value with physical value 
    {
        if(chgEv_GW_356_IMS_EyeGazeStatus == 0)
        {
            phyValue = getvalue(this);
            // physical to raw conversion
            rawValue = ((phyValue -(-75))/1);
            putValue(E_pubc_GW_GW_356_IMS_EyeGazeStatus_Rv, rawValue);
            chgEv_GW_356_IMS_EyeGazeStatus = 1;  
        }
        else
        {
            chgEv_GW_356_IMS_EyeGazeStatus = 0;
        }
    }
}
/*@@end*/


 
/*@@envVar:E_pubc_GW_GW_356_IMS_BrowOffsetValue_Rv:*/
on envVar E_pubc_GW_GW_356_IMS_BrowOffsetValue_Rv
{
    int64 rawValue = 0ll;
    float rawValue_float = 0.0;
    float phyValue = 0.0;        

    //set the signal with updated raw value
    if(getValue(E_pubc_GW_GW_356_IMS_BrowOffsetValue_SetVt)==0)
    {
        rawValue = getvalue(this);
        if(chgEv_GW_356_IMS_BrowOffsetValue == 0)
        {
            //type conversion to float
            rawValue_float = rawValue;        
            // raw to physical conversion
            phyValue = ((rawValue_float *1)+(0));
            putValue(E_pubc_GW_GW_356_IMS_BrowOffsetValue_Pv, phyValue);
            chgEv_GW_356_IMS_BrowOffsetValue = 1;
        }
        else
        {
            chgEv_GW_356_IMS_BrowOffsetValue = 0;
        }    
        //update the signal value
        Msg_GW_356.IMS_BrowOffsetValue=rawValue;        
    }                                                                           
}
/*@@end*/

/*@@envVar:E_pubc_GW_GW_356_IMS_BrowOffsetValue_Pv:*/
on envVar E_pubc_GW_GW_356_IMS_BrowOffsetValue_Pv
{
    int64 rawValue = 0ll;
    float phyValue = 0.0;
    
    //update the raw value with physical value 
    if(getValue(E_pubc_GW_GW_356_IMS_BrowOffsetValue_SetVt)==0)
    {
        if(chgEv_GW_356_IMS_BrowOffsetValue == 0)
        {
            phyValue = getvalue(this);
            // physical to raw conversion
            rawValue = ((phyValue -(0))/1);
            putValue(E_pubc_GW_GW_356_IMS_BrowOffsetValue_Rv, rawValue);
            chgEv_GW_356_IMS_BrowOffsetValue = 1;  
        }
        else
        {
            chgEv_GW_356_IMS_BrowOffsetValue = 0;
        }
    }
}
/*@@end*/

/*@@envVar:E_pubc_GW_GW_356_IMS_BrowOffsetValue_Vt:*/
on envVar E_pubc_GW_GW_356_IMS_BrowOffsetValue_Vt
{
    qword rawValue = 0ll;
    if(getValue(E_pubc_GW_GW_356_IMS_BrowOffsetValue_SetVt))
    {
        //update the signal value
        Msg_GW_356.IMS_BrowOffsetValue=getValue(this);
    }
}
/*@@end*/

/*@@envVar:E_pubc_GW_GW_356_IMS_BrowOffsetValue_SetVt:*/
on envVar E_pubc_GW_GW_356_IMS_BrowOffsetValue_SetVt
{
    if(getValue(E_pubc_GW_GW_356_IMS_BrowOffsetValue_SetVt))
    {
        //update the signal value
        Msg_GW_356.IMS_BrowOffsetValue=getvalue(E_pubc_GW_GW_356_IMS_BrowOffsetValue_Vt);
    }
    else
    {
        Msg_GW_356.IMS_BrowOffsetValue=getValue(E_pubc_GW_GW_356_IMS_BrowOffsetValue_Rv);
    }
}
/*@@end*/
 
/*@@envVar:E_pubc_GW_GW_356_IMS_DistractionStatus_Rv:*/
on envVar E_pubc_GW_GW_356_IMS_DistractionStatus_Rv
{
    int64 rawValue = 0ll;
    float rawValue_float = 0.0;
    float phyValue = 0.0;        

    //set the signal with updated raw value
    if(getValue(E_pubc_GW_GW_356_IMS_DistractionStatus_SetVt)==0)
    {
        rawValue = getvalue(this);
        if(chgEv_GW_356_IMS_DistractionStatus == 0)
        {
            //type conversion to float
            rawValue_float = rawValue;        
            // raw to physical conversion
            phyValue = ((rawValue_float *1)+(0));
            putValue(E_pubc_GW_GW_356_IMS_DistractionStatus_Pv, phyValue);
            chgEv_GW_356_IMS_DistractionStatus = 1;
        }
        else
        {
            chgEv_GW_356_IMS_DistractionStatus = 0;
        }    
        //update the signal value
        Msg_GW_356.IMS_DistractionStatus=rawValue;        
    }                                                                           
}
/*@@end*/

/*@@envVar:E_pubc_GW_GW_356_IMS_DistractionStatus_Pv:*/
on envVar E_pubc_GW_GW_356_IMS_DistractionStatus_Pv
{
    int64 rawValue = 0ll;
    float phyValue = 0.0;
    
    //update the raw value with physical value 
    if(getValue(E_pubc_GW_GW_356_IMS_DistractionStatus_SetVt)==0)
    {
        if(chgEv_GW_356_IMS_DistractionStatus == 0)
        {
            phyValue = getvalue(this);
            // physical to raw conversion
            rawValue = ((phyValue -(0))/1);
            putValue(E_pubc_GW_GW_356_IMS_DistractionStatus_Rv, rawValue);
            chgEv_GW_356_IMS_DistractionStatus = 1;  
        }
        else
        {
            chgEv_GW_356_IMS_DistractionStatus = 0;
        }
    }
}
/*@@end*/

/*@@envVar:E_pubc_GW_GW_356_IMS_DistractionStatus_Vt:*/
on envVar E_pubc_GW_GW_356_IMS_DistractionStatus_Vt
{
    qword rawValue = 0ll;
    if(getValue(E_pubc_GW_GW_356_IMS_DistractionStatus_SetVt))
    {
        //update the signal value
        Msg_GW_356.IMS_DistractionStatus=getValue(this);
    }
}
/*@@end*/

/*@@envVar:E_pubc_GW_GW_356_IMS_DistractionStatus_SetVt:*/
on envVar E_pubc_GW_GW_356_IMS_DistractionStatus_SetVt
{
    if(getValue(E_pubc_GW_GW_356_IMS_DistractionStatus_SetVt))
    {
        //update the signal value
        Msg_GW_356.IMS_DistractionStatus=getvalue(E_pubc_GW_GW_356_IMS_DistractionStatus_Vt);
    }
    else
    {
        Msg_GW_356.IMS_DistractionStatus=getValue(E_pubc_GW_GW_356_IMS_DistractionStatus_Rv);
    }
}
/*@@end*/
 
/*@@envVar:E_pubc_GW_GW_356_IMS_HeadDetectSts_Pitch_Rv:*/
on envVar E_pubc_GW_GW_356_IMS_HeadDetectSts_Pitch_Rv
{
    int64 rawValue = 0ll;
    float rawValue_float = 0.0;
    float phyValue = 0.0;        

    //set the signal with updated raw value
    {
        rawValue = getvalue(this);
        if(chgEv_GW_356_IMS_HeadDetectSts_Pitch == 0)
        {
            //type conversion to float
            rawValue_float = rawValue;        
            // raw to physical conversion
            phyValue = ((rawValue_float *1)+(-25));
            putValue(E_pubc_GW_GW_356_IMS_HeadDetectSts_Pitch_Pv, phyValue);
            chgEv_GW_356_IMS_HeadDetectSts_Pitch = 1;
        }
        else
        {
            chgEv_GW_356_IMS_HeadDetectSts_Pitch = 0;
        }    
        //update the signal value
        Msg_GW_356.IMS_HeadDetectSts_Pitch=rawValue;        
    }                                                                           
}
/*@@end*/

/*@@envVar:E_pubc_GW_GW_356_IMS_HeadDetectSts_Pitch_Pv:*/
on envVar E_pubc_GW_GW_356_IMS_HeadDetectSts_Pitch_Pv
{
    int64 rawValue = 0ll;
    float phyValue = 0.0;
    
    //update the raw value with physical value 
    {
        if(chgEv_GW_356_IMS_HeadDetectSts_Pitch == 0)
        {
            phyValue = getvalue(this);
            // physical to raw conversion
            rawValue = ((phyValue -(-25))/1);
            putValue(E_pubc_GW_GW_356_IMS_HeadDetectSts_Pitch_Rv, rawValue);
            chgEv_GW_356_IMS_HeadDetectSts_Pitch = 1;  
        }
        else
        {
            chgEv_GW_356_IMS_HeadDetectSts_Pitch = 0;
        }
    }
}
/*@@end*/


 
/*@@envVar:E_pubc_GW_GW_356_IMS_IMSStatus_Rv:*/
on envVar E_pubc_GW_GW_356_IMS_IMSStatus_Rv
{
    int64 rawValue = 0ll;
    float rawValue_float = 0.0;
    float phyValue = 0.0;        

    //set the signal with updated raw value
    if(getValue(E_pubc_GW_GW_356_IMS_IMSStatus_SetVt)==0)
    {
        rawValue = getvalue(this);
        if(chgEv_GW_356_IMS_IMSStatus == 0)
        {
            //type conversion to float
            rawValue_float = rawValue;        
            // raw to physical conversion
            phyValue = ((rawValue_float *1)+(0));
            putValue(E_pubc_GW_GW_356_IMS_IMSStatus_Pv, phyValue);
            chgEv_GW_356_IMS_IMSStatus = 1;
        }
        else
        {
            chgEv_GW_356_IMS_IMSStatus = 0;
        }    
        //update the signal value
        Msg_GW_356.IMS_IMSStatus=rawValue;        
    }                                                                           
}
/*@@end*/

/*@@envVar:E_pubc_GW_GW_356_IMS_IMSStatus_Pv:*/
on envVar E_pubc_GW_GW_356_IMS_IMSStatus_Pv
{
    int64 rawValue = 0ll;
    float phyValue = 0.0;
    
    //update the raw value with physical value 
    if(getValue(E_pubc_GW_GW_356_IMS_IMSStatus_SetVt)==0)
    {
        if(chgEv_GW_356_IMS_IMSStatus == 0)
        {
            phyValue = getvalue(this);
            // physical to raw conversion
            rawValue = ((phyValue -(0))/1);
            putValue(E_pubc_GW_GW_356_IMS_IMSStatus_Rv, rawValue);
            chgEv_GW_356_IMS_IMSStatus = 1;  
        }
        else
        {
            chgEv_GW_356_IMS_IMSStatus = 0;
        }
    }
}
/*@@end*/

/*@@envVar:E_pubc_GW_GW_356_IMS_IMSStatus_Vt:*/
on envVar E_pubc_GW_GW_356_IMS_IMSStatus_Vt
{
    qword rawValue = 0ll;
    if(getValue(E_pubc_GW_GW_356_IMS_IMSStatus_SetVt))
    {
        //update the signal value
        Msg_GW_356.IMS_IMSStatus=getValue(this);
    }
}
/*@@end*/

/*@@envVar:E_pubc_GW_GW_356_IMS_IMSStatus_SetVt:*/
on envVar E_pubc_GW_GW_356_IMS_IMSStatus_SetVt
{
    if(getValue(E_pubc_GW_GW_356_IMS_IMSStatus_SetVt))
    {
        //update the signal value
        Msg_GW_356.IMS_IMSStatus=getvalue(E_pubc_GW_GW_356_IMS_IMSStatus_Vt);
    }
    else
    {
        Msg_GW_356.IMS_IMSStatus=getValue(E_pubc_GW_GW_356_IMS_IMSStatus_Rv);
    }
}
/*@@end*/
 
/*@@envVar:E_pubc_GW_GW_356_IMS_DriverEyesFovArea_Rv:*/
on envVar E_pubc_GW_GW_356_IMS_DriverEyesFovArea_Rv
{
    int64 rawValue = 0ll;
    float rawValue_float = 0.0;
    float phyValue = 0.0;        

    //set the signal with updated raw value
    if(getValue(E_pubc_GW_GW_356_IMS_DriverEyesFovArea_SetVt)==0)
    {
        rawValue = getvalue(this);
        if(chgEv_GW_356_IMS_DriverEyesFovArea == 0)
        {
            //type conversion to float
            rawValue_float = rawValue;        
            // raw to physical conversion
            phyValue = ((rawValue_float *1)+(0));
            putValue(E_pubc_GW_GW_356_IMS_DriverEyesFovArea_Pv, phyValue);
            chgEv_GW_356_IMS_DriverEyesFovArea = 1;
        }
        else
        {
            chgEv_GW_356_IMS_DriverEyesFovArea = 0;
        }    
        //update the signal value
        Msg_GW_356.IMS_DriverEyesFovArea=rawValue;        
    }                                                                           
}
/*@@end*/

/*@@envVar:E_pubc_GW_GW_356_IMS_DriverEyesFovArea_Pv:*/
on envVar E_pubc_GW_GW_356_IMS_DriverEyesFovArea_Pv
{
    int64 rawValue = 0ll;
    float phyValue = 0.0;
    
    //update the raw value with physical value 
    if(getValue(E_pubc_GW_GW_356_IMS_DriverEyesFovArea_SetVt)==0)
    {
        if(chgEv_GW_356_IMS_DriverEyesFovArea == 0)
        {
            phyValue = getvalue(this);
            // physical to raw conversion
            rawValue = ((phyValue -(0))/1);
            putValue(E_pubc_GW_GW_356_IMS_DriverEyesFovArea_Rv, rawValue);
            chgEv_GW_356_IMS_DriverEyesFovArea = 1;  
        }
        else
        {
            chgEv_GW_356_IMS_DriverEyesFovArea = 0;
        }
    }
}
/*@@end*/

/*@@envVar:E_pubc_GW_GW_356_IMS_DriverEyesFovArea_Vt:*/
on envVar E_pubc_GW_GW_356_IMS_DriverEyesFovArea_Vt
{
    qword rawValue = 0ll;
    if(getValue(E_pubc_GW_GW_356_IMS_DriverEyesFovArea_SetVt))
    {
        //update the signal value
        Msg_GW_356.IMS_DriverEyesFovArea=getValue(this);
    }
}
/*@@end*/

/*@@envVar:E_pubc_GW_GW_356_IMS_DriverEyesFovArea_SetVt:*/
on envVar E_pubc_GW_GW_356_IMS_DriverEyesFovArea_SetVt
{
    if(getValue(E_pubc_GW_GW_356_IMS_DriverEyesFovArea_SetVt))
    {
        //update the signal value
        Msg_GW_356.IMS_DriverEyesFovArea=getvalue(E_pubc_GW_GW_356_IMS_DriverEyesFovArea_Vt);
    }
    else
    {
        Msg_GW_356.IMS_DriverEyesFovArea=getValue(E_pubc_GW_GW_356_IMS_DriverEyesFovArea_Rv);
    }
}
/*@@end*/
 
/*@@envVar:E_pubc_GW_GW_356_IMS_EyeDetectSatus_Rv:*/
on envVar E_pubc_GW_GW_356_IMS_EyeDetectSatus_Rv
{
    int64 rawValue = 0ll;
    float rawValue_float = 0.0;
    float phyValue = 0.0;        

    //set the signal with updated raw value
    {
        rawValue = getvalue(this);
        if(chgEv_GW_356_IMS_EyeDetectSatus == 0)
        {
            //type conversion to float
            rawValue_float = rawValue;        
            // raw to physical conversion
            phyValue = ((rawValue_float *1)+(0));
            putValue(E_pubc_GW_GW_356_IMS_EyeDetectSatus_Pv, phyValue);
            chgEv_GW_356_IMS_EyeDetectSatus = 1;
        }
        else
        {
            chgEv_GW_356_IMS_EyeDetectSatus = 0;
        }    
        //update the signal value
        Msg_GW_356.IMS_EyeDetectSatus=rawValue;        
    }                                                                           
}
/*@@end*/

/*@@envVar:E_pubc_GW_GW_356_IMS_EyeDetectSatus_Pv:*/
on envVar E_pubc_GW_GW_356_IMS_EyeDetectSatus_Pv
{
    int64 rawValue = 0ll;
    float phyValue = 0.0;
    
    //update the raw value with physical value 
    {
        if(chgEv_GW_356_IMS_EyeDetectSatus == 0)
        {
            phyValue = getvalue(this);
            // physical to raw conversion
            rawValue = ((phyValue -(0))/1);
            putValue(E_pubc_GW_GW_356_IMS_EyeDetectSatus_Rv, rawValue);
            chgEv_GW_356_IMS_EyeDetectSatus = 1;  
        }
        else
        {
            chgEv_GW_356_IMS_EyeDetectSatus = 0;
        }
    }
}
/*@@end*/


 
/*@@envVar:E_pubc_GW_GW_356_IMS_JawOffsetValue_Rv:*/
on envVar E_pubc_GW_GW_356_IMS_JawOffsetValue_Rv
{
    int64 rawValue = 0ll;
    float rawValue_float = 0.0;
    float phyValue = 0.0;        

    //set the signal with updated raw value
    if(getValue(E_pubc_GW_GW_356_IMS_JawOffsetValue_SetVt)==0)
    {
        rawValue = getvalue(this);
        if(chgEv_GW_356_IMS_JawOffsetValue == 0)
        {
            //type conversion to float
            rawValue_float = rawValue;        
            // raw to physical conversion
            phyValue = ((rawValue_float *1)+(0));
            putValue(E_pubc_GW_GW_356_IMS_JawOffsetValue_Pv, phyValue);
            chgEv_GW_356_IMS_JawOffsetValue = 1;
        }
        else
        {
            chgEv_GW_356_IMS_JawOffsetValue = 0;
        }    
        //update the signal value
        Msg_GW_356.IMS_JawOffsetValue=rawValue;        
    }                                                                           
}
/*@@end*/

/*@@envVar:E_pubc_GW_GW_356_IMS_JawOffsetValue_Pv:*/
on envVar E_pubc_GW_GW_356_IMS_JawOffsetValue_Pv
{
    int64 rawValue = 0ll;
    float phyValue = 0.0;
    
    //update the raw value with physical value 
    if(getValue(E_pubc_GW_GW_356_IMS_JawOffsetValue_SetVt)==0)
    {
        if(chgEv_GW_356_IMS_JawOffsetValue == 0)
        {
            phyValue = getvalue(this);
            // physical to raw conversion
            rawValue = ((phyValue -(0))/1);
            putValue(E_pubc_GW_GW_356_IMS_JawOffsetValue_Rv, rawValue);
            chgEv_GW_356_IMS_JawOffsetValue = 1;  
        }
        else
        {
            chgEv_GW_356_IMS_JawOffsetValue = 0;
        }
    }
}
/*@@end*/

/*@@envVar:E_pubc_GW_GW_356_IMS_JawOffsetValue_Vt:*/
on envVar E_pubc_GW_GW_356_IMS_JawOffsetValue_Vt
{
    qword rawValue = 0ll;
    if(getValue(E_pubc_GW_GW_356_IMS_JawOffsetValue_SetVt))
    {
        //update the signal value
        Msg_GW_356.IMS_JawOffsetValue=getValue(this);
    }
}
/*@@end*/

/*@@envVar:E_pubc_GW_GW_356_IMS_JawOffsetValue_SetVt:*/
on envVar E_pubc_GW_GW_356_IMS_JawOffsetValue_SetVt
{
    if(getValue(E_pubc_GW_GW_356_IMS_JawOffsetValue_SetVt))
    {
        //update the signal value
        Msg_GW_356.IMS_JawOffsetValue=getvalue(E_pubc_GW_GW_356_IMS_JawOffsetValue_Vt);
    }
    else
    {
        Msg_GW_356.IMS_JawOffsetValue=getValue(E_pubc_GW_GW_356_IMS_JawOffsetValue_Rv);
    }
}
/*@@end*/
 
/*@@envVar:E_pubc_GW_GW_356_IMS_HeadDetectSts_Roll_Rv:*/
on envVar E_pubc_GW_GW_356_IMS_HeadDetectSts_Roll_Rv
{
    int64 rawValue = 0ll;
    float rawValue_float = 0.0;
    float phyValue = 0.0;        

    //set the signal with updated raw value
    {
        rawValue = getvalue(this);
        if(chgEv_GW_356_IMS_HeadDetectSts_Roll == 0)
        {
            //type conversion to float
            rawValue_float = rawValue;        
            // raw to physical conversion
            phyValue = ((rawValue_float *1)+(-45));
            putValue(E_pubc_GW_GW_356_IMS_HeadDetectSts_Roll_Pv, phyValue);
            chgEv_GW_356_IMS_HeadDetectSts_Roll = 1;
        }
        else
        {
            chgEv_GW_356_IMS_HeadDetectSts_Roll = 0;
        }    
        //update the signal value
        Msg_GW_356.IMS_HeadDetectSts_Roll=rawValue;        
    }                                                                           
}
/*@@end*/

/*@@envVar:E_pubc_GW_GW_356_IMS_HeadDetectSts_Roll_Pv:*/
on envVar E_pubc_GW_GW_356_IMS_HeadDetectSts_Roll_Pv
{
    int64 rawValue = 0ll;
    float phyValue = 0.0;
    
    //update the raw value with physical value 
    {
        if(chgEv_GW_356_IMS_HeadDetectSts_Roll == 0)
        {
            phyValue = getvalue(this);
            // physical to raw conversion
            rawValue = ((phyValue -(-45))/1);
            putValue(E_pubc_GW_GW_356_IMS_HeadDetectSts_Roll_Rv, rawValue);
            chgEv_GW_356_IMS_HeadDetectSts_Roll = 1;  
        }
        else
        {
            chgEv_GW_356_IMS_HeadDetectSts_Roll = 0;
        }
    }
}
/*@@end*/


 
/*@@envVar:E_pubc_GW_GW_356_IMS_DriverEyeConfidence_Rv:*/
on envVar E_pubc_GW_GW_356_IMS_DriverEyeConfidence_Rv
{
    int64 rawValue = 0ll;
    float rawValue_float = 0.0;
    float phyValue = 0.0;        

    //set the signal with updated raw value
    {
        rawValue = getvalue(this);
        if(chgEv_GW_356_IMS_DriverEyeConfidence == 0)
        {
            //type conversion to float
            rawValue_float = rawValue;        
            // raw to physical conversion
            phyValue = ((rawValue_float *1)+(0));
            putValue(E_pubc_GW_GW_356_IMS_DriverEyeConfidence_Pv, phyValue);
            chgEv_GW_356_IMS_DriverEyeConfidence = 1;
        }
        else
        {
            chgEv_GW_356_IMS_DriverEyeConfidence = 0;
        }    
        //update the signal value
        Msg_GW_356.IMS_DriverEyeConfidence=rawValue;        
    }                                                                           
}
/*@@end*/

/*@@envVar:E_pubc_GW_GW_356_IMS_DriverEyeConfidence_Pv:*/
on envVar E_pubc_GW_GW_356_IMS_DriverEyeConfidence_Pv
{
    int64 rawValue = 0ll;
    float phyValue = 0.0;
    
    //update the raw value with physical value 
    {
        if(chgEv_GW_356_IMS_DriverEyeConfidence == 0)
        {
            phyValue = getvalue(this);
            // physical to raw conversion
            rawValue = ((phyValue -(0))/1);
            putValue(E_pubc_GW_GW_356_IMS_DriverEyeConfidence_Rv, rawValue);
            chgEv_GW_356_IMS_DriverEyeConfidence = 1;  
        }
        else
        {
            chgEv_GW_356_IMS_DriverEyeConfidence = 0;
        }
    }
}
/*@@end*/


 
/*@@envVar:E_pubc_GW_GW_356_IMS_PhoneCallSts_Rv:*/
on envVar E_pubc_GW_GW_356_IMS_PhoneCallSts_Rv
{
    int64 rawValue = 0ll;
    float rawValue_float = 0.0;
    float phyValue = 0.0;        

    //set the signal with updated raw value
    if(getValue(E_pubc_GW_GW_356_IMS_PhoneCallSts_SetVt)==0)
    {
        rawValue = getvalue(this);
        if(chgEv_GW_356_IMS_PhoneCallSts == 0)
        {
            //type conversion to float
            rawValue_float = rawValue;        
            // raw to physical conversion
            phyValue = ((rawValue_float *1)+(0));
            putValue(E_pubc_GW_GW_356_IMS_PhoneCallSts_Pv, phyValue);
            chgEv_GW_356_IMS_PhoneCallSts = 1;
        }
        else
        {
            chgEv_GW_356_IMS_PhoneCallSts = 0;
        }    
        //update the signal value
        Msg_GW_356.IMS_PhoneCallSts=rawValue;        
    }                                                                           
}
/*@@end*/

/*@@envVar:E_pubc_GW_GW_356_IMS_PhoneCallSts_Pv:*/
on envVar E_pubc_GW_GW_356_IMS_PhoneCallSts_Pv
{
    int64 rawValue = 0ll;
    float phyValue = 0.0;
    
    //update the raw value with physical value 
    if(getValue(E_pubc_GW_GW_356_IMS_PhoneCallSts_SetVt)==0)
    {
        if(chgEv_GW_356_IMS_PhoneCallSts == 0)
        {
            phyValue = getvalue(this);
            // physical to raw conversion
            rawValue = ((phyValue -(0))/1);
            putValue(E_pubc_GW_GW_356_IMS_PhoneCallSts_Rv, rawValue);
            chgEv_GW_356_IMS_PhoneCallSts = 1;  
        }
        else
        {
            chgEv_GW_356_IMS_PhoneCallSts = 0;
        }
    }
}
/*@@end*/

/*@@envVar:E_pubc_GW_GW_356_IMS_PhoneCallSts_Vt:*/
on envVar E_pubc_GW_GW_356_IMS_PhoneCallSts_Vt
{
    qword rawValue = 0ll;
    if(getValue(E_pubc_GW_GW_356_IMS_PhoneCallSts_SetVt))
    {
        //update the signal value
        Msg_GW_356.IMS_PhoneCallSts=getValue(this);
    }
}
/*@@end*/

/*@@envVar:E_pubc_GW_GW_356_IMS_PhoneCallSts_SetVt:*/
on envVar E_pubc_GW_GW_356_IMS_PhoneCallSts_SetVt
{
    if(getValue(E_pubc_GW_GW_356_IMS_PhoneCallSts_SetVt))
    {
        //update the signal value
        Msg_GW_356.IMS_PhoneCallSts=getvalue(E_pubc_GW_GW_356_IMS_PhoneCallSts_Vt);
    }
    else
    {
        Msg_GW_356.IMS_PhoneCallSts=getValue(E_pubc_GW_GW_356_IMS_PhoneCallSts_Rv);
    }
}
/*@@end*/
 
/*@@envVar:E_pubc_GW_GW_356_IMS_DriverEyeDetect_Rv:*/
on envVar E_pubc_GW_GW_356_IMS_DriverEyeDetect_Rv
{
    int64 rawValue = 0ll;
    float rawValue_float = 0.0;
    float phyValue = 0.0;        

    //set the signal with updated raw value
    if(getValue(E_pubc_GW_GW_356_IMS_DriverEyeDetect_SetVt)==0)
    {
        rawValue = getvalue(this);
        if(chgEv_GW_356_IMS_DriverEyeDetect == 0)
        {
            //type conversion to float
            rawValue_float = rawValue;        
            // raw to physical conversion
            phyValue = ((rawValue_float *1)+(0));
            putValue(E_pubc_GW_GW_356_IMS_DriverEyeDetect_Pv, phyValue);
            chgEv_GW_356_IMS_DriverEyeDetect = 1;
        }
        else
        {
            chgEv_GW_356_IMS_DriverEyeDetect = 0;
        }    
        //update the signal value
        Msg_GW_356.IMS_DriverEyeDetect=rawValue;        
    }                                                                           
}
/*@@end*/

/*@@envVar:E_pubc_GW_GW_356_IMS_DriverEyeDetect_Pv:*/
on envVar E_pubc_GW_GW_356_IMS_DriverEyeDetect_Pv
{
    int64 rawValue = 0ll;
    float phyValue = 0.0;
    
    //update the raw value with physical value 
    if(getValue(E_pubc_GW_GW_356_IMS_DriverEyeDetect_SetVt)==0)
    {
        if(chgEv_GW_356_IMS_DriverEyeDetect == 0)
        {
            phyValue = getvalue(this);
            // physical to raw conversion
            rawValue = ((phyValue -(0))/1);
            putValue(E_pubc_GW_GW_356_IMS_DriverEyeDetect_Rv, rawValue);
            chgEv_GW_356_IMS_DriverEyeDetect = 1;  
        }
        else
        {
            chgEv_GW_356_IMS_DriverEyeDetect = 0;
        }
    }
}
/*@@end*/

/*@@envVar:E_pubc_GW_GW_356_IMS_DriverEyeDetect_Vt:*/
on envVar E_pubc_GW_GW_356_IMS_DriverEyeDetect_Vt
{
    qword rawValue = 0ll;
    if(getValue(E_pubc_GW_GW_356_IMS_DriverEyeDetect_SetVt))
    {
        //update the signal value
        Msg_GW_356.IMS_DriverEyeDetect=getValue(this);
    }
}
/*@@end*/

/*@@envVar:E_pubc_GW_GW_356_IMS_DriverEyeDetect_SetVt:*/
on envVar E_pubc_GW_GW_356_IMS_DriverEyeDetect_SetVt
{
    if(getValue(E_pubc_GW_GW_356_IMS_DriverEyeDetect_SetVt))
    {
        //update the signal value
        Msg_GW_356.IMS_DriverEyeDetect=getvalue(E_pubc_GW_GW_356_IMS_DriverEyeDetect_Vt);
    }
    else
    {
        Msg_GW_356.IMS_DriverEyeDetect=getValue(E_pubc_GW_GW_356_IMS_DriverEyeDetect_Rv);
    }
}
/*@@end*/
 
/*@@envVar:E_pubc_GW_GW_356_IMS_DrowsinessStatus_Rv:*/
on envVar E_pubc_GW_GW_356_IMS_DrowsinessStatus_Rv
{
    int64 rawValue = 0ll;
    float rawValue_float = 0.0;
    float phyValue = 0.0;        

    //set the signal with updated raw value
    if(getValue(E_pubc_GW_GW_356_IMS_DrowsinessStatus_SetVt)==0)
    {
        rawValue = getvalue(this);
        if(chgEv_GW_356_IMS_DrowsinessStatus == 0)
        {
            //type conversion to float
            rawValue_float = rawValue;        
            // raw to physical conversion
            phyValue = ((rawValue_float *1)+(0));
            putValue(E_pubc_GW_GW_356_IMS_DrowsinessStatus_Pv, phyValue);
            chgEv_GW_356_IMS_DrowsinessStatus = 1;
        }
        else
        {
            chgEv_GW_356_IMS_DrowsinessStatus = 0;
        }    
        //update the signal value
        Msg_GW_356.IMS_DrowsinessStatus=rawValue;        
    }                                                                           
}
/*@@end*/

/*@@envVar:E_pubc_GW_GW_356_IMS_DrowsinessStatus_Pv:*/
on envVar E_pubc_GW_GW_356_IMS_DrowsinessStatus_Pv
{
    int64 rawValue = 0ll;
    float phyValue = 0.0;
    
    //update the raw value with physical value 
    if(getValue(E_pubc_GW_GW_356_IMS_DrowsinessStatus_SetVt)==0)
    {
        if(chgEv_GW_356_IMS_DrowsinessStatus == 0)
        {
            phyValue = getvalue(this);
            // physical to raw conversion
            rawValue = ((phyValue -(0))/1);
            putValue(E_pubc_GW_GW_356_IMS_DrowsinessStatus_Rv, rawValue);
            chgEv_GW_356_IMS_DrowsinessStatus = 1;  
        }
        else
        {
            chgEv_GW_356_IMS_DrowsinessStatus = 0;
        }
    }
}
/*@@end*/

/*@@envVar:E_pubc_GW_GW_356_IMS_DrowsinessStatus_Vt:*/
on envVar E_pubc_GW_GW_356_IMS_DrowsinessStatus_Vt
{
    qword rawValue = 0ll;
    if(getValue(E_pubc_GW_GW_356_IMS_DrowsinessStatus_SetVt))
    {
        //update the signal value
        Msg_GW_356.IMS_DrowsinessStatus=getValue(this);
    }
}
/*@@end*/

/*@@envVar:E_pubc_GW_GW_356_IMS_DrowsinessStatus_SetVt:*/
on envVar E_pubc_GW_GW_356_IMS_DrowsinessStatus_SetVt
{
    if(getValue(E_pubc_GW_GW_356_IMS_DrowsinessStatus_SetVt))
    {
        //update the signal value
        Msg_GW_356.IMS_DrowsinessStatus=getvalue(E_pubc_GW_GW_356_IMS_DrowsinessStatus_Vt);
    }
    else
    {
        Msg_GW_356.IMS_DrowsinessStatus=getValue(E_pubc_GW_GW_356_IMS_DrowsinessStatus_Rv);
    }
}
/*@@end*/
 
/*@@envVar:E_pubc_GW_GW_356_IMS_DriverEyeClosestatus_Rv:*/
on envVar E_pubc_GW_GW_356_IMS_DriverEyeClosestatus_Rv
{
    int64 rawValue = 0ll;
    float rawValue_float = 0.0;
    float phyValue = 0.0;        

    //set the signal with updated raw value
    if(getValue(E_pubc_GW_GW_356_IMS_DriverEyeClosestatus_SetVt)==0)
    {
        rawValue = getvalue(this);
        if(chgEv_GW_356_IMS_DriverEyeClosestatus == 0)
        {
            //type conversion to float
            rawValue_float = rawValue;        
            // raw to physical conversion
            phyValue = ((rawValue_float *1)+(0));
            putValue(E_pubc_GW_GW_356_IMS_DriverEyeClosestatus_Pv, phyValue);
            chgEv_GW_356_IMS_DriverEyeClosestatus = 1;
        }
        else
        {
            chgEv_GW_356_IMS_DriverEyeClosestatus = 0;
        }    
        //update the signal value
        Msg_GW_356.IMS_DriverEyeClosestatus=rawValue;        
    }                                                                           
}
/*@@end*/

/*@@envVar:E_pubc_GW_GW_356_IMS_DriverEyeClosestatus_Pv:*/
on envVar E_pubc_GW_GW_356_IMS_DriverEyeClosestatus_Pv
{
    int64 rawValue = 0ll;
    float phyValue = 0.0;
    
    //update the raw value with physical value 
    if(getValue(E_pubc_GW_GW_356_IMS_DriverEyeClosestatus_SetVt)==0)
    {
        if(chgEv_GW_356_IMS_DriverEyeClosestatus == 0)
        {
            phyValue = getvalue(this);
            // physical to raw conversion
            rawValue = ((phyValue -(0))/1);
            putValue(E_pubc_GW_GW_356_IMS_DriverEyeClosestatus_Rv, rawValue);
            chgEv_GW_356_IMS_DriverEyeClosestatus = 1;  
        }
        else
        {
            chgEv_GW_356_IMS_DriverEyeClosestatus = 0;
        }
    }
}
/*@@end*/

/*@@envVar:E_pubc_GW_GW_356_IMS_DriverEyeClosestatus_Vt:*/
on envVar E_pubc_GW_GW_356_IMS_DriverEyeClosestatus_Vt
{
    qword rawValue = 0ll;
    if(getValue(E_pubc_GW_GW_356_IMS_DriverEyeClosestatus_SetVt))
    {
        //update the signal value
        Msg_GW_356.IMS_DriverEyeClosestatus=getValue(this);
    }
}
/*@@end*/

/*@@envVar:E_pubc_GW_GW_356_IMS_DriverEyeClosestatus_SetVt:*/
on envVar E_pubc_GW_GW_356_IMS_DriverEyeClosestatus_SetVt
{
    if(getValue(E_pubc_GW_GW_356_IMS_DriverEyeClosestatus_SetVt))
    {
        //update the signal value
        Msg_GW_356.IMS_DriverEyeClosestatus=getvalue(E_pubc_GW_GW_356_IMS_DriverEyeClosestatus_Vt);
    }
    else
    {
        Msg_GW_356.IMS_DriverEyeClosestatus=getValue(E_pubc_GW_GW_356_IMS_DriverEyeClosestatus_Rv);
    }
}
/*@@end*/
 
/*@@envVar:E_pubc_GW_GW_356_IMS_HeadDetectSts_Yaw_Rv:*/
on envVar E_pubc_GW_GW_356_IMS_HeadDetectSts_Yaw_Rv
{
    int64 rawValue = 0ll;
    float rawValue_float = 0.0;
    float phyValue = 0.0;        

    //set the signal with updated raw value
    {
        rawValue = getvalue(this);
        if(chgEv_GW_356_IMS_HeadDetectSts_Yaw == 0)
        {
            //type conversion to float
            rawValue_float = rawValue;        
            // raw to physical conversion
            phyValue = ((rawValue_float *1)+(-75));
            putValue(E_pubc_GW_GW_356_IMS_HeadDetectSts_Yaw_Pv, phyValue);
            chgEv_GW_356_IMS_HeadDetectSts_Yaw = 1;
        }
        else
        {
            chgEv_GW_356_IMS_HeadDetectSts_Yaw = 0;
        }    
        //update the signal value
        Msg_GW_356.IMS_HeadDetectSts_Yaw=rawValue;        
    }                                                                           
}
/*@@end*/

/*@@envVar:E_pubc_GW_GW_356_IMS_HeadDetectSts_Yaw_Pv:*/
on envVar E_pubc_GW_GW_356_IMS_HeadDetectSts_Yaw_Pv
{
    int64 rawValue = 0ll;
    float phyValue = 0.0;
    
    //update the raw value with physical value 
    {
        if(chgEv_GW_356_IMS_HeadDetectSts_Yaw == 0)
        {
            phyValue = getvalue(this);
            // physical to raw conversion
            rawValue = ((phyValue -(-75))/1);
            putValue(E_pubc_GW_GW_356_IMS_HeadDetectSts_Yaw_Rv, rawValue);
            chgEv_GW_356_IMS_HeadDetectSts_Yaw = 1;  
        }
        else
        {
            chgEv_GW_356_IMS_HeadDetectSts_Yaw = 0;
        }
    }
}
/*@@end*/


 
/*@@envVar:E_pubc_GW_GW_356_IMS_DriverHeadDetect_Rv:*/
on envVar E_pubc_GW_GW_356_IMS_DriverHeadDetect_Rv
{
    int64 rawValue = 0ll;
    float rawValue_float = 0.0;
    float phyValue = 0.0;        

    //set the signal with updated raw value
    if(getValue(E_pubc_GW_GW_356_IMS_DriverHeadDetect_SetVt)==0)
    {
        rawValue = getvalue(this);
        if(chgEv_GW_356_IMS_DriverHeadDetect == 0)
        {
            //type conversion to float
            rawValue_float = rawValue;        
            // raw to physical conversion
            phyValue = ((rawValue_float *1)+(0));
            putValue(E_pubc_GW_GW_356_IMS_DriverHeadDetect_Pv, phyValue);
            chgEv_GW_356_IMS_DriverHeadDetect = 1;
        }
        else
        {
            chgEv_GW_356_IMS_DriverHeadDetect = 0;
        }    
        //update the signal value
        Msg_GW_356.IMS_DriverHeadDetect=rawValue;        
    }                                                                           
}
/*@@end*/

/*@@envVar:E_pubc_GW_GW_356_IMS_DriverHeadDetect_Pv:*/
on envVar E_pubc_GW_GW_356_IMS_DriverHeadDetect_Pv
{
    int64 rawValue = 0ll;
    float phyValue = 0.0;
    
    //update the raw value with physical value 
    if(getValue(E_pubc_GW_GW_356_IMS_DriverHeadDetect_SetVt)==0)
    {
        if(chgEv_GW_356_IMS_DriverHeadDetect == 0)
        {
            phyValue = getvalue(this);
            // physical to raw conversion
            rawValue = ((phyValue -(0))/1);
            putValue(E_pubc_GW_GW_356_IMS_DriverHeadDetect_Rv, rawValue);
            chgEv_GW_356_IMS_DriverHeadDetect = 1;  
        }
        else
        {
            chgEv_GW_356_IMS_DriverHeadDetect = 0;
        }
    }
}
/*@@end*/

/*@@envVar:E_pubc_GW_GW_356_IMS_DriverHeadDetect_Vt:*/
on envVar E_pubc_GW_GW_356_IMS_DriverHeadDetect_Vt
{
    qword rawValue = 0ll;
    if(getValue(E_pubc_GW_GW_356_IMS_DriverHeadDetect_SetVt))
    {
        //update the signal value
        Msg_GW_356.IMS_DriverHeadDetect=getValue(this);
    }
}
/*@@end*/

/*@@envVar:E_pubc_GW_GW_356_IMS_DriverHeadDetect_SetVt:*/
on envVar E_pubc_GW_GW_356_IMS_DriverHeadDetect_SetVt
{
    if(getValue(E_pubc_GW_GW_356_IMS_DriverHeadDetect_SetVt))
    {
        //update the signal value
        Msg_GW_356.IMS_DriverHeadDetect=getvalue(E_pubc_GW_GW_356_IMS_DriverHeadDetect_Vt);
    }
    else
    {
        Msg_GW_356.IMS_DriverHeadDetect=getValue(E_pubc_GW_GW_356_IMS_DriverHeadDetect_Rv);
    }
}
/*@@end*/
 
/*@@envVar:E_pubc_GW_GW_507_tx:*/
on envVar E_pubc_GW_GW_507_tx
{
    if(getValue(this))
    {       
        

        output(Msg_GW_507);        
    }
}
/*@@end*/

/*@@envVar:E_pubc_GW_GW_507_Range:*/
on envVar E_pubc_GW_GW_507_Range
{
    qword rawstatus = 0ll;
    qword rawValue = 0ll;    
    
    rawstatus = getvalue(this);    
    // set all the signals with min raw /max raw /init raw
    switch (rawstatus) 
    {
     case(0) :
        rawValue= 0;
        putValue(E_pubc_GW_GW_507_HU_VC_CruiseSetDistance_Rv, rawValue);
        rawValue= 0;
        putValue(E_pubc_GW_GW_507_HU_VC_CruiseControl_Rv, rawValue);
        rawValue= 0;
        putValue(E_pubc_GW_GW_507_HU_VC_CruiseSetSpeed_Rv, rawValue);
        rawValue= 0;
        putValue(E_pubc_GW_GW_507_HU_OverspeedWarningOffset_Rv, rawValue);
        rawValue= 0;
        putValue(E_pubc_GW_GW_507_HU_LASWarningModeSelection_Rv, rawValue);
        rawValue= 0;
        putValue(E_pubc_GW_GW_507_HU_AutoBrakeEnable_Rv, rawValue);
        rawValue= 0;
        putValue(E_pubc_GW_GW_507_HU_LASModeSelection_Rv, rawValue);
        rawValue= 0;
        putValue(E_pubc_GW_GW_507_HU_TSRSwitch_Rv, rawValue);
        rawValue= 0;
        putValue(E_pubc_GW_GW_507_HU_OverspeedWarningEnable_Rv, rawValue);
        rawValue= 0;
        putValue(E_pubc_GW_GW_507_HU_OverspeedSoundWarEnable_Rv, rawValue);
        rawValue= 0;
        putValue(E_pubc_GW_GW_507_HU_HMAEnable_Rv, rawValue);
        rawValue= 0;
        putValue(E_pubc_GW_GW_507_HU_LDWShakeLev_Rv, rawValue);
        rawValue= 0;
        putValue(E_pubc_GW_GW_507_HU_IACCEnable_Rv, rawValue);
        rawValue= 0;
        putValue(E_pubc_GW_GW_507_HU_FCWSetting_Rv, rawValue);
        rawValue= 0;
        putValue(E_pubc_GW_GW_507_HU_CruiseControlSet_Rv, rawValue);
        break;
     case(1) :
        rawValue= 7;
        putValue(E_pubc_GW_GW_507_HU_VC_CruiseSetDistance_Rv, rawValue);
        rawValue= 7;
        putValue(E_pubc_GW_GW_507_HU_VC_CruiseControl_Rv, rawValue);
        rawValue= 255;
        putValue(E_pubc_GW_GW_507_HU_VC_CruiseSetSpeed_Rv, rawValue);
        rawValue= 20;
        putValue(E_pubc_GW_GW_507_HU_OverspeedWarningOffset_Rv, rawValue);
        rawValue= 7;
        putValue(E_pubc_GW_GW_507_HU_LASWarningModeSelection_Rv, rawValue);
        rawValue= 1;
        putValue(E_pubc_GW_GW_507_HU_AutoBrakeEnable_Rv, rawValue);
        rawValue= 7;
        putValue(E_pubc_GW_GW_507_HU_LASModeSelection_Rv, rawValue);
        rawValue= 1;
        putValue(E_pubc_GW_GW_507_HU_TSRSwitch_Rv, rawValue);
        rawValue= 3;
        putValue(E_pubc_GW_GW_507_HU_OverspeedWarningEnable_Rv, rawValue);
        rawValue= 3;
        putValue(E_pubc_GW_GW_507_HU_OverspeedSoundWarEnable_Rv, rawValue);
        rawValue= 1;
        putValue(E_pubc_GW_GW_507_HU_HMAEnable_Rv, rawValue);
        rawValue= 3;
        putValue(E_pubc_GW_GW_507_HU_LDWShakeLev_Rv, rawValue);
        rawValue= 3;
        putValue(E_pubc_GW_GW_507_HU_IACCEnable_Rv, rawValue);
        rawValue= 7;
        putValue(E_pubc_GW_GW_507_HU_FCWSetting_Rv, rawValue);
        rawValue= 7;
        putValue(E_pubc_GW_GW_507_HU_CruiseControlSet_Rv, rawValue);
        break;
     default :
        rawValue= 0;
        putValue(E_pubc_GW_GW_507_HU_VC_CruiseSetDistance_Rv, rawValue);
        rawValue= 0;
        putValue(E_pubc_GW_GW_507_HU_VC_CruiseControl_Rv, rawValue);
        rawValue= 0;
        putValue(E_pubc_GW_GW_507_HU_VC_CruiseSetSpeed_Rv, rawValue);
        rawValue= 0;
        putValue(E_pubc_GW_GW_507_HU_OverspeedWarningOffset_Rv, rawValue);
        rawValue= 0;
        putValue(E_pubc_GW_GW_507_HU_LASWarningModeSelection_Rv, rawValue);
        rawValue= 0;
        putValue(E_pubc_GW_GW_507_HU_AutoBrakeEnable_Rv, rawValue);
        rawValue= 0;
        putValue(E_pubc_GW_GW_507_HU_LASModeSelection_Rv, rawValue);
        rawValue= 0;
        putValue(E_pubc_GW_GW_507_HU_TSRSwitch_Rv, rawValue);
        rawValue= 0;
        putValue(E_pubc_GW_GW_507_HU_OverspeedWarningEnable_Rv, rawValue);
        rawValue= 0;
        putValue(E_pubc_GW_GW_507_HU_OverspeedSoundWarEnable_Rv, rawValue);
        rawValue= 0;
        putValue(E_pubc_GW_GW_507_HU_HMAEnable_Rv, rawValue);
        rawValue= 0;
        putValue(E_pubc_GW_GW_507_HU_LDWShakeLev_Rv, rawValue);
        rawValue= 0;
        putValue(E_pubc_GW_GW_507_HU_IACCEnable_Rv, rawValue);
        rawValue= 0;
        putValue(E_pubc_GW_GW_507_HU_FCWSetting_Rv, rawValue);
        rawValue= 0;
        putValue(E_pubc_GW_GW_507_HU_CruiseControlSet_Rv, rawValue);
      break;
   }
}
/*@@end*/

/*@@envVar:E_pubc_GW_GW_507_Dlc:*/
on envVar E_pubc_GW_GW_507_Dlc
{
    if(getValue(E_pubc_GW_GW_507_enDlc))
    {
        Msg_GW_507.dlc =getValue(this);
    }
    else
    {
       Dbc_dlc = 32;
	   Msg_GW_507.dlc = Calc_Canfd_dlc(Dbc_dlc);
	   // Msg_GW_507.dlc = 32;
	   	
  }
}
/*@@end*/

/*@@envVar:E_pubc_GW_GW_507_enDlc:*/
on envVar E_pubc_GW_GW_507_enDlc
{
    //For Messages with DLC = 8, set wrong DLC to smaller than defined DLC
    //For Messages with DLC < 8 set wrong DLC to smaller/longer than defined DLC
    if(getValue(this))
    {
        Msg_GW_507.dlc =getValue(E_pubc_GW_GW_507_Dlc);
    }
    else
    {
       Dbc_dlc = 32;
	   Msg_GW_507.dlc = Calc_Canfd_dlc(Dbc_dlc);
	   // Msg_GW_507.dlc = 32;
    }
}
/*@@end*/


/*@@envVar:E_pubc_GW_GW_507_HU_VC_CruiseSetDistance_Rv:*/
on envVar E_pubc_GW_GW_507_HU_VC_CruiseSetDistance_Rv
{
    int64 rawValue = 0ll;
    float rawValue_float = 0.0;
    float phyValue = 0.0;        

    //set the signal with updated raw value
    if(getValue(E_pubc_GW_GW_507_HU_VC_CruiseSetDistance_SetVt)==0)
    {
        rawValue = getvalue(this);
        if(chgEv_GW_507_HU_VC_CruiseSetDistance == 0)
        {
            //type conversion to float
            rawValue_float = rawValue;        
            // raw to physical conversion
            phyValue = ((rawValue_float *1)+(0));
            putValue(E_pubc_GW_GW_507_HU_VC_CruiseSetDistance_Pv, phyValue);
            chgEv_GW_507_HU_VC_CruiseSetDistance = 1;
        }
        else
        {
            chgEv_GW_507_HU_VC_CruiseSetDistance = 0;
        }    
        //update the signal value
        Msg_GW_507.HU_VC_CruiseSetDistance=rawValue;        
    }                                                                           
}
/*@@end*/

/*@@envVar:E_pubc_GW_GW_507_HU_VC_CruiseSetDistance_Pv:*/
on envVar E_pubc_GW_GW_507_HU_VC_CruiseSetDistance_Pv
{
    int64 rawValue = 0ll;
    float phyValue = 0.0;
    
    //update the raw value with physical value 
    if(getValue(E_pubc_GW_GW_507_HU_VC_CruiseSetDistance_SetVt)==0)
    {
        if(chgEv_GW_507_HU_VC_CruiseSetDistance == 0)
        {
            phyValue = getvalue(this);
            // physical to raw conversion
            rawValue = ((phyValue -(0))/1);
            putValue(E_pubc_GW_GW_507_HU_VC_CruiseSetDistance_Rv, rawValue);
            chgEv_GW_507_HU_VC_CruiseSetDistance = 1;  
        }
        else
        {
            chgEv_GW_507_HU_VC_CruiseSetDistance = 0;
        }
    }
}
/*@@end*/

/*@@envVar:E_pubc_GW_GW_507_HU_VC_CruiseSetDistance_Vt:*/
on envVar E_pubc_GW_GW_507_HU_VC_CruiseSetDistance_Vt
{
    qword rawValue = 0ll;
    if(getValue(E_pubc_GW_GW_507_HU_VC_CruiseSetDistance_SetVt))
    {
        //update the signal value
        Msg_GW_507.HU_VC_CruiseSetDistance=getValue(this);
    }
}
/*@@end*/

/*@@envVar:E_pubc_GW_GW_507_HU_VC_CruiseSetDistance_SetVt:*/
on envVar E_pubc_GW_GW_507_HU_VC_CruiseSetDistance_SetVt
{
    if(getValue(E_pubc_GW_GW_507_HU_VC_CruiseSetDistance_SetVt))
    {
        //update the signal value
        Msg_GW_507.HU_VC_CruiseSetDistance=getvalue(E_pubc_GW_GW_507_HU_VC_CruiseSetDistance_Vt);
    }
    else
    {
        Msg_GW_507.HU_VC_CruiseSetDistance=getValue(E_pubc_GW_GW_507_HU_VC_CruiseSetDistance_Rv);
    }
}
/*@@end*/
 
/*@@envVar:E_pubc_GW_GW_507_HU_VC_CruiseControl_Rv:*/
on envVar E_pubc_GW_GW_507_HU_VC_CruiseControl_Rv
{
    int64 rawValue = 0ll;
    float rawValue_float = 0.0;
    float phyValue = 0.0;        

    //set the signal with updated raw value
    if(getValue(E_pubc_GW_GW_507_HU_VC_CruiseControl_SetVt)==0)
    {
        rawValue = getvalue(this);
        if(chgEv_GW_507_HU_VC_CruiseControl == 0)
        {
            //type conversion to float
            rawValue_float = rawValue;        
            // raw to physical conversion
            phyValue = ((rawValue_float *1)+(0));
            putValue(E_pubc_GW_GW_507_HU_VC_CruiseControl_Pv, phyValue);
            chgEv_GW_507_HU_VC_CruiseControl = 1;
        }
        else
        {
            chgEv_GW_507_HU_VC_CruiseControl = 0;
        }    
        //update the signal value
        Msg_GW_507.HU_VC_CruiseControl=rawValue;        
    }                                                                           
}
/*@@end*/

/*@@envVar:E_pubc_GW_GW_507_HU_VC_CruiseControl_Pv:*/
on envVar E_pubc_GW_GW_507_HU_VC_CruiseControl_Pv
{
    int64 rawValue = 0ll;
    float phyValue = 0.0;
    
    //update the raw value with physical value 
    if(getValue(E_pubc_GW_GW_507_HU_VC_CruiseControl_SetVt)==0)
    {
        if(chgEv_GW_507_HU_VC_CruiseControl == 0)
        {
            phyValue = getvalue(this);
            // physical to raw conversion
            rawValue = ((phyValue -(0))/1);
            putValue(E_pubc_GW_GW_507_HU_VC_CruiseControl_Rv, rawValue);
            chgEv_GW_507_HU_VC_CruiseControl = 1;  
        }
        else
        {
            chgEv_GW_507_HU_VC_CruiseControl = 0;
        }
    }
}
/*@@end*/

/*@@envVar:E_pubc_GW_GW_507_HU_VC_CruiseControl_Vt:*/
on envVar E_pubc_GW_GW_507_HU_VC_CruiseControl_Vt
{
    qword rawValue = 0ll;
    if(getValue(E_pubc_GW_GW_507_HU_VC_CruiseControl_SetVt))
    {
        //update the signal value
        Msg_GW_507.HU_VC_CruiseControl=getValue(this);
    }
}
/*@@end*/

/*@@envVar:E_pubc_GW_GW_507_HU_VC_CruiseControl_SetVt:*/
on envVar E_pubc_GW_GW_507_HU_VC_CruiseControl_SetVt
{
    if(getValue(E_pubc_GW_GW_507_HU_VC_CruiseControl_SetVt))
    {
        //update the signal value
        Msg_GW_507.HU_VC_CruiseControl=getvalue(E_pubc_GW_GW_507_HU_VC_CruiseControl_Vt);
    }
    else
    {
        Msg_GW_507.HU_VC_CruiseControl=getValue(E_pubc_GW_GW_507_HU_VC_CruiseControl_Rv);
    }
}
/*@@end*/
 
/*@@envVar:E_pubc_GW_GW_507_HU_VC_CruiseSetSpeed_Rv:*/
on envVar E_pubc_GW_GW_507_HU_VC_CruiseSetSpeed_Rv
{
    int64 rawValue = 0ll;
    float rawValue_float = 0.0;
    float phyValue = 0.0;        

    //set the signal with updated raw value
    if(getValue(E_pubc_GW_GW_507_HU_VC_CruiseSetSpeed_SetVt)==0)
    {
        rawValue = getvalue(this);
        if(chgEv_GW_507_HU_VC_CruiseSetSpeed == 0)
        {
            //type conversion to float
            rawValue_float = rawValue;        
            // raw to physical conversion
            phyValue = ((rawValue_float *1)+(0));
            putValue(E_pubc_GW_GW_507_HU_VC_CruiseSetSpeed_Pv, phyValue);
            chgEv_GW_507_HU_VC_CruiseSetSpeed = 1;
        }
        else
        {
            chgEv_GW_507_HU_VC_CruiseSetSpeed = 0;
        }    
        //update the signal value
        Msg_GW_507.HU_VC_CruiseSetSpeed=rawValue;        
    }                                                                           
}
/*@@end*/

/*@@envVar:E_pubc_GW_GW_507_HU_VC_CruiseSetSpeed_Pv:*/
on envVar E_pubc_GW_GW_507_HU_VC_CruiseSetSpeed_Pv
{
    int64 rawValue = 0ll;
    float phyValue = 0.0;
    
    //update the raw value with physical value 
    if(getValue(E_pubc_GW_GW_507_HU_VC_CruiseSetSpeed_SetVt)==0)
    {
        if(chgEv_GW_507_HU_VC_CruiseSetSpeed == 0)
        {
            phyValue = getvalue(this);
            // physical to raw conversion
            rawValue = ((phyValue -(0))/1);
            putValue(E_pubc_GW_GW_507_HU_VC_CruiseSetSpeed_Rv, rawValue);
            chgEv_GW_507_HU_VC_CruiseSetSpeed = 1;  
        }
        else
        {
            chgEv_GW_507_HU_VC_CruiseSetSpeed = 0;
        }
    }
}
/*@@end*/

/*@@envVar:E_pubc_GW_GW_507_HU_VC_CruiseSetSpeed_Vt:*/
on envVar E_pubc_GW_GW_507_HU_VC_CruiseSetSpeed_Vt
{
    qword rawValue = 0ll;
    if(getValue(E_pubc_GW_GW_507_HU_VC_CruiseSetSpeed_SetVt))
    {
        //update the signal value
        Msg_GW_507.HU_VC_CruiseSetSpeed=getValue(this);
    }
}
/*@@end*/

/*@@envVar:E_pubc_GW_GW_507_HU_VC_CruiseSetSpeed_SetVt:*/
on envVar E_pubc_GW_GW_507_HU_VC_CruiseSetSpeed_SetVt
{
    if(getValue(E_pubc_GW_GW_507_HU_VC_CruiseSetSpeed_SetVt))
    {
        //update the signal value
        Msg_GW_507.HU_VC_CruiseSetSpeed=getvalue(E_pubc_GW_GW_507_HU_VC_CruiseSetSpeed_Vt);
    }
    else
    {
        Msg_GW_507.HU_VC_CruiseSetSpeed=getValue(E_pubc_GW_GW_507_HU_VC_CruiseSetSpeed_Rv);
    }
}
/*@@end*/
 
/*@@envVar:E_pubc_GW_GW_507_HU_OverspeedWarningOffset_Rv:*/
on envVar E_pubc_GW_GW_507_HU_OverspeedWarningOffset_Rv
{
    int64 rawValue = 0ll;
    float rawValue_float = 0.0;
    float phyValue = 0.0;        

    //set the signal with updated raw value
    {
        rawValue = getvalue(this);
        if(chgEv_GW_507_HU_OverspeedWarningOffset == 0)
        {
            //type conversion to float
            rawValue_float = rawValue;        
            // raw to physical conversion
            phyValue = ((rawValue_float *1)+(-10));
            putValue(E_pubc_GW_GW_507_HU_OverspeedWarningOffset_Pv, phyValue);
            chgEv_GW_507_HU_OverspeedWarningOffset = 1;
        }
        else
        {
            chgEv_GW_507_HU_OverspeedWarningOffset = 0;
        }    
        //update the signal value
        Msg_GW_507.HU_OverspeedWarningOffset=rawValue;        
    }                                                                           
}
/*@@end*/

/*@@envVar:E_pubc_GW_GW_507_HU_OverspeedWarningOffset_Pv:*/
on envVar E_pubc_GW_GW_507_HU_OverspeedWarningOffset_Pv
{
    int64 rawValue = 0ll;
    float phyValue = 0.0;
    
    //update the raw value with physical value 
    {
        if(chgEv_GW_507_HU_OverspeedWarningOffset == 0)
        {
            phyValue = getvalue(this);
            // physical to raw conversion
            rawValue = ((phyValue -(-10))/1);
            putValue(E_pubc_GW_GW_507_HU_OverspeedWarningOffset_Rv, rawValue);
            chgEv_GW_507_HU_OverspeedWarningOffset = 1;  
        }
        else
        {
            chgEv_GW_507_HU_OverspeedWarningOffset = 0;
        }
    }
}
/*@@end*/


 
/*@@envVar:E_pubc_GW_GW_507_HU_LASWarningModeSelection_Rv:*/
on envVar E_pubc_GW_GW_507_HU_LASWarningModeSelection_Rv
{
    int64 rawValue = 0ll;
    float rawValue_float = 0.0;
    float phyValue = 0.0;        

    //set the signal with updated raw value
    if(getValue(E_pubc_GW_GW_507_HU_LASWarningModeSelection_SetVt)==0)
    {
        rawValue = getvalue(this);
        if(chgEv_GW_507_HU_LASWarningModeSelection == 0)
        {
            //type conversion to float
            rawValue_float = rawValue;        
            // raw to physical conversion
            phyValue = ((rawValue_float *1)+(0));
            putValue(E_pubc_GW_GW_507_HU_LASWarningModeSelection_Pv, phyValue);
            chgEv_GW_507_HU_LASWarningModeSelection = 1;
        }
        else
        {
            chgEv_GW_507_HU_LASWarningModeSelection = 0;
        }    
        //update the signal value
        Msg_GW_507.HU_LASWarningModeSelection=rawValue;        
    }                                                                           
}
/*@@end*/

/*@@envVar:E_pubc_GW_GW_507_HU_LASWarningModeSelection_Pv:*/
on envVar E_pubc_GW_GW_507_HU_LASWarningModeSelection_Pv
{
    int64 rawValue = 0ll;
    float phyValue = 0.0;
    
    //update the raw value with physical value 
    if(getValue(E_pubc_GW_GW_507_HU_LASWarningModeSelection_SetVt)==0)
    {
        if(chgEv_GW_507_HU_LASWarningModeSelection == 0)
        {
            phyValue = getvalue(this);
            // physical to raw conversion
            rawValue = ((phyValue -(0))/1);
            putValue(E_pubc_GW_GW_507_HU_LASWarningModeSelection_Rv, rawValue);
            chgEv_GW_507_HU_LASWarningModeSelection = 1;  
        }
        else
        {
            chgEv_GW_507_HU_LASWarningModeSelection = 0;
        }
    }
}
/*@@end*/

/*@@envVar:E_pubc_GW_GW_507_HU_LASWarningModeSelection_Vt:*/
on envVar E_pubc_GW_GW_507_HU_LASWarningModeSelection_Vt
{
    qword rawValue = 0ll;
    if(getValue(E_pubc_GW_GW_507_HU_LASWarningModeSelection_SetVt))
    {
        //update the signal value
        Msg_GW_507.HU_LASWarningModeSelection=getValue(this);
    }
}
/*@@end*/

/*@@envVar:E_pubc_GW_GW_507_HU_LASWarningModeSelection_SetVt:*/
on envVar E_pubc_GW_GW_507_HU_LASWarningModeSelection_SetVt
{
    if(getValue(E_pubc_GW_GW_507_HU_LASWarningModeSelection_SetVt))
    {
        //update the signal value
        Msg_GW_507.HU_LASWarningModeSelection=getvalue(E_pubc_GW_GW_507_HU_LASWarningModeSelection_Vt);
    }
    else
    {
        Msg_GW_507.HU_LASWarningModeSelection=getValue(E_pubc_GW_GW_507_HU_LASWarningModeSelection_Rv);
    }
}
/*@@end*/
 
/*@@envVar:E_pubc_GW_GW_507_HU_AutoBrakeEnable_Rv:*/
on envVar E_pubc_GW_GW_507_HU_AutoBrakeEnable_Rv
{
    int64 rawValue = 0ll;
    float rawValue_float = 0.0;
    float phyValue = 0.0;        

    //set the signal with updated raw value
    if(getValue(E_pubc_GW_GW_507_HU_AutoBrakeEnable_SetVt)==0)
    {
        rawValue = getvalue(this);
        if(chgEv_GW_507_HU_AutoBrakeEnable == 0)
        {
            //type conversion to float
            rawValue_float = rawValue;        
            // raw to physical conversion
            phyValue = ((rawValue_float *1)+(0));
            putValue(E_pubc_GW_GW_507_HU_AutoBrakeEnable_Pv, phyValue);
            chgEv_GW_507_HU_AutoBrakeEnable = 1;
        }
        else
        {
            chgEv_GW_507_HU_AutoBrakeEnable = 0;
        }    
        //update the signal value
        Msg_GW_507.HU_AutoBrakeEnable=rawValue;        
    }                                                                           
}
/*@@end*/

/*@@envVar:E_pubc_GW_GW_507_HU_AutoBrakeEnable_Pv:*/
on envVar E_pubc_GW_GW_507_HU_AutoBrakeEnable_Pv
{
    int64 rawValue = 0ll;
    float phyValue = 0.0;
    
    //update the raw value with physical value 
    if(getValue(E_pubc_GW_GW_507_HU_AutoBrakeEnable_SetVt)==0)
    {
        if(chgEv_GW_507_HU_AutoBrakeEnable == 0)
        {
            phyValue = getvalue(this);
            // physical to raw conversion
            rawValue = ((phyValue -(0))/1);
            putValue(E_pubc_GW_GW_507_HU_AutoBrakeEnable_Rv, rawValue);
            chgEv_GW_507_HU_AutoBrakeEnable = 1;  
        }
        else
        {
            chgEv_GW_507_HU_AutoBrakeEnable = 0;
        }
    }
}
/*@@end*/

/*@@envVar:E_pubc_GW_GW_507_HU_AutoBrakeEnable_Vt:*/
on envVar E_pubc_GW_GW_507_HU_AutoBrakeEnable_Vt
{
    qword rawValue = 0ll;
    if(getValue(E_pubc_GW_GW_507_HU_AutoBrakeEnable_SetVt))
    {
        //update the signal value
        Msg_GW_507.HU_AutoBrakeEnable=getValue(this);
    }
}
/*@@end*/

/*@@envVar:E_pubc_GW_GW_507_HU_AutoBrakeEnable_SetVt:*/
on envVar E_pubc_GW_GW_507_HU_AutoBrakeEnable_SetVt
{
    if(getValue(E_pubc_GW_GW_507_HU_AutoBrakeEnable_SetVt))
    {
        //update the signal value
        Msg_GW_507.HU_AutoBrakeEnable=getvalue(E_pubc_GW_GW_507_HU_AutoBrakeEnable_Vt);
    }
    else
    {
        Msg_GW_507.HU_AutoBrakeEnable=getValue(E_pubc_GW_GW_507_HU_AutoBrakeEnable_Rv);
    }
}
/*@@end*/
 
/*@@envVar:E_pubc_GW_GW_507_HU_LASModeSelection_Rv:*/
on envVar E_pubc_GW_GW_507_HU_LASModeSelection_Rv
{
    int64 rawValue = 0ll;
    float rawValue_float = 0.0;
    float phyValue = 0.0;        

    //set the signal with updated raw value
    if(getValue(E_pubc_GW_GW_507_HU_LASModeSelection_SetVt)==0)
    {
        rawValue = getvalue(this);
        if(chgEv_GW_507_HU_LASModeSelection == 0)
        {
            //type conversion to float
            rawValue_float = rawValue;        
            // raw to physical conversion
            phyValue = ((rawValue_float *1)+(0));
            putValue(E_pubc_GW_GW_507_HU_LASModeSelection_Pv, phyValue);
            chgEv_GW_507_HU_LASModeSelection = 1;
        }
        else
        {
            chgEv_GW_507_HU_LASModeSelection = 0;
        }    
        //update the signal value
        Msg_GW_507.HU_LASModeSelection=rawValue;        
    }                                                                           
}
/*@@end*/

/*@@envVar:E_pubc_GW_GW_507_HU_LASModeSelection_Pv:*/
on envVar E_pubc_GW_GW_507_HU_LASModeSelection_Pv
{
    int64 rawValue = 0ll;
    float phyValue = 0.0;
    
    //update the raw value with physical value 
    if(getValue(E_pubc_GW_GW_507_HU_LASModeSelection_SetVt)==0)
    {
        if(chgEv_GW_507_HU_LASModeSelection == 0)
        {
            phyValue = getvalue(this);
            // physical to raw conversion
            rawValue = ((phyValue -(0))/1);
            putValue(E_pubc_GW_GW_507_HU_LASModeSelection_Rv, rawValue);
            chgEv_GW_507_HU_LASModeSelection = 1;  
        }
        else
        {
            chgEv_GW_507_HU_LASModeSelection = 0;
        }
    }
}
/*@@end*/

/*@@envVar:E_pubc_GW_GW_507_HU_LASModeSelection_Vt:*/
on envVar E_pubc_GW_GW_507_HU_LASModeSelection_Vt
{
    qword rawValue = 0ll;
    if(getValue(E_pubc_GW_GW_507_HU_LASModeSelection_SetVt))
    {
        //update the signal value
        Msg_GW_507.HU_LASModeSelection=getValue(this);
    }
}
/*@@end*/

/*@@envVar:E_pubc_GW_GW_507_HU_LASModeSelection_SetVt:*/
on envVar E_pubc_GW_GW_507_HU_LASModeSelection_SetVt
{
    if(getValue(E_pubc_GW_GW_507_HU_LASModeSelection_SetVt))
    {
        //update the signal value
        Msg_GW_507.HU_LASModeSelection=getvalue(E_pubc_GW_GW_507_HU_LASModeSelection_Vt);
    }
    else
    {
        Msg_GW_507.HU_LASModeSelection=getValue(E_pubc_GW_GW_507_HU_LASModeSelection_Rv);
    }
}
/*@@end*/
 
/*@@envVar:E_pubc_GW_GW_507_HU_TSRSwitch_Rv:*/
on envVar E_pubc_GW_GW_507_HU_TSRSwitch_Rv
{
    int64 rawValue = 0ll;
    float rawValue_float = 0.0;
    float phyValue = 0.0;        

    //set the signal with updated raw value
    if(getValue(E_pubc_GW_GW_507_HU_TSRSwitch_SetVt)==0)
    {
        rawValue = getvalue(this);
        if(chgEv_GW_507_HU_TSRSwitch == 0)
        {
            //type conversion to float
            rawValue_float = rawValue;        
            // raw to physical conversion
            phyValue = ((rawValue_float *1)+(0));
            putValue(E_pubc_GW_GW_507_HU_TSRSwitch_Pv, phyValue);
            chgEv_GW_507_HU_TSRSwitch = 1;
        }
        else
        {
            chgEv_GW_507_HU_TSRSwitch = 0;
        }    
        //update the signal value
        Msg_GW_507.HU_TSRSwitch=rawValue;        
    }                                                                           
}
/*@@end*/

/*@@envVar:E_pubc_GW_GW_507_HU_TSRSwitch_Pv:*/
on envVar E_pubc_GW_GW_507_HU_TSRSwitch_Pv
{
    int64 rawValue = 0ll;
    float phyValue = 0.0;
    
    //update the raw value with physical value 
    if(getValue(E_pubc_GW_GW_507_HU_TSRSwitch_SetVt)==0)
    {
        if(chgEv_GW_507_HU_TSRSwitch == 0)
        {
            phyValue = getvalue(this);
            // physical to raw conversion
            rawValue = ((phyValue -(0))/1);
            putValue(E_pubc_GW_GW_507_HU_TSRSwitch_Rv, rawValue);
            chgEv_GW_507_HU_TSRSwitch = 1;  
        }
        else
        {
            chgEv_GW_507_HU_TSRSwitch = 0;
        }
    }
}
/*@@end*/

/*@@envVar:E_pubc_GW_GW_507_HU_TSRSwitch_Vt:*/
on envVar E_pubc_GW_GW_507_HU_TSRSwitch_Vt
{
    qword rawValue = 0ll;
    if(getValue(E_pubc_GW_GW_507_HU_TSRSwitch_SetVt))
    {
        //update the signal value
        Msg_GW_507.HU_TSRSwitch=getValue(this);
    }
}
/*@@end*/

/*@@envVar:E_pubc_GW_GW_507_HU_TSRSwitch_SetVt:*/
on envVar E_pubc_GW_GW_507_HU_TSRSwitch_SetVt
{
    if(getValue(E_pubc_GW_GW_507_HU_TSRSwitch_SetVt))
    {
        //update the signal value
        Msg_GW_507.HU_TSRSwitch=getvalue(E_pubc_GW_GW_507_HU_TSRSwitch_Vt);
    }
    else
    {
        Msg_GW_507.HU_TSRSwitch=getValue(E_pubc_GW_GW_507_HU_TSRSwitch_Rv);
    }
}
/*@@end*/
 
/*@@envVar:E_pubc_GW_GW_507_HU_OverspeedWarningEnable_Rv:*/
on envVar E_pubc_GW_GW_507_HU_OverspeedWarningEnable_Rv
{
    int64 rawValue = 0ll;
    float rawValue_float = 0.0;
    float phyValue = 0.0;        

    //set the signal with updated raw value
    if(getValue(E_pubc_GW_GW_507_HU_OverspeedWarningEnable_SetVt)==0)
    {
        rawValue = getvalue(this);
        if(chgEv_GW_507_HU_OverspeedWarningEnable == 0)
        {
            //type conversion to float
            rawValue_float = rawValue;        
            // raw to physical conversion
            phyValue = ((rawValue_float *1)+(0));
            putValue(E_pubc_GW_GW_507_HU_OverspeedWarningEnable_Pv, phyValue);
            chgEv_GW_507_HU_OverspeedWarningEnable = 1;
        }
        else
        {
            chgEv_GW_507_HU_OverspeedWarningEnable = 0;
        }    
        //update the signal value
        Msg_GW_507.HU_OverspeedWarningEnable=rawValue;        
    }                                                                           
}
/*@@end*/

/*@@envVar:E_pubc_GW_GW_507_HU_OverspeedWarningEnable_Pv:*/
on envVar E_pubc_GW_GW_507_HU_OverspeedWarningEnable_Pv
{
    int64 rawValue = 0ll;
    float phyValue = 0.0;
    
    //update the raw value with physical value 
    if(getValue(E_pubc_GW_GW_507_HU_OverspeedWarningEnable_SetVt)==0)
    {
        if(chgEv_GW_507_HU_OverspeedWarningEnable == 0)
        {
            phyValue = getvalue(this);
            // physical to raw conversion
            rawValue = ((phyValue -(0))/1);
            putValue(E_pubc_GW_GW_507_HU_OverspeedWarningEnable_Rv, rawValue);
            chgEv_GW_507_HU_OverspeedWarningEnable = 1;  
        }
        else
        {
            chgEv_GW_507_HU_OverspeedWarningEnable = 0;
        }
    }
}
/*@@end*/

/*@@envVar:E_pubc_GW_GW_507_HU_OverspeedWarningEnable_Vt:*/
on envVar E_pubc_GW_GW_507_HU_OverspeedWarningEnable_Vt
{
    qword rawValue = 0ll;
    if(getValue(E_pubc_GW_GW_507_HU_OverspeedWarningEnable_SetVt))
    {
        //update the signal value
        Msg_GW_507.HU_OverspeedWarningEnable=getValue(this);
    }
}
/*@@end*/

/*@@envVar:E_pubc_GW_GW_507_HU_OverspeedWarningEnable_SetVt:*/
on envVar E_pubc_GW_GW_507_HU_OverspeedWarningEnable_SetVt
{
    if(getValue(E_pubc_GW_GW_507_HU_OverspeedWarningEnable_SetVt))
    {
        //update the signal value
        Msg_GW_507.HU_OverspeedWarningEnable=getvalue(E_pubc_GW_GW_507_HU_OverspeedWarningEnable_Vt);
    }
    else
    {
        Msg_GW_507.HU_OverspeedWarningEnable=getValue(E_pubc_GW_GW_507_HU_OverspeedWarningEnable_Rv);
    }
}
/*@@end*/
 
/*@@envVar:E_pubc_GW_GW_507_HU_OverspeedSoundWarEnable_Rv:*/
on envVar E_pubc_GW_GW_507_HU_OverspeedSoundWarEnable_Rv
{
    int64 rawValue = 0ll;
    float rawValue_float = 0.0;
    float phyValue = 0.0;        

    //set the signal with updated raw value
    if(getValue(E_pubc_GW_GW_507_HU_OverspeedSoundWarEnable_SetVt)==0)
    {
        rawValue = getvalue(this);
        if(chgEv_GW_507_HU_OverspeedSoundWarEnable == 0)
        {
            //type conversion to float
            rawValue_float = rawValue;        
            // raw to physical conversion
            phyValue = ((rawValue_float *1)+(0));
            putValue(E_pubc_GW_GW_507_HU_OverspeedSoundWarEnable_Pv, phyValue);
            chgEv_GW_507_HU_OverspeedSoundWarEnable = 1;
        }
        else
        {
            chgEv_GW_507_HU_OverspeedSoundWarEnable = 0;
        }    
        //update the signal value
        Msg_GW_507.HU_OverspeedSoundWarEnable=rawValue;        
    }                                                                           
}
/*@@end*/

/*@@envVar:E_pubc_GW_GW_507_HU_OverspeedSoundWarEnable_Pv:*/
on envVar E_pubc_GW_GW_507_HU_OverspeedSoundWarEnable_Pv
{
    int64 rawValue = 0ll;
    float phyValue = 0.0;
    
    //update the raw value with physical value 
    if(getValue(E_pubc_GW_GW_507_HU_OverspeedSoundWarEnable_SetVt)==0)
    {
        if(chgEv_GW_507_HU_OverspeedSoundWarEnable == 0)
        {
            phyValue = getvalue(this);
            // physical to raw conversion
            rawValue = ((phyValue -(0))/1);
            putValue(E_pubc_GW_GW_507_HU_OverspeedSoundWarEnable_Rv, rawValue);
            chgEv_GW_507_HU_OverspeedSoundWarEnable = 1;  
        }
        else
        {
            chgEv_GW_507_HU_OverspeedSoundWarEnable = 0;
        }
    }
}
/*@@end*/

/*@@envVar:E_pubc_GW_GW_507_HU_OverspeedSoundWarEnable_Vt:*/
on envVar E_pubc_GW_GW_507_HU_OverspeedSoundWarEnable_Vt
{
    qword rawValue = 0ll;
    if(getValue(E_pubc_GW_GW_507_HU_OverspeedSoundWarEnable_SetVt))
    {
        //update the signal value
        Msg_GW_507.HU_OverspeedSoundWarEnable=getValue(this);
    }
}
/*@@end*/

/*@@envVar:E_pubc_GW_GW_507_HU_OverspeedSoundWarEnable_SetVt:*/
on envVar E_pubc_GW_GW_507_HU_OverspeedSoundWarEnable_SetVt
{
    if(getValue(E_pubc_GW_GW_507_HU_OverspeedSoundWarEnable_SetVt))
    {
        //update the signal value
        Msg_GW_507.HU_OverspeedSoundWarEnable=getvalue(E_pubc_GW_GW_507_HU_OverspeedSoundWarEnable_Vt);
    }
    else
    {
        Msg_GW_507.HU_OverspeedSoundWarEnable=getValue(E_pubc_GW_GW_507_HU_OverspeedSoundWarEnable_Rv);
    }
}
/*@@end*/
 
/*@@envVar:E_pubc_GW_GW_507_HU_HMAEnable_Rv:*/
on envVar E_pubc_GW_GW_507_HU_HMAEnable_Rv
{
    int64 rawValue = 0ll;
    float rawValue_float = 0.0;
    float phyValue = 0.0;        

    //set the signal with updated raw value
    if(getValue(E_pubc_GW_GW_507_HU_HMAEnable_SetVt)==0)
    {
        rawValue = getvalue(this);
        if(chgEv_GW_507_HU_HMAEnable == 0)
        {
            //type conversion to float
            rawValue_float = rawValue;        
            // raw to physical conversion
            phyValue = ((rawValue_float *1)+(0));
            putValue(E_pubc_GW_GW_507_HU_HMAEnable_Pv, phyValue);
            chgEv_GW_507_HU_HMAEnable = 1;
        }
        else
        {
            chgEv_GW_507_HU_HMAEnable = 0;
        }    
        //update the signal value
        Msg_GW_507.HU_HMAEnable=rawValue;        
    }                                                                           
}
/*@@end*/

/*@@envVar:E_pubc_GW_GW_507_HU_HMAEnable_Pv:*/
on envVar E_pubc_GW_GW_507_HU_HMAEnable_Pv
{
    int64 rawValue = 0ll;
    float phyValue = 0.0;
    
    //update the raw value with physical value 
    if(getValue(E_pubc_GW_GW_507_HU_HMAEnable_SetVt)==0)
    {
        if(chgEv_GW_507_HU_HMAEnable == 0)
        {
            phyValue = getvalue(this);
            // physical to raw conversion
            rawValue = ((phyValue -(0))/1);
            putValue(E_pubc_GW_GW_507_HU_HMAEnable_Rv, rawValue);
            chgEv_GW_507_HU_HMAEnable = 1;  
        }
        else
        {
            chgEv_GW_507_HU_HMAEnable = 0;
        }
    }
}
/*@@end*/

/*@@envVar:E_pubc_GW_GW_507_HU_HMAEnable_Vt:*/
on envVar E_pubc_GW_GW_507_HU_HMAEnable_Vt
{
    qword rawValue = 0ll;
    if(getValue(E_pubc_GW_GW_507_HU_HMAEnable_SetVt))
    {
        //update the signal value
        Msg_GW_507.HU_HMAEnable=getValue(this);
    }
}
/*@@end*/

/*@@envVar:E_pubc_GW_GW_507_HU_HMAEnable_SetVt:*/
on envVar E_pubc_GW_GW_507_HU_HMAEnable_SetVt
{
    if(getValue(E_pubc_GW_GW_507_HU_HMAEnable_SetVt))
    {
        //update the signal value
        Msg_GW_507.HU_HMAEnable=getvalue(E_pubc_GW_GW_507_HU_HMAEnable_Vt);
    }
    else
    {
        Msg_GW_507.HU_HMAEnable=getValue(E_pubc_GW_GW_507_HU_HMAEnable_Rv);
    }
}
/*@@end*/
 
/*@@envVar:E_pubc_GW_GW_507_HU_LDWShakeLev_Rv:*/
on envVar E_pubc_GW_GW_507_HU_LDWShakeLev_Rv
{
    int64 rawValue = 0ll;
    float rawValue_float = 0.0;
    float phyValue = 0.0;        

    //set the signal with updated raw value
    if(getValue(E_pubc_GW_GW_507_HU_LDWShakeLev_SetVt)==0)
    {
        rawValue = getvalue(this);
        if(chgEv_GW_507_HU_LDWShakeLev == 0)
        {
            //type conversion to float
            rawValue_float = rawValue;        
            // raw to physical conversion
            phyValue = ((rawValue_float *1)+(0));
            putValue(E_pubc_GW_GW_507_HU_LDWShakeLev_Pv, phyValue);
            chgEv_GW_507_HU_LDWShakeLev = 1;
        }
        else
        {
            chgEv_GW_507_HU_LDWShakeLev = 0;
        }    
        //update the signal value
        Msg_GW_507.HU_LDWShakeLev=rawValue;        
    }                                                                           
}
/*@@end*/

/*@@envVar:E_pubc_GW_GW_507_HU_LDWShakeLev_Pv:*/
on envVar E_pubc_GW_GW_507_HU_LDWShakeLev_Pv
{
    int64 rawValue = 0ll;
    float phyValue = 0.0;
    
    //update the raw value with physical value 
    if(getValue(E_pubc_GW_GW_507_HU_LDWShakeLev_SetVt)==0)
    {
        if(chgEv_GW_507_HU_LDWShakeLev == 0)
        {
            phyValue = getvalue(this);
            // physical to raw conversion
            rawValue = ((phyValue -(0))/1);
            putValue(E_pubc_GW_GW_507_HU_LDWShakeLev_Rv, rawValue);
            chgEv_GW_507_HU_LDWShakeLev = 1;  
        }
        else
        {
            chgEv_GW_507_HU_LDWShakeLev = 0;
        }
    }
}
/*@@end*/

/*@@envVar:E_pubc_GW_GW_507_HU_LDWShakeLev_Vt:*/
on envVar E_pubc_GW_GW_507_HU_LDWShakeLev_Vt
{
    qword rawValue = 0ll;
    if(getValue(E_pubc_GW_GW_507_HU_LDWShakeLev_SetVt))
    {
        //update the signal value
        Msg_GW_507.HU_LDWShakeLev=getValue(this);
    }
}
/*@@end*/

/*@@envVar:E_pubc_GW_GW_507_HU_LDWShakeLev_SetVt:*/
on envVar E_pubc_GW_GW_507_HU_LDWShakeLev_SetVt
{
    if(getValue(E_pubc_GW_GW_507_HU_LDWShakeLev_SetVt))
    {
        //update the signal value
        Msg_GW_507.HU_LDWShakeLev=getvalue(E_pubc_GW_GW_507_HU_LDWShakeLev_Vt);
    }
    else
    {
        Msg_GW_507.HU_LDWShakeLev=getValue(E_pubc_GW_GW_507_HU_LDWShakeLev_Rv);
    }
}
/*@@end*/
 
/*@@envVar:E_pubc_GW_GW_507_HU_IACCEnable_Rv:*/
on envVar E_pubc_GW_GW_507_HU_IACCEnable_Rv
{
    int64 rawValue = 0ll;
    float rawValue_float = 0.0;
    float phyValue = 0.0;        

    //set the signal with updated raw value
    if(getValue(E_pubc_GW_GW_507_HU_IACCEnable_SetVt)==0)
    {
        rawValue = getvalue(this);
        if(chgEv_GW_507_HU_IACCEnable == 0)
        {
            //type conversion to float
            rawValue_float = rawValue;        
            // raw to physical conversion
            phyValue = ((rawValue_float *1)+(0));
            putValue(E_pubc_GW_GW_507_HU_IACCEnable_Pv, phyValue);
            chgEv_GW_507_HU_IACCEnable = 1;
        }
        else
        {
            chgEv_GW_507_HU_IACCEnable = 0;
        }    
        //update the signal value
        Msg_GW_507.HU_IACCEnable=rawValue;        
    }                                                                           
}
/*@@end*/

/*@@envVar:E_pubc_GW_GW_507_HU_IACCEnable_Pv:*/
on envVar E_pubc_GW_GW_507_HU_IACCEnable_Pv
{
    int64 rawValue = 0ll;
    float phyValue = 0.0;
    
    //update the raw value with physical value 
    if(getValue(E_pubc_GW_GW_507_HU_IACCEnable_SetVt)==0)
    {
        if(chgEv_GW_507_HU_IACCEnable == 0)
        {
            phyValue = getvalue(this);
            // physical to raw conversion
            rawValue = ((phyValue -(0))/1);
            putValue(E_pubc_GW_GW_507_HU_IACCEnable_Rv, rawValue);
            chgEv_GW_507_HU_IACCEnable = 1;  
        }
        else
        {
            chgEv_GW_507_HU_IACCEnable = 0;
        }
    }
}
/*@@end*/

/*@@envVar:E_pubc_GW_GW_507_HU_IACCEnable_Vt:*/
on envVar E_pubc_GW_GW_507_HU_IACCEnable_Vt
{
    qword rawValue = 0ll;
    if(getValue(E_pubc_GW_GW_507_HU_IACCEnable_SetVt))
    {
        //update the signal value
        Msg_GW_507.HU_IACCEnable=getValue(this);
    }
}
/*@@end*/

/*@@envVar:E_pubc_GW_GW_507_HU_IACCEnable_SetVt:*/
on envVar E_pubc_GW_GW_507_HU_IACCEnable_SetVt
{
    if(getValue(E_pubc_GW_GW_507_HU_IACCEnable_SetVt))
    {
        //update the signal value
        Msg_GW_507.HU_IACCEnable=getvalue(E_pubc_GW_GW_507_HU_IACCEnable_Vt);
    }
    else
    {
        Msg_GW_507.HU_IACCEnable=getValue(E_pubc_GW_GW_507_HU_IACCEnable_Rv);
    }
}
/*@@end*/
 
/*@@envVar:E_pubc_GW_GW_507_HU_FCWSetting_Rv:*/
on envVar E_pubc_GW_GW_507_HU_FCWSetting_Rv
{
    int64 rawValue = 0ll;
    float rawValue_float = 0.0;
    float phyValue = 0.0;        

    //set the signal with updated raw value
    if(getValue(E_pubc_GW_GW_507_HU_FCWSetting_SetVt)==0)
    {
        rawValue = getvalue(this);
        if(chgEv_GW_507_HU_FCWSetting == 0)
        {
            //type conversion to float
            rawValue_float = rawValue;        
            // raw to physical conversion
            phyValue = ((rawValue_float *1)+(0));
            putValue(E_pubc_GW_GW_507_HU_FCWSetting_Pv, phyValue);
            chgEv_GW_507_HU_FCWSetting = 1;
        }
        else
        {
            chgEv_GW_507_HU_FCWSetting = 0;
        }    
        //update the signal value
        Msg_GW_507.HU_FCWSetting=rawValue;        
    }                                                                           
}
/*@@end*/

/*@@envVar:E_pubc_GW_GW_507_HU_FCWSetting_Pv:*/
on envVar E_pubc_GW_GW_507_HU_FCWSetting_Pv
{
    int64 rawValue = 0ll;
    float phyValue = 0.0;
    
    //update the raw value with physical value 
    if(getValue(E_pubc_GW_GW_507_HU_FCWSetting_SetVt)==0)
    {
        if(chgEv_GW_507_HU_FCWSetting == 0)
        {
            phyValue = getvalue(this);
            // physical to raw conversion
            rawValue = ((phyValue -(0))/1);
            putValue(E_pubc_GW_GW_507_HU_FCWSetting_Rv, rawValue);
            chgEv_GW_507_HU_FCWSetting = 1;  
        }
        else
        {
            chgEv_GW_507_HU_FCWSetting = 0;
        }
    }
}
/*@@end*/

/*@@envVar:E_pubc_GW_GW_507_HU_FCWSetting_Vt:*/
on envVar E_pubc_GW_GW_507_HU_FCWSetting_Vt
{
    qword rawValue = 0ll;
    if(getValue(E_pubc_GW_GW_507_HU_FCWSetting_SetVt))
    {
        //update the signal value
        Msg_GW_507.HU_FCWSetting=getValue(this);
    }
}
/*@@end*/

/*@@envVar:E_pubc_GW_GW_507_HU_FCWSetting_SetVt:*/
on envVar E_pubc_GW_GW_507_HU_FCWSetting_SetVt
{
    if(getValue(E_pubc_GW_GW_507_HU_FCWSetting_SetVt))
    {
        //update the signal value
        Msg_GW_507.HU_FCWSetting=getvalue(E_pubc_GW_GW_507_HU_FCWSetting_Vt);
    }
    else
    {
        Msg_GW_507.HU_FCWSetting=getValue(E_pubc_GW_GW_507_HU_FCWSetting_Rv);
    }
}
/*@@end*/
 
/*@@envVar:E_pubc_GW_GW_507_HU_CruiseControlSet_Rv:*/
on envVar E_pubc_GW_GW_507_HU_CruiseControlSet_Rv
{
    int64 rawValue = 0ll;
    float rawValue_float = 0.0;
    float phyValue = 0.0;        

    //set the signal with updated raw value
    if(getValue(E_pubc_GW_GW_507_HU_CruiseControlSet_SetVt)==0)
    {
        rawValue = getvalue(this);
        if(chgEv_GW_507_HU_CruiseControlSet == 0)
        {
            //type conversion to float
            rawValue_float = rawValue;        
            // raw to physical conversion
            phyValue = ((rawValue_float *1)+(0));
            putValue(E_pubc_GW_GW_507_HU_CruiseControlSet_Pv, phyValue);
            chgEv_GW_507_HU_CruiseControlSet = 1;
        }
        else
        {
            chgEv_GW_507_HU_CruiseControlSet = 0;
        }    
        //update the signal value
        Msg_GW_507.HU_CruiseControlSet=rawValue;        
    }                                                                           
}
/*@@end*/

/*@@envVar:E_pubc_GW_GW_507_HU_CruiseControlSet_Pv:*/
on envVar E_pubc_GW_GW_507_HU_CruiseControlSet_Pv
{
    int64 rawValue = 0ll;
    float phyValue = 0.0;
    
    //update the raw value with physical value 
    if(getValue(E_pubc_GW_GW_507_HU_CruiseControlSet_SetVt)==0)
    {
        if(chgEv_GW_507_HU_CruiseControlSet == 0)
        {
            phyValue = getvalue(this);
            // physical to raw conversion
            rawValue = ((phyValue -(0))/1);
            putValue(E_pubc_GW_GW_507_HU_CruiseControlSet_Rv, rawValue);
            chgEv_GW_507_HU_CruiseControlSet = 1;  
        }
        else
        {
            chgEv_GW_507_HU_CruiseControlSet = 0;
        }
    }
}
/*@@end*/

/*@@envVar:E_pubc_GW_GW_507_HU_CruiseControlSet_Vt:*/
on envVar E_pubc_GW_GW_507_HU_CruiseControlSet_Vt
{
    qword rawValue = 0ll;
    if(getValue(E_pubc_GW_GW_507_HU_CruiseControlSet_SetVt))
    {
        //update the signal value
        Msg_GW_507.HU_CruiseControlSet=getValue(this);
    }
}
/*@@end*/

/*@@envVar:E_pubc_GW_GW_507_HU_CruiseControlSet_SetVt:*/
on envVar E_pubc_GW_GW_507_HU_CruiseControlSet_SetVt
{
    if(getValue(E_pubc_GW_GW_507_HU_CruiseControlSet_SetVt))
    {
        //update the signal value
        Msg_GW_507.HU_CruiseControlSet=getvalue(E_pubc_GW_GW_507_HU_CruiseControlSet_Vt);
    }
    else
    {
        Msg_GW_507.HU_CruiseControlSet=getValue(E_pubc_GW_GW_507_HU_CruiseControlSet_Rv);
    }
}
/*@@end*/
 
/*@@envVar:E_pubc_GW_GW_3C4_tx:*/
on envVar E_pubc_GW_GW_3C4_tx
{
    if(getValue(this))
    {       
        
        //update the BZ Signal
        if(GW_3C4_HU_RollingCounter_3B8_wrongvalctr == 0)
        {
            update_GW_3C4_HU_RollingCounter_3B8_counter();
            Msg_GW_3C4.HU_RollingCounter_3B8= GW_3C4_HU_RollingCounter_3B8_counter;
        }
        else if(GW_3C4_HU_RollingCounter_3B8_wrongvalctr > 0)
        {
			GW_3C4_HU_RollingCounter_3B8_counter=GW_3C4_HU_RollingCounter_3B8_counter + GW_3C4_HU_RollingCounter_3B8_wrongvalctr;
			 Msg_GW_3C4.HU_RollingCounter_3B8= GW_3C4_HU_RollingCounter_3B8_counter;
            /* GW_3C4_HU_RollingCounter_3B8_wrongvalctr--;
              // if counter becomes zero, update panel controller to zero
             if(GW_3C4_HU_RollingCounter_3B8_wrongvalctr == 0)
             {
                 putValue(E_pubc_GW_GW_3C4_HU_RollingCounter_3B8_wrongvalctr,0);
             } */
        }
        else
        { 
			// do nothing
        }    
        //update the BZ Signal
        if(GW_3C4_HU_RollingCounter_3C4_wrongvalctr == 0)
        {
            update_GW_3C4_HU_RollingCounter_3C4_counter();
            Msg_GW_3C4.HU_RollingCounter_3C4= GW_3C4_HU_RollingCounter_3C4_counter;
        }
        else if(GW_3C4_HU_RollingCounter_3C4_wrongvalctr > 0)
        {
			GW_3C4_HU_RollingCounter_3C4_counter=GW_3C4_HU_RollingCounter_3C4_counter + GW_3C4_HU_RollingCounter_3C4_wrongvalctr;
			 Msg_GW_3C4.HU_RollingCounter_3C4= GW_3C4_HU_RollingCounter_3C4_counter;
            /* GW_3C4_HU_RollingCounter_3C4_wrongvalctr--;
              // if counter becomes zero, update panel controller to zero
             if(GW_3C4_HU_RollingCounter_3C4_wrongvalctr == 0)
             {
                 putValue(E_pubc_GW_GW_3C4_HU_RollingCounter_3C4_wrongvalctr,0);
             } */
        }
        else
        { 
			// do nothing
        }    
        //update the BZ Signal
        if(GW_3C4_HU_RollingCounter_3C2_wrongvalctr == 0)
        {
            update_GW_3C4_HU_RollingCounter_3C2_counter();
            Msg_GW_3C4.HU_RollingCounter_3C2= GW_3C4_HU_RollingCounter_3C2_counter;
        }
        else if(GW_3C4_HU_RollingCounter_3C2_wrongvalctr > 0)
        {
			GW_3C4_HU_RollingCounter_3C2_counter=GW_3C4_HU_RollingCounter_3C2_counter + GW_3C4_HU_RollingCounter_3C2_wrongvalctr;
			 Msg_GW_3C4.HU_RollingCounter_3C2= GW_3C4_HU_RollingCounter_3C2_counter;
            /* GW_3C4_HU_RollingCounter_3C2_wrongvalctr--;
              // if counter becomes zero, update panel controller to zero
             if(GW_3C4_HU_RollingCounter_3C2_wrongvalctr == 0)
             {
                 putValue(E_pubc_GW_GW_3C4_HU_RollingCounter_3C2_wrongvalctr,0);
             } */
        }
        else
        { 
			// do nothing
        }    
        //update the BZ Signal
        if(GW_3C4_HU_RollingCounter_3C6_wrongvalctr == 0)
        {
            update_GW_3C4_HU_RollingCounter_3C6_counter();
            Msg_GW_3C4.HU_RollingCounter_3C6= GW_3C4_HU_RollingCounter_3C6_counter;
        }
        else if(GW_3C4_HU_RollingCounter_3C6_wrongvalctr > 0)
        {
			GW_3C4_HU_RollingCounter_3C6_counter=GW_3C4_HU_RollingCounter_3C6_counter + GW_3C4_HU_RollingCounter_3C6_wrongvalctr;
			 Msg_GW_3C4.HU_RollingCounter_3C6= GW_3C4_HU_RollingCounter_3C6_counter;
            /* GW_3C4_HU_RollingCounter_3C6_wrongvalctr--;
              // if counter becomes zero, update panel controller to zero
             if(GW_3C4_HU_RollingCounter_3C6_wrongvalctr == 0)
             {
                 putValue(E_pubc_GW_GW_3C4_HU_RollingCounter_3C6_wrongvalctr,0);
             } */
        }
        else
        { 
			// do nothing
        }    
        //update the BZ Signal
        if(GW_3C4_HU_RollingCounter_3C7_wrongvalctr == 0)
        {
            update_GW_3C4_HU_RollingCounter_3C7_counter();
            Msg_GW_3C4.HU_RollingCounter_3C7= GW_3C4_HU_RollingCounter_3C7_counter;
        }
        else if(GW_3C4_HU_RollingCounter_3C7_wrongvalctr > 0)
        {
			GW_3C4_HU_RollingCounter_3C7_counter=GW_3C4_HU_RollingCounter_3C7_counter + GW_3C4_HU_RollingCounter_3C7_wrongvalctr;
			 Msg_GW_3C4.HU_RollingCounter_3C7= GW_3C4_HU_RollingCounter_3C7_counter;
            /* GW_3C4_HU_RollingCounter_3C7_wrongvalctr--;
              // if counter becomes zero, update panel controller to zero
             if(GW_3C4_HU_RollingCounter_3C7_wrongvalctr == 0)
             {
                 putValue(E_pubc_GW_GW_3C4_HU_RollingCounter_3C7_wrongvalctr,0);
             } */
        }
        else
        { 
			// do nothing
        }    
        //calculate the CRC CheckSum
        update_GW_3C4_CRC_CheckSum();

        output(Msg_GW_3C4);        
    }
}
/*@@end*/

/*@@envVar:E_pubc_GW_GW_3C4_Range:*/
on envVar E_pubc_GW_GW_3C4_Range
{
    qword rawstatus = 0ll;
    qword rawValue = 0ll;    
    
    rawstatus = getvalue(this);    
    // set all the signals with min raw /max raw /init raw
    switch (rawstatus) 
    {
     case(0) :
        rawValue= 0;
        putValue(E_pubc_GW_GW_3C4_HU_RoadCurvature_30m_Rv, rawValue);
        rawValue= 0;
        putValue(E_pubc_GW_GW_3C4_HU_TrafficAccident_Info_Rv, rawValue);
        rawValue= 0;
        putValue(E_pubc_GW_GW_3C4_HU_RoadCurvature_20m_Rv, rawValue);
        rawValue= 0;
        putValue(E_pubc_GW_GW_3C4_HU_EnterTunnelInfo_Rv, rawValue);
        rawValue= 0;
        putValue(E_pubc_GW_GW_3C4_HU_MapDataUpdateStatus_Rv, rawValue);
        rawValue= 0;
        putValue(E_pubc_GW_GW_3C4_HU_TunnelDistance_Rv, rawValue);
        rawValue= 0;
        putValue(E_pubc_GW_GW_3C4_HU_FallingRockDi_Rv, rawValue);
        rawValue= 0;
        putValue(E_pubc_GW_GW_3C4_HU_Byroad_Rv, rawValue);
        rawValue= 0;
        putValue(E_pubc_GW_GW_3C4_HU_BranchInfo_Rv, rawValue);
        rawValue= 0;
        putValue(E_pubc_GW_GW_3C4_HU_RoadCurvature_Rv, rawValue);
        rawValue= 0;
        putValue(E_pubc_GW_GW_3C4_HU_RoadCurvature_80m_Rv, rawValue);
        rawValue= 0;
        putValue(E_pubc_GW_GW_3C4_HU_RoadCurvature_90m_Rv, rawValue);
        rawValue= 0;
        putValue(E_pubc_GW_GW_3C4_HU_RoadCurvature_600m_Rv, rawValue);
        rawValue= 0;
        putValue(E_pubc_GW_GW_3C4_HU_SlopeDistance_Rv, rawValue);
        rawValue= 0;
        putValue(E_pubc_GW_GW_3C4_HU_LaneCnt_Rv, rawValue);
        rawValue= 0;
        putValue(E_pubc_GW_GW_3C4_HU_RoadCurvature_100m_Rv, rawValue);
        rawValue= 0;
        putValue(E_pubc_GW_GW_3C4_HU_TollDis_Rv, rawValue);
        rawValue= 0;
        putValue(E_pubc_GW_GW_3C4_HU_To_Construction_Dis_Rv, rawValue);
        rawValue= 0;
        putValue(E_pubc_GW_GW_3C4_HU_To_Branch_Dis_Rv, rawValue);
        rawValue= 0;
        putValue(E_pubc_GW_GW_3C4_HU_RoadCurvature_70m_Rv, rawValue);
        rawValue= 0;
        putValue(E_pubc_GW_GW_3C4_HU_To_TrafficAccident_Dis_Rv, rawValue);
        rawValue= 0;
        putValue(E_pubc_GW_GW_3C4_HU_To_NumchangeOfLanes_Dist_Rv, rawValue);
        rawValue= 0;
        putValue(E_pubc_GW_GW_3C4_HU_RoadCurvature_60m_Rv, rawValue);
        rawValue= 0;
        putValue(E_pubc_GW_GW_3C4_HU_TunnelLength_Rv, rawValue);
        rawValue= 0;
        putValue(E_pubc_GW_GW_3C4_HU_Construction_Info_Rv, rawValue);
        rawValue= 0;
        putValue(E_pubc_GW_GW_3C4_HU_TollInfo_Rv, rawValue);
        rawValue= 0;
        putValue(E_pubc_GW_GW_3C4_HU_RoadCurvature_300m_Rv, rawValue);
        rawValue= 0;
        putValue(E_pubc_GW_GW_3C4_HU_NavGuiganceStatus_Rv, rawValue);
        rawValue= 0;
        putValue(E_pubc_GW_GW_3C4_HU_Lane_Changtype_Rv, rawValue);
        rawValue= 0;
        putValue(E_pubc_GW_GW_3C4_HU_RoadCurvatureFar_Rv, rawValue);
        rawValue= 0;
        putValue(E_pubc_GW_GW_3C4_HU_RampSide_Rv, rawValue);
        rawValue= 0;
        putValue(E_pubc_GW_GW_3C4_HU_ForwardRoadType_Rv, rawValue);
        rawValue= 0;
        putValue(E_pubc_GW_GW_3C4_HU_RoadCurvature_400m_Rv, rawValue);
        rawValue= 0;
        putValue(E_pubc_GW_GW_3C4_HU_FallingRockInfo_Rv, rawValue);
        rawValue= 0;
        putValue(E_pubc_GW_GW_3C4_HU_MapMatchStatus_Rv, rawValue);
        rawValue= 0;
        putValue(E_pubc_GW_GW_3C4_HU_EnterSlopeInfo_Rv, rawValue);
        rawValue= 0;
        putValue(E_pubc_GW_GW_3C4_HU_SlopeGradient_300m_Rv, rawValue);
        rawValue= 0;
        putValue(E_pubc_GW_GW_3C4_HU_Road_TrafficFlow_Rv, rawValue);
        rawValue= 0;
        putValue(E_pubc_GW_GW_3C4_HU_RoadCurvature_50m_Rv, rawValue);
        rawValue= 0;
        putValue(E_pubc_GW_GW_3C4_HU_RoadCurvature_10m_Rv, rawValue);
        rawValue= 0;
        putValue(E_pubc_GW_GW_3C4_HU_RoadCurvature_40m_Rv, rawValue);
        break;
     case(1) :
        rawValue= 1023;
        putValue(E_pubc_GW_GW_3C4_HU_RoadCurvature_30m_Rv, rawValue);
        rawValue= 3;
        putValue(E_pubc_GW_GW_3C4_HU_TrafficAccident_Info_Rv, rawValue);
        rawValue= 1023;
        putValue(E_pubc_GW_GW_3C4_HU_RoadCurvature_20m_Rv, rawValue);
        rawValue= 3;
        putValue(E_pubc_GW_GW_3C4_HU_EnterTunnelInfo_Rv, rawValue);
        rawValue= 7;
        putValue(E_pubc_GW_GW_3C4_HU_MapDataUpdateStatus_Rv, rawValue);
        rawValue= 60;
        putValue(E_pubc_GW_GW_3C4_HU_TunnelDistance_Rv, rawValue);
        rawValue= 60;
        putValue(E_pubc_GW_GW_3C4_HU_FallingRockDi_Rv, rawValue);
        rawValue= 3;
        putValue(E_pubc_GW_GW_3C4_HU_Byroad_Rv, rawValue);
        rawValue= 3;
        putValue(E_pubc_GW_GW_3C4_HU_BranchInfo_Rv, rawValue);
        rawValue= 1023;
        putValue(E_pubc_GW_GW_3C4_HU_RoadCurvature_Rv, rawValue);
        rawValue= 1023;
        putValue(E_pubc_GW_GW_3C4_HU_RoadCurvature_80m_Rv, rawValue);
        rawValue= 1023;
        putValue(E_pubc_GW_GW_3C4_HU_RoadCurvature_90m_Rv, rawValue);
        rawValue= 1023;
        putValue(E_pubc_GW_GW_3C4_HU_RoadCurvature_600m_Rv, rawValue);
        rawValue= 60;
        putValue(E_pubc_GW_GW_3C4_HU_SlopeDistance_Rv, rawValue);
        rawValue= 7;
        putValue(E_pubc_GW_GW_3C4_HU_LaneCnt_Rv, rawValue);
        rawValue= 1023;
        putValue(E_pubc_GW_GW_3C4_HU_RoadCurvature_100m_Rv, rawValue);
        rawValue= 60;
        putValue(E_pubc_GW_GW_3C4_HU_TollDis_Rv, rawValue);
        rawValue= 60;
        putValue(E_pubc_GW_GW_3C4_HU_To_Construction_Dis_Rv, rawValue);
        rawValue= 60;
        putValue(E_pubc_GW_GW_3C4_HU_To_Branch_Dis_Rv, rawValue);
        rawValue= 1023;
        putValue(E_pubc_GW_GW_3C4_HU_RoadCurvature_70m_Rv, rawValue);
        rawValue= 60;
        putValue(E_pubc_GW_GW_3C4_HU_To_TrafficAccident_Dis_Rv, rawValue);
        rawValue= 60;
        putValue(E_pubc_GW_GW_3C4_HU_To_NumchangeOfLanes_Dist_Rv, rawValue);
        rawValue= 1023;
        putValue(E_pubc_GW_GW_3C4_HU_RoadCurvature_60m_Rv, rawValue);
        rawValue= 63;
        putValue(E_pubc_GW_GW_3C4_HU_TunnelLength_Rv, rawValue);
        rawValue= 3;
        putValue(E_pubc_GW_GW_3C4_HU_Construction_Info_Rv, rawValue);
        rawValue= 3;
        putValue(E_pubc_GW_GW_3C4_HU_TollInfo_Rv, rawValue);
        rawValue= 1023;
        putValue(E_pubc_GW_GW_3C4_HU_RoadCurvature_300m_Rv, rawValue);
        rawValue= 3;
        putValue(E_pubc_GW_GW_3C4_HU_NavGuiganceStatus_Rv, rawValue);
        rawValue= 3;
        putValue(E_pubc_GW_GW_3C4_HU_Lane_Changtype_Rv, rawValue);
        rawValue= 1023;
        putValue(E_pubc_GW_GW_3C4_HU_RoadCurvatureFar_Rv, rawValue);
        rawValue= 3;
        putValue(E_pubc_GW_GW_3C4_HU_RampSide_Rv, rawValue);
        rawValue= 7;
        putValue(E_pubc_GW_GW_3C4_HU_ForwardRoadType_Rv, rawValue);
        rawValue= 1023;
        putValue(E_pubc_GW_GW_3C4_HU_RoadCurvature_400m_Rv, rawValue);
        rawValue= 3;
        putValue(E_pubc_GW_GW_3C4_HU_FallingRockInfo_Rv, rawValue);
        rawValue= 3;
        putValue(E_pubc_GW_GW_3C4_HU_MapMatchStatus_Rv, rawValue);
        rawValue= 3;
        putValue(E_pubc_GW_GW_3C4_HU_EnterSlopeInfo_Rv, rawValue);
        rawValue= 1022;
        putValue(E_pubc_GW_GW_3C4_HU_SlopeGradient_300m_Rv, rawValue);
        rawValue= 7;
        putValue(E_pubc_GW_GW_3C4_HU_Road_TrafficFlow_Rv, rawValue);
        rawValue= 1023;
        putValue(E_pubc_GW_GW_3C4_HU_RoadCurvature_50m_Rv, rawValue);
        rawValue= 1023;
        putValue(E_pubc_GW_GW_3C4_HU_RoadCurvature_10m_Rv, rawValue);
        rawValue= 1023;
        putValue(E_pubc_GW_GW_3C4_HU_RoadCurvature_40m_Rv, rawValue);
        break;
     default :
        rawValue= 0;
        putValue(E_pubc_GW_GW_3C4_HU_RoadCurvature_30m_Rv, rawValue);
        rawValue= 0;
        putValue(E_pubc_GW_GW_3C4_HU_TrafficAccident_Info_Rv, rawValue);
        rawValue= 0;
        putValue(E_pubc_GW_GW_3C4_HU_RoadCurvature_20m_Rv, rawValue);
        rawValue= 0;
        putValue(E_pubc_GW_GW_3C4_HU_EnterTunnelInfo_Rv, rawValue);
        rawValue= 0;
        putValue(E_pubc_GW_GW_3C4_HU_MapDataUpdateStatus_Rv, rawValue);
        rawValue= 0;
        putValue(E_pubc_GW_GW_3C4_HU_TunnelDistance_Rv, rawValue);
        rawValue= 0;
        putValue(E_pubc_GW_GW_3C4_HU_FallingRockDi_Rv, rawValue);
        rawValue= 0;
        putValue(E_pubc_GW_GW_3C4_HU_Byroad_Rv, rawValue);
        rawValue= 0;
        putValue(E_pubc_GW_GW_3C4_HU_BranchInfo_Rv, rawValue);
        rawValue= 0;
        putValue(E_pubc_GW_GW_3C4_HU_RoadCurvature_Rv, rawValue);
        rawValue= 0;
        putValue(E_pubc_GW_GW_3C4_HU_RoadCurvature_80m_Rv, rawValue);
        rawValue= 0;
        putValue(E_pubc_GW_GW_3C4_HU_RoadCurvature_90m_Rv, rawValue);
        rawValue= 0;
        putValue(E_pubc_GW_GW_3C4_HU_RoadCurvature_600m_Rv, rawValue);
        rawValue= 0;
        putValue(E_pubc_GW_GW_3C4_HU_SlopeDistance_Rv, rawValue);
        rawValue= 0;
        putValue(E_pubc_GW_GW_3C4_HU_LaneCnt_Rv, rawValue);
        rawValue= 0;
        putValue(E_pubc_GW_GW_3C4_HU_RoadCurvature_100m_Rv, rawValue);
        rawValue= 0;
        putValue(E_pubc_GW_GW_3C4_HU_TollDis_Rv, rawValue);
        rawValue= 0;
        putValue(E_pubc_GW_GW_3C4_HU_To_Construction_Dis_Rv, rawValue);
        rawValue= 0;
        putValue(E_pubc_GW_GW_3C4_HU_To_Branch_Dis_Rv, rawValue);
        rawValue= 0;
        putValue(E_pubc_GW_GW_3C4_HU_RoadCurvature_70m_Rv, rawValue);
        rawValue= 0;
        putValue(E_pubc_GW_GW_3C4_HU_To_TrafficAccident_Dis_Rv, rawValue);
        rawValue= 0;
        putValue(E_pubc_GW_GW_3C4_HU_To_NumchangeOfLanes_Dist_Rv, rawValue);
        rawValue= 0;
        putValue(E_pubc_GW_GW_3C4_HU_RoadCurvature_60m_Rv, rawValue);
        rawValue= 0;
        putValue(E_pubc_GW_GW_3C4_HU_TunnelLength_Rv, rawValue);
        rawValue= 0;
        putValue(E_pubc_GW_GW_3C4_HU_Construction_Info_Rv, rawValue);
        rawValue= 0;
        putValue(E_pubc_GW_GW_3C4_HU_TollInfo_Rv, rawValue);
        rawValue= 0;
        putValue(E_pubc_GW_GW_3C4_HU_RoadCurvature_300m_Rv, rawValue);
        rawValue= 0;
        putValue(E_pubc_GW_GW_3C4_HU_NavGuiganceStatus_Rv, rawValue);
        rawValue= 0;
        putValue(E_pubc_GW_GW_3C4_HU_Lane_Changtype_Rv, rawValue);
        rawValue= 0;
        putValue(E_pubc_GW_GW_3C4_HU_RoadCurvatureFar_Rv, rawValue);
        rawValue= 0;
        putValue(E_pubc_GW_GW_3C4_HU_RampSide_Rv, rawValue);
        rawValue= 0;
        putValue(E_pubc_GW_GW_3C4_HU_ForwardRoadType_Rv, rawValue);
        rawValue= 0;
        putValue(E_pubc_GW_GW_3C4_HU_RoadCurvature_400m_Rv, rawValue);
        rawValue= 0;
        putValue(E_pubc_GW_GW_3C4_HU_FallingRockInfo_Rv, rawValue);
        rawValue= 0;
        putValue(E_pubc_GW_GW_3C4_HU_MapMatchStatus_Rv, rawValue);
        rawValue= 0;
        putValue(E_pubc_GW_GW_3C4_HU_EnterSlopeInfo_Rv, rawValue);
        rawValue= 0;
        putValue(E_pubc_GW_GW_3C4_HU_SlopeGradient_300m_Rv, rawValue);
        rawValue= 0;
        putValue(E_pubc_GW_GW_3C4_HU_Road_TrafficFlow_Rv, rawValue);
        rawValue= 0;
        putValue(E_pubc_GW_GW_3C4_HU_RoadCurvature_50m_Rv, rawValue);
        rawValue= 0;
        putValue(E_pubc_GW_GW_3C4_HU_RoadCurvature_10m_Rv, rawValue);
        rawValue= 0;
        putValue(E_pubc_GW_GW_3C4_HU_RoadCurvature_40m_Rv, rawValue);
      break;
   }
}
/*@@end*/

/*@@envVar:E_pubc_GW_GW_3C4_Dlc:*/
on envVar E_pubc_GW_GW_3C4_Dlc
{
    if(getValue(E_pubc_GW_GW_3C4_enDlc))
    {
        Msg_GW_3C4.dlc =getValue(this);
    }
    else
    {
       Dbc_dlc = 64;
	   Msg_GW_3C4.dlc = Calc_Canfd_dlc(Dbc_dlc);
	   // Msg_GW_3C4.dlc = 64;
	   	
  }
}
/*@@end*/

/*@@envVar:E_pubc_GW_GW_3C4_enDlc:*/
on envVar E_pubc_GW_GW_3C4_enDlc
{
    //For Messages with DLC = 8, set wrong DLC to smaller than defined DLC
    //For Messages with DLC < 8 set wrong DLC to smaller/longer than defined DLC
    if(getValue(this))
    {
        Msg_GW_3C4.dlc =getValue(E_pubc_GW_GW_3C4_Dlc);
    }
    else
    {
       Dbc_dlc = 64;
	   Msg_GW_3C4.dlc = Calc_Canfd_dlc(Dbc_dlc);
	   // Msg_GW_3C4.dlc = 64;
    }
}
/*@@end*/

/*@@envVar:E_pubc_GW_GW_3C4_HU_CRCCheck_3B8_wrongvalctr:*/
on envVar E_pubc_GW_GW_3C4_HU_CRCCheck_3B8_wrongvalctr
{
    //update disturb count
    //disturb value range:(-1 = always send wrong value),( X>0 ,x is the number of Messages with wrong CHK sent)
    GW_3C4_HU_CRCCheck_3B8_wrongvalctr =getValue(this);    
}
/*@@end*/
/*@@envVar:E_pubc_GW_GW_3C4_HU_CRCCheck_3C2_wrongvalctr:*/
on envVar E_pubc_GW_GW_3C4_HU_CRCCheck_3C2_wrongvalctr
{
    //update disturb count
    //disturb value range:(-1 = always send wrong value),( X>0 ,x is the number of Messages with wrong CHK sent)
    GW_3C4_HU_CRCCheck_3C2_wrongvalctr =getValue(this);    
}
/*@@end*/
/*@@envVar:E_pubc_GW_GW_3C4_HU_CRCCheck_3C4_wrongvalctr:*/
on envVar E_pubc_GW_GW_3C4_HU_CRCCheck_3C4_wrongvalctr
{
    //update disturb count
    //disturb value range:(-1 = always send wrong value),( X>0 ,x is the number of Messages with wrong CHK sent)
    GW_3C4_HU_CRCCheck_3C4_wrongvalctr =getValue(this);    
}
/*@@end*/
/*@@envVar:E_pubc_GW_GW_3C4_HU_CRCCheck_3C6_wrongvalctr:*/
on envVar E_pubc_GW_GW_3C4_HU_CRCCheck_3C6_wrongvalctr
{
    //update disturb count
    //disturb value range:(-1 = always send wrong value),( X>0 ,x is the number of Messages with wrong CHK sent)
    GW_3C4_HU_CRCCheck_3C6_wrongvalctr =getValue(this);    
}
/*@@end*/
/*@@envVar:E_pubc_GW_GW_3C4_HU_CRCCheck_3C7_wrongvalctr:*/
on envVar E_pubc_GW_GW_3C4_HU_CRCCheck_3C7_wrongvalctr
{
    //update disturb count
    //disturb value range:(-1 = always send wrong value),( X>0 ,x is the number of Messages with wrong CHK sent)
    GW_3C4_HU_CRCCheck_3C7_wrongvalctr =getValue(this);    
}
/*@@end*/
/*@@envVar:E_pubc_GW_GW_3C4_HU_RollingCounter_3B8_wrongvalctr:*/
on envVar E_pubc_GW_GW_3C4_HU_RollingCounter_3B8_wrongvalctr
{
    //update disturb count
    //disturb value range:(-1 = always send wrong value),( X>0 ,x is the number of Messages with wrong CHK sent)
    GW_3C4_HU_RollingCounter_3B8_wrongvalctr =getValue(this);    
}
/*@@end*/
/*@@envVar:E_pubc_GW_GW_3C4_HU_RollingCounter_3C2_wrongvalctr:*/
on envVar E_pubc_GW_GW_3C4_HU_RollingCounter_3C2_wrongvalctr
{
    //update disturb count
    //disturb value range:(-1 = always send wrong value),( X>0 ,x is the number of Messages with wrong CHK sent)
    GW_3C4_HU_RollingCounter_3C2_wrongvalctr =getValue(this);    
}
/*@@end*/
/*@@envVar:E_pubc_GW_GW_3C4_HU_RollingCounter_3C4_wrongvalctr:*/
on envVar E_pubc_GW_GW_3C4_HU_RollingCounter_3C4_wrongvalctr
{
    //update disturb count
    //disturb value range:(-1 = always send wrong value),( X>0 ,x is the number of Messages with wrong CHK sent)
    GW_3C4_HU_RollingCounter_3C4_wrongvalctr =getValue(this);    
}
/*@@end*/
/*@@envVar:E_pubc_GW_GW_3C4_HU_RollingCounter_3C6_wrongvalctr:*/
on envVar E_pubc_GW_GW_3C4_HU_RollingCounter_3C6_wrongvalctr
{
    //update disturb count
    //disturb value range:(-1 = always send wrong value),( X>0 ,x is the number of Messages with wrong CHK sent)
    GW_3C4_HU_RollingCounter_3C6_wrongvalctr =getValue(this);    
}
/*@@end*/
/*@@envVar:E_pubc_GW_GW_3C4_HU_RollingCounter_3C7_wrongvalctr:*/
on envVar E_pubc_GW_GW_3C4_HU_RollingCounter_3C7_wrongvalctr
{
    //update disturb count
    //disturb value range:(-1 = always send wrong value),( X>0 ,x is the number of Messages with wrong CHK sent)
    GW_3C4_HU_RollingCounter_3C7_wrongvalctr =getValue(this);    
}
/*@@end*/

/*@@envVar:E_pubc_GW_GW_3C4_HU_RoadCurvature_30m_Rv:*/
on envVar E_pubc_GW_GW_3C4_HU_RoadCurvature_30m_Rv
{
    int64 rawValue = 0ll;
    float rawValue_float = 0.0;
    float phyValue = 0.0;        

    //set the signal with updated raw value
    {
        rawValue = getvalue(this);
        if(chgEv_GW_3C4_HU_RoadCurvature_30m == 0)
        {
            //type conversion to float
            rawValue_float = rawValue;        
            // raw to physical conversion
            phyValue = ((rawValue_float *1)+(0));
            putValue(E_pubc_GW_GW_3C4_HU_RoadCurvature_30m_Pv, phyValue);
            chgEv_GW_3C4_HU_RoadCurvature_30m = 1;
        }
        else
        {
            chgEv_GW_3C4_HU_RoadCurvature_30m = 0;
        }    
        //update the signal value
        Msg_GW_3C4.HU_RoadCurvature_30m=rawValue;        
    }                                                                           
}
/*@@end*/

/*@@envVar:E_pubc_GW_GW_3C4_HU_RoadCurvature_30m_Pv:*/
on envVar E_pubc_GW_GW_3C4_HU_RoadCurvature_30m_Pv
{
    int64 rawValue = 0ll;
    float phyValue = 0.0;
    
    //update the raw value with physical value 
    {
        if(chgEv_GW_3C4_HU_RoadCurvature_30m == 0)
        {
            phyValue = getvalue(this);
            // physical to raw conversion
            rawValue = ((phyValue -(0))/1);
            putValue(E_pubc_GW_GW_3C4_HU_RoadCurvature_30m_Rv, rawValue);
            chgEv_GW_3C4_HU_RoadCurvature_30m = 1;  
        }
        else
        {
            chgEv_GW_3C4_HU_RoadCurvature_30m = 0;
        }
    }
}
/*@@end*/


 
/*@@envVar:E_pubc_GW_GW_3C4_HU_TrafficAccident_Info_Rv:*/
on envVar E_pubc_GW_GW_3C4_HU_TrafficAccident_Info_Rv
{
    int64 rawValue = 0ll;
    float rawValue_float = 0.0;
    float phyValue = 0.0;        

    //set the signal with updated raw value
    if(getValue(E_pubc_GW_GW_3C4_HU_TrafficAccident_Info_SetVt)==0)
    {
        rawValue = getvalue(this);
        if(chgEv_GW_3C4_HU_TrafficAccident_Info == 0)
        {
            //type conversion to float
            rawValue_float = rawValue;        
            // raw to physical conversion
            phyValue = ((rawValue_float *1)+(0));
            putValue(E_pubc_GW_GW_3C4_HU_TrafficAccident_Info_Pv, phyValue);
            chgEv_GW_3C4_HU_TrafficAccident_Info = 1;
        }
        else
        {
            chgEv_GW_3C4_HU_TrafficAccident_Info = 0;
        }    
        //update the signal value
        Msg_GW_3C4.HU_TrafficAccident_Info=rawValue;        
    }                                                                           
}
/*@@end*/

/*@@envVar:E_pubc_GW_GW_3C4_HU_TrafficAccident_Info_Pv:*/
on envVar E_pubc_GW_GW_3C4_HU_TrafficAccident_Info_Pv
{
    int64 rawValue = 0ll;
    float phyValue = 0.0;
    
    //update the raw value with physical value 
    if(getValue(E_pubc_GW_GW_3C4_HU_TrafficAccident_Info_SetVt)==0)
    {
        if(chgEv_GW_3C4_HU_TrafficAccident_Info == 0)
        {
            phyValue = getvalue(this);
            // physical to raw conversion
            rawValue = ((phyValue -(0))/1);
            putValue(E_pubc_GW_GW_3C4_HU_TrafficAccident_Info_Rv, rawValue);
            chgEv_GW_3C4_HU_TrafficAccident_Info = 1;  
        }
        else
        {
            chgEv_GW_3C4_HU_TrafficAccident_Info = 0;
        }
    }
}
/*@@end*/

/*@@envVar:E_pubc_GW_GW_3C4_HU_TrafficAccident_Info_Vt:*/
on envVar E_pubc_GW_GW_3C4_HU_TrafficAccident_Info_Vt
{
    qword rawValue = 0ll;
    if(getValue(E_pubc_GW_GW_3C4_HU_TrafficAccident_Info_SetVt))
    {
        //update the signal value
        Msg_GW_3C4.HU_TrafficAccident_Info=getValue(this);
    }
}
/*@@end*/

/*@@envVar:E_pubc_GW_GW_3C4_HU_TrafficAccident_Info_SetVt:*/
on envVar E_pubc_GW_GW_3C4_HU_TrafficAccident_Info_SetVt
{
    if(getValue(E_pubc_GW_GW_3C4_HU_TrafficAccident_Info_SetVt))
    {
        //update the signal value
        Msg_GW_3C4.HU_TrafficAccident_Info=getvalue(E_pubc_GW_GW_3C4_HU_TrafficAccident_Info_Vt);
    }
    else
    {
        Msg_GW_3C4.HU_TrafficAccident_Info=getValue(E_pubc_GW_GW_3C4_HU_TrafficAccident_Info_Rv);
    }
}
/*@@end*/
 
/*@@envVar:E_pubc_GW_GW_3C4_HU_RoadCurvature_20m_Rv:*/
on envVar E_pubc_GW_GW_3C4_HU_RoadCurvature_20m_Rv
{
    int64 rawValue = 0ll;
    float rawValue_float = 0.0;
    float phyValue = 0.0;        

    //set the signal with updated raw value
    {
        rawValue = getvalue(this);
        if(chgEv_GW_3C4_HU_RoadCurvature_20m == 0)
        {
            //type conversion to float
            rawValue_float = rawValue;        
            // raw to physical conversion
            phyValue = ((rawValue_float *1)+(0));
            putValue(E_pubc_GW_GW_3C4_HU_RoadCurvature_20m_Pv, phyValue);
            chgEv_GW_3C4_HU_RoadCurvature_20m = 1;
        }
        else
        {
            chgEv_GW_3C4_HU_RoadCurvature_20m = 0;
        }    
        //update the signal value
        Msg_GW_3C4.HU_RoadCurvature_20m=rawValue;        
    }                                                                           
}
/*@@end*/

/*@@envVar:E_pubc_GW_GW_3C4_HU_RoadCurvature_20m_Pv:*/
on envVar E_pubc_GW_GW_3C4_HU_RoadCurvature_20m_Pv
{
    int64 rawValue = 0ll;
    float phyValue = 0.0;
    
    //update the raw value with physical value 
    {
        if(chgEv_GW_3C4_HU_RoadCurvature_20m == 0)
        {
            phyValue = getvalue(this);
            // physical to raw conversion
            rawValue = ((phyValue -(0))/1);
            putValue(E_pubc_GW_GW_3C4_HU_RoadCurvature_20m_Rv, rawValue);
            chgEv_GW_3C4_HU_RoadCurvature_20m = 1;  
        }
        else
        {
            chgEv_GW_3C4_HU_RoadCurvature_20m = 0;
        }
    }
}
/*@@end*/


 
/*@@envVar:E_pubc_GW_GW_3C4_HU_EnterTunnelInfo_Rv:*/
on envVar E_pubc_GW_GW_3C4_HU_EnterTunnelInfo_Rv
{
    int64 rawValue = 0ll;
    float rawValue_float = 0.0;
    float phyValue = 0.0;        

    //set the signal with updated raw value
    if(getValue(E_pubc_GW_GW_3C4_HU_EnterTunnelInfo_SetVt)==0)
    {
        rawValue = getvalue(this);
        if(chgEv_GW_3C4_HU_EnterTunnelInfo == 0)
        {
            //type conversion to float
            rawValue_float = rawValue;        
            // raw to physical conversion
            phyValue = ((rawValue_float *1)+(0));
            putValue(E_pubc_GW_GW_3C4_HU_EnterTunnelInfo_Pv, phyValue);
            chgEv_GW_3C4_HU_EnterTunnelInfo = 1;
        }
        else
        {
            chgEv_GW_3C4_HU_EnterTunnelInfo = 0;
        }    
        //update the signal value
        Msg_GW_3C4.HU_EnterTunnelInfo=rawValue;        
    }                                                                           
}
/*@@end*/

/*@@envVar:E_pubc_GW_GW_3C4_HU_EnterTunnelInfo_Pv:*/
on envVar E_pubc_GW_GW_3C4_HU_EnterTunnelInfo_Pv
{
    int64 rawValue = 0ll;
    float phyValue = 0.0;
    
    //update the raw value with physical value 
    if(getValue(E_pubc_GW_GW_3C4_HU_EnterTunnelInfo_SetVt)==0)
    {
        if(chgEv_GW_3C4_HU_EnterTunnelInfo == 0)
        {
            phyValue = getvalue(this);
            // physical to raw conversion
            rawValue = ((phyValue -(0))/1);
            putValue(E_pubc_GW_GW_3C4_HU_EnterTunnelInfo_Rv, rawValue);
            chgEv_GW_3C4_HU_EnterTunnelInfo = 1;  
        }
        else
        {
            chgEv_GW_3C4_HU_EnterTunnelInfo = 0;
        }
    }
}
/*@@end*/

/*@@envVar:E_pubc_GW_GW_3C4_HU_EnterTunnelInfo_Vt:*/
on envVar E_pubc_GW_GW_3C4_HU_EnterTunnelInfo_Vt
{
    qword rawValue = 0ll;
    if(getValue(E_pubc_GW_GW_3C4_HU_EnterTunnelInfo_SetVt))
    {
        //update the signal value
        Msg_GW_3C4.HU_EnterTunnelInfo=getValue(this);
    }
}
/*@@end*/

/*@@envVar:E_pubc_GW_GW_3C4_HU_EnterTunnelInfo_SetVt:*/
on envVar E_pubc_GW_GW_3C4_HU_EnterTunnelInfo_SetVt
{
    if(getValue(E_pubc_GW_GW_3C4_HU_EnterTunnelInfo_SetVt))
    {
        //update the signal value
        Msg_GW_3C4.HU_EnterTunnelInfo=getvalue(E_pubc_GW_GW_3C4_HU_EnterTunnelInfo_Vt);
    }
    else
    {
        Msg_GW_3C4.HU_EnterTunnelInfo=getValue(E_pubc_GW_GW_3C4_HU_EnterTunnelInfo_Rv);
    }
}
/*@@end*/
 
/*@@envVar:E_pubc_GW_GW_3C4_HU_MapDataUpdateStatus_Rv:*/
on envVar E_pubc_GW_GW_3C4_HU_MapDataUpdateStatus_Rv
{
    int64 rawValue = 0ll;
    float rawValue_float = 0.0;
    float phyValue = 0.0;        

    //set the signal with updated raw value
    if(getValue(E_pubc_GW_GW_3C4_HU_MapDataUpdateStatus_SetVt)==0)
    {
        rawValue = getvalue(this);
        if(chgEv_GW_3C4_HU_MapDataUpdateStatus == 0)
        {
            //type conversion to float
            rawValue_float = rawValue;        
            // raw to physical conversion
            phyValue = ((rawValue_float *1)+(0));
            putValue(E_pubc_GW_GW_3C4_HU_MapDataUpdateStatus_Pv, phyValue);
            chgEv_GW_3C4_HU_MapDataUpdateStatus = 1;
        }
        else
        {
            chgEv_GW_3C4_HU_MapDataUpdateStatus = 0;
        }    
        //update the signal value
        Msg_GW_3C4.HU_MapDataUpdateStatus=rawValue;        
    }                                                                           
}
/*@@end*/

/*@@envVar:E_pubc_GW_GW_3C4_HU_MapDataUpdateStatus_Pv:*/
on envVar E_pubc_GW_GW_3C4_HU_MapDataUpdateStatus_Pv
{
    int64 rawValue = 0ll;
    float phyValue = 0.0;
    
    //update the raw value with physical value 
    if(getValue(E_pubc_GW_GW_3C4_HU_MapDataUpdateStatus_SetVt)==0)
    {
        if(chgEv_GW_3C4_HU_MapDataUpdateStatus == 0)
        {
            phyValue = getvalue(this);
            // physical to raw conversion
            rawValue = ((phyValue -(0))/1);
            putValue(E_pubc_GW_GW_3C4_HU_MapDataUpdateStatus_Rv, rawValue);
            chgEv_GW_3C4_HU_MapDataUpdateStatus = 1;  
        }
        else
        {
            chgEv_GW_3C4_HU_MapDataUpdateStatus = 0;
        }
    }
}
/*@@end*/

/*@@envVar:E_pubc_GW_GW_3C4_HU_MapDataUpdateStatus_Vt:*/
on envVar E_pubc_GW_GW_3C4_HU_MapDataUpdateStatus_Vt
{
    qword rawValue = 0ll;
    if(getValue(E_pubc_GW_GW_3C4_HU_MapDataUpdateStatus_SetVt))
    {
        //update the signal value
        Msg_GW_3C4.HU_MapDataUpdateStatus=getValue(this);
    }
}
/*@@end*/

/*@@envVar:E_pubc_GW_GW_3C4_HU_MapDataUpdateStatus_SetVt:*/
on envVar E_pubc_GW_GW_3C4_HU_MapDataUpdateStatus_SetVt
{
    if(getValue(E_pubc_GW_GW_3C4_HU_MapDataUpdateStatus_SetVt))
    {
        //update the signal value
        Msg_GW_3C4.HU_MapDataUpdateStatus=getvalue(E_pubc_GW_GW_3C4_HU_MapDataUpdateStatus_Vt);
    }
    else
    {
        Msg_GW_3C4.HU_MapDataUpdateStatus=getValue(E_pubc_GW_GW_3C4_HU_MapDataUpdateStatus_Rv);
    }
}
/*@@end*/
 
/*@@envVar:E_pubc_GW_GW_3C4_HU_TunnelDistance_Rv:*/
on envVar E_pubc_GW_GW_3C4_HU_TunnelDistance_Rv
{
    int64 rawValue = 0ll;
    float rawValue_float = 0.0;
    float phyValue = 0.0;        

    //set the signal with updated raw value
    if(getValue(E_pubc_GW_GW_3C4_HU_TunnelDistance_SetVt)==0)
    {
        rawValue = getvalue(this);
        if(chgEv_GW_3C4_HU_TunnelDistance == 0)
        {
            //type conversion to float
            rawValue_float = rawValue;        
            // raw to physical conversion
            phyValue = ((rawValue_float *10)+(0));
            putValue(E_pubc_GW_GW_3C4_HU_TunnelDistance_Pv, phyValue);
            chgEv_GW_3C4_HU_TunnelDistance = 1;
        }
        else
        {
            chgEv_GW_3C4_HU_TunnelDistance = 0;
        }    
        //update the signal value
        Msg_GW_3C4.HU_TunnelDistance=rawValue;        
    }                                                                           
}
/*@@end*/

/*@@envVar:E_pubc_GW_GW_3C4_HU_TunnelDistance_Pv:*/
on envVar E_pubc_GW_GW_3C4_HU_TunnelDistance_Pv
{
    int64 rawValue = 0ll;
    float phyValue = 0.0;
    
    //update the raw value with physical value 
    if(getValue(E_pubc_GW_GW_3C4_HU_TunnelDistance_SetVt)==0)
    {
        if(chgEv_GW_3C4_HU_TunnelDistance == 0)
        {
            phyValue = getvalue(this);
            // physical to raw conversion
            rawValue = ((phyValue -(0))/10);
            putValue(E_pubc_GW_GW_3C4_HU_TunnelDistance_Rv, rawValue);
            chgEv_GW_3C4_HU_TunnelDistance = 1;  
        }
        else
        {
            chgEv_GW_3C4_HU_TunnelDistance = 0;
        }
    }
}
/*@@end*/

/*@@envVar:E_pubc_GW_GW_3C4_HU_TunnelDistance_Vt:*/
on envVar E_pubc_GW_GW_3C4_HU_TunnelDistance_Vt
{
    qword rawValue = 0ll;
    if(getValue(E_pubc_GW_GW_3C4_HU_TunnelDistance_SetVt))
    {
        //update the signal value
        Msg_GW_3C4.HU_TunnelDistance=getValue(this);
    }
}
/*@@end*/

/*@@envVar:E_pubc_GW_GW_3C4_HU_TunnelDistance_SetVt:*/
on envVar E_pubc_GW_GW_3C4_HU_TunnelDistance_SetVt
{
    if(getValue(E_pubc_GW_GW_3C4_HU_TunnelDistance_SetVt))
    {
        //update the signal value
        Msg_GW_3C4.HU_TunnelDistance=getvalue(E_pubc_GW_GW_3C4_HU_TunnelDistance_Vt);
    }
    else
    {
        Msg_GW_3C4.HU_TunnelDistance=getValue(E_pubc_GW_GW_3C4_HU_TunnelDistance_Rv);
    }
}
/*@@end*/
 
/*@@envVar:E_pubc_GW_GW_3C4_HU_FallingRockDi_Rv:*/
on envVar E_pubc_GW_GW_3C4_HU_FallingRockDi_Rv
{
    int64 rawValue = 0ll;
    float rawValue_float = 0.0;
    float phyValue = 0.0;        

    //set the signal with updated raw value
    if(getValue(E_pubc_GW_GW_3C4_HU_FallingRockDi_SetVt)==0)
    {
        rawValue = getvalue(this);
        if(chgEv_GW_3C4_HU_FallingRockDi == 0)
        {
            //type conversion to float
            rawValue_float = rawValue;        
            // raw to physical conversion
            phyValue = ((rawValue_float *10)+(0));
            putValue(E_pubc_GW_GW_3C4_HU_FallingRockDi_Pv, phyValue);
            chgEv_GW_3C4_HU_FallingRockDi = 1;
        }
        else
        {
            chgEv_GW_3C4_HU_FallingRockDi = 0;
        }    
        //update the signal value
        Msg_GW_3C4.HU_FallingRockDi=rawValue;        
    }                                                                           
}
/*@@end*/

/*@@envVar:E_pubc_GW_GW_3C4_HU_FallingRockDi_Pv:*/
on envVar E_pubc_GW_GW_3C4_HU_FallingRockDi_Pv
{
    int64 rawValue = 0ll;
    float phyValue = 0.0;
    
    //update the raw value with physical value 
    if(getValue(E_pubc_GW_GW_3C4_HU_FallingRockDi_SetVt)==0)
    {
        if(chgEv_GW_3C4_HU_FallingRockDi == 0)
        {
            phyValue = getvalue(this);
            // physical to raw conversion
            rawValue = ((phyValue -(0))/10);
            putValue(E_pubc_GW_GW_3C4_HU_FallingRockDi_Rv, rawValue);
            chgEv_GW_3C4_HU_FallingRockDi = 1;  
        }
        else
        {
            chgEv_GW_3C4_HU_FallingRockDi = 0;
        }
    }
}
/*@@end*/

/*@@envVar:E_pubc_GW_GW_3C4_HU_FallingRockDi_Vt:*/
on envVar E_pubc_GW_GW_3C4_HU_FallingRockDi_Vt
{
    qword rawValue = 0ll;
    if(getValue(E_pubc_GW_GW_3C4_HU_FallingRockDi_SetVt))
    {
        //update the signal value
        Msg_GW_3C4.HU_FallingRockDi=getValue(this);
    }
}
/*@@end*/

/*@@envVar:E_pubc_GW_GW_3C4_HU_FallingRockDi_SetVt:*/
on envVar E_pubc_GW_GW_3C4_HU_FallingRockDi_SetVt
{
    if(getValue(E_pubc_GW_GW_3C4_HU_FallingRockDi_SetVt))
    {
        //update the signal value
        Msg_GW_3C4.HU_FallingRockDi=getvalue(E_pubc_GW_GW_3C4_HU_FallingRockDi_Vt);
    }
    else
    {
        Msg_GW_3C4.HU_FallingRockDi=getValue(E_pubc_GW_GW_3C4_HU_FallingRockDi_Rv);
    }
}
/*@@end*/
 
/*@@envVar:E_pubc_GW_GW_3C4_HU_Byroad_Rv:*/
on envVar E_pubc_GW_GW_3C4_HU_Byroad_Rv
{
    int64 rawValue = 0ll;
    float rawValue_float = 0.0;
    float phyValue = 0.0;        

    //set the signal with updated raw value
    if(getValue(E_pubc_GW_GW_3C4_HU_Byroad_SetVt)==0)
    {
        rawValue = getvalue(this);
        if(chgEv_GW_3C4_HU_Byroad == 0)
        {
            //type conversion to float
            rawValue_float = rawValue;        
            // raw to physical conversion
            phyValue = ((rawValue_float *1)+(0));
            putValue(E_pubc_GW_GW_3C4_HU_Byroad_Pv, phyValue);
            chgEv_GW_3C4_HU_Byroad = 1;
        }
        else
        {
            chgEv_GW_3C4_HU_Byroad = 0;
        }    
        //update the signal value
        Msg_GW_3C4.HU_Byroad=rawValue;        
    }                                                                           
}
/*@@end*/

/*@@envVar:E_pubc_GW_GW_3C4_HU_Byroad_Pv:*/
on envVar E_pubc_GW_GW_3C4_HU_Byroad_Pv
{
    int64 rawValue = 0ll;
    float phyValue = 0.0;
    
    //update the raw value with physical value 
    if(getValue(E_pubc_GW_GW_3C4_HU_Byroad_SetVt)==0)
    {
        if(chgEv_GW_3C4_HU_Byroad == 0)
        {
            phyValue = getvalue(this);
            // physical to raw conversion
            rawValue = ((phyValue -(0))/1);
            putValue(E_pubc_GW_GW_3C4_HU_Byroad_Rv, rawValue);
            chgEv_GW_3C4_HU_Byroad = 1;  
        }
        else
        {
            chgEv_GW_3C4_HU_Byroad = 0;
        }
    }
}
/*@@end*/

/*@@envVar:E_pubc_GW_GW_3C4_HU_Byroad_Vt:*/
on envVar E_pubc_GW_GW_3C4_HU_Byroad_Vt
{
    qword rawValue = 0ll;
    if(getValue(E_pubc_GW_GW_3C4_HU_Byroad_SetVt))
    {
        //update the signal value
        Msg_GW_3C4.HU_Byroad=getValue(this);
    }
}
/*@@end*/

/*@@envVar:E_pubc_GW_GW_3C4_HU_Byroad_SetVt:*/
on envVar E_pubc_GW_GW_3C4_HU_Byroad_SetVt
{
    if(getValue(E_pubc_GW_GW_3C4_HU_Byroad_SetVt))
    {
        //update the signal value
        Msg_GW_3C4.HU_Byroad=getvalue(E_pubc_GW_GW_3C4_HU_Byroad_Vt);
    }
    else
    {
        Msg_GW_3C4.HU_Byroad=getValue(E_pubc_GW_GW_3C4_HU_Byroad_Rv);
    }
}
/*@@end*/
 
/*@@envVar:E_pubc_GW_GW_3C4_HU_BranchInfo_Rv:*/
on envVar E_pubc_GW_GW_3C4_HU_BranchInfo_Rv
{
    int64 rawValue = 0ll;
    float rawValue_float = 0.0;
    float phyValue = 0.0;        

    //set the signal with updated raw value
    if(getValue(E_pubc_GW_GW_3C4_HU_BranchInfo_SetVt)==0)
    {
        rawValue = getvalue(this);
        if(chgEv_GW_3C4_HU_BranchInfo == 0)
        {
            //type conversion to float
            rawValue_float = rawValue;        
            // raw to physical conversion
            phyValue = ((rawValue_float *1)+(0));
            putValue(E_pubc_GW_GW_3C4_HU_BranchInfo_Pv, phyValue);
            chgEv_GW_3C4_HU_BranchInfo = 1;
        }
        else
        {
            chgEv_GW_3C4_HU_BranchInfo = 0;
        }    
        //update the signal value
        Msg_GW_3C4.HU_BranchInfo=rawValue;        
    }                                                                           
}
/*@@end*/

/*@@envVar:E_pubc_GW_GW_3C4_HU_BranchInfo_Pv:*/
on envVar E_pubc_GW_GW_3C4_HU_BranchInfo_Pv
{
    int64 rawValue = 0ll;
    float phyValue = 0.0;
    
    //update the raw value with physical value 
    if(getValue(E_pubc_GW_GW_3C4_HU_BranchInfo_SetVt)==0)
    {
        if(chgEv_GW_3C4_HU_BranchInfo == 0)
        {
            phyValue = getvalue(this);
            // physical to raw conversion
            rawValue = ((phyValue -(0))/1);
            putValue(E_pubc_GW_GW_3C4_HU_BranchInfo_Rv, rawValue);
            chgEv_GW_3C4_HU_BranchInfo = 1;  
        }
        else
        {
            chgEv_GW_3C4_HU_BranchInfo = 0;
        }
    }
}
/*@@end*/

/*@@envVar:E_pubc_GW_GW_3C4_HU_BranchInfo_Vt:*/
on envVar E_pubc_GW_GW_3C4_HU_BranchInfo_Vt
{
    qword rawValue = 0ll;
    if(getValue(E_pubc_GW_GW_3C4_HU_BranchInfo_SetVt))
    {
        //update the signal value
        Msg_GW_3C4.HU_BranchInfo=getValue(this);
    }
}
/*@@end*/

/*@@envVar:E_pubc_GW_GW_3C4_HU_BranchInfo_SetVt:*/
on envVar E_pubc_GW_GW_3C4_HU_BranchInfo_SetVt
{
    if(getValue(E_pubc_GW_GW_3C4_HU_BranchInfo_SetVt))
    {
        //update the signal value
        Msg_GW_3C4.HU_BranchInfo=getvalue(E_pubc_GW_GW_3C4_HU_BranchInfo_Vt);
    }
    else
    {
        Msg_GW_3C4.HU_BranchInfo=getValue(E_pubc_GW_GW_3C4_HU_BranchInfo_Rv);
    }
}
/*@@end*/
 
/*@@envVar:E_pubc_GW_GW_3C4_HU_RoadCurvature_Rv:*/
on envVar E_pubc_GW_GW_3C4_HU_RoadCurvature_Rv
{
    int64 rawValue = 0ll;
    float rawValue_float = 0.0;
    float phyValue = 0.0;        

    //set the signal with updated raw value
    {
        rawValue = getvalue(this);
        if(chgEv_GW_3C4_HU_RoadCurvature == 0)
        {
            //type conversion to float
            rawValue_float = rawValue;        
            // raw to physical conversion
            phyValue = ((rawValue_float *1)+(0));
            putValue(E_pubc_GW_GW_3C4_HU_RoadCurvature_Pv, phyValue);
            chgEv_GW_3C4_HU_RoadCurvature = 1;
        }
        else
        {
            chgEv_GW_3C4_HU_RoadCurvature = 0;
        }    
        //update the signal value
        Msg_GW_3C4.HU_RoadCurvature=rawValue;        
    }                                                                           
}
/*@@end*/

/*@@envVar:E_pubc_GW_GW_3C4_HU_RoadCurvature_Pv:*/
on envVar E_pubc_GW_GW_3C4_HU_RoadCurvature_Pv
{
    int64 rawValue = 0ll;
    float phyValue = 0.0;
    
    //update the raw value with physical value 
    {
        if(chgEv_GW_3C4_HU_RoadCurvature == 0)
        {
            phyValue = getvalue(this);
            // physical to raw conversion
            rawValue = ((phyValue -(0))/1);
            putValue(E_pubc_GW_GW_3C4_HU_RoadCurvature_Rv, rawValue);
            chgEv_GW_3C4_HU_RoadCurvature = 1;  
        }
        else
        {
            chgEv_GW_3C4_HU_RoadCurvature = 0;
        }
    }
}
/*@@end*/


 
/*@@envVar:E_pubc_GW_GW_3C4_HU_RoadCurvature_80m_Rv:*/
on envVar E_pubc_GW_GW_3C4_HU_RoadCurvature_80m_Rv
{
    int64 rawValue = 0ll;
    float rawValue_float = 0.0;
    float phyValue = 0.0;        

    //set the signal with updated raw value
    {
        rawValue = getvalue(this);
        if(chgEv_GW_3C4_HU_RoadCurvature_80m == 0)
        {
            //type conversion to float
            rawValue_float = rawValue;        
            // raw to physical conversion
            phyValue = ((rawValue_float *1)+(0));
            putValue(E_pubc_GW_GW_3C4_HU_RoadCurvature_80m_Pv, phyValue);
            chgEv_GW_3C4_HU_RoadCurvature_80m = 1;
        }
        else
        {
            chgEv_GW_3C4_HU_RoadCurvature_80m = 0;
        }    
        //update the signal value
        Msg_GW_3C4.HU_RoadCurvature_80m=rawValue;        
    }                                                                           
}
/*@@end*/

/*@@envVar:E_pubc_GW_GW_3C4_HU_RoadCurvature_80m_Pv:*/
on envVar E_pubc_GW_GW_3C4_HU_RoadCurvature_80m_Pv
{
    int64 rawValue = 0ll;
    float phyValue = 0.0;
    
    //update the raw value with physical value 
    {
        if(chgEv_GW_3C4_HU_RoadCurvature_80m == 0)
        {
            phyValue = getvalue(this);
            // physical to raw conversion
            rawValue = ((phyValue -(0))/1);
            putValue(E_pubc_GW_GW_3C4_HU_RoadCurvature_80m_Rv, rawValue);
            chgEv_GW_3C4_HU_RoadCurvature_80m = 1;  
        }
        else
        {
            chgEv_GW_3C4_HU_RoadCurvature_80m = 0;
        }
    }
}
/*@@end*/


 
/*@@envVar:E_pubc_GW_GW_3C4_HU_RoadCurvature_90m_Rv:*/
on envVar E_pubc_GW_GW_3C4_HU_RoadCurvature_90m_Rv
{
    int64 rawValue = 0ll;
    float rawValue_float = 0.0;
    float phyValue = 0.0;        

    //set the signal with updated raw value
    {
        rawValue = getvalue(this);
        if(chgEv_GW_3C4_HU_RoadCurvature_90m == 0)
        {
            //type conversion to float
            rawValue_float = rawValue;        
            // raw to physical conversion
            phyValue = ((rawValue_float *1)+(0));
            putValue(E_pubc_GW_GW_3C4_HU_RoadCurvature_90m_Pv, phyValue);
            chgEv_GW_3C4_HU_RoadCurvature_90m = 1;
        }
        else
        {
            chgEv_GW_3C4_HU_RoadCurvature_90m = 0;
        }    
        //update the signal value
        Msg_GW_3C4.HU_RoadCurvature_90m=rawValue;        
    }                                                                           
}
/*@@end*/

/*@@envVar:E_pubc_GW_GW_3C4_HU_RoadCurvature_90m_Pv:*/
on envVar E_pubc_GW_GW_3C4_HU_RoadCurvature_90m_Pv
{
    int64 rawValue = 0ll;
    float phyValue = 0.0;
    
    //update the raw value with physical value 
    {
        if(chgEv_GW_3C4_HU_RoadCurvature_90m == 0)
        {
            phyValue = getvalue(this);
            // physical to raw conversion
            rawValue = ((phyValue -(0))/1);
            putValue(E_pubc_GW_GW_3C4_HU_RoadCurvature_90m_Rv, rawValue);
            chgEv_GW_3C4_HU_RoadCurvature_90m = 1;  
        }
        else
        {
            chgEv_GW_3C4_HU_RoadCurvature_90m = 0;
        }
    }
}
/*@@end*/


 
/*@@envVar:E_pubc_GW_GW_3C4_HU_RoadCurvature_600m_Rv:*/
on envVar E_pubc_GW_GW_3C4_HU_RoadCurvature_600m_Rv
{
    int64 rawValue = 0ll;
    float rawValue_float = 0.0;
    float phyValue = 0.0;        

    //set the signal with updated raw value
    {
        rawValue = getvalue(this);
        if(chgEv_GW_3C4_HU_RoadCurvature_600m == 0)
        {
            //type conversion to float
            rawValue_float = rawValue;        
            // raw to physical conversion
            phyValue = ((rawValue_float *1)+(0));
            putValue(E_pubc_GW_GW_3C4_HU_RoadCurvature_600m_Pv, phyValue);
            chgEv_GW_3C4_HU_RoadCurvature_600m = 1;
        }
        else
        {
            chgEv_GW_3C4_HU_RoadCurvature_600m = 0;
        }    
        //update the signal value
        Msg_GW_3C4.HU_RoadCurvature_600m=rawValue;        
    }                                                                           
}
/*@@end*/

/*@@envVar:E_pubc_GW_GW_3C4_HU_RoadCurvature_600m_Pv:*/
on envVar E_pubc_GW_GW_3C4_HU_RoadCurvature_600m_Pv
{
    int64 rawValue = 0ll;
    float phyValue = 0.0;
    
    //update the raw value with physical value 
    {
        if(chgEv_GW_3C4_HU_RoadCurvature_600m == 0)
        {
            phyValue = getvalue(this);
            // physical to raw conversion
            rawValue = ((phyValue -(0))/1);
            putValue(E_pubc_GW_GW_3C4_HU_RoadCurvature_600m_Rv, rawValue);
            chgEv_GW_3C4_HU_RoadCurvature_600m = 1;  
        }
        else
        {
            chgEv_GW_3C4_HU_RoadCurvature_600m = 0;
        }
    }
}
/*@@end*/


 
/*@@envVar:E_pubc_GW_GW_3C4_HU_SlopeDistance_Rv:*/
on envVar E_pubc_GW_GW_3C4_HU_SlopeDistance_Rv
{
    int64 rawValue = 0ll;
    float rawValue_float = 0.0;
    float phyValue = 0.0;        

    //set the signal with updated raw value
    if(getValue(E_pubc_GW_GW_3C4_HU_SlopeDistance_SetVt)==0)
    {
        rawValue = getvalue(this);
        if(chgEv_GW_3C4_HU_SlopeDistance == 0)
        {
            //type conversion to float
            rawValue_float = rawValue;        
            // raw to physical conversion
            phyValue = ((rawValue_float *10)+(0));
            putValue(E_pubc_GW_GW_3C4_HU_SlopeDistance_Pv, phyValue);
            chgEv_GW_3C4_HU_SlopeDistance = 1;
        }
        else
        {
            chgEv_GW_3C4_HU_SlopeDistance = 0;
        }    
        //update the signal value
        Msg_GW_3C4.HU_SlopeDistance=rawValue;        
    }                                                                           
}
/*@@end*/

/*@@envVar:E_pubc_GW_GW_3C4_HU_SlopeDistance_Pv:*/
on envVar E_pubc_GW_GW_3C4_HU_SlopeDistance_Pv
{
    int64 rawValue = 0ll;
    float phyValue = 0.0;
    
    //update the raw value with physical value 
    if(getValue(E_pubc_GW_GW_3C4_HU_SlopeDistance_SetVt)==0)
    {
        if(chgEv_GW_3C4_HU_SlopeDistance == 0)
        {
            phyValue = getvalue(this);
            // physical to raw conversion
            rawValue = ((phyValue -(0))/10);
            putValue(E_pubc_GW_GW_3C4_HU_SlopeDistance_Rv, rawValue);
            chgEv_GW_3C4_HU_SlopeDistance = 1;  
        }
        else
        {
            chgEv_GW_3C4_HU_SlopeDistance = 0;
        }
    }
}
/*@@end*/

/*@@envVar:E_pubc_GW_GW_3C4_HU_SlopeDistance_Vt:*/
on envVar E_pubc_GW_GW_3C4_HU_SlopeDistance_Vt
{
    qword rawValue = 0ll;
    if(getValue(E_pubc_GW_GW_3C4_HU_SlopeDistance_SetVt))
    {
        //update the signal value
        Msg_GW_3C4.HU_SlopeDistance=getValue(this);
    }
}
/*@@end*/

/*@@envVar:E_pubc_GW_GW_3C4_HU_SlopeDistance_SetVt:*/
on envVar E_pubc_GW_GW_3C4_HU_SlopeDistance_SetVt
{
    if(getValue(E_pubc_GW_GW_3C4_HU_SlopeDistance_SetVt))
    {
        //update the signal value
        Msg_GW_3C4.HU_SlopeDistance=getvalue(E_pubc_GW_GW_3C4_HU_SlopeDistance_Vt);
    }
    else
    {
        Msg_GW_3C4.HU_SlopeDistance=getValue(E_pubc_GW_GW_3C4_HU_SlopeDistance_Rv);
    }
}
/*@@end*/
 
/*@@envVar:E_pubc_GW_GW_3C4_HU_LaneCnt_Rv:*/
on envVar E_pubc_GW_GW_3C4_HU_LaneCnt_Rv
{
    int64 rawValue = 0ll;
    float rawValue_float = 0.0;
    float phyValue = 0.0;        

    //set the signal with updated raw value
    if(getValue(E_pubc_GW_GW_3C4_HU_LaneCnt_SetVt)==0)
    {
        rawValue = getvalue(this);
        if(chgEv_GW_3C4_HU_LaneCnt == 0)
        {
            //type conversion to float
            rawValue_float = rawValue;        
            // raw to physical conversion
            phyValue = ((rawValue_float *1)+(0));
            putValue(E_pubc_GW_GW_3C4_HU_LaneCnt_Pv, phyValue);
            chgEv_GW_3C4_HU_LaneCnt = 1;
        }
        else
        {
            chgEv_GW_3C4_HU_LaneCnt = 0;
        }    
        //update the signal value
        Msg_GW_3C4.HU_LaneCnt=rawValue;        
    }                                                                           
}
/*@@end*/

/*@@envVar:E_pubc_GW_GW_3C4_HU_LaneCnt_Pv:*/
on envVar E_pubc_GW_GW_3C4_HU_LaneCnt_Pv
{
    int64 rawValue = 0ll;
    float phyValue = 0.0;
    
    //update the raw value with physical value 
    if(getValue(E_pubc_GW_GW_3C4_HU_LaneCnt_SetVt)==0)
    {
        if(chgEv_GW_3C4_HU_LaneCnt == 0)
        {
            phyValue = getvalue(this);
            // physical to raw conversion
            rawValue = ((phyValue -(0))/1);
            putValue(E_pubc_GW_GW_3C4_HU_LaneCnt_Rv, rawValue);
            chgEv_GW_3C4_HU_LaneCnt = 1;  
        }
        else
        {
            chgEv_GW_3C4_HU_LaneCnt = 0;
        }
    }
}
/*@@end*/

/*@@envVar:E_pubc_GW_GW_3C4_HU_LaneCnt_Vt:*/
on envVar E_pubc_GW_GW_3C4_HU_LaneCnt_Vt
{
    qword rawValue = 0ll;
    if(getValue(E_pubc_GW_GW_3C4_HU_LaneCnt_SetVt))
    {
        //update the signal value
        Msg_GW_3C4.HU_LaneCnt=getValue(this);
    }
}
/*@@end*/

/*@@envVar:E_pubc_GW_GW_3C4_HU_LaneCnt_SetVt:*/
on envVar E_pubc_GW_GW_3C4_HU_LaneCnt_SetVt
{
    if(getValue(E_pubc_GW_GW_3C4_HU_LaneCnt_SetVt))
    {
        //update the signal value
        Msg_GW_3C4.HU_LaneCnt=getvalue(E_pubc_GW_GW_3C4_HU_LaneCnt_Vt);
    }
    else
    {
        Msg_GW_3C4.HU_LaneCnt=getValue(E_pubc_GW_GW_3C4_HU_LaneCnt_Rv);
    }
}
/*@@end*/
 
/*@@envVar:E_pubc_GW_GW_3C4_HU_RoadCurvature_100m_Rv:*/
on envVar E_pubc_GW_GW_3C4_HU_RoadCurvature_100m_Rv
{
    int64 rawValue = 0ll;
    float rawValue_float = 0.0;
    float phyValue = 0.0;        

    //set the signal with updated raw value
    {
        rawValue = getvalue(this);
        if(chgEv_GW_3C4_HU_RoadCurvature_100m == 0)
        {
            //type conversion to float
            rawValue_float = rawValue;        
            // raw to physical conversion
            phyValue = ((rawValue_float *1)+(0));
            putValue(E_pubc_GW_GW_3C4_HU_RoadCurvature_100m_Pv, phyValue);
            chgEv_GW_3C4_HU_RoadCurvature_100m = 1;
        }
        else
        {
            chgEv_GW_3C4_HU_RoadCurvature_100m = 0;
        }    
        //update the signal value
        Msg_GW_3C4.HU_RoadCurvature_100m=rawValue;        
    }                                                                           
}
/*@@end*/

/*@@envVar:E_pubc_GW_GW_3C4_HU_RoadCurvature_100m_Pv:*/
on envVar E_pubc_GW_GW_3C4_HU_RoadCurvature_100m_Pv
{
    int64 rawValue = 0ll;
    float phyValue = 0.0;
    
    //update the raw value with physical value 
    {
        if(chgEv_GW_3C4_HU_RoadCurvature_100m == 0)
        {
            phyValue = getvalue(this);
            // physical to raw conversion
            rawValue = ((phyValue -(0))/1);
            putValue(E_pubc_GW_GW_3C4_HU_RoadCurvature_100m_Rv, rawValue);
            chgEv_GW_3C4_HU_RoadCurvature_100m = 1;  
        }
        else
        {
            chgEv_GW_3C4_HU_RoadCurvature_100m = 0;
        }
    }
}
/*@@end*/


 
/*@@envVar:E_pubc_GW_GW_3C4_HU_TollDis_Rv:*/
on envVar E_pubc_GW_GW_3C4_HU_TollDis_Rv
{
    int64 rawValue = 0ll;
    float rawValue_float = 0.0;
    float phyValue = 0.0;        

    //set the signal with updated raw value
    if(getValue(E_pubc_GW_GW_3C4_HU_TollDis_SetVt)==0)
    {
        rawValue = getvalue(this);
        if(chgEv_GW_3C4_HU_TollDis == 0)
        {
            //type conversion to float
            rawValue_float = rawValue;        
            // raw to physical conversion
            phyValue = ((rawValue_float *10)+(0));
            putValue(E_pubc_GW_GW_3C4_HU_TollDis_Pv, phyValue);
            chgEv_GW_3C4_HU_TollDis = 1;
        }
        else
        {
            chgEv_GW_3C4_HU_TollDis = 0;
        }    
        //update the signal value
        Msg_GW_3C4.HU_TollDis=rawValue;        
    }                                                                           
}
/*@@end*/

/*@@envVar:E_pubc_GW_GW_3C4_HU_TollDis_Pv:*/
on envVar E_pubc_GW_GW_3C4_HU_TollDis_Pv
{
    int64 rawValue = 0ll;
    float phyValue = 0.0;
    
    //update the raw value with physical value 
    if(getValue(E_pubc_GW_GW_3C4_HU_TollDis_SetVt)==0)
    {
        if(chgEv_GW_3C4_HU_TollDis == 0)
        {
            phyValue = getvalue(this);
            // physical to raw conversion
            rawValue = ((phyValue -(0))/10);
            putValue(E_pubc_GW_GW_3C4_HU_TollDis_Rv, rawValue);
            chgEv_GW_3C4_HU_TollDis = 1;  
        }
        else
        {
            chgEv_GW_3C4_HU_TollDis = 0;
        }
    }
}
/*@@end*/

/*@@envVar:E_pubc_GW_GW_3C4_HU_TollDis_Vt:*/
on envVar E_pubc_GW_GW_3C4_HU_TollDis_Vt
{
    qword rawValue = 0ll;
    if(getValue(E_pubc_GW_GW_3C4_HU_TollDis_SetVt))
    {
        //update the signal value
        Msg_GW_3C4.HU_TollDis=getValue(this);
    }
}
/*@@end*/

/*@@envVar:E_pubc_GW_GW_3C4_HU_TollDis_SetVt:*/
on envVar E_pubc_GW_GW_3C4_HU_TollDis_SetVt
{
    if(getValue(E_pubc_GW_GW_3C4_HU_TollDis_SetVt))
    {
        //update the signal value
        Msg_GW_3C4.HU_TollDis=getvalue(E_pubc_GW_GW_3C4_HU_TollDis_Vt);
    }
    else
    {
        Msg_GW_3C4.HU_TollDis=getValue(E_pubc_GW_GW_3C4_HU_TollDis_Rv);
    }
}
/*@@end*/
 
/*@@envVar:E_pubc_GW_GW_3C4_HU_To_Construction_Dis_Rv:*/
on envVar E_pubc_GW_GW_3C4_HU_To_Construction_Dis_Rv
{
    int64 rawValue = 0ll;
    float rawValue_float = 0.0;
    float phyValue = 0.0;        

    //set the signal with updated raw value
    if(getValue(E_pubc_GW_GW_3C4_HU_To_Construction_Dis_SetVt)==0)
    {
        rawValue = getvalue(this);
        if(chgEv_GW_3C4_HU_To_Construction_Dis == 0)
        {
            //type conversion to float
            rawValue_float = rawValue;        
            // raw to physical conversion
            phyValue = ((rawValue_float *10)+(0));
            putValue(E_pubc_GW_GW_3C4_HU_To_Construction_Dis_Pv, phyValue);
            chgEv_GW_3C4_HU_To_Construction_Dis = 1;
        }
        else
        {
            chgEv_GW_3C4_HU_To_Construction_Dis = 0;
        }    
        //update the signal value
        Msg_GW_3C4.HU_To_Construction_Dis=rawValue;        
    }                                                                           
}
/*@@end*/

/*@@envVar:E_pubc_GW_GW_3C4_HU_To_Construction_Dis_Pv:*/
on envVar E_pubc_GW_GW_3C4_HU_To_Construction_Dis_Pv
{
    int64 rawValue = 0ll;
    float phyValue = 0.0;
    
    //update the raw value with physical value 
    if(getValue(E_pubc_GW_GW_3C4_HU_To_Construction_Dis_SetVt)==0)
    {
        if(chgEv_GW_3C4_HU_To_Construction_Dis == 0)
        {
            phyValue = getvalue(this);
            // physical to raw conversion
            rawValue = ((phyValue -(0))/10);
            putValue(E_pubc_GW_GW_3C4_HU_To_Construction_Dis_Rv, rawValue);
            chgEv_GW_3C4_HU_To_Construction_Dis = 1;  
        }
        else
        {
            chgEv_GW_3C4_HU_To_Construction_Dis = 0;
        }
    }
}
/*@@end*/

/*@@envVar:E_pubc_GW_GW_3C4_HU_To_Construction_Dis_Vt:*/
on envVar E_pubc_GW_GW_3C4_HU_To_Construction_Dis_Vt
{
    qword rawValue = 0ll;
    if(getValue(E_pubc_GW_GW_3C4_HU_To_Construction_Dis_SetVt))
    {
        //update the signal value
        Msg_GW_3C4.HU_To_Construction_Dis=getValue(this);
    }
}
/*@@end*/

/*@@envVar:E_pubc_GW_GW_3C4_HU_To_Construction_Dis_SetVt:*/
on envVar E_pubc_GW_GW_3C4_HU_To_Construction_Dis_SetVt
{
    if(getValue(E_pubc_GW_GW_3C4_HU_To_Construction_Dis_SetVt))
    {
        //update the signal value
        Msg_GW_3C4.HU_To_Construction_Dis=getvalue(E_pubc_GW_GW_3C4_HU_To_Construction_Dis_Vt);
    }
    else
    {
        Msg_GW_3C4.HU_To_Construction_Dis=getValue(E_pubc_GW_GW_3C4_HU_To_Construction_Dis_Rv);
    }
}
/*@@end*/
 
/*@@envVar:E_pubc_GW_GW_3C4_HU_To_Branch_Dis_Rv:*/
on envVar E_pubc_GW_GW_3C4_HU_To_Branch_Dis_Rv
{
    int64 rawValue = 0ll;
    float rawValue_float = 0.0;
    float phyValue = 0.0;        

    //set the signal with updated raw value
    if(getValue(E_pubc_GW_GW_3C4_HU_To_Branch_Dis_SetVt)==0)
    {
        rawValue = getvalue(this);
        if(chgEv_GW_3C4_HU_To_Branch_Dis == 0)
        {
            //type conversion to float
            rawValue_float = rawValue;        
            // raw to physical conversion
            phyValue = ((rawValue_float *10)+(0));
            putValue(E_pubc_GW_GW_3C4_HU_To_Branch_Dis_Pv, phyValue);
            chgEv_GW_3C4_HU_To_Branch_Dis = 1;
        }
        else
        {
            chgEv_GW_3C4_HU_To_Branch_Dis = 0;
        }    
        //update the signal value
        Msg_GW_3C4.HU_To_Branch_Dis=rawValue;        
    }                                                                           
}
/*@@end*/

/*@@envVar:E_pubc_GW_GW_3C4_HU_To_Branch_Dis_Pv:*/
on envVar E_pubc_GW_GW_3C4_HU_To_Branch_Dis_Pv
{
    int64 rawValue = 0ll;
    float phyValue = 0.0;
    
    //update the raw value with physical value 
    if(getValue(E_pubc_GW_GW_3C4_HU_To_Branch_Dis_SetVt)==0)
    {
        if(chgEv_GW_3C4_HU_To_Branch_Dis == 0)
        {
            phyValue = getvalue(this);
            // physical to raw conversion
            rawValue = ((phyValue -(0))/10);
            putValue(E_pubc_GW_GW_3C4_HU_To_Branch_Dis_Rv, rawValue);
            chgEv_GW_3C4_HU_To_Branch_Dis = 1;  
        }
        else
        {
            chgEv_GW_3C4_HU_To_Branch_Dis = 0;
        }
    }
}
/*@@end*/

/*@@envVar:E_pubc_GW_GW_3C4_HU_To_Branch_Dis_Vt:*/
on envVar E_pubc_GW_GW_3C4_HU_To_Branch_Dis_Vt
{
    qword rawValue = 0ll;
    if(getValue(E_pubc_GW_GW_3C4_HU_To_Branch_Dis_SetVt))
    {
        //update the signal value
        Msg_GW_3C4.HU_To_Branch_Dis=getValue(this);
    }
}
/*@@end*/

/*@@envVar:E_pubc_GW_GW_3C4_HU_To_Branch_Dis_SetVt:*/
on envVar E_pubc_GW_GW_3C4_HU_To_Branch_Dis_SetVt
{
    if(getValue(E_pubc_GW_GW_3C4_HU_To_Branch_Dis_SetVt))
    {
        //update the signal value
        Msg_GW_3C4.HU_To_Branch_Dis=getvalue(E_pubc_GW_GW_3C4_HU_To_Branch_Dis_Vt);
    }
    else
    {
        Msg_GW_3C4.HU_To_Branch_Dis=getValue(E_pubc_GW_GW_3C4_HU_To_Branch_Dis_Rv);
    }
}
/*@@end*/
 
/*@@envVar:E_pubc_GW_GW_3C4_HU_RoadCurvature_70m_Rv:*/
on envVar E_pubc_GW_GW_3C4_HU_RoadCurvature_70m_Rv
{
    int64 rawValue = 0ll;
    float rawValue_float = 0.0;
    float phyValue = 0.0;        

    //set the signal with updated raw value
    {
        rawValue = getvalue(this);
        if(chgEv_GW_3C4_HU_RoadCurvature_70m == 0)
        {
            //type conversion to float
            rawValue_float = rawValue;        
            // raw to physical conversion
            phyValue = ((rawValue_float *1)+(0));
            putValue(E_pubc_GW_GW_3C4_HU_RoadCurvature_70m_Pv, phyValue);
            chgEv_GW_3C4_HU_RoadCurvature_70m = 1;
        }
        else
        {
            chgEv_GW_3C4_HU_RoadCurvature_70m = 0;
        }    
        //update the signal value
        Msg_GW_3C4.HU_RoadCurvature_70m=rawValue;        
    }                                                                           
}
/*@@end*/

/*@@envVar:E_pubc_GW_GW_3C4_HU_RoadCurvature_70m_Pv:*/
on envVar E_pubc_GW_GW_3C4_HU_RoadCurvature_70m_Pv
{
    int64 rawValue = 0ll;
    float phyValue = 0.0;
    
    //update the raw value with physical value 
    {
        if(chgEv_GW_3C4_HU_RoadCurvature_70m == 0)
        {
            phyValue = getvalue(this);
            // physical to raw conversion
            rawValue = ((phyValue -(0))/1);
            putValue(E_pubc_GW_GW_3C4_HU_RoadCurvature_70m_Rv, rawValue);
            chgEv_GW_3C4_HU_RoadCurvature_70m = 1;  
        }
        else
        {
            chgEv_GW_3C4_HU_RoadCurvature_70m = 0;
        }
    }
}
/*@@end*/


 
/*@@envVar:E_pubc_GW_GW_3C4_HU_To_TrafficAccident_Dis_Rv:*/
on envVar E_pubc_GW_GW_3C4_HU_To_TrafficAccident_Dis_Rv
{
    int64 rawValue = 0ll;
    float rawValue_float = 0.0;
    float phyValue = 0.0;        

    //set the signal with updated raw value
    if(getValue(E_pubc_GW_GW_3C4_HU_To_TrafficAccident_Dis_SetVt)==0)
    {
        rawValue = getvalue(this);
        if(chgEv_GW_3C4_HU_To_TrafficAccident_Dis == 0)
        {
            //type conversion to float
            rawValue_float = rawValue;        
            // raw to physical conversion
            phyValue = ((rawValue_float *10)+(0));
            putValue(E_pubc_GW_GW_3C4_HU_To_TrafficAccident_Dis_Pv, phyValue);
            chgEv_GW_3C4_HU_To_TrafficAccident_Dis = 1;
        }
        else
        {
            chgEv_GW_3C4_HU_To_TrafficAccident_Dis = 0;
        }    
        //update the signal value
        Msg_GW_3C4.HU_To_TrafficAccident_Dis=rawValue;        
    }                                                                           
}
/*@@end*/

/*@@envVar:E_pubc_GW_GW_3C4_HU_To_TrafficAccident_Dis_Pv:*/
on envVar E_pubc_GW_GW_3C4_HU_To_TrafficAccident_Dis_Pv
{
    int64 rawValue = 0ll;
    float phyValue = 0.0;
    
    //update the raw value with physical value 
    if(getValue(E_pubc_GW_GW_3C4_HU_To_TrafficAccident_Dis_SetVt)==0)
    {
        if(chgEv_GW_3C4_HU_To_TrafficAccident_Dis == 0)
        {
            phyValue = getvalue(this);
            // physical to raw conversion
            rawValue = ((phyValue -(0))/10);
            putValue(E_pubc_GW_GW_3C4_HU_To_TrafficAccident_Dis_Rv, rawValue);
            chgEv_GW_3C4_HU_To_TrafficAccident_Dis = 1;  
        }
        else
        {
            chgEv_GW_3C4_HU_To_TrafficAccident_Dis = 0;
        }
    }
}
/*@@end*/

/*@@envVar:E_pubc_GW_GW_3C4_HU_To_TrafficAccident_Dis_Vt:*/
on envVar E_pubc_GW_GW_3C4_HU_To_TrafficAccident_Dis_Vt
{
    qword rawValue = 0ll;
    if(getValue(E_pubc_GW_GW_3C4_HU_To_TrafficAccident_Dis_SetVt))
    {
        //update the signal value
        Msg_GW_3C4.HU_To_TrafficAccident_Dis=getValue(this);
    }
}
/*@@end*/

/*@@envVar:E_pubc_GW_GW_3C4_HU_To_TrafficAccident_Dis_SetVt:*/
on envVar E_pubc_GW_GW_3C4_HU_To_TrafficAccident_Dis_SetVt
{
    if(getValue(E_pubc_GW_GW_3C4_HU_To_TrafficAccident_Dis_SetVt))
    {
        //update the signal value
        Msg_GW_3C4.HU_To_TrafficAccident_Dis=getvalue(E_pubc_GW_GW_3C4_HU_To_TrafficAccident_Dis_Vt);
    }
    else
    {
        Msg_GW_3C4.HU_To_TrafficAccident_Dis=getValue(E_pubc_GW_GW_3C4_HU_To_TrafficAccident_Dis_Rv);
    }
}
/*@@end*/
 
/*@@envVar:E_pubc_GW_GW_3C4_HU_To_NumchangeOfLanes_Dist_Rv:*/
on envVar E_pubc_GW_GW_3C4_HU_To_NumchangeOfLanes_Dist_Rv
{
    int64 rawValue = 0ll;
    float rawValue_float = 0.0;
    float phyValue = 0.0;        

    //set the signal with updated raw value
    if(getValue(E_pubc_GW_GW_3C4_HU_To_NumchangeOfLanes_Dist_SetVt)==0)
    {
        rawValue = getvalue(this);
        if(chgEv_GW_3C4_HU_To_NumchangeOfLanes_Dist == 0)
        {
            //type conversion to float
            rawValue_float = rawValue;        
            // raw to physical conversion
            phyValue = ((rawValue_float *10)+(0));
            putValue(E_pubc_GW_GW_3C4_HU_To_NumchangeOfLanes_Dist_Pv, phyValue);
            chgEv_GW_3C4_HU_To_NumchangeOfLanes_Dist = 1;
        }
        else
        {
            chgEv_GW_3C4_HU_To_NumchangeOfLanes_Dist = 0;
        }    
        //update the signal value
        Msg_GW_3C4.HU_To_NumchangeOfLanes_Dist=rawValue;        
    }                                                                           
}
/*@@end*/

/*@@envVar:E_pubc_GW_GW_3C4_HU_To_NumchangeOfLanes_Dist_Pv:*/
on envVar E_pubc_GW_GW_3C4_HU_To_NumchangeOfLanes_Dist_Pv
{
    int64 rawValue = 0ll;
    float phyValue = 0.0;
    
    //update the raw value with physical value 
    if(getValue(E_pubc_GW_GW_3C4_HU_To_NumchangeOfLanes_Dist_SetVt)==0)
    {
        if(chgEv_GW_3C4_HU_To_NumchangeOfLanes_Dist == 0)
        {
            phyValue = getvalue(this);
            // physical to raw conversion
            rawValue = ((phyValue -(0))/10);
            putValue(E_pubc_GW_GW_3C4_HU_To_NumchangeOfLanes_Dist_Rv, rawValue);
            chgEv_GW_3C4_HU_To_NumchangeOfLanes_Dist = 1;  
        }
        else
        {
            chgEv_GW_3C4_HU_To_NumchangeOfLanes_Dist = 0;
        }
    }
}
/*@@end*/

/*@@envVar:E_pubc_GW_GW_3C4_HU_To_NumchangeOfLanes_Dist_Vt:*/
on envVar E_pubc_GW_GW_3C4_HU_To_NumchangeOfLanes_Dist_Vt
{
    qword rawValue = 0ll;
    if(getValue(E_pubc_GW_GW_3C4_HU_To_NumchangeOfLanes_Dist_SetVt))
    {
        //update the signal value
        Msg_GW_3C4.HU_To_NumchangeOfLanes_Dist=getValue(this);
    }
}
/*@@end*/

/*@@envVar:E_pubc_GW_GW_3C4_HU_To_NumchangeOfLanes_Dist_SetVt:*/
on envVar E_pubc_GW_GW_3C4_HU_To_NumchangeOfLanes_Dist_SetVt
{
    if(getValue(E_pubc_GW_GW_3C4_HU_To_NumchangeOfLanes_Dist_SetVt))
    {
        //update the signal value
        Msg_GW_3C4.HU_To_NumchangeOfLanes_Dist=getvalue(E_pubc_GW_GW_3C4_HU_To_NumchangeOfLanes_Dist_Vt);
    }
    else
    {
        Msg_GW_3C4.HU_To_NumchangeOfLanes_Dist=getValue(E_pubc_GW_GW_3C4_HU_To_NumchangeOfLanes_Dist_Rv);
    }
}
/*@@end*/
 
/*@@envVar:E_pubc_GW_GW_3C4_HU_RoadCurvature_60m_Rv:*/
on envVar E_pubc_GW_GW_3C4_HU_RoadCurvature_60m_Rv
{
    int64 rawValue = 0ll;
    float rawValue_float = 0.0;
    float phyValue = 0.0;        

    //set the signal with updated raw value
    {
        rawValue = getvalue(this);
        if(chgEv_GW_3C4_HU_RoadCurvature_60m == 0)
        {
            //type conversion to float
            rawValue_float = rawValue;        
            // raw to physical conversion
            phyValue = ((rawValue_float *1)+(0));
            putValue(E_pubc_GW_GW_3C4_HU_RoadCurvature_60m_Pv, phyValue);
            chgEv_GW_3C4_HU_RoadCurvature_60m = 1;
        }
        else
        {
            chgEv_GW_3C4_HU_RoadCurvature_60m = 0;
        }    
        //update the signal value
        Msg_GW_3C4.HU_RoadCurvature_60m=rawValue;        
    }                                                                           
}
/*@@end*/

/*@@envVar:E_pubc_GW_GW_3C4_HU_RoadCurvature_60m_Pv:*/
on envVar E_pubc_GW_GW_3C4_HU_RoadCurvature_60m_Pv
{
    int64 rawValue = 0ll;
    float phyValue = 0.0;
    
    //update the raw value with physical value 
    {
        if(chgEv_GW_3C4_HU_RoadCurvature_60m == 0)
        {
            phyValue = getvalue(this);
            // physical to raw conversion
            rawValue = ((phyValue -(0))/1);
            putValue(E_pubc_GW_GW_3C4_HU_RoadCurvature_60m_Rv, rawValue);
            chgEv_GW_3C4_HU_RoadCurvature_60m = 1;  
        }
        else
        {
            chgEv_GW_3C4_HU_RoadCurvature_60m = 0;
        }
    }
}
/*@@end*/


 
/*@@envVar:E_pubc_GW_GW_3C4_HU_TunnelLength_Rv:*/
on envVar E_pubc_GW_GW_3C4_HU_TunnelLength_Rv
{
    int64 rawValue = 0ll;
    float rawValue_float = 0.0;
    float phyValue = 0.0;        

    //set the signal with updated raw value
    if(getValue(E_pubc_GW_GW_3C4_HU_TunnelLength_SetVt)==0)
    {
        rawValue = getvalue(this);
        if(chgEv_GW_3C4_HU_TunnelLength == 0)
        {
            //type conversion to float
            rawValue_float = rawValue;        
            // raw to physical conversion
            phyValue = ((rawValue_float *1)+(0));
            putValue(E_pubc_GW_GW_3C4_HU_TunnelLength_Pv, phyValue);
            chgEv_GW_3C4_HU_TunnelLength = 1;
        }
        else
        {
            chgEv_GW_3C4_HU_TunnelLength = 0;
        }    
        //update the signal value
        Msg_GW_3C4.HU_TunnelLength=rawValue;        
    }                                                                           
}
/*@@end*/

/*@@envVar:E_pubc_GW_GW_3C4_HU_TunnelLength_Pv:*/
on envVar E_pubc_GW_GW_3C4_HU_TunnelLength_Pv
{
    int64 rawValue = 0ll;
    float phyValue = 0.0;
    
    //update the raw value with physical value 
    if(getValue(E_pubc_GW_GW_3C4_HU_TunnelLength_SetVt)==0)
    {
        if(chgEv_GW_3C4_HU_TunnelLength == 0)
        {
            phyValue = getvalue(this);
            // physical to raw conversion
            rawValue = ((phyValue -(0))/1);
            putValue(E_pubc_GW_GW_3C4_HU_TunnelLength_Rv, rawValue);
            chgEv_GW_3C4_HU_TunnelLength = 1;  
        }
        else
        {
            chgEv_GW_3C4_HU_TunnelLength = 0;
        }
    }
}
/*@@end*/

/*@@envVar:E_pubc_GW_GW_3C4_HU_TunnelLength_Vt:*/
on envVar E_pubc_GW_GW_3C4_HU_TunnelLength_Vt
{
    qword rawValue = 0ll;
    if(getValue(E_pubc_GW_GW_3C4_HU_TunnelLength_SetVt))
    {
        //update the signal value
        Msg_GW_3C4.HU_TunnelLength=getValue(this);
    }
}
/*@@end*/

/*@@envVar:E_pubc_GW_GW_3C4_HU_TunnelLength_SetVt:*/
on envVar E_pubc_GW_GW_3C4_HU_TunnelLength_SetVt
{
    if(getValue(E_pubc_GW_GW_3C4_HU_TunnelLength_SetVt))
    {
        //update the signal value
        Msg_GW_3C4.HU_TunnelLength=getvalue(E_pubc_GW_GW_3C4_HU_TunnelLength_Vt);
    }
    else
    {
        Msg_GW_3C4.HU_TunnelLength=getValue(E_pubc_GW_GW_3C4_HU_TunnelLength_Rv);
    }
}
/*@@end*/
 
/*@@envVar:E_pubc_GW_GW_3C4_HU_Construction_Info_Rv:*/
on envVar E_pubc_GW_GW_3C4_HU_Construction_Info_Rv
{
    int64 rawValue = 0ll;
    float rawValue_float = 0.0;
    float phyValue = 0.0;        

    //set the signal with updated raw value
    if(getValue(E_pubc_GW_GW_3C4_HU_Construction_Info_SetVt)==0)
    {
        rawValue = getvalue(this);
        if(chgEv_GW_3C4_HU_Construction_Info == 0)
        {
            //type conversion to float
            rawValue_float = rawValue;        
            // raw to physical conversion
            phyValue = ((rawValue_float *1)+(0));
            putValue(E_pubc_GW_GW_3C4_HU_Construction_Info_Pv, phyValue);
            chgEv_GW_3C4_HU_Construction_Info = 1;
        }
        else
        {
            chgEv_GW_3C4_HU_Construction_Info = 0;
        }    
        //update the signal value
        Msg_GW_3C4.HU_Construction_Info=rawValue;        
    }                                                                           
}
/*@@end*/

/*@@envVar:E_pubc_GW_GW_3C4_HU_Construction_Info_Pv:*/
on envVar E_pubc_GW_GW_3C4_HU_Construction_Info_Pv
{
    int64 rawValue = 0ll;
    float phyValue = 0.0;
    
    //update the raw value with physical value 
    if(getValue(E_pubc_GW_GW_3C4_HU_Construction_Info_SetVt)==0)
    {
        if(chgEv_GW_3C4_HU_Construction_Info == 0)
        {
            phyValue = getvalue(this);
            // physical to raw conversion
            rawValue = ((phyValue -(0))/1);
            putValue(E_pubc_GW_GW_3C4_HU_Construction_Info_Rv, rawValue);
            chgEv_GW_3C4_HU_Construction_Info = 1;  
        }
        else
        {
            chgEv_GW_3C4_HU_Construction_Info = 0;
        }
    }
}
/*@@end*/

/*@@envVar:E_pubc_GW_GW_3C4_HU_Construction_Info_Vt:*/
on envVar E_pubc_GW_GW_3C4_HU_Construction_Info_Vt
{
    qword rawValue = 0ll;
    if(getValue(E_pubc_GW_GW_3C4_HU_Construction_Info_SetVt))
    {
        //update the signal value
        Msg_GW_3C4.HU_Construction_Info=getValue(this);
    }
}
/*@@end*/

/*@@envVar:E_pubc_GW_GW_3C4_HU_Construction_Info_SetVt:*/
on envVar E_pubc_GW_GW_3C4_HU_Construction_Info_SetVt
{
    if(getValue(E_pubc_GW_GW_3C4_HU_Construction_Info_SetVt))
    {
        //update the signal value
        Msg_GW_3C4.HU_Construction_Info=getvalue(E_pubc_GW_GW_3C4_HU_Construction_Info_Vt);
    }
    else
    {
        Msg_GW_3C4.HU_Construction_Info=getValue(E_pubc_GW_GW_3C4_HU_Construction_Info_Rv);
    }
}
/*@@end*/
 
/*@@envVar:E_pubc_GW_GW_3C4_HU_TollInfo_Rv:*/
on envVar E_pubc_GW_GW_3C4_HU_TollInfo_Rv
{
    int64 rawValue = 0ll;
    float rawValue_float = 0.0;
    float phyValue = 0.0;        

    //set the signal with updated raw value
    if(getValue(E_pubc_GW_GW_3C4_HU_TollInfo_SetVt)==0)
    {
        rawValue = getvalue(this);
        if(chgEv_GW_3C4_HU_TollInfo == 0)
        {
            //type conversion to float
            rawValue_float = rawValue;        
            // raw to physical conversion
            phyValue = ((rawValue_float *1)+(0));
            putValue(E_pubc_GW_GW_3C4_HU_TollInfo_Pv, phyValue);
            chgEv_GW_3C4_HU_TollInfo = 1;
        }
        else
        {
            chgEv_GW_3C4_HU_TollInfo = 0;
        }    
        //update the signal value
        Msg_GW_3C4.HU_TollInfo=rawValue;        
    }                                                                           
}
/*@@end*/

/*@@envVar:E_pubc_GW_GW_3C4_HU_TollInfo_Pv:*/
on envVar E_pubc_GW_GW_3C4_HU_TollInfo_Pv
{
    int64 rawValue = 0ll;
    float phyValue = 0.0;
    
    //update the raw value with physical value 
    if(getValue(E_pubc_GW_GW_3C4_HU_TollInfo_SetVt)==0)
    {
        if(chgEv_GW_3C4_HU_TollInfo == 0)
        {
            phyValue = getvalue(this);
            // physical to raw conversion
            rawValue = ((phyValue -(0))/1);
            putValue(E_pubc_GW_GW_3C4_HU_TollInfo_Rv, rawValue);
            chgEv_GW_3C4_HU_TollInfo = 1;  
        }
        else
        {
            chgEv_GW_3C4_HU_TollInfo = 0;
        }
    }
}
/*@@end*/

/*@@envVar:E_pubc_GW_GW_3C4_HU_TollInfo_Vt:*/
on envVar E_pubc_GW_GW_3C4_HU_TollInfo_Vt
{
    qword rawValue = 0ll;
    if(getValue(E_pubc_GW_GW_3C4_HU_TollInfo_SetVt))
    {
        //update the signal value
        Msg_GW_3C4.HU_TollInfo=getValue(this);
    }
}
/*@@end*/

/*@@envVar:E_pubc_GW_GW_3C4_HU_TollInfo_SetVt:*/
on envVar E_pubc_GW_GW_3C4_HU_TollInfo_SetVt
{
    if(getValue(E_pubc_GW_GW_3C4_HU_TollInfo_SetVt))
    {
        //update the signal value
        Msg_GW_3C4.HU_TollInfo=getvalue(E_pubc_GW_GW_3C4_HU_TollInfo_Vt);
    }
    else
    {
        Msg_GW_3C4.HU_TollInfo=getValue(E_pubc_GW_GW_3C4_HU_TollInfo_Rv);
    }
}
/*@@end*/
 
/*@@envVar:E_pubc_GW_GW_3C4_HU_RoadCurvature_300m_Rv:*/
on envVar E_pubc_GW_GW_3C4_HU_RoadCurvature_300m_Rv
{
    int64 rawValue = 0ll;
    float rawValue_float = 0.0;
    float phyValue = 0.0;        

    //set the signal with updated raw value
    {
        rawValue = getvalue(this);
        if(chgEv_GW_3C4_HU_RoadCurvature_300m == 0)
        {
            //type conversion to float
            rawValue_float = rawValue;        
            // raw to physical conversion
            phyValue = ((rawValue_float *1)+(0));
            putValue(E_pubc_GW_GW_3C4_HU_RoadCurvature_300m_Pv, phyValue);
            chgEv_GW_3C4_HU_RoadCurvature_300m = 1;
        }
        else
        {
            chgEv_GW_3C4_HU_RoadCurvature_300m = 0;
        }    
        //update the signal value
        Msg_GW_3C4.HU_RoadCurvature_300m=rawValue;        
    }                                                                           
}
/*@@end*/

/*@@envVar:E_pubc_GW_GW_3C4_HU_RoadCurvature_300m_Pv:*/
on envVar E_pubc_GW_GW_3C4_HU_RoadCurvature_300m_Pv
{
    int64 rawValue = 0ll;
    float phyValue = 0.0;
    
    //update the raw value with physical value 
    {
        if(chgEv_GW_3C4_HU_RoadCurvature_300m == 0)
        {
            phyValue = getvalue(this);
            // physical to raw conversion
            rawValue = ((phyValue -(0))/1);
            putValue(E_pubc_GW_GW_3C4_HU_RoadCurvature_300m_Rv, rawValue);
            chgEv_GW_3C4_HU_RoadCurvature_300m = 1;  
        }
        else
        {
            chgEv_GW_3C4_HU_RoadCurvature_300m = 0;
        }
    }
}
/*@@end*/


 
/*@@envVar:E_pubc_GW_GW_3C4_HU_NavGuiganceStatus_Rv:*/
on envVar E_pubc_GW_GW_3C4_HU_NavGuiganceStatus_Rv
{
    int64 rawValue = 0ll;
    float rawValue_float = 0.0;
    float phyValue = 0.0;        

    //set the signal with updated raw value
    if(getValue(E_pubc_GW_GW_3C4_HU_NavGuiganceStatus_SetVt)==0)
    {
        rawValue = getvalue(this);
        if(chgEv_GW_3C4_HU_NavGuiganceStatus == 0)
        {
            //type conversion to float
            rawValue_float = rawValue;        
            // raw to physical conversion
            phyValue = ((rawValue_float *1)+(0));
            putValue(E_pubc_GW_GW_3C4_HU_NavGuiganceStatus_Pv, phyValue);
            chgEv_GW_3C4_HU_NavGuiganceStatus = 1;
        }
        else
        {
            chgEv_GW_3C4_HU_NavGuiganceStatus = 0;
        }    
        //update the signal value
        Msg_GW_3C4.HU_NavGuiganceStatus=rawValue;        
    }                                                                           
}
/*@@end*/

/*@@envVar:E_pubc_GW_GW_3C4_HU_NavGuiganceStatus_Pv:*/
on envVar E_pubc_GW_GW_3C4_HU_NavGuiganceStatus_Pv
{
    int64 rawValue = 0ll;
    float phyValue = 0.0;
    
    //update the raw value with physical value 
    if(getValue(E_pubc_GW_GW_3C4_HU_NavGuiganceStatus_SetVt)==0)
    {
        if(chgEv_GW_3C4_HU_NavGuiganceStatus == 0)
        {
            phyValue = getvalue(this);
            // physical to raw conversion
            rawValue = ((phyValue -(0))/1);
            putValue(E_pubc_GW_GW_3C4_HU_NavGuiganceStatus_Rv, rawValue);
            chgEv_GW_3C4_HU_NavGuiganceStatus = 1;  
        }
        else
        {
            chgEv_GW_3C4_HU_NavGuiganceStatus = 0;
        }
    }
}
/*@@end*/

/*@@envVar:E_pubc_GW_GW_3C4_HU_NavGuiganceStatus_Vt:*/
on envVar E_pubc_GW_GW_3C4_HU_NavGuiganceStatus_Vt
{
    qword rawValue = 0ll;
    if(getValue(E_pubc_GW_GW_3C4_HU_NavGuiganceStatus_SetVt))
    {
        //update the signal value
        Msg_GW_3C4.HU_NavGuiganceStatus=getValue(this);
    }
}
/*@@end*/

/*@@envVar:E_pubc_GW_GW_3C4_HU_NavGuiganceStatus_SetVt:*/
on envVar E_pubc_GW_GW_3C4_HU_NavGuiganceStatus_SetVt
{
    if(getValue(E_pubc_GW_GW_3C4_HU_NavGuiganceStatus_SetVt))
    {
        //update the signal value
        Msg_GW_3C4.HU_NavGuiganceStatus=getvalue(E_pubc_GW_GW_3C4_HU_NavGuiganceStatus_Vt);
    }
    else
    {
        Msg_GW_3C4.HU_NavGuiganceStatus=getValue(E_pubc_GW_GW_3C4_HU_NavGuiganceStatus_Rv);
    }
}
/*@@end*/
 
/*@@envVar:E_pubc_GW_GW_3C4_HU_Lane_Changtype_Rv:*/
on envVar E_pubc_GW_GW_3C4_HU_Lane_Changtype_Rv
{
    int64 rawValue = 0ll;
    float rawValue_float = 0.0;
    float phyValue = 0.0;        

    //set the signal with updated raw value
    if(getValue(E_pubc_GW_GW_3C4_HU_Lane_Changtype_SetVt)==0)
    {
        rawValue = getvalue(this);
        if(chgEv_GW_3C4_HU_Lane_Changtype == 0)
        {
            //type conversion to float
            rawValue_float = rawValue;        
            // raw to physical conversion
            phyValue = ((rawValue_float *1)+(0));
            putValue(E_pubc_GW_GW_3C4_HU_Lane_Changtype_Pv, phyValue);
            chgEv_GW_3C4_HU_Lane_Changtype = 1;
        }
        else
        {
            chgEv_GW_3C4_HU_Lane_Changtype = 0;
        }    
        //update the signal value
        Msg_GW_3C4.HU_Lane_Changtype=rawValue;        
    }                                                                           
}
/*@@end*/

/*@@envVar:E_pubc_GW_GW_3C4_HU_Lane_Changtype_Pv:*/
on envVar E_pubc_GW_GW_3C4_HU_Lane_Changtype_Pv
{
    int64 rawValue = 0ll;
    float phyValue = 0.0;
    
    //update the raw value with physical value 
    if(getValue(E_pubc_GW_GW_3C4_HU_Lane_Changtype_SetVt)==0)
    {
        if(chgEv_GW_3C4_HU_Lane_Changtype == 0)
        {
            phyValue = getvalue(this);
            // physical to raw conversion
            rawValue = ((phyValue -(0))/1);
            putValue(E_pubc_GW_GW_3C4_HU_Lane_Changtype_Rv, rawValue);
            chgEv_GW_3C4_HU_Lane_Changtype = 1;  
        }
        else
        {
            chgEv_GW_3C4_HU_Lane_Changtype = 0;
        }
    }
}
/*@@end*/

/*@@envVar:E_pubc_GW_GW_3C4_HU_Lane_Changtype_Vt:*/
on envVar E_pubc_GW_GW_3C4_HU_Lane_Changtype_Vt
{
    qword rawValue = 0ll;
    if(getValue(E_pubc_GW_GW_3C4_HU_Lane_Changtype_SetVt))
    {
        //update the signal value
        Msg_GW_3C4.HU_Lane_Changtype=getValue(this);
    }
}
/*@@end*/

/*@@envVar:E_pubc_GW_GW_3C4_HU_Lane_Changtype_SetVt:*/
on envVar E_pubc_GW_GW_3C4_HU_Lane_Changtype_SetVt
{
    if(getValue(E_pubc_GW_GW_3C4_HU_Lane_Changtype_SetVt))
    {
        //update the signal value
        Msg_GW_3C4.HU_Lane_Changtype=getvalue(E_pubc_GW_GW_3C4_HU_Lane_Changtype_Vt);
    }
    else
    {
        Msg_GW_3C4.HU_Lane_Changtype=getValue(E_pubc_GW_GW_3C4_HU_Lane_Changtype_Rv);
    }
}
/*@@end*/
 
/*@@envVar:E_pubc_GW_GW_3C4_HU_RoadCurvatureFar_Rv:*/
on envVar E_pubc_GW_GW_3C4_HU_RoadCurvatureFar_Rv
{
    int64 rawValue = 0ll;
    float rawValue_float = 0.0;
    float phyValue = 0.0;        

    //set the signal with updated raw value
    {
        rawValue = getvalue(this);
        if(chgEv_GW_3C4_HU_RoadCurvatureFar == 0)
        {
            //type conversion to float
            rawValue_float = rawValue;        
            // raw to physical conversion
            phyValue = ((rawValue_float *1)+(0));
            putValue(E_pubc_GW_GW_3C4_HU_RoadCurvatureFar_Pv, phyValue);
            chgEv_GW_3C4_HU_RoadCurvatureFar = 1;
        }
        else
        {
            chgEv_GW_3C4_HU_RoadCurvatureFar = 0;
        }    
        //update the signal value
        Msg_GW_3C4.HU_RoadCurvatureFar=rawValue;        
    }                                                                           
}
/*@@end*/

/*@@envVar:E_pubc_GW_GW_3C4_HU_RoadCurvatureFar_Pv:*/
on envVar E_pubc_GW_GW_3C4_HU_RoadCurvatureFar_Pv
{
    int64 rawValue = 0ll;
    float phyValue = 0.0;
    
    //update the raw value with physical value 
    {
        if(chgEv_GW_3C4_HU_RoadCurvatureFar == 0)
        {
            phyValue = getvalue(this);
            // physical to raw conversion
            rawValue = ((phyValue -(0))/1);
            putValue(E_pubc_GW_GW_3C4_HU_RoadCurvatureFar_Rv, rawValue);
            chgEv_GW_3C4_HU_RoadCurvatureFar = 1;  
        }
        else
        {
            chgEv_GW_3C4_HU_RoadCurvatureFar = 0;
        }
    }
}
/*@@end*/


 
/*@@envVar:E_pubc_GW_GW_3C4_HU_RampSide_Rv:*/
on envVar E_pubc_GW_GW_3C4_HU_RampSide_Rv
{
    int64 rawValue = 0ll;
    float rawValue_float = 0.0;
    float phyValue = 0.0;        

    //set the signal with updated raw value
    if(getValue(E_pubc_GW_GW_3C4_HU_RampSide_SetVt)==0)
    {
        rawValue = getvalue(this);
        if(chgEv_GW_3C4_HU_RampSide == 0)
        {
            //type conversion to float
            rawValue_float = rawValue;        
            // raw to physical conversion
            phyValue = ((rawValue_float *1)+(0));
            putValue(E_pubc_GW_GW_3C4_HU_RampSide_Pv, phyValue);
            chgEv_GW_3C4_HU_RampSide = 1;
        }
        else
        {
            chgEv_GW_3C4_HU_RampSide = 0;
        }    
        //update the signal value
        Msg_GW_3C4.HU_RampSide=rawValue;        
    }                                                                           
}
/*@@end*/

/*@@envVar:E_pubc_GW_GW_3C4_HU_RampSide_Pv:*/
on envVar E_pubc_GW_GW_3C4_HU_RampSide_Pv
{
    int64 rawValue = 0ll;
    float phyValue = 0.0;
    
    //update the raw value with physical value 
    if(getValue(E_pubc_GW_GW_3C4_HU_RampSide_SetVt)==0)
    {
        if(chgEv_GW_3C4_HU_RampSide == 0)
        {
            phyValue = getvalue(this);
            // physical to raw conversion
            rawValue = ((phyValue -(0))/1);
            putValue(E_pubc_GW_GW_3C4_HU_RampSide_Rv, rawValue);
            chgEv_GW_3C4_HU_RampSide = 1;  
        }
        else
        {
            chgEv_GW_3C4_HU_RampSide = 0;
        }
    }
}
/*@@end*/

/*@@envVar:E_pubc_GW_GW_3C4_HU_RampSide_Vt:*/
on envVar E_pubc_GW_GW_3C4_HU_RampSide_Vt
{
    qword rawValue = 0ll;
    if(getValue(E_pubc_GW_GW_3C4_HU_RampSide_SetVt))
    {
        //update the signal value
        Msg_GW_3C4.HU_RampSide=getValue(this);
    }
}
/*@@end*/

/*@@envVar:E_pubc_GW_GW_3C4_HU_RampSide_SetVt:*/
on envVar E_pubc_GW_GW_3C4_HU_RampSide_SetVt
{
    if(getValue(E_pubc_GW_GW_3C4_HU_RampSide_SetVt))
    {
        //update the signal value
        Msg_GW_3C4.HU_RampSide=getvalue(E_pubc_GW_GW_3C4_HU_RampSide_Vt);
    }
    else
    {
        Msg_GW_3C4.HU_RampSide=getValue(E_pubc_GW_GW_3C4_HU_RampSide_Rv);
    }
}
/*@@end*/
 
/*@@envVar:E_pubc_GW_GW_3C4_HU_ForwardRoadType_Rv:*/
on envVar E_pubc_GW_GW_3C4_HU_ForwardRoadType_Rv
{
    int64 rawValue = 0ll;
    float rawValue_float = 0.0;
    float phyValue = 0.0;        

    //set the signal with updated raw value
    {
        rawValue = getvalue(this);
        if(chgEv_GW_3C4_HU_ForwardRoadType == 0)
        {
            //type conversion to float
            rawValue_float = rawValue;        
            // raw to physical conversion
            phyValue = ((rawValue_float *1)+(0));
            putValue(E_pubc_GW_GW_3C4_HU_ForwardRoadType_Pv, phyValue);
            chgEv_GW_3C4_HU_ForwardRoadType = 1;
        }
        else
        {
            chgEv_GW_3C4_HU_ForwardRoadType = 0;
        }    
        //update the signal value
        Msg_GW_3C4.HU_ForwardRoadType=rawValue;        
    }                                                                           
}
/*@@end*/

/*@@envVar:E_pubc_GW_GW_3C4_HU_ForwardRoadType_Pv:*/
on envVar E_pubc_GW_GW_3C4_HU_ForwardRoadType_Pv
{
    int64 rawValue = 0ll;
    float phyValue = 0.0;
    
    //update the raw value with physical value 
    {
        if(chgEv_GW_3C4_HU_ForwardRoadType == 0)
        {
            phyValue = getvalue(this);
            // physical to raw conversion
            rawValue = ((phyValue -(0))/1);
            putValue(E_pubc_GW_GW_3C4_HU_ForwardRoadType_Rv, rawValue);
            chgEv_GW_3C4_HU_ForwardRoadType = 1;  
        }
        else
        {
            chgEv_GW_3C4_HU_ForwardRoadType = 0;
        }
    }
}
/*@@end*/


 
/*@@envVar:E_pubc_GW_GW_3C4_HU_RoadCurvature_400m_Rv:*/
on envVar E_pubc_GW_GW_3C4_HU_RoadCurvature_400m_Rv
{
    int64 rawValue = 0ll;
    float rawValue_float = 0.0;
    float phyValue = 0.0;        

    //set the signal with updated raw value
    {
        rawValue = getvalue(this);
        if(chgEv_GW_3C4_HU_RoadCurvature_400m == 0)
        {
            //type conversion to float
            rawValue_float = rawValue;        
            // raw to physical conversion
            phyValue = ((rawValue_float *1)+(0));
            putValue(E_pubc_GW_GW_3C4_HU_RoadCurvature_400m_Pv, phyValue);
            chgEv_GW_3C4_HU_RoadCurvature_400m = 1;
        }
        else
        {
            chgEv_GW_3C4_HU_RoadCurvature_400m = 0;
        }    
        //update the signal value
        Msg_GW_3C4.HU_RoadCurvature_400m=rawValue;        
    }                                                                           
}
/*@@end*/

/*@@envVar:E_pubc_GW_GW_3C4_HU_RoadCurvature_400m_Pv:*/
on envVar E_pubc_GW_GW_3C4_HU_RoadCurvature_400m_Pv
{
    int64 rawValue = 0ll;
    float phyValue = 0.0;
    
    //update the raw value with physical value 
    {
        if(chgEv_GW_3C4_HU_RoadCurvature_400m == 0)
        {
            phyValue = getvalue(this);
            // physical to raw conversion
            rawValue = ((phyValue -(0))/1);
            putValue(E_pubc_GW_GW_3C4_HU_RoadCurvature_400m_Rv, rawValue);
            chgEv_GW_3C4_HU_RoadCurvature_400m = 1;  
        }
        else
        {
            chgEv_GW_3C4_HU_RoadCurvature_400m = 0;
        }
    }
}
/*@@end*/


 
/*@@envVar:E_pubc_GW_GW_3C4_HU_FallingRockInfo_Rv:*/
on envVar E_pubc_GW_GW_3C4_HU_FallingRockInfo_Rv
{
    int64 rawValue = 0ll;
    float rawValue_float = 0.0;
    float phyValue = 0.0;        

    //set the signal with updated raw value
    if(getValue(E_pubc_GW_GW_3C4_HU_FallingRockInfo_SetVt)==0)
    {
        rawValue = getvalue(this);
        if(chgEv_GW_3C4_HU_FallingRockInfo == 0)
        {
            //type conversion to float
            rawValue_float = rawValue;        
            // raw to physical conversion
            phyValue = ((rawValue_float *1)+(0));
            putValue(E_pubc_GW_GW_3C4_HU_FallingRockInfo_Pv, phyValue);
            chgEv_GW_3C4_HU_FallingRockInfo = 1;
        }
        else
        {
            chgEv_GW_3C4_HU_FallingRockInfo = 0;
        }    
        //update the signal value
        Msg_GW_3C4.HU_FallingRockInfo=rawValue;        
    }                                                                           
}
/*@@end*/

/*@@envVar:E_pubc_GW_GW_3C4_HU_FallingRockInfo_Pv:*/
on envVar E_pubc_GW_GW_3C4_HU_FallingRockInfo_Pv
{
    int64 rawValue = 0ll;
    float phyValue = 0.0;
    
    //update the raw value with physical value 
    if(getValue(E_pubc_GW_GW_3C4_HU_FallingRockInfo_SetVt)==0)
    {
        if(chgEv_GW_3C4_HU_FallingRockInfo == 0)
        {
            phyValue = getvalue(this);
            // physical to raw conversion
            rawValue = ((phyValue -(0))/1);
            putValue(E_pubc_GW_GW_3C4_HU_FallingRockInfo_Rv, rawValue);
            chgEv_GW_3C4_HU_FallingRockInfo = 1;  
        }
        else
        {
            chgEv_GW_3C4_HU_FallingRockInfo = 0;
        }
    }
}
/*@@end*/

/*@@envVar:E_pubc_GW_GW_3C4_HU_FallingRockInfo_Vt:*/
on envVar E_pubc_GW_GW_3C4_HU_FallingRockInfo_Vt
{
    qword rawValue = 0ll;
    if(getValue(E_pubc_GW_GW_3C4_HU_FallingRockInfo_SetVt))
    {
        //update the signal value
        Msg_GW_3C4.HU_FallingRockInfo=getValue(this);
    }
}
/*@@end*/

/*@@envVar:E_pubc_GW_GW_3C4_HU_FallingRockInfo_SetVt:*/
on envVar E_pubc_GW_GW_3C4_HU_FallingRockInfo_SetVt
{
    if(getValue(E_pubc_GW_GW_3C4_HU_FallingRockInfo_SetVt))
    {
        //update the signal value
        Msg_GW_3C4.HU_FallingRockInfo=getvalue(E_pubc_GW_GW_3C4_HU_FallingRockInfo_Vt);
    }
    else
    {
        Msg_GW_3C4.HU_FallingRockInfo=getValue(E_pubc_GW_GW_3C4_HU_FallingRockInfo_Rv);
    }
}
/*@@end*/
 
/*@@envVar:E_pubc_GW_GW_3C4_HU_MapMatchStatus_Rv:*/
on envVar E_pubc_GW_GW_3C4_HU_MapMatchStatus_Rv
{
    int64 rawValue = 0ll;
    float rawValue_float = 0.0;
    float phyValue = 0.0;        

    //set the signal with updated raw value
    if(getValue(E_pubc_GW_GW_3C4_HU_MapMatchStatus_SetVt)==0)
    {
        rawValue = getvalue(this);
        if(chgEv_GW_3C4_HU_MapMatchStatus == 0)
        {
            //type conversion to float
            rawValue_float = rawValue;        
            // raw to physical conversion
            phyValue = ((rawValue_float *1)+(0));
            putValue(E_pubc_GW_GW_3C4_HU_MapMatchStatus_Pv, phyValue);
            chgEv_GW_3C4_HU_MapMatchStatus = 1;
        }
        else
        {
            chgEv_GW_3C4_HU_MapMatchStatus = 0;
        }    
        //update the signal value
        Msg_GW_3C4.HU_MapMatchStatus=rawValue;        
    }                                                                           
}
/*@@end*/

/*@@envVar:E_pubc_GW_GW_3C4_HU_MapMatchStatus_Pv:*/
on envVar E_pubc_GW_GW_3C4_HU_MapMatchStatus_Pv
{
    int64 rawValue = 0ll;
    float phyValue = 0.0;
    
    //update the raw value with physical value 
    if(getValue(E_pubc_GW_GW_3C4_HU_MapMatchStatus_SetVt)==0)
    {
        if(chgEv_GW_3C4_HU_MapMatchStatus == 0)
        {
            phyValue = getvalue(this);
            // physical to raw conversion
            rawValue = ((phyValue -(0))/1);
            putValue(E_pubc_GW_GW_3C4_HU_MapMatchStatus_Rv, rawValue);
            chgEv_GW_3C4_HU_MapMatchStatus = 1;  
        }
        else
        {
            chgEv_GW_3C4_HU_MapMatchStatus = 0;
        }
    }
}
/*@@end*/

/*@@envVar:E_pubc_GW_GW_3C4_HU_MapMatchStatus_Vt:*/
on envVar E_pubc_GW_GW_3C4_HU_MapMatchStatus_Vt
{
    qword rawValue = 0ll;
    if(getValue(E_pubc_GW_GW_3C4_HU_MapMatchStatus_SetVt))
    {
        //update the signal value
        Msg_GW_3C4.HU_MapMatchStatus=getValue(this);
    }
}
/*@@end*/

/*@@envVar:E_pubc_GW_GW_3C4_HU_MapMatchStatus_SetVt:*/
on envVar E_pubc_GW_GW_3C4_HU_MapMatchStatus_SetVt
{
    if(getValue(E_pubc_GW_GW_3C4_HU_MapMatchStatus_SetVt))
    {
        //update the signal value
        Msg_GW_3C4.HU_MapMatchStatus=getvalue(E_pubc_GW_GW_3C4_HU_MapMatchStatus_Vt);
    }
    else
    {
        Msg_GW_3C4.HU_MapMatchStatus=getValue(E_pubc_GW_GW_3C4_HU_MapMatchStatus_Rv);
    }
}
/*@@end*/
 
/*@@envVar:E_pubc_GW_GW_3C4_HU_EnterSlopeInfo_Rv:*/
on envVar E_pubc_GW_GW_3C4_HU_EnterSlopeInfo_Rv
{
    int64 rawValue = 0ll;
    float rawValue_float = 0.0;
    float phyValue = 0.0;        

    //set the signal with updated raw value
    if(getValue(E_pubc_GW_GW_3C4_HU_EnterSlopeInfo_SetVt)==0)
    {
        rawValue = getvalue(this);
        if(chgEv_GW_3C4_HU_EnterSlopeInfo == 0)
        {
            //type conversion to float
            rawValue_float = rawValue;        
            // raw to physical conversion
            phyValue = ((rawValue_float *1)+(0));
            putValue(E_pubc_GW_GW_3C4_HU_EnterSlopeInfo_Pv, phyValue);
            chgEv_GW_3C4_HU_EnterSlopeInfo = 1;
        }
        else
        {
            chgEv_GW_3C4_HU_EnterSlopeInfo = 0;
        }    
        //update the signal value
        Msg_GW_3C4.HU_EnterSlopeInfo=rawValue;        
    }                                                                           
}
/*@@end*/

/*@@envVar:E_pubc_GW_GW_3C4_HU_EnterSlopeInfo_Pv:*/
on envVar E_pubc_GW_GW_3C4_HU_EnterSlopeInfo_Pv
{
    int64 rawValue = 0ll;
    float phyValue = 0.0;
    
    //update the raw value with physical value 
    if(getValue(E_pubc_GW_GW_3C4_HU_EnterSlopeInfo_SetVt)==0)
    {
        if(chgEv_GW_3C4_HU_EnterSlopeInfo == 0)
        {
            phyValue = getvalue(this);
            // physical to raw conversion
            rawValue = ((phyValue -(0))/1);
            putValue(E_pubc_GW_GW_3C4_HU_EnterSlopeInfo_Rv, rawValue);
            chgEv_GW_3C4_HU_EnterSlopeInfo = 1;  
        }
        else
        {
            chgEv_GW_3C4_HU_EnterSlopeInfo = 0;
        }
    }
}
/*@@end*/

/*@@envVar:E_pubc_GW_GW_3C4_HU_EnterSlopeInfo_Vt:*/
on envVar E_pubc_GW_GW_3C4_HU_EnterSlopeInfo_Vt
{
    qword rawValue = 0ll;
    if(getValue(E_pubc_GW_GW_3C4_HU_EnterSlopeInfo_SetVt))
    {
        //update the signal value
        Msg_GW_3C4.HU_EnterSlopeInfo=getValue(this);
    }
}
/*@@end*/

/*@@envVar:E_pubc_GW_GW_3C4_HU_EnterSlopeInfo_SetVt:*/
on envVar E_pubc_GW_GW_3C4_HU_EnterSlopeInfo_SetVt
{
    if(getValue(E_pubc_GW_GW_3C4_HU_EnterSlopeInfo_SetVt))
    {
        //update the signal value
        Msg_GW_3C4.HU_EnterSlopeInfo=getvalue(E_pubc_GW_GW_3C4_HU_EnterSlopeInfo_Vt);
    }
    else
    {
        Msg_GW_3C4.HU_EnterSlopeInfo=getValue(E_pubc_GW_GW_3C4_HU_EnterSlopeInfo_Rv);
    }
}
/*@@end*/
 
/*@@envVar:E_pubc_GW_GW_3C4_HU_SlopeGradient_300m_Rv:*/
on envVar E_pubc_GW_GW_3C4_HU_SlopeGradient_300m_Rv
{
    int64 rawValue = 0ll;
    float rawValue_float = 0.0;
    float phyValue = 0.0;        

    //set the signal with updated raw value
    {
        rawValue = getvalue(this);
        if(chgEv_GW_3C4_HU_SlopeGradient_300m == 0)
        {
            //type conversion to float
            rawValue_float = rawValue;        
            // raw to physical conversion
            phyValue = ((rawValue_float *0.1)+(-51.1));
            putValue(E_pubc_GW_GW_3C4_HU_SlopeGradient_300m_Pv, phyValue);
            chgEv_GW_3C4_HU_SlopeGradient_300m = 1;
        }
        else
        {
            chgEv_GW_3C4_HU_SlopeGradient_300m = 0;
        }    
        //update the signal value
        Msg_GW_3C4.HU_SlopeGradient_300m=rawValue;        
    }                                                                           
}
/*@@end*/

/*@@envVar:E_pubc_GW_GW_3C4_HU_SlopeGradient_300m_Pv:*/
on envVar E_pubc_GW_GW_3C4_HU_SlopeGradient_300m_Pv
{
    int64 rawValue = 0ll;
    float phyValue = 0.0;
    
    //update the raw value with physical value 
    {
        if(chgEv_GW_3C4_HU_SlopeGradient_300m == 0)
        {
            phyValue = getvalue(this);
            // physical to raw conversion
            rawValue = ((phyValue -(-51.1))/0.1);
            putValue(E_pubc_GW_GW_3C4_HU_SlopeGradient_300m_Rv, rawValue);
            chgEv_GW_3C4_HU_SlopeGradient_300m = 1;  
        }
        else
        {
            chgEv_GW_3C4_HU_SlopeGradient_300m = 0;
        }
    }
}
/*@@end*/


 
/*@@envVar:E_pubc_GW_GW_3C4_HU_Road_TrafficFlow_Rv:*/
on envVar E_pubc_GW_GW_3C4_HU_Road_TrafficFlow_Rv
{
    int64 rawValue = 0ll;
    float rawValue_float = 0.0;
    float phyValue = 0.0;        

    //set the signal with updated raw value
    if(getValue(E_pubc_GW_GW_3C4_HU_Road_TrafficFlow_SetVt)==0)
    {
        rawValue = getvalue(this);
        if(chgEv_GW_3C4_HU_Road_TrafficFlow == 0)
        {
            //type conversion to float
            rawValue_float = rawValue;        
            // raw to physical conversion
            phyValue = ((rawValue_float *1)+(0));
            putValue(E_pubc_GW_GW_3C4_HU_Road_TrafficFlow_Pv, phyValue);
            chgEv_GW_3C4_HU_Road_TrafficFlow = 1;
        }
        else
        {
            chgEv_GW_3C4_HU_Road_TrafficFlow = 0;
        }    
        //update the signal value
        Msg_GW_3C4.HU_Road_TrafficFlow=rawValue;        
    }                                                                           
}
/*@@end*/

/*@@envVar:E_pubc_GW_GW_3C4_HU_Road_TrafficFlow_Pv:*/
on envVar E_pubc_GW_GW_3C4_HU_Road_TrafficFlow_Pv
{
    int64 rawValue = 0ll;
    float phyValue = 0.0;
    
    //update the raw value with physical value 
    if(getValue(E_pubc_GW_GW_3C4_HU_Road_TrafficFlow_SetVt)==0)
    {
        if(chgEv_GW_3C4_HU_Road_TrafficFlow == 0)
        {
            phyValue = getvalue(this);
            // physical to raw conversion
            rawValue = ((phyValue -(0))/1);
            putValue(E_pubc_GW_GW_3C4_HU_Road_TrafficFlow_Rv, rawValue);
            chgEv_GW_3C4_HU_Road_TrafficFlow = 1;  
        }
        else
        {
            chgEv_GW_3C4_HU_Road_TrafficFlow = 0;
        }
    }
}
/*@@end*/

/*@@envVar:E_pubc_GW_GW_3C4_HU_Road_TrafficFlow_Vt:*/
on envVar E_pubc_GW_GW_3C4_HU_Road_TrafficFlow_Vt
{
    qword rawValue = 0ll;
    if(getValue(E_pubc_GW_GW_3C4_HU_Road_TrafficFlow_SetVt))
    {
        //update the signal value
        Msg_GW_3C4.HU_Road_TrafficFlow=getValue(this);
    }
}
/*@@end*/

/*@@envVar:E_pubc_GW_GW_3C4_HU_Road_TrafficFlow_SetVt:*/
on envVar E_pubc_GW_GW_3C4_HU_Road_TrafficFlow_SetVt
{
    if(getValue(E_pubc_GW_GW_3C4_HU_Road_TrafficFlow_SetVt))
    {
        //update the signal value
        Msg_GW_3C4.HU_Road_TrafficFlow=getvalue(E_pubc_GW_GW_3C4_HU_Road_TrafficFlow_Vt);
    }
    else
    {
        Msg_GW_3C4.HU_Road_TrafficFlow=getValue(E_pubc_GW_GW_3C4_HU_Road_TrafficFlow_Rv);
    }
}
/*@@end*/
 
/*@@envVar:E_pubc_GW_GW_3C4_HU_RoadCurvature_50m_Rv:*/
on envVar E_pubc_GW_GW_3C4_HU_RoadCurvature_50m_Rv
{
    int64 rawValue = 0ll;
    float rawValue_float = 0.0;
    float phyValue = 0.0;        

    //set the signal with updated raw value
    {
        rawValue = getvalue(this);
        if(chgEv_GW_3C4_HU_RoadCurvature_50m == 0)
        {
            //type conversion to float
            rawValue_float = rawValue;        
            // raw to physical conversion
            phyValue = ((rawValue_float *1)+(0));
            putValue(E_pubc_GW_GW_3C4_HU_RoadCurvature_50m_Pv, phyValue);
            chgEv_GW_3C4_HU_RoadCurvature_50m = 1;
        }
        else
        {
            chgEv_GW_3C4_HU_RoadCurvature_50m = 0;
        }    
        //update the signal value
        Msg_GW_3C4.HU_RoadCurvature_50m=rawValue;        
    }                                                                           
}
/*@@end*/

/*@@envVar:E_pubc_GW_GW_3C4_HU_RoadCurvature_50m_Pv:*/
on envVar E_pubc_GW_GW_3C4_HU_RoadCurvature_50m_Pv
{
    int64 rawValue = 0ll;
    float phyValue = 0.0;
    
    //update the raw value with physical value 
    {
        if(chgEv_GW_3C4_HU_RoadCurvature_50m == 0)
        {
            phyValue = getvalue(this);
            // physical to raw conversion
            rawValue = ((phyValue -(0))/1);
            putValue(E_pubc_GW_GW_3C4_HU_RoadCurvature_50m_Rv, rawValue);
            chgEv_GW_3C4_HU_RoadCurvature_50m = 1;  
        }
        else
        {
            chgEv_GW_3C4_HU_RoadCurvature_50m = 0;
        }
    }
}
/*@@end*/


 
/*@@envVar:E_pubc_GW_GW_3C4_HU_RoadCurvature_10m_Rv:*/
on envVar E_pubc_GW_GW_3C4_HU_RoadCurvature_10m_Rv
{
    int64 rawValue = 0ll;
    float rawValue_float = 0.0;
    float phyValue = 0.0;        

    //set the signal with updated raw value
    {
        rawValue = getvalue(this);
        if(chgEv_GW_3C4_HU_RoadCurvature_10m == 0)
        {
            //type conversion to float
            rawValue_float = rawValue;        
            // raw to physical conversion
            phyValue = ((rawValue_float *1)+(0));
            putValue(E_pubc_GW_GW_3C4_HU_RoadCurvature_10m_Pv, phyValue);
            chgEv_GW_3C4_HU_RoadCurvature_10m = 1;
        }
        else
        {
            chgEv_GW_3C4_HU_RoadCurvature_10m = 0;
        }    
        //update the signal value
        Msg_GW_3C4.HU_RoadCurvature_10m=rawValue;        
    }                                                                           
}
/*@@end*/

/*@@envVar:E_pubc_GW_GW_3C4_HU_RoadCurvature_10m_Pv:*/
on envVar E_pubc_GW_GW_3C4_HU_RoadCurvature_10m_Pv
{
    int64 rawValue = 0ll;
    float phyValue = 0.0;
    
    //update the raw value with physical value 
    {
        if(chgEv_GW_3C4_HU_RoadCurvature_10m == 0)
        {
            phyValue = getvalue(this);
            // physical to raw conversion
            rawValue = ((phyValue -(0))/1);
            putValue(E_pubc_GW_GW_3C4_HU_RoadCurvature_10m_Rv, rawValue);
            chgEv_GW_3C4_HU_RoadCurvature_10m = 1;  
        }
        else
        {
            chgEv_GW_3C4_HU_RoadCurvature_10m = 0;
        }
    }
}
/*@@end*/


 
/*@@envVar:E_pubc_GW_GW_3C4_HU_RoadCurvature_40m_Rv:*/
on envVar E_pubc_GW_GW_3C4_HU_RoadCurvature_40m_Rv
{
    int64 rawValue = 0ll;
    float rawValue_float = 0.0;
    float phyValue = 0.0;        

    //set the signal with updated raw value
    {
        rawValue = getvalue(this);
        if(chgEv_GW_3C4_HU_RoadCurvature_40m == 0)
        {
            //type conversion to float
            rawValue_float = rawValue;        
            // raw to physical conversion
            phyValue = ((rawValue_float *1)+(0));
            putValue(E_pubc_GW_GW_3C4_HU_RoadCurvature_40m_Pv, phyValue);
            chgEv_GW_3C4_HU_RoadCurvature_40m = 1;
        }
        else
        {
            chgEv_GW_3C4_HU_RoadCurvature_40m = 0;
        }    
        //update the signal value
        Msg_GW_3C4.HU_RoadCurvature_40m=rawValue;        
    }                                                                           
}
/*@@end*/

/*@@envVar:E_pubc_GW_GW_3C4_HU_RoadCurvature_40m_Pv:*/
on envVar E_pubc_GW_GW_3C4_HU_RoadCurvature_40m_Pv
{
    int64 rawValue = 0ll;
    float phyValue = 0.0;
    
    //update the raw value with physical value 
    {
        if(chgEv_GW_3C4_HU_RoadCurvature_40m == 0)
        {
            phyValue = getvalue(this);
            // physical to raw conversion
            rawValue = ((phyValue -(0))/1);
            putValue(E_pubc_GW_GW_3C4_HU_RoadCurvature_40m_Rv, rawValue);
            chgEv_GW_3C4_HU_RoadCurvature_40m = 1;  
        }
        else
        {
            chgEv_GW_3C4_HU_RoadCurvature_40m = 0;
        }
    }
}
/*@@end*/


 
/*@@envVar:E_pubc_GW_GW_3C2_tx:*/
on envVar E_pubc_GW_GW_3C2_tx
{
    if(getValue(this))
    {       
        
        //update the BZ Signal
        if(GW_3C2_EspCycCntr3C2_wrongvalctr == 0)
        {
            update_GW_3C2_EspCycCntr3C2_counter();
            Msg_GW_3C2.EspCycCntr3C2= GW_3C2_EspCycCntr3C2_counter;
        }
        else if(GW_3C2_EspCycCntr3C2_wrongvalctr > 0)
        {
			GW_3C2_EspCycCntr3C2_counter=GW_3C2_EspCycCntr3C2_counter + GW_3C2_EspCycCntr3C2_wrongvalctr;
			 Msg_GW_3C2.EspCycCntr3C2= GW_3C2_EspCycCntr3C2_counter;
            /* GW_3C2_EspCycCntr3C2_wrongvalctr--;
              // if counter becomes zero, update panel controller to zero
             if(GW_3C2_EspCycCntr3C2_wrongvalctr == 0)
             {
                 putValue(E_pubc_GW_GW_3C2_EspCycCntr3C2_wrongvalctr,0);
             } */
        }
        else
        { 
			// do nothing
        }    
        //calculate the CRC CheckSum
        update_GW_3C2_CRC_CheckSum();

        output(Msg_GW_3C2);        
    }
}
/*@@end*/

/*@@envVar:E_pubc_GW_GW_3C2_Range:*/
on envVar E_pubc_GW_GW_3C2_Range
{
    qword rawstatus = 0ll;
    qword rawValue = 0ll;    
    
    rawstatus = getvalue(this);    
    // set all the signals with min raw /max raw /init raw
    switch (rawstatus) 
    {
     case(0) :
        rawValue= 0;
        putValue(E_pubc_GW_GW_3C2_EpbDriverReqParkBrakeDominant_Rv, rawValue);
        rawValue= 0;
        putValue(E_pubc_GW_GW_3C2_EpbRiAchievedClmpF_Rv, rawValue);
        rawValue= 0;
        putValue(E_pubc_GW_GW_3C2_EpbFailrSts_Rv, rawValue);
        rawValue= 0;
        putValue(E_pubc_GW_GW_3C2_EspEpbReqAvl_Rv, rawValue);
        rawValue= 0;
        putValue(E_pubc_GW_GW_3C2_EpbSts_Rv, rawValue);
        rawValue= 0;
        putValue(E_pubc_GW_GW_3C2_EpbLeAchievedClmpF_Rv, rawValue);
        break;
     case(1) :
        rawValue= 1;
        putValue(E_pubc_GW_GW_3C2_EpbDriverReqParkBrakeDominant_Rv, rawValue);
        rawValue= 31;
        putValue(E_pubc_GW_GW_3C2_EpbRiAchievedClmpF_Rv, rawValue);
        rawValue= 3;
        putValue(E_pubc_GW_GW_3C2_EpbFailrSts_Rv, rawValue);
        rawValue= 1;
        putValue(E_pubc_GW_GW_3C2_EspEpbReqAvl_Rv, rawValue);
        rawValue= 7;
        putValue(E_pubc_GW_GW_3C2_EpbSts_Rv, rawValue);
        rawValue= 31;
        putValue(E_pubc_GW_GW_3C2_EpbLeAchievedClmpF_Rv, rawValue);
        break;
     default :
        rawValue= 0;
        putValue(E_pubc_GW_GW_3C2_EpbDriverReqParkBrakeDominant_Rv, rawValue);
        rawValue= 0;
        putValue(E_pubc_GW_GW_3C2_EpbRiAchievedClmpF_Rv, rawValue);
        rawValue= 0;
        putValue(E_pubc_GW_GW_3C2_EpbFailrSts_Rv, rawValue);
        rawValue= 0;
        putValue(E_pubc_GW_GW_3C2_EspEpbReqAvl_Rv, rawValue);
        rawValue= 0;
        putValue(E_pubc_GW_GW_3C2_EpbSts_Rv, rawValue);
        rawValue= 0;
        putValue(E_pubc_GW_GW_3C2_EpbLeAchievedClmpF_Rv, rawValue);
      break;
   }
}
/*@@end*/

/*@@envVar:E_pubc_GW_GW_3C2_Dlc:*/
on envVar E_pubc_GW_GW_3C2_Dlc
{
    if(getValue(E_pubc_GW_GW_3C2_enDlc))
    {
        Msg_GW_3C2.dlc =getValue(this);
    }
    else
    {
       Dbc_dlc = 64;
	   Msg_GW_3C2.dlc = Calc_Canfd_dlc(Dbc_dlc);
	   // Msg_GW_3C2.dlc = 64;
	   	
  }
}
/*@@end*/

/*@@envVar:E_pubc_GW_GW_3C2_enDlc:*/
on envVar E_pubc_GW_GW_3C2_enDlc
{
    //For Messages with DLC = 8, set wrong DLC to smaller than defined DLC
    //For Messages with DLC < 8 set wrong DLC to smaller/longer than defined DLC
    if(getValue(this))
    {
        Msg_GW_3C2.dlc =getValue(E_pubc_GW_GW_3C2_Dlc);
    }
    else
    {
       Dbc_dlc = 64;
	   Msg_GW_3C2.dlc = Calc_Canfd_dlc(Dbc_dlc);
	   // Msg_GW_3C2.dlc = 64;
    }
}
/*@@end*/

/*@@envVar:E_pubc_GW_GW_3C2_EspCrcChk3C2_wrongvalctr:*/
on envVar E_pubc_GW_GW_3C2_EspCrcChk3C2_wrongvalctr
{
    //update disturb count
    //disturb value range:(-1 = always send wrong value),( X>0 ,x is the number of Messages with wrong CHK sent)
    GW_3C2_EspCrcChk3C2_wrongvalctr =getValue(this);    
}
/*@@end*/
/*@@envVar:E_pubc_GW_GW_3C2_EspCycCntr3C2_wrongvalctr:*/
on envVar E_pubc_GW_GW_3C2_EspCycCntr3C2_wrongvalctr
{
    //update disturb count
    //disturb value range:(-1 = always send wrong value),( X>0 ,x is the number of Messages with wrong CHK sent)
    GW_3C2_EspCycCntr3C2_wrongvalctr =getValue(this);    
}
/*@@end*/

/*@@envVar:E_pubc_GW_GW_3C2_EpbDriverReqParkBrakeDominant_Rv:*/
on envVar E_pubc_GW_GW_3C2_EpbDriverReqParkBrakeDominant_Rv
{
    int64 rawValue = 0ll;
    float rawValue_float = 0.0;
    float phyValue = 0.0;        

    //set the signal with updated raw value
    if(getValue(E_pubc_GW_GW_3C2_EpbDriverReqParkBrakeDominant_SetVt)==0)
    {
        rawValue = getvalue(this);
        if(chgEv_GW_3C2_EpbDriverReqParkBrakeDominant == 0)
        {
            //type conversion to float
            rawValue_float = rawValue;        
            // raw to physical conversion
            phyValue = ((rawValue_float *1)+(0));
            putValue(E_pubc_GW_GW_3C2_EpbDriverReqParkBrakeDominant_Pv, phyValue);
            chgEv_GW_3C2_EpbDriverReqParkBrakeDominant = 1;
        }
        else
        {
            chgEv_GW_3C2_EpbDriverReqParkBrakeDominant = 0;
        }    
        //update the signal value
        Msg_GW_3C2.EpbDriverReqParkBrakeDominant=rawValue;        
    }                                                                           
}
/*@@end*/

/*@@envVar:E_pubc_GW_GW_3C2_EpbDriverReqParkBrakeDominant_Pv:*/
on envVar E_pubc_GW_GW_3C2_EpbDriverReqParkBrakeDominant_Pv
{
    int64 rawValue = 0ll;
    float phyValue = 0.0;
    
    //update the raw value with physical value 
    if(getValue(E_pubc_GW_GW_3C2_EpbDriverReqParkBrakeDominant_SetVt)==0)
    {
        if(chgEv_GW_3C2_EpbDriverReqParkBrakeDominant == 0)
        {
            phyValue = getvalue(this);
            // physical to raw conversion
            rawValue = ((phyValue -(0))/1);
            putValue(E_pubc_GW_GW_3C2_EpbDriverReqParkBrakeDominant_Rv, rawValue);
            chgEv_GW_3C2_EpbDriverReqParkBrakeDominant = 1;  
        }
        else
        {
            chgEv_GW_3C2_EpbDriverReqParkBrakeDominant = 0;
        }
    }
}
/*@@end*/

/*@@envVar:E_pubc_GW_GW_3C2_EpbDriverReqParkBrakeDominant_Vt:*/
on envVar E_pubc_GW_GW_3C2_EpbDriverReqParkBrakeDominant_Vt
{
    qword rawValue = 0ll;
    if(getValue(E_pubc_GW_GW_3C2_EpbDriverReqParkBrakeDominant_SetVt))
    {
        //update the signal value
        Msg_GW_3C2.EpbDriverReqParkBrakeDominant=getValue(this);
    }
}
/*@@end*/

/*@@envVar:E_pubc_GW_GW_3C2_EpbDriverReqParkBrakeDominant_SetVt:*/
on envVar E_pubc_GW_GW_3C2_EpbDriverReqParkBrakeDominant_SetVt
{
    if(getValue(E_pubc_GW_GW_3C2_EpbDriverReqParkBrakeDominant_SetVt))
    {
        //update the signal value
        Msg_GW_3C2.EpbDriverReqParkBrakeDominant=getvalue(E_pubc_GW_GW_3C2_EpbDriverReqParkBrakeDominant_Vt);
    }
    else
    {
        Msg_GW_3C2.EpbDriverReqParkBrakeDominant=getValue(E_pubc_GW_GW_3C2_EpbDriverReqParkBrakeDominant_Rv);
    }
}
/*@@end*/
 
/*@@envVar:E_pubc_GW_GW_3C2_EpbRiAchievedClmpF_Rv:*/
on envVar E_pubc_GW_GW_3C2_EpbRiAchievedClmpF_Rv
{
    int64 rawValue = 0ll;
    float rawValue_float = 0.0;
    float phyValue = 0.0;        

    //set the signal with updated raw value
    {
        rawValue = getvalue(this);
        if(chgEv_GW_3C2_EpbRiAchievedClmpF == 0)
        {
            //type conversion to float
            rawValue_float = rawValue;        
            // raw to physical conversion
            phyValue = ((rawValue_float *1)+(0));
            putValue(E_pubc_GW_GW_3C2_EpbRiAchievedClmpF_Pv, phyValue);
            chgEv_GW_3C2_EpbRiAchievedClmpF = 1;
        }
        else
        {
            chgEv_GW_3C2_EpbRiAchievedClmpF = 0;
        }    
        //update the signal value
        Msg_GW_3C2.EpbRiAchievedClmpF=rawValue;        
    }                                                                           
}
/*@@end*/

/*@@envVar:E_pubc_GW_GW_3C2_EpbRiAchievedClmpF_Pv:*/
on envVar E_pubc_GW_GW_3C2_EpbRiAchievedClmpF_Pv
{
    int64 rawValue = 0ll;
    float phyValue = 0.0;
    
    //update the raw value with physical value 
    {
        if(chgEv_GW_3C2_EpbRiAchievedClmpF == 0)
        {
            phyValue = getvalue(this);
            // physical to raw conversion
            rawValue = ((phyValue -(0))/1);
            putValue(E_pubc_GW_GW_3C2_EpbRiAchievedClmpF_Rv, rawValue);
            chgEv_GW_3C2_EpbRiAchievedClmpF = 1;  
        }
        else
        {
            chgEv_GW_3C2_EpbRiAchievedClmpF = 0;
        }
    }
}
/*@@end*/


 
/*@@envVar:E_pubc_GW_GW_3C2_EpbFailrSts_Rv:*/
on envVar E_pubc_GW_GW_3C2_EpbFailrSts_Rv
{
    int64 rawValue = 0ll;
    float rawValue_float = 0.0;
    float phyValue = 0.0;        

    //set the signal with updated raw value
    if(getValue(E_pubc_GW_GW_3C2_EpbFailrSts_SetVt)==0)
    {
        rawValue = getvalue(this);
        if(chgEv_GW_3C2_EpbFailrSts == 0)
        {
            //type conversion to float
            rawValue_float = rawValue;        
            // raw to physical conversion
            phyValue = ((rawValue_float *1)+(0));
            putValue(E_pubc_GW_GW_3C2_EpbFailrSts_Pv, phyValue);
            chgEv_GW_3C2_EpbFailrSts = 1;
        }
        else
        {
            chgEv_GW_3C2_EpbFailrSts = 0;
        }    
        //update the signal value
        Msg_GW_3C2.EpbFailrSts=rawValue;        
    }                                                                           
}
/*@@end*/

/*@@envVar:E_pubc_GW_GW_3C2_EpbFailrSts_Pv:*/
on envVar E_pubc_GW_GW_3C2_EpbFailrSts_Pv
{
    int64 rawValue = 0ll;
    float phyValue = 0.0;
    
    //update the raw value with physical value 
    if(getValue(E_pubc_GW_GW_3C2_EpbFailrSts_SetVt)==0)
    {
        if(chgEv_GW_3C2_EpbFailrSts == 0)
        {
            phyValue = getvalue(this);
            // physical to raw conversion
            rawValue = ((phyValue -(0))/1);
            putValue(E_pubc_GW_GW_3C2_EpbFailrSts_Rv, rawValue);
            chgEv_GW_3C2_EpbFailrSts = 1;  
        }
        else
        {
            chgEv_GW_3C2_EpbFailrSts = 0;
        }
    }
}
/*@@end*/

/*@@envVar:E_pubc_GW_GW_3C2_EpbFailrSts_Vt:*/
on envVar E_pubc_GW_GW_3C2_EpbFailrSts_Vt
{
    qword rawValue = 0ll;
    if(getValue(E_pubc_GW_GW_3C2_EpbFailrSts_SetVt))
    {
        //update the signal value
        Msg_GW_3C2.EpbFailrSts=getValue(this);
    }
}
/*@@end*/

/*@@envVar:E_pubc_GW_GW_3C2_EpbFailrSts_SetVt:*/
on envVar E_pubc_GW_GW_3C2_EpbFailrSts_SetVt
{
    if(getValue(E_pubc_GW_GW_3C2_EpbFailrSts_SetVt))
    {
        //update the signal value
        Msg_GW_3C2.EpbFailrSts=getvalue(E_pubc_GW_GW_3C2_EpbFailrSts_Vt);
    }
    else
    {
        Msg_GW_3C2.EpbFailrSts=getValue(E_pubc_GW_GW_3C2_EpbFailrSts_Rv);
    }
}
/*@@end*/
 
/*@@envVar:E_pubc_GW_GW_3C2_EspEpbReqAvl_Rv:*/
on envVar E_pubc_GW_GW_3C2_EspEpbReqAvl_Rv
{
    int64 rawValue = 0ll;
    float rawValue_float = 0.0;
    float phyValue = 0.0;        

    //set the signal with updated raw value
    if(getValue(E_pubc_GW_GW_3C2_EspEpbReqAvl_SetVt)==0)
    {
        rawValue = getvalue(this);
        if(chgEv_GW_3C2_EspEpbReqAvl == 0)
        {
            //type conversion to float
            rawValue_float = rawValue;        
            // raw to physical conversion
            phyValue = ((rawValue_float *1)+(0));
            putValue(E_pubc_GW_GW_3C2_EspEpbReqAvl_Pv, phyValue);
            chgEv_GW_3C2_EspEpbReqAvl = 1;
        }
        else
        {
            chgEv_GW_3C2_EspEpbReqAvl = 0;
        }    
        //update the signal value
        Msg_GW_3C2.EspEpbReqAvl=rawValue;        
    }                                                                           
}
/*@@end*/

/*@@envVar:E_pubc_GW_GW_3C2_EspEpbReqAvl_Pv:*/
on envVar E_pubc_GW_GW_3C2_EspEpbReqAvl_Pv
{
    int64 rawValue = 0ll;
    float phyValue = 0.0;
    
    //update the raw value with physical value 
    if(getValue(E_pubc_GW_GW_3C2_EspEpbReqAvl_SetVt)==0)
    {
        if(chgEv_GW_3C2_EspEpbReqAvl == 0)
        {
            phyValue = getvalue(this);
            // physical to raw conversion
            rawValue = ((phyValue -(0))/1);
            putValue(E_pubc_GW_GW_3C2_EspEpbReqAvl_Rv, rawValue);
            chgEv_GW_3C2_EspEpbReqAvl = 1;  
        }
        else
        {
            chgEv_GW_3C2_EspEpbReqAvl = 0;
        }
    }
}
/*@@end*/

/*@@envVar:E_pubc_GW_GW_3C2_EspEpbReqAvl_Vt:*/
on envVar E_pubc_GW_GW_3C2_EspEpbReqAvl_Vt
{
    qword rawValue = 0ll;
    if(getValue(E_pubc_GW_GW_3C2_EspEpbReqAvl_SetVt))
    {
        //update the signal value
        Msg_GW_3C2.EspEpbReqAvl=getValue(this);
    }
}
/*@@end*/

/*@@envVar:E_pubc_GW_GW_3C2_EspEpbReqAvl_SetVt:*/
on envVar E_pubc_GW_GW_3C2_EspEpbReqAvl_SetVt
{
    if(getValue(E_pubc_GW_GW_3C2_EspEpbReqAvl_SetVt))
    {
        //update the signal value
        Msg_GW_3C2.EspEpbReqAvl=getvalue(E_pubc_GW_GW_3C2_EspEpbReqAvl_Vt);
    }
    else
    {
        Msg_GW_3C2.EspEpbReqAvl=getValue(E_pubc_GW_GW_3C2_EspEpbReqAvl_Rv);
    }
}
/*@@end*/
 
/*@@envVar:E_pubc_GW_GW_3C2_EpbSts_Rv:*/
on envVar E_pubc_GW_GW_3C2_EpbSts_Rv
{
    int64 rawValue = 0ll;
    float rawValue_float = 0.0;
    float phyValue = 0.0;        

    //set the signal with updated raw value
    if(getValue(E_pubc_GW_GW_3C2_EpbSts_SetVt)==0)
    {
        rawValue = getvalue(this);
        if(chgEv_GW_3C2_EpbSts == 0)
        {
            //type conversion to float
            rawValue_float = rawValue;        
            // raw to physical conversion
            phyValue = ((rawValue_float *1)+(0));
            putValue(E_pubc_GW_GW_3C2_EpbSts_Pv, phyValue);
            chgEv_GW_3C2_EpbSts = 1;
        }
        else
        {
            chgEv_GW_3C2_EpbSts = 0;
        }    
        //update the signal value
        Msg_GW_3C2.EpbSts=rawValue;        
    }                                                                           
}
/*@@end*/

/*@@envVar:E_pubc_GW_GW_3C2_EpbSts_Pv:*/
on envVar E_pubc_GW_GW_3C2_EpbSts_Pv
{
    int64 rawValue = 0ll;
    float phyValue = 0.0;
    
    //update the raw value with physical value 
    if(getValue(E_pubc_GW_GW_3C2_EpbSts_SetVt)==0)
    {
        if(chgEv_GW_3C2_EpbSts == 0)
        {
            phyValue = getvalue(this);
            // physical to raw conversion
            rawValue = ((phyValue -(0))/1);
            putValue(E_pubc_GW_GW_3C2_EpbSts_Rv, rawValue);
            chgEv_GW_3C2_EpbSts = 1;  
        }
        else
        {
            chgEv_GW_3C2_EpbSts = 0;
        }
    }
}
/*@@end*/

/*@@envVar:E_pubc_GW_GW_3C2_EpbSts_Vt:*/
on envVar E_pubc_GW_GW_3C2_EpbSts_Vt
{
    qword rawValue = 0ll;
    if(getValue(E_pubc_GW_GW_3C2_EpbSts_SetVt))
    {
        //update the signal value
        Msg_GW_3C2.EpbSts=getValue(this);
    }
}
/*@@end*/

/*@@envVar:E_pubc_GW_GW_3C2_EpbSts_SetVt:*/
on envVar E_pubc_GW_GW_3C2_EpbSts_SetVt
{
    if(getValue(E_pubc_GW_GW_3C2_EpbSts_SetVt))
    {
        //update the signal value
        Msg_GW_3C2.EpbSts=getvalue(E_pubc_GW_GW_3C2_EpbSts_Vt);
    }
    else
    {
        Msg_GW_3C2.EpbSts=getValue(E_pubc_GW_GW_3C2_EpbSts_Rv);
    }
}
/*@@end*/
 
/*@@envVar:E_pubc_GW_GW_3C2_EpbLeAchievedClmpF_Rv:*/
on envVar E_pubc_GW_GW_3C2_EpbLeAchievedClmpF_Rv
{
    int64 rawValue = 0ll;
    float rawValue_float = 0.0;
    float phyValue = 0.0;        

    //set the signal with updated raw value
    {
        rawValue = getvalue(this);
        if(chgEv_GW_3C2_EpbLeAchievedClmpF == 0)
        {
            //type conversion to float
            rawValue_float = rawValue;        
            // raw to physical conversion
            phyValue = ((rawValue_float *1)+(0));
            putValue(E_pubc_GW_GW_3C2_EpbLeAchievedClmpF_Pv, phyValue);
            chgEv_GW_3C2_EpbLeAchievedClmpF = 1;
        }
        else
        {
            chgEv_GW_3C2_EpbLeAchievedClmpF = 0;
        }    
        //update the signal value
        Msg_GW_3C2.EpbLeAchievedClmpF=rawValue;        
    }                                                                           
}
/*@@end*/

/*@@envVar:E_pubc_GW_GW_3C2_EpbLeAchievedClmpF_Pv:*/
on envVar E_pubc_GW_GW_3C2_EpbLeAchievedClmpF_Pv
{
    int64 rawValue = 0ll;
    float phyValue = 0.0;
    
    //update the raw value with physical value 
    {
        if(chgEv_GW_3C2_EpbLeAchievedClmpF == 0)
        {
            phyValue = getvalue(this);
            // physical to raw conversion
            rawValue = ((phyValue -(0))/1);
            putValue(E_pubc_GW_GW_3C2_EpbLeAchievedClmpF_Rv, rawValue);
            chgEv_GW_3C2_EpbLeAchievedClmpF = 1;  
        }
        else
        {
            chgEv_GW_3C2_EpbLeAchievedClmpF = 0;
        }
    }
}
/*@@end*/


 
/*@@envVar:E_pubc_GW_GW_3AF_tx:*/
on envVar E_pubc_GW_GW_3AF_tx
{
    if(getValue(this))
    {       
        
        //update the BZ Signal
        if(GW_3AF_HU_RollingCounter_3BB_wrongvalctr == 0)
        {
            update_GW_3AF_HU_RollingCounter_3BB_counter();
            Msg_GW_3AF.HU_RollingCounter_3BB= GW_3AF_HU_RollingCounter_3BB_counter;
        }
        else if(GW_3AF_HU_RollingCounter_3BB_wrongvalctr > 0)
        {
			GW_3AF_HU_RollingCounter_3BB_counter=GW_3AF_HU_RollingCounter_3BB_counter + GW_3AF_HU_RollingCounter_3BB_wrongvalctr;
			 Msg_GW_3AF.HU_RollingCounter_3BB= GW_3AF_HU_RollingCounter_3BB_counter;
            /* GW_3AF_HU_RollingCounter_3BB_wrongvalctr--;
              // if counter becomes zero, update panel controller to zero
             if(GW_3AF_HU_RollingCounter_3BB_wrongvalctr == 0)
             {
                 putValue(E_pubc_GW_GW_3AF_HU_RollingCounter_3BB_wrongvalctr,0);
             } */
        }
        else
        { 
			// do nothing
        }    
        //update the BZ Signal
        if(GW_3AF_HU_RollingCounter_3AF_wrongvalctr == 0)
        {
            update_GW_3AF_HU_RollingCounter_3AF_counter();
            Msg_GW_3AF.HU_RollingCounter_3AF= GW_3AF_HU_RollingCounter_3AF_counter;
        }
        else if(GW_3AF_HU_RollingCounter_3AF_wrongvalctr > 0)
        {
			GW_3AF_HU_RollingCounter_3AF_counter=GW_3AF_HU_RollingCounter_3AF_counter + GW_3AF_HU_RollingCounter_3AF_wrongvalctr;
			 Msg_GW_3AF.HU_RollingCounter_3AF= GW_3AF_HU_RollingCounter_3AF_counter;
            /* GW_3AF_HU_RollingCounter_3AF_wrongvalctr--;
              // if counter becomes zero, update panel controller to zero
             if(GW_3AF_HU_RollingCounter_3AF_wrongvalctr == 0)
             {
                 putValue(E_pubc_GW_GW_3AF_HU_RollingCounter_3AF_wrongvalctr,0);
             } */
        }
        else
        { 
			// do nothing
        }    
        //calculate the CRC CheckSum
        update_GW_3AF_CRC_CheckSum();

        output(Msg_GW_3AF);        
    }
}
/*@@end*/

/*@@envVar:E_pubc_GW_GW_3AF_Range:*/
on envVar E_pubc_GW_GW_3AF_Range
{
    qword rawstatus = 0ll;
    qword rawValue = 0ll;    
    
    rawstatus = getvalue(this);    
    // set all the signals with min raw /max raw /init raw
    switch (rawstatus) 
    {
     case(0) :
        rawValue= 0;
        putValue(E_pubc_GW_GW_3AF_HU_SlopeGradientFar_Rv, rawValue);
        rawValue= 0;
        putValue(E_pubc_GW_GW_3AF_HU_NavCurrentRoadType_Rv, rawValue);
        rawValue= 0;
        putValue(E_pubc_GW_GW_3AF_HU_AccidentProne_Rv, rawValue);
        rawValue= 0;
        putValue(E_pubc_GW_GW_3AF_HU_CurveDistance_Rv, rawValue);
        rawValue= 0;
        putValue(E_pubc_GW_GW_3AF_HU_IntervalVelocityDis_Rv, rawValue);
        rawValue= 0;
        putValue(E_pubc_GW_GW_3AF_HU_SlopeGradient_Rv, rawValue);
        rawValue= 0;
        putValue(E_pubc_GW_GW_3AF_HU_NavStatus_Rv, rawValue);
        rawValue= 0;
        putValue(E_pubc_GW_GW_3AF_HU_IntervalVelocityInfo_Rv, rawValue);
        rawValue= 0;
        putValue(E_pubc_GW_GW_3AF_HU_SlopeGradient_50m_Rv, rawValue);
        rawValue= 0;
        putValue(E_pubc_GW_GW_3AF_HU_BridgeDis_Rv, rawValue);
        rawValue= 0;
        putValue(E_pubc_GW_GW_3AF_HU_SlopeGradient_40m_Rv, rawValue);
        rawValue= 0;
        putValue(E_pubc_GW_GW_3AF_HU_LaneType_ID5_Rv, rawValue);
        rawValue= 0;
        putValue(E_pubc_GW_GW_3AF_HU_LaneType_ID4_Rv, rawValue);
        rawValue= 0;
        putValue(E_pubc_GW_GW_3AF_HU_LaneType_ID6_Rv, rawValue);
        rawValue= 0;
        putValue(E_pubc_GW_GW_3AF_HU_LaneType_ID1_Rv, rawValue);
        rawValue= 0;
        putValue(E_pubc_GW_GW_3AF_HU_LaneType_ID3_Rv, rawValue);
        rawValue= 0;
        putValue(E_pubc_GW_GW_3AF_HU_RampInfo_Rv, rawValue);
        rawValue= 0;
        putValue(E_pubc_GW_GW_3AF_HU_NavCountryCode_Rv, rawValue);
        rawValue= 0;
        putValue(E_pubc_GW_GW_3AF_HU_SpeedLimitDistance_Rv, rawValue);
        rawValue= 0;
        putValue(E_pubc_GW_GW_3AF_HU_NavSpeedLimitType_Rv, rawValue);
        rawValue= 0;
        putValue(E_pubc_GW_GW_3AF_HU_NavSpeedLimitUnits_Rv, rawValue);
        rawValue= 0;
        putValue(E_pubc_GW_GW_3AF_HU_ServiceRoadDis_Rv, rawValue);
        rawValue= 0;
        putValue(E_pubc_GW_GW_3AF_HU_WeatherType_Rv, rawValue);
        rawValue= 0;
        putValue(E_pubc_GW_GW_3AF_HU_EnterCurveInfo_Rv, rawValue);
        rawValue= 0;
        putValue(E_pubc_GW_GW_3AF_HU_ServiceRoad_Rv, rawValue);
        rawValue= 0;
        putValue(E_pubc_GW_GW_3AF_HU_SlopeGradient_100m_Rv, rawValue);
        rawValue= 0;
        putValue(E_pubc_GW_GW_3AF_HU_LaneConfluenceDis_Rv, rawValue);
        rawValue= 0;
        putValue(E_pubc_GW_GW_3AF_HU_AccidentProneDistance_Rv, rawValue);
        rawValue= 0;
        putValue(E_pubc_GW_GW_3AF_HU_SlopeGradient_30m_Rv, rawValue);
        rawValue= 0;
        putValue(E_pubc_GW_GW_3AF_HU_LaneConfluence_Rv, rawValue);
        rawValue= 0;
        putValue(E_pubc_GW_GW_3AF_HU_BridgeInfo_Rv, rawValue);
        rawValue= 0;
        putValue(E_pubc_GW_GW_3AF_HU_SlopeGradient_20m_Rv, rawValue);
        rawValue= 0;
        putValue(E_pubc_GW_GW_3AF_HU_NavSpeedLimit_Rv, rawValue);
        rawValue= 0;
        putValue(E_pubc_GW_GW_3AF_HU_SlopeGradient_10m_Rv, rawValue);
        rawValue= 0;
        putValue(E_pubc_GW_GW_3AF_HU_RampDistance_Rv, rawValue);
        rawValue= 0;
        putValue(E_pubc_GW_GW_3AF_HU_NavSpeedLimitStatus_Rv, rawValue);
        rawValue= 0;
        putValue(E_pubc_GW_GW_3AF_HU_LaneType_ID2_Rv, rawValue);
        rawValue= 0;
        putValue(E_pubc_GW_GW_3AF_HU_EnterRampInfo_Rv, rawValue);
        break;
     case(1) :
        rawValue= 1022;
        putValue(E_pubc_GW_GW_3AF_HU_SlopeGradientFar_Rv, rawValue);
        rawValue= 7;
        putValue(E_pubc_GW_GW_3AF_HU_NavCurrentRoadType_Rv, rawValue);
        rawValue= 3;
        putValue(E_pubc_GW_GW_3AF_HU_AccidentProne_Rv, rawValue);
        rawValue= 60;
        putValue(E_pubc_GW_GW_3AF_HU_CurveDistance_Rv, rawValue);
        rawValue= 60;
        putValue(E_pubc_GW_GW_3AF_HU_IntervalVelocityDis_Rv, rawValue);
        rawValue= 1022;
        putValue(E_pubc_GW_GW_3AF_HU_SlopeGradient_Rv, rawValue);
        rawValue= 1;
        putValue(E_pubc_GW_GW_3AF_HU_NavStatus_Rv, rawValue);
        rawValue= 3;
        putValue(E_pubc_GW_GW_3AF_HU_IntervalVelocityInfo_Rv, rawValue);
        rawValue= 1022;
        putValue(E_pubc_GW_GW_3AF_HU_SlopeGradient_50m_Rv, rawValue);
        rawValue= 60;
        putValue(E_pubc_GW_GW_3AF_HU_BridgeDis_Rv, rawValue);
        rawValue= 1022;
        putValue(E_pubc_GW_GW_3AF_HU_SlopeGradient_40m_Rv, rawValue);
        rawValue= 15;
        putValue(E_pubc_GW_GW_3AF_HU_LaneType_ID5_Rv, rawValue);
        rawValue= 15;
        putValue(E_pubc_GW_GW_3AF_HU_LaneType_ID4_Rv, rawValue);
        rawValue= 15;
        putValue(E_pubc_GW_GW_3AF_HU_LaneType_ID6_Rv, rawValue);
        rawValue= 15;
        putValue(E_pubc_GW_GW_3AF_HU_LaneType_ID1_Rv, rawValue);
        rawValue= 15;
        putValue(E_pubc_GW_GW_3AF_HU_LaneType_ID3_Rv, rawValue);
        rawValue= 3;
        putValue(E_pubc_GW_GW_3AF_HU_RampInfo_Rv, rawValue);
        rawValue= 255;
        putValue(E_pubc_GW_GW_3AF_HU_NavCountryCode_Rv, rawValue);
        rawValue= 60;
        putValue(E_pubc_GW_GW_3AF_HU_SpeedLimitDistance_Rv, rawValue);
        rawValue= 3;
        putValue(E_pubc_GW_GW_3AF_HU_NavSpeedLimitType_Rv, rawValue);
        rawValue= 3;
        putValue(E_pubc_GW_GW_3AF_HU_NavSpeedLimitUnits_Rv, rawValue);
        rawValue= 60;
        putValue(E_pubc_GW_GW_3AF_HU_ServiceRoadDis_Rv, rawValue);
        rawValue= 63;
        putValue(E_pubc_GW_GW_3AF_HU_WeatherType_Rv, rawValue);
        rawValue= 3;
        putValue(E_pubc_GW_GW_3AF_HU_EnterCurveInfo_Rv, rawValue);
        rawValue= 3;
        putValue(E_pubc_GW_GW_3AF_HU_ServiceRoad_Rv, rawValue);
        rawValue= 1022;
        putValue(E_pubc_GW_GW_3AF_HU_SlopeGradient_100m_Rv, rawValue);
        rawValue= 60;
        putValue(E_pubc_GW_GW_3AF_HU_LaneConfluenceDis_Rv, rawValue);
        rawValue= 60;
        putValue(E_pubc_GW_GW_3AF_HU_AccidentProneDistance_Rv, rawValue);
        rawValue= 1022;
        putValue(E_pubc_GW_GW_3AF_HU_SlopeGradient_30m_Rv, rawValue);
        rawValue= 3;
        putValue(E_pubc_GW_GW_3AF_HU_LaneConfluence_Rv, rawValue);
        rawValue= 3;
        putValue(E_pubc_GW_GW_3AF_HU_BridgeInfo_Rv, rawValue);
        rawValue= 1022;
        putValue(E_pubc_GW_GW_3AF_HU_SlopeGradient_20m_Rv, rawValue);
        rawValue= 255;
        putValue(E_pubc_GW_GW_3AF_HU_NavSpeedLimit_Rv, rawValue);
        rawValue= 1022;
        putValue(E_pubc_GW_GW_3AF_HU_SlopeGradient_10m_Rv, rawValue);
        rawValue= 300;
        putValue(E_pubc_GW_GW_3AF_HU_RampDistance_Rv, rawValue);
        rawValue= 3;
        putValue(E_pubc_GW_GW_3AF_HU_NavSpeedLimitStatus_Rv, rawValue);
        rawValue= 15;
        putValue(E_pubc_GW_GW_3AF_HU_LaneType_ID2_Rv, rawValue);
        rawValue= 3;
        putValue(E_pubc_GW_GW_3AF_HU_EnterRampInfo_Rv, rawValue);
        break;
     default :
        rawValue= 0;
        putValue(E_pubc_GW_GW_3AF_HU_SlopeGradientFar_Rv, rawValue);
        rawValue= 0;
        putValue(E_pubc_GW_GW_3AF_HU_NavCurrentRoadType_Rv, rawValue);
        rawValue= 0;
        putValue(E_pubc_GW_GW_3AF_HU_AccidentProne_Rv, rawValue);
        rawValue= 0;
        putValue(E_pubc_GW_GW_3AF_HU_CurveDistance_Rv, rawValue);
        rawValue= 0;
        putValue(E_pubc_GW_GW_3AF_HU_IntervalVelocityDis_Rv, rawValue);
        rawValue= 0;
        putValue(E_pubc_GW_GW_3AF_HU_SlopeGradient_Rv, rawValue);
        rawValue= 0;
        putValue(E_pubc_GW_GW_3AF_HU_NavStatus_Rv, rawValue);
        rawValue= 0;
        putValue(E_pubc_GW_GW_3AF_HU_IntervalVelocityInfo_Rv, rawValue);
        rawValue= 0;
        putValue(E_pubc_GW_GW_3AF_HU_SlopeGradient_50m_Rv, rawValue);
        rawValue= 0;
        putValue(E_pubc_GW_GW_3AF_HU_BridgeDis_Rv, rawValue);
        rawValue= 0;
        putValue(E_pubc_GW_GW_3AF_HU_SlopeGradient_40m_Rv, rawValue);
        rawValue= 0;
        putValue(E_pubc_GW_GW_3AF_HU_LaneType_ID5_Rv, rawValue);
        rawValue= 0;
        putValue(E_pubc_GW_GW_3AF_HU_LaneType_ID4_Rv, rawValue);
        rawValue= 0;
        putValue(E_pubc_GW_GW_3AF_HU_LaneType_ID6_Rv, rawValue);
        rawValue= 0;
        putValue(E_pubc_GW_GW_3AF_HU_LaneType_ID1_Rv, rawValue);
        rawValue= 0;
        putValue(E_pubc_GW_GW_3AF_HU_LaneType_ID3_Rv, rawValue);
        rawValue= 0;
        putValue(E_pubc_GW_GW_3AF_HU_RampInfo_Rv, rawValue);
        rawValue= 0;
        putValue(E_pubc_GW_GW_3AF_HU_NavCountryCode_Rv, rawValue);
        rawValue= 0;
        putValue(E_pubc_GW_GW_3AF_HU_SpeedLimitDistance_Rv, rawValue);
        rawValue= 0;
        putValue(E_pubc_GW_GW_3AF_HU_NavSpeedLimitType_Rv, rawValue);
        rawValue= 0;
        putValue(E_pubc_GW_GW_3AF_HU_NavSpeedLimitUnits_Rv, rawValue);
        rawValue= 0;
        putValue(E_pubc_GW_GW_3AF_HU_ServiceRoadDis_Rv, rawValue);
        rawValue= 0;
        putValue(E_pubc_GW_GW_3AF_HU_WeatherType_Rv, rawValue);
        rawValue= 0;
        putValue(E_pubc_GW_GW_3AF_HU_EnterCurveInfo_Rv, rawValue);
        rawValue= 0;
        putValue(E_pubc_GW_GW_3AF_HU_ServiceRoad_Rv, rawValue);
        rawValue= 0;
        putValue(E_pubc_GW_GW_3AF_HU_SlopeGradient_100m_Rv, rawValue);
        rawValue= 0;
        putValue(E_pubc_GW_GW_3AF_HU_LaneConfluenceDis_Rv, rawValue);
        rawValue= 0;
        putValue(E_pubc_GW_GW_3AF_HU_AccidentProneDistance_Rv, rawValue);
        rawValue= 0;
        putValue(E_pubc_GW_GW_3AF_HU_SlopeGradient_30m_Rv, rawValue);
        rawValue= 0;
        putValue(E_pubc_GW_GW_3AF_HU_LaneConfluence_Rv, rawValue);
        rawValue= 0;
        putValue(E_pubc_GW_GW_3AF_HU_BridgeInfo_Rv, rawValue);
        rawValue= 0;
        putValue(E_pubc_GW_GW_3AF_HU_SlopeGradient_20m_Rv, rawValue);
        rawValue= 0;
        putValue(E_pubc_GW_GW_3AF_HU_NavSpeedLimit_Rv, rawValue);
        rawValue= 0;
        putValue(E_pubc_GW_GW_3AF_HU_SlopeGradient_10m_Rv, rawValue);
        rawValue= 0;
        putValue(E_pubc_GW_GW_3AF_HU_RampDistance_Rv, rawValue);
        rawValue= 0;
        putValue(E_pubc_GW_GW_3AF_HU_NavSpeedLimitStatus_Rv, rawValue);
        rawValue= 0;
        putValue(E_pubc_GW_GW_3AF_HU_LaneType_ID2_Rv, rawValue);
        rawValue= 0;
        putValue(E_pubc_GW_GW_3AF_HU_EnterRampInfo_Rv, rawValue);
      break;
   }
}
/*@@end*/

/*@@envVar:E_pubc_GW_GW_3AF_Dlc:*/
on envVar E_pubc_GW_GW_3AF_Dlc
{
    if(getValue(E_pubc_GW_GW_3AF_enDlc))
    {
        Msg_GW_3AF.dlc =getValue(this);
    }
    else
    {
       Dbc_dlc = 64;
	   Msg_GW_3AF.dlc = Calc_Canfd_dlc(Dbc_dlc);
	   // Msg_GW_3AF.dlc = 64;
	   	
  }
}
/*@@end*/

/*@@envVar:E_pubc_GW_GW_3AF_enDlc:*/
on envVar E_pubc_GW_GW_3AF_enDlc
{
    //For Messages with DLC = 8, set wrong DLC to smaller than defined DLC
    //For Messages with DLC < 8 set wrong DLC to smaller/longer than defined DLC
    if(getValue(this))
    {
        Msg_GW_3AF.dlc =getValue(E_pubc_GW_GW_3AF_Dlc);
    }
    else
    {
       Dbc_dlc = 64;
	   Msg_GW_3AF.dlc = Calc_Canfd_dlc(Dbc_dlc);
	   // Msg_GW_3AF.dlc = 64;
    }
}
/*@@end*/

/*@@envVar:E_pubc_GW_GW_3AF_HU_CRCCheck_3AF_wrongvalctr:*/
on envVar E_pubc_GW_GW_3AF_HU_CRCCheck_3AF_wrongvalctr
{
    //update disturb count
    //disturb value range:(-1 = always send wrong value),( X>0 ,x is the number of Messages with wrong CHK sent)
    GW_3AF_HU_CRCCheck_3AF_wrongvalctr =getValue(this);    
}
/*@@end*/
/*@@envVar:E_pubc_GW_GW_3AF_HU_CRCCheck_3BB_wrongvalctr:*/
on envVar E_pubc_GW_GW_3AF_HU_CRCCheck_3BB_wrongvalctr
{
    //update disturb count
    //disturb value range:(-1 = always send wrong value),( X>0 ,x is the number of Messages with wrong CHK sent)
    GW_3AF_HU_CRCCheck_3BB_wrongvalctr =getValue(this);    
}
/*@@end*/
/*@@envVar:E_pubc_GW_GW_3AF_HU_RollingCounter_3AF_wrongvalctr:*/
on envVar E_pubc_GW_GW_3AF_HU_RollingCounter_3AF_wrongvalctr
{
    //update disturb count
    //disturb value range:(-1 = always send wrong value),( X>0 ,x is the number of Messages with wrong CHK sent)
    GW_3AF_HU_RollingCounter_3AF_wrongvalctr =getValue(this);    
}
/*@@end*/
/*@@envVar:E_pubc_GW_GW_3AF_HU_RollingCounter_3BB_wrongvalctr:*/
on envVar E_pubc_GW_GW_3AF_HU_RollingCounter_3BB_wrongvalctr
{
    //update disturb count
    //disturb value range:(-1 = always send wrong value),( X>0 ,x is the number of Messages with wrong CHK sent)
    GW_3AF_HU_RollingCounter_3BB_wrongvalctr =getValue(this);    
}
/*@@end*/

/*@@envVar:E_pubc_GW_GW_3AF_HU_SlopeGradientFar_Rv:*/
on envVar E_pubc_GW_GW_3AF_HU_SlopeGradientFar_Rv
{
    int64 rawValue = 0ll;
    float rawValue_float = 0.0;
    float phyValue = 0.0;        

    //set the signal with updated raw value
    {
        rawValue = getvalue(this);
        if(chgEv_GW_3AF_HU_SlopeGradientFar == 0)
        {
            //type conversion to float
            rawValue_float = rawValue;        
            // raw to physical conversion
            phyValue = ((rawValue_float *0.1)+(-51.1));
            putValue(E_pubc_GW_GW_3AF_HU_SlopeGradientFar_Pv, phyValue);
            chgEv_GW_3AF_HU_SlopeGradientFar = 1;
        }
        else
        {
            chgEv_GW_3AF_HU_SlopeGradientFar = 0;
        }    
        //update the signal value
        Msg_GW_3AF.HU_SlopeGradientFar=rawValue;        
    }                                                                           
}
/*@@end*/

/*@@envVar:E_pubc_GW_GW_3AF_HU_SlopeGradientFar_Pv:*/
on envVar E_pubc_GW_GW_3AF_HU_SlopeGradientFar_Pv
{
    int64 rawValue = 0ll;
    float phyValue = 0.0;
    
    //update the raw value with physical value 
    {
        if(chgEv_GW_3AF_HU_SlopeGradientFar == 0)
        {
            phyValue = getvalue(this);
            // physical to raw conversion
            rawValue = ((phyValue -(-51.1))/0.1);
            putValue(E_pubc_GW_GW_3AF_HU_SlopeGradientFar_Rv, rawValue);
            chgEv_GW_3AF_HU_SlopeGradientFar = 1;  
        }
        else
        {
            chgEv_GW_3AF_HU_SlopeGradientFar = 0;
        }
    }
}
/*@@end*/


 
/*@@envVar:E_pubc_GW_GW_3AF_HU_NavCurrentRoadType_Rv:*/
on envVar E_pubc_GW_GW_3AF_HU_NavCurrentRoadType_Rv
{
    int64 rawValue = 0ll;
    float rawValue_float = 0.0;
    float phyValue = 0.0;        

    //set the signal with updated raw value
    {
        rawValue = getvalue(this);
        if(chgEv_GW_3AF_HU_NavCurrentRoadType == 0)
        {
            //type conversion to float
            rawValue_float = rawValue;        
            // raw to physical conversion
            phyValue = ((rawValue_float *1)+(0));
            putValue(E_pubc_GW_GW_3AF_HU_NavCurrentRoadType_Pv, phyValue);
            chgEv_GW_3AF_HU_NavCurrentRoadType = 1;
        }
        else
        {
            chgEv_GW_3AF_HU_NavCurrentRoadType = 0;
        }    
        //update the signal value
        Msg_GW_3AF.HU_NavCurrentRoadType=rawValue;        
    }                                                                           
}
/*@@end*/

/*@@envVar:E_pubc_GW_GW_3AF_HU_NavCurrentRoadType_Pv:*/
on envVar E_pubc_GW_GW_3AF_HU_NavCurrentRoadType_Pv
{
    int64 rawValue = 0ll;
    float phyValue = 0.0;
    
    //update the raw value with physical value 
    {
        if(chgEv_GW_3AF_HU_NavCurrentRoadType == 0)
        {
            phyValue = getvalue(this);
            // physical to raw conversion
            rawValue = ((phyValue -(0))/1);
            putValue(E_pubc_GW_GW_3AF_HU_NavCurrentRoadType_Rv, rawValue);
            chgEv_GW_3AF_HU_NavCurrentRoadType = 1;  
        }
        else
        {
            chgEv_GW_3AF_HU_NavCurrentRoadType = 0;
        }
    }
}
/*@@end*/


 
/*@@envVar:E_pubc_GW_GW_3AF_HU_AccidentProne_Rv:*/
on envVar E_pubc_GW_GW_3AF_HU_AccidentProne_Rv
{
    int64 rawValue = 0ll;
    float rawValue_float = 0.0;
    float phyValue = 0.0;        

    //set the signal with updated raw value
    if(getValue(E_pubc_GW_GW_3AF_HU_AccidentProne_SetVt)==0)
    {
        rawValue = getvalue(this);
        if(chgEv_GW_3AF_HU_AccidentProne == 0)
        {
            //type conversion to float
            rawValue_float = rawValue;        
            // raw to physical conversion
            phyValue = ((rawValue_float *1)+(0));
            putValue(E_pubc_GW_GW_3AF_HU_AccidentProne_Pv, phyValue);
            chgEv_GW_3AF_HU_AccidentProne = 1;
        }
        else
        {
            chgEv_GW_3AF_HU_AccidentProne = 0;
        }    
        //update the signal value
        Msg_GW_3AF.HU_AccidentProne=rawValue;        
    }                                                                           
}
/*@@end*/

/*@@envVar:E_pubc_GW_GW_3AF_HU_AccidentProne_Pv:*/
on envVar E_pubc_GW_GW_3AF_HU_AccidentProne_Pv
{
    int64 rawValue = 0ll;
    float phyValue = 0.0;
    
    //update the raw value with physical value 
    if(getValue(E_pubc_GW_GW_3AF_HU_AccidentProne_SetVt)==0)
    {
        if(chgEv_GW_3AF_HU_AccidentProne == 0)
        {
            phyValue = getvalue(this);
            // physical to raw conversion
            rawValue = ((phyValue -(0))/1);
            putValue(E_pubc_GW_GW_3AF_HU_AccidentProne_Rv, rawValue);
            chgEv_GW_3AF_HU_AccidentProne = 1;  
        }
        else
        {
            chgEv_GW_3AF_HU_AccidentProne = 0;
        }
    }
}
/*@@end*/

/*@@envVar:E_pubc_GW_GW_3AF_HU_AccidentProne_Vt:*/
on envVar E_pubc_GW_GW_3AF_HU_AccidentProne_Vt
{
    qword rawValue = 0ll;
    if(getValue(E_pubc_GW_GW_3AF_HU_AccidentProne_SetVt))
    {
        //update the signal value
        Msg_GW_3AF.HU_AccidentProne=getValue(this);
    }
}
/*@@end*/

/*@@envVar:E_pubc_GW_GW_3AF_HU_AccidentProne_SetVt:*/
on envVar E_pubc_GW_GW_3AF_HU_AccidentProne_SetVt
{
    if(getValue(E_pubc_GW_GW_3AF_HU_AccidentProne_SetVt))
    {
        //update the signal value
        Msg_GW_3AF.HU_AccidentProne=getvalue(E_pubc_GW_GW_3AF_HU_AccidentProne_Vt);
    }
    else
    {
        Msg_GW_3AF.HU_AccidentProne=getValue(E_pubc_GW_GW_3AF_HU_AccidentProne_Rv);
    }
}
/*@@end*/
 
/*@@envVar:E_pubc_GW_GW_3AF_HU_CurveDistance_Rv:*/
on envVar E_pubc_GW_GW_3AF_HU_CurveDistance_Rv
{
    int64 rawValue = 0ll;
    float rawValue_float = 0.0;
    float phyValue = 0.0;        

    //set the signal with updated raw value
    if(getValue(E_pubc_GW_GW_3AF_HU_CurveDistance_SetVt)==0)
    {
        rawValue = getvalue(this);
        if(chgEv_GW_3AF_HU_CurveDistance == 0)
        {
            //type conversion to float
            rawValue_float = rawValue;        
            // raw to physical conversion
            phyValue = ((rawValue_float *10)+(0));
            putValue(E_pubc_GW_GW_3AF_HU_CurveDistance_Pv, phyValue);
            chgEv_GW_3AF_HU_CurveDistance = 1;
        }
        else
        {
            chgEv_GW_3AF_HU_CurveDistance = 0;
        }    
        //update the signal value
        Msg_GW_3AF.HU_CurveDistance=rawValue;        
    }                                                                           
}
/*@@end*/

/*@@envVar:E_pubc_GW_GW_3AF_HU_CurveDistance_Pv:*/
on envVar E_pubc_GW_GW_3AF_HU_CurveDistance_Pv
{
    int64 rawValue = 0ll;
    float phyValue = 0.0;
    
    //update the raw value with physical value 
    if(getValue(E_pubc_GW_GW_3AF_HU_CurveDistance_SetVt)==0)
    {
        if(chgEv_GW_3AF_HU_CurveDistance == 0)
        {
            phyValue = getvalue(this);
            // physical to raw conversion
            rawValue = ((phyValue -(0))/10);
            putValue(E_pubc_GW_GW_3AF_HU_CurveDistance_Rv, rawValue);
            chgEv_GW_3AF_HU_CurveDistance = 1;  
        }
        else
        {
            chgEv_GW_3AF_HU_CurveDistance = 0;
        }
    }
}
/*@@end*/

/*@@envVar:E_pubc_GW_GW_3AF_HU_CurveDistance_Vt:*/
on envVar E_pubc_GW_GW_3AF_HU_CurveDistance_Vt
{
    qword rawValue = 0ll;
    if(getValue(E_pubc_GW_GW_3AF_HU_CurveDistance_SetVt))
    {
        //update the signal value
        Msg_GW_3AF.HU_CurveDistance=getValue(this);
    }
}
/*@@end*/

/*@@envVar:E_pubc_GW_GW_3AF_HU_CurveDistance_SetVt:*/
on envVar E_pubc_GW_GW_3AF_HU_CurveDistance_SetVt
{
    if(getValue(E_pubc_GW_GW_3AF_HU_CurveDistance_SetVt))
    {
        //update the signal value
        Msg_GW_3AF.HU_CurveDistance=getvalue(E_pubc_GW_GW_3AF_HU_CurveDistance_Vt);
    }
    else
    {
        Msg_GW_3AF.HU_CurveDistance=getValue(E_pubc_GW_GW_3AF_HU_CurveDistance_Rv);
    }
}
/*@@end*/
 
/*@@envVar:E_pubc_GW_GW_3AF_HU_IntervalVelocityDis_Rv:*/
on envVar E_pubc_GW_GW_3AF_HU_IntervalVelocityDis_Rv
{
    int64 rawValue = 0ll;
    float rawValue_float = 0.0;
    float phyValue = 0.0;        

    //set the signal with updated raw value
    if(getValue(E_pubc_GW_GW_3AF_HU_IntervalVelocityDis_SetVt)==0)
    {
        rawValue = getvalue(this);
        if(chgEv_GW_3AF_HU_IntervalVelocityDis == 0)
        {
            //type conversion to float
            rawValue_float = rawValue;        
            // raw to physical conversion
            phyValue = ((rawValue_float *10)+(0));
            putValue(E_pubc_GW_GW_3AF_HU_IntervalVelocityDis_Pv, phyValue);
            chgEv_GW_3AF_HU_IntervalVelocityDis = 1;
        }
        else
        {
            chgEv_GW_3AF_HU_IntervalVelocityDis = 0;
        }    
        //update the signal value
        Msg_GW_3AF.HU_IntervalVelocityDis=rawValue;        
    }                                                                           
}
/*@@end*/

/*@@envVar:E_pubc_GW_GW_3AF_HU_IntervalVelocityDis_Pv:*/
on envVar E_pubc_GW_GW_3AF_HU_IntervalVelocityDis_Pv
{
    int64 rawValue = 0ll;
    float phyValue = 0.0;
    
    //update the raw value with physical value 
    if(getValue(E_pubc_GW_GW_3AF_HU_IntervalVelocityDis_SetVt)==0)
    {
        if(chgEv_GW_3AF_HU_IntervalVelocityDis == 0)
        {
            phyValue = getvalue(this);
            // physical to raw conversion
            rawValue = ((phyValue -(0))/10);
            putValue(E_pubc_GW_GW_3AF_HU_IntervalVelocityDis_Rv, rawValue);
            chgEv_GW_3AF_HU_IntervalVelocityDis = 1;  
        }
        else
        {
            chgEv_GW_3AF_HU_IntervalVelocityDis = 0;
        }
    }
}
/*@@end*/

/*@@envVar:E_pubc_GW_GW_3AF_HU_IntervalVelocityDis_Vt:*/
on envVar E_pubc_GW_GW_3AF_HU_IntervalVelocityDis_Vt
{
    qword rawValue = 0ll;
    if(getValue(E_pubc_GW_GW_3AF_HU_IntervalVelocityDis_SetVt))
    {
        //update the signal value
        Msg_GW_3AF.HU_IntervalVelocityDis=getValue(this);
    }
}
/*@@end*/

/*@@envVar:E_pubc_GW_GW_3AF_HU_IntervalVelocityDis_SetVt:*/
on envVar E_pubc_GW_GW_3AF_HU_IntervalVelocityDis_SetVt
{
    if(getValue(E_pubc_GW_GW_3AF_HU_IntervalVelocityDis_SetVt))
    {
        //update the signal value
        Msg_GW_3AF.HU_IntervalVelocityDis=getvalue(E_pubc_GW_GW_3AF_HU_IntervalVelocityDis_Vt);
    }
    else
    {
        Msg_GW_3AF.HU_IntervalVelocityDis=getValue(E_pubc_GW_GW_3AF_HU_IntervalVelocityDis_Rv);
    }
}
/*@@end*/
 
/*@@envVar:E_pubc_GW_GW_3AF_HU_SlopeGradient_Rv:*/
on envVar E_pubc_GW_GW_3AF_HU_SlopeGradient_Rv
{
    int64 rawValue = 0ll;
    float rawValue_float = 0.0;
    float phyValue = 0.0;        

    //set the signal with updated raw value
    {
        rawValue = getvalue(this);
        if(chgEv_GW_3AF_HU_SlopeGradient == 0)
        {
            //type conversion to float
            rawValue_float = rawValue;        
            // raw to physical conversion
            phyValue = ((rawValue_float *0.1)+(-51.1));
            putValue(E_pubc_GW_GW_3AF_HU_SlopeGradient_Pv, phyValue);
            chgEv_GW_3AF_HU_SlopeGradient = 1;
        }
        else
        {
            chgEv_GW_3AF_HU_SlopeGradient = 0;
        }    
        //update the signal value
        Msg_GW_3AF.HU_SlopeGradient=rawValue;        
    }                                                                           
}
/*@@end*/

/*@@envVar:E_pubc_GW_GW_3AF_HU_SlopeGradient_Pv:*/
on envVar E_pubc_GW_GW_3AF_HU_SlopeGradient_Pv
{
    int64 rawValue = 0ll;
    float phyValue = 0.0;
    
    //update the raw value with physical value 
    {
        if(chgEv_GW_3AF_HU_SlopeGradient == 0)
        {
            phyValue = getvalue(this);
            // physical to raw conversion
            rawValue = ((phyValue -(-51.1))/0.1);
            putValue(E_pubc_GW_GW_3AF_HU_SlopeGradient_Rv, rawValue);
            chgEv_GW_3AF_HU_SlopeGradient = 1;  
        }
        else
        {
            chgEv_GW_3AF_HU_SlopeGradient = 0;
        }
    }
}
/*@@end*/


 
/*@@envVar:E_pubc_GW_GW_3AF_HU_NavStatus_Rv:*/
on envVar E_pubc_GW_GW_3AF_HU_NavStatus_Rv
{
    int64 rawValue = 0ll;
    float rawValue_float = 0.0;
    float phyValue = 0.0;        

    //set the signal with updated raw value
    if(getValue(E_pubc_GW_GW_3AF_HU_NavStatus_SetVt)==0)
    {
        rawValue = getvalue(this);
        if(chgEv_GW_3AF_HU_NavStatus == 0)
        {
            //type conversion to float
            rawValue_float = rawValue;        
            // raw to physical conversion
            phyValue = ((rawValue_float *1)+(0));
            putValue(E_pubc_GW_GW_3AF_HU_NavStatus_Pv, phyValue);
            chgEv_GW_3AF_HU_NavStatus = 1;
        }
        else
        {
            chgEv_GW_3AF_HU_NavStatus = 0;
        }    
        //update the signal value
        Msg_GW_3AF.HU_NavStatus=rawValue;        
    }                                                                           
}
/*@@end*/

/*@@envVar:E_pubc_GW_GW_3AF_HU_NavStatus_Pv:*/
on envVar E_pubc_GW_GW_3AF_HU_NavStatus_Pv
{
    int64 rawValue = 0ll;
    float phyValue = 0.0;
    
    //update the raw value with physical value 
    if(getValue(E_pubc_GW_GW_3AF_HU_NavStatus_SetVt)==0)
    {
        if(chgEv_GW_3AF_HU_NavStatus == 0)
        {
            phyValue = getvalue(this);
            // physical to raw conversion
            rawValue = ((phyValue -(0))/1);
            putValue(E_pubc_GW_GW_3AF_HU_NavStatus_Rv, rawValue);
            chgEv_GW_3AF_HU_NavStatus = 1;  
        }
        else
        {
            chgEv_GW_3AF_HU_NavStatus = 0;
        }
    }
}
/*@@end*/

/*@@envVar:E_pubc_GW_GW_3AF_HU_NavStatus_Vt:*/
on envVar E_pubc_GW_GW_3AF_HU_NavStatus_Vt
{
    qword rawValue = 0ll;
    if(getValue(E_pubc_GW_GW_3AF_HU_NavStatus_SetVt))
    {
        //update the signal value
        Msg_GW_3AF.HU_NavStatus=getValue(this);
    }
}
/*@@end*/

/*@@envVar:E_pubc_GW_GW_3AF_HU_NavStatus_SetVt:*/
on envVar E_pubc_GW_GW_3AF_HU_NavStatus_SetVt
{
    if(getValue(E_pubc_GW_GW_3AF_HU_NavStatus_SetVt))
    {
        //update the signal value
        Msg_GW_3AF.HU_NavStatus=getvalue(E_pubc_GW_GW_3AF_HU_NavStatus_Vt);
    }
    else
    {
        Msg_GW_3AF.HU_NavStatus=getValue(E_pubc_GW_GW_3AF_HU_NavStatus_Rv);
    }
}
/*@@end*/
 
/*@@envVar:E_pubc_GW_GW_3AF_HU_IntervalVelocityInfo_Rv:*/
on envVar E_pubc_GW_GW_3AF_HU_IntervalVelocityInfo_Rv
{
    int64 rawValue = 0ll;
    float rawValue_float = 0.0;
    float phyValue = 0.0;        

    //set the signal with updated raw value
    if(getValue(E_pubc_GW_GW_3AF_HU_IntervalVelocityInfo_SetVt)==0)
    {
        rawValue = getvalue(this);
        if(chgEv_GW_3AF_HU_IntervalVelocityInfo == 0)
        {
            //type conversion to float
            rawValue_float = rawValue;        
            // raw to physical conversion
            phyValue = ((rawValue_float *1)+(0));
            putValue(E_pubc_GW_GW_3AF_HU_IntervalVelocityInfo_Pv, phyValue);
            chgEv_GW_3AF_HU_IntervalVelocityInfo = 1;
        }
        else
        {
            chgEv_GW_3AF_HU_IntervalVelocityInfo = 0;
        }    
        //update the signal value
        Msg_GW_3AF.HU_IntervalVelocityInfo=rawValue;        
    }                                                                           
}
/*@@end*/

/*@@envVar:E_pubc_GW_GW_3AF_HU_IntervalVelocityInfo_Pv:*/
on envVar E_pubc_GW_GW_3AF_HU_IntervalVelocityInfo_Pv
{
    int64 rawValue = 0ll;
    float phyValue = 0.0;
    
    //update the raw value with physical value 
    if(getValue(E_pubc_GW_GW_3AF_HU_IntervalVelocityInfo_SetVt)==0)
    {
        if(chgEv_GW_3AF_HU_IntervalVelocityInfo == 0)
        {
            phyValue = getvalue(this);
            // physical to raw conversion
            rawValue = ((phyValue -(0))/1);
            putValue(E_pubc_GW_GW_3AF_HU_IntervalVelocityInfo_Rv, rawValue);
            chgEv_GW_3AF_HU_IntervalVelocityInfo = 1;  
        }
        else
        {
            chgEv_GW_3AF_HU_IntervalVelocityInfo = 0;
        }
    }
}
/*@@end*/

/*@@envVar:E_pubc_GW_GW_3AF_HU_IntervalVelocityInfo_Vt:*/
on envVar E_pubc_GW_GW_3AF_HU_IntervalVelocityInfo_Vt
{
    qword rawValue = 0ll;
    if(getValue(E_pubc_GW_GW_3AF_HU_IntervalVelocityInfo_SetVt))
    {
        //update the signal value
        Msg_GW_3AF.HU_IntervalVelocityInfo=getValue(this);
    }
}
/*@@end*/

/*@@envVar:E_pubc_GW_GW_3AF_HU_IntervalVelocityInfo_SetVt:*/
on envVar E_pubc_GW_GW_3AF_HU_IntervalVelocityInfo_SetVt
{
    if(getValue(E_pubc_GW_GW_3AF_HU_IntervalVelocityInfo_SetVt))
    {
        //update the signal value
        Msg_GW_3AF.HU_IntervalVelocityInfo=getvalue(E_pubc_GW_GW_3AF_HU_IntervalVelocityInfo_Vt);
    }
    else
    {
        Msg_GW_3AF.HU_IntervalVelocityInfo=getValue(E_pubc_GW_GW_3AF_HU_IntervalVelocityInfo_Rv);
    }
}
/*@@end*/
 
/*@@envVar:E_pubc_GW_GW_3AF_HU_SlopeGradient_50m_Rv:*/
on envVar E_pubc_GW_GW_3AF_HU_SlopeGradient_50m_Rv
{
    int64 rawValue = 0ll;
    float rawValue_float = 0.0;
    float phyValue = 0.0;        

    //set the signal with updated raw value
    {
        rawValue = getvalue(this);
        if(chgEv_GW_3AF_HU_SlopeGradient_50m == 0)
        {
            //type conversion to float
            rawValue_float = rawValue;        
            // raw to physical conversion
            phyValue = ((rawValue_float *0.1)+(-51.1));
            putValue(E_pubc_GW_GW_3AF_HU_SlopeGradient_50m_Pv, phyValue);
            chgEv_GW_3AF_HU_SlopeGradient_50m = 1;
        }
        else
        {
            chgEv_GW_3AF_HU_SlopeGradient_50m = 0;
        }    
        //update the signal value
        Msg_GW_3AF.HU_SlopeGradient_50m=rawValue;        
    }                                                                           
}
/*@@end*/

/*@@envVar:E_pubc_GW_GW_3AF_HU_SlopeGradient_50m_Pv:*/
on envVar E_pubc_GW_GW_3AF_HU_SlopeGradient_50m_Pv
{
    int64 rawValue = 0ll;
    float phyValue = 0.0;
    
    //update the raw value with physical value 
    {
        if(chgEv_GW_3AF_HU_SlopeGradient_50m == 0)
        {
            phyValue = getvalue(this);
            // physical to raw conversion
            rawValue = ((phyValue -(-51.1))/0.1);
            putValue(E_pubc_GW_GW_3AF_HU_SlopeGradient_50m_Rv, rawValue);
            chgEv_GW_3AF_HU_SlopeGradient_50m = 1;  
        }
        else
        {
            chgEv_GW_3AF_HU_SlopeGradient_50m = 0;
        }
    }
}
/*@@end*/


 
/*@@envVar:E_pubc_GW_GW_3AF_HU_BridgeDis_Rv:*/
on envVar E_pubc_GW_GW_3AF_HU_BridgeDis_Rv
{
    int64 rawValue = 0ll;
    float rawValue_float = 0.0;
    float phyValue = 0.0;        

    //set the signal with updated raw value
    if(getValue(E_pubc_GW_GW_3AF_HU_BridgeDis_SetVt)==0)
    {
        rawValue = getvalue(this);
        if(chgEv_GW_3AF_HU_BridgeDis == 0)
        {
            //type conversion to float
            rawValue_float = rawValue;        
            // raw to physical conversion
            phyValue = ((rawValue_float *10)+(0));
            putValue(E_pubc_GW_GW_3AF_HU_BridgeDis_Pv, phyValue);
            chgEv_GW_3AF_HU_BridgeDis = 1;
        }
        else
        {
            chgEv_GW_3AF_HU_BridgeDis = 0;
        }    
        //update the signal value
        Msg_GW_3AF.HU_BridgeDis=rawValue;        
    }                                                                           
}
/*@@end*/

/*@@envVar:E_pubc_GW_GW_3AF_HU_BridgeDis_Pv:*/
on envVar E_pubc_GW_GW_3AF_HU_BridgeDis_Pv
{
    int64 rawValue = 0ll;
    float phyValue = 0.0;
    
    //update the raw value with physical value 
    if(getValue(E_pubc_GW_GW_3AF_HU_BridgeDis_SetVt)==0)
    {
        if(chgEv_GW_3AF_HU_BridgeDis == 0)
        {
            phyValue = getvalue(this);
            // physical to raw conversion
            rawValue = ((phyValue -(0))/10);
            putValue(E_pubc_GW_GW_3AF_HU_BridgeDis_Rv, rawValue);
            chgEv_GW_3AF_HU_BridgeDis = 1;  
        }
        else
        {
            chgEv_GW_3AF_HU_BridgeDis = 0;
        }
    }
}
/*@@end*/

/*@@envVar:E_pubc_GW_GW_3AF_HU_BridgeDis_Vt:*/
on envVar E_pubc_GW_GW_3AF_HU_BridgeDis_Vt
{
    qword rawValue = 0ll;
    if(getValue(E_pubc_GW_GW_3AF_HU_BridgeDis_SetVt))
    {
        //update the signal value
        Msg_GW_3AF.HU_BridgeDis=getValue(this);
    }
}
/*@@end*/

/*@@envVar:E_pubc_GW_GW_3AF_HU_BridgeDis_SetVt:*/
on envVar E_pubc_GW_GW_3AF_HU_BridgeDis_SetVt
{
    if(getValue(E_pubc_GW_GW_3AF_HU_BridgeDis_SetVt))
    {
        //update the signal value
        Msg_GW_3AF.HU_BridgeDis=getvalue(E_pubc_GW_GW_3AF_HU_BridgeDis_Vt);
    }
    else
    {
        Msg_GW_3AF.HU_BridgeDis=getValue(E_pubc_GW_GW_3AF_HU_BridgeDis_Rv);
    }
}
/*@@end*/
 
/*@@envVar:E_pubc_GW_GW_3AF_HU_SlopeGradient_40m_Rv:*/
on envVar E_pubc_GW_GW_3AF_HU_SlopeGradient_40m_Rv
{
    int64 rawValue = 0ll;
    float rawValue_float = 0.0;
    float phyValue = 0.0;        

    //set the signal with updated raw value
    {
        rawValue = getvalue(this);
        if(chgEv_GW_3AF_HU_SlopeGradient_40m == 0)
        {
            //type conversion to float
            rawValue_float = rawValue;        
            // raw to physical conversion
            phyValue = ((rawValue_float *0.1)+(-51.1));
            putValue(E_pubc_GW_GW_3AF_HU_SlopeGradient_40m_Pv, phyValue);
            chgEv_GW_3AF_HU_SlopeGradient_40m = 1;
        }
        else
        {
            chgEv_GW_3AF_HU_SlopeGradient_40m = 0;
        }    
        //update the signal value
        Msg_GW_3AF.HU_SlopeGradient_40m=rawValue;        
    }                                                                           
}
/*@@end*/

/*@@envVar:E_pubc_GW_GW_3AF_HU_SlopeGradient_40m_Pv:*/
on envVar E_pubc_GW_GW_3AF_HU_SlopeGradient_40m_Pv
{
    int64 rawValue = 0ll;
    float phyValue = 0.0;
    
    //update the raw value with physical value 
    {
        if(chgEv_GW_3AF_HU_SlopeGradient_40m == 0)
        {
            phyValue = getvalue(this);
            // physical to raw conversion
            rawValue = ((phyValue -(-51.1))/0.1);
            putValue(E_pubc_GW_GW_3AF_HU_SlopeGradient_40m_Rv, rawValue);
            chgEv_GW_3AF_HU_SlopeGradient_40m = 1;  
        }
        else
        {
            chgEv_GW_3AF_HU_SlopeGradient_40m = 0;
        }
    }
}
/*@@end*/


 
/*@@envVar:E_pubc_GW_GW_3AF_HU_LaneType_ID5_Rv:*/
on envVar E_pubc_GW_GW_3AF_HU_LaneType_ID5_Rv
{
    int64 rawValue = 0ll;
    float rawValue_float = 0.0;
    float phyValue = 0.0;        

    //set the signal with updated raw value
    {
        rawValue = getvalue(this);
        if(chgEv_GW_3AF_HU_LaneType_ID5 == 0)
        {
            //type conversion to float
            rawValue_float = rawValue;        
            // raw to physical conversion
            phyValue = ((rawValue_float *1)+(0));
            putValue(E_pubc_GW_GW_3AF_HU_LaneType_ID5_Pv, phyValue);
            chgEv_GW_3AF_HU_LaneType_ID5 = 1;
        }
        else
        {
            chgEv_GW_3AF_HU_LaneType_ID5 = 0;
        }    
        //update the signal value
        Msg_GW_3AF.HU_LaneType_ID5=rawValue;        
    }                                                                           
}
/*@@end*/

/*@@envVar:E_pubc_GW_GW_3AF_HU_LaneType_ID5_Pv:*/
on envVar E_pubc_GW_GW_3AF_HU_LaneType_ID5_Pv
{
    int64 rawValue = 0ll;
    float phyValue = 0.0;
    
    //update the raw value with physical value 
    {
        if(chgEv_GW_3AF_HU_LaneType_ID5 == 0)
        {
            phyValue = getvalue(this);
            // physical to raw conversion
            rawValue = ((phyValue -(0))/1);
            putValue(E_pubc_GW_GW_3AF_HU_LaneType_ID5_Rv, rawValue);
            chgEv_GW_3AF_HU_LaneType_ID5 = 1;  
        }
        else
        {
            chgEv_GW_3AF_HU_LaneType_ID5 = 0;
        }
    }
}
/*@@end*/


 
/*@@envVar:E_pubc_GW_GW_3AF_HU_LaneType_ID4_Rv:*/
on envVar E_pubc_GW_GW_3AF_HU_LaneType_ID4_Rv
{
    int64 rawValue = 0ll;
    float rawValue_float = 0.0;
    float phyValue = 0.0;        

    //set the signal with updated raw value
    {
        rawValue = getvalue(this);
        if(chgEv_GW_3AF_HU_LaneType_ID4 == 0)
        {
            //type conversion to float
            rawValue_float = rawValue;        
            // raw to physical conversion
            phyValue = ((rawValue_float *1)+(0));
            putValue(E_pubc_GW_GW_3AF_HU_LaneType_ID4_Pv, phyValue);
            chgEv_GW_3AF_HU_LaneType_ID4 = 1;
        }
        else
        {
            chgEv_GW_3AF_HU_LaneType_ID4 = 0;
        }    
        //update the signal value
        Msg_GW_3AF.HU_LaneType_ID4=rawValue;        
    }                                                                           
}
/*@@end*/

/*@@envVar:E_pubc_GW_GW_3AF_HU_LaneType_ID4_Pv:*/
on envVar E_pubc_GW_GW_3AF_HU_LaneType_ID4_Pv
{
    int64 rawValue = 0ll;
    float phyValue = 0.0;
    
    //update the raw value with physical value 
    {
        if(chgEv_GW_3AF_HU_LaneType_ID4 == 0)
        {
            phyValue = getvalue(this);
            // physical to raw conversion
            rawValue = ((phyValue -(0))/1);
            putValue(E_pubc_GW_GW_3AF_HU_LaneType_ID4_Rv, rawValue);
            chgEv_GW_3AF_HU_LaneType_ID4 = 1;  
        }
        else
        {
            chgEv_GW_3AF_HU_LaneType_ID4 = 0;
        }
    }
}
/*@@end*/


 
/*@@envVar:E_pubc_GW_GW_3AF_HU_LaneType_ID6_Rv:*/
on envVar E_pubc_GW_GW_3AF_HU_LaneType_ID6_Rv
{
    int64 rawValue = 0ll;
    float rawValue_float = 0.0;
    float phyValue = 0.0;        

    //set the signal with updated raw value
    {
        rawValue = getvalue(this);
        if(chgEv_GW_3AF_HU_LaneType_ID6 == 0)
        {
            //type conversion to float
            rawValue_float = rawValue;        
            // raw to physical conversion
            phyValue = ((rawValue_float *1)+(0));
            putValue(E_pubc_GW_GW_3AF_HU_LaneType_ID6_Pv, phyValue);
            chgEv_GW_3AF_HU_LaneType_ID6 = 1;
        }
        else
        {
            chgEv_GW_3AF_HU_LaneType_ID6 = 0;
        }    
        //update the signal value
        Msg_GW_3AF.HU_LaneType_ID6=rawValue;        
    }                                                                           
}
/*@@end*/

/*@@envVar:E_pubc_GW_GW_3AF_HU_LaneType_ID6_Pv:*/
on envVar E_pubc_GW_GW_3AF_HU_LaneType_ID6_Pv
{
    int64 rawValue = 0ll;
    float phyValue = 0.0;
    
    //update the raw value with physical value 
    {
        if(chgEv_GW_3AF_HU_LaneType_ID6 == 0)
        {
            phyValue = getvalue(this);
            // physical to raw conversion
            rawValue = ((phyValue -(0))/1);
            putValue(E_pubc_GW_GW_3AF_HU_LaneType_ID6_Rv, rawValue);
            chgEv_GW_3AF_HU_LaneType_ID6 = 1;  
        }
        else
        {
            chgEv_GW_3AF_HU_LaneType_ID6 = 0;
        }
    }
}
/*@@end*/


 
/*@@envVar:E_pubc_GW_GW_3AF_HU_LaneType_ID1_Rv:*/
on envVar E_pubc_GW_GW_3AF_HU_LaneType_ID1_Rv
{
    int64 rawValue = 0ll;
    float rawValue_float = 0.0;
    float phyValue = 0.0;        

    //set the signal with updated raw value
    {
        rawValue = getvalue(this);
        if(chgEv_GW_3AF_HU_LaneType_ID1 == 0)
        {
            //type conversion to float
            rawValue_float = rawValue;        
            // raw to physical conversion
            phyValue = ((rawValue_float *1)+(0));
            putValue(E_pubc_GW_GW_3AF_HU_LaneType_ID1_Pv, phyValue);
            chgEv_GW_3AF_HU_LaneType_ID1 = 1;
        }
        else
        {
            chgEv_GW_3AF_HU_LaneType_ID1 = 0;
        }    
        //update the signal value
        Msg_GW_3AF.HU_LaneType_ID1=rawValue;        
    }                                                                           
}
/*@@end*/

/*@@envVar:E_pubc_GW_GW_3AF_HU_LaneType_ID1_Pv:*/
on envVar E_pubc_GW_GW_3AF_HU_LaneType_ID1_Pv
{
    int64 rawValue = 0ll;
    float phyValue = 0.0;
    
    //update the raw value with physical value 
    {
        if(chgEv_GW_3AF_HU_LaneType_ID1 == 0)
        {
            phyValue = getvalue(this);
            // physical to raw conversion
            rawValue = ((phyValue -(0))/1);
            putValue(E_pubc_GW_GW_3AF_HU_LaneType_ID1_Rv, rawValue);
            chgEv_GW_3AF_HU_LaneType_ID1 = 1;  
        }
        else
        {
            chgEv_GW_3AF_HU_LaneType_ID1 = 0;
        }
    }
}
/*@@end*/


 
/*@@envVar:E_pubc_GW_GW_3AF_HU_LaneType_ID3_Rv:*/
on envVar E_pubc_GW_GW_3AF_HU_LaneType_ID3_Rv
{
    int64 rawValue = 0ll;
    float rawValue_float = 0.0;
    float phyValue = 0.0;        

    //set the signal with updated raw value
    {
        rawValue = getvalue(this);
        if(chgEv_GW_3AF_HU_LaneType_ID3 == 0)
        {
            //type conversion to float
            rawValue_float = rawValue;        
            // raw to physical conversion
            phyValue = ((rawValue_float *1)+(0));
            putValue(E_pubc_GW_GW_3AF_HU_LaneType_ID3_Pv, phyValue);
            chgEv_GW_3AF_HU_LaneType_ID3 = 1;
        }
        else
        {
            chgEv_GW_3AF_HU_LaneType_ID3 = 0;
        }    
        //update the signal value
        Msg_GW_3AF.HU_LaneType_ID3=rawValue;        
    }                                                                           
}
/*@@end*/

/*@@envVar:E_pubc_GW_GW_3AF_HU_LaneType_ID3_Pv:*/
on envVar E_pubc_GW_GW_3AF_HU_LaneType_ID3_Pv
{
    int64 rawValue = 0ll;
    float phyValue = 0.0;
    
    //update the raw value with physical value 
    {
        if(chgEv_GW_3AF_HU_LaneType_ID3 == 0)
        {
            phyValue = getvalue(this);
            // physical to raw conversion
            rawValue = ((phyValue -(0))/1);
            putValue(E_pubc_GW_GW_3AF_HU_LaneType_ID3_Rv, rawValue);
            chgEv_GW_3AF_HU_LaneType_ID3 = 1;  
        }
        else
        {
            chgEv_GW_3AF_HU_LaneType_ID3 = 0;
        }
    }
}
/*@@end*/


 
/*@@envVar:E_pubc_GW_GW_3AF_HU_RampInfo_Rv:*/
on envVar E_pubc_GW_GW_3AF_HU_RampInfo_Rv
{
    int64 rawValue = 0ll;
    float rawValue_float = 0.0;
    float phyValue = 0.0;        

    //set the signal with updated raw value
    if(getValue(E_pubc_GW_GW_3AF_HU_RampInfo_SetVt)==0)
    {
        rawValue = getvalue(this);
        if(chgEv_GW_3AF_HU_RampInfo == 0)
        {
            //type conversion to float
            rawValue_float = rawValue;        
            // raw to physical conversion
            phyValue = ((rawValue_float *1)+(0));
            putValue(E_pubc_GW_GW_3AF_HU_RampInfo_Pv, phyValue);
            chgEv_GW_3AF_HU_RampInfo = 1;
        }
        else
        {
            chgEv_GW_3AF_HU_RampInfo = 0;
        }    
        //update the signal value
        Msg_GW_3AF.HU_RampInfo=rawValue;        
    }                                                                           
}
/*@@end*/

/*@@envVar:E_pubc_GW_GW_3AF_HU_RampInfo_Pv:*/
on envVar E_pubc_GW_GW_3AF_HU_RampInfo_Pv
{
    int64 rawValue = 0ll;
    float phyValue = 0.0;
    
    //update the raw value with physical value 
    if(getValue(E_pubc_GW_GW_3AF_HU_RampInfo_SetVt)==0)
    {
        if(chgEv_GW_3AF_HU_RampInfo == 0)
        {
            phyValue = getvalue(this);
            // physical to raw conversion
            rawValue = ((phyValue -(0))/1);
            putValue(E_pubc_GW_GW_3AF_HU_RampInfo_Rv, rawValue);
            chgEv_GW_3AF_HU_RampInfo = 1;  
        }
        else
        {
            chgEv_GW_3AF_HU_RampInfo = 0;
        }
    }
}
/*@@end*/

/*@@envVar:E_pubc_GW_GW_3AF_HU_RampInfo_Vt:*/
on envVar E_pubc_GW_GW_3AF_HU_RampInfo_Vt
{
    qword rawValue = 0ll;
    if(getValue(E_pubc_GW_GW_3AF_HU_RampInfo_SetVt))
    {
        //update the signal value
        Msg_GW_3AF.HU_RampInfo=getValue(this);
    }
}
/*@@end*/

/*@@envVar:E_pubc_GW_GW_3AF_HU_RampInfo_SetVt:*/
on envVar E_pubc_GW_GW_3AF_HU_RampInfo_SetVt
{
    if(getValue(E_pubc_GW_GW_3AF_HU_RampInfo_SetVt))
    {
        //update the signal value
        Msg_GW_3AF.HU_RampInfo=getvalue(E_pubc_GW_GW_3AF_HU_RampInfo_Vt);
    }
    else
    {
        Msg_GW_3AF.HU_RampInfo=getValue(E_pubc_GW_GW_3AF_HU_RampInfo_Rv);
    }
}
/*@@end*/
 
/*@@envVar:E_pubc_GW_GW_3AF_HU_NavCountryCode_Rv:*/
on envVar E_pubc_GW_GW_3AF_HU_NavCountryCode_Rv
{
    int64 rawValue = 0ll;
    float rawValue_float = 0.0;
    float phyValue = 0.0;        

    //set the signal with updated raw value
    {
        rawValue = getvalue(this);
        if(chgEv_GW_3AF_HU_NavCountryCode == 0)
        {
            //type conversion to float
            rawValue_float = rawValue;        
            // raw to physical conversion
            phyValue = ((rawValue_float *1)+(0));
            putValue(E_pubc_GW_GW_3AF_HU_NavCountryCode_Pv, phyValue);
            chgEv_GW_3AF_HU_NavCountryCode = 1;
        }
        else
        {
            chgEv_GW_3AF_HU_NavCountryCode = 0;
        }    
        //update the signal value
        Msg_GW_3AF.HU_NavCountryCode=rawValue;        
    }                                                                           
}
/*@@end*/

/*@@envVar:E_pubc_GW_GW_3AF_HU_NavCountryCode_Pv:*/
on envVar E_pubc_GW_GW_3AF_HU_NavCountryCode_Pv
{
    int64 rawValue = 0ll;
    float phyValue = 0.0;
    
    //update the raw value with physical value 
    {
        if(chgEv_GW_3AF_HU_NavCountryCode == 0)
        {
            phyValue = getvalue(this);
            // physical to raw conversion
            rawValue = ((phyValue -(0))/1);
            putValue(E_pubc_GW_GW_3AF_HU_NavCountryCode_Rv, rawValue);
            chgEv_GW_3AF_HU_NavCountryCode = 1;  
        }
        else
        {
            chgEv_GW_3AF_HU_NavCountryCode = 0;
        }
    }
}
/*@@end*/


 
/*@@envVar:E_pubc_GW_GW_3AF_HU_SpeedLimitDistance_Rv:*/
on envVar E_pubc_GW_GW_3AF_HU_SpeedLimitDistance_Rv
{
    int64 rawValue = 0ll;
    float rawValue_float = 0.0;
    float phyValue = 0.0;        

    //set the signal with updated raw value
    if(getValue(E_pubc_GW_GW_3AF_HU_SpeedLimitDistance_SetVt)==0)
    {
        rawValue = getvalue(this);
        if(chgEv_GW_3AF_HU_SpeedLimitDistance == 0)
        {
            //type conversion to float
            rawValue_float = rawValue;        
            // raw to physical conversion
            phyValue = ((rawValue_float *10)+(0));
            putValue(E_pubc_GW_GW_3AF_HU_SpeedLimitDistance_Pv, phyValue);
            chgEv_GW_3AF_HU_SpeedLimitDistance = 1;
        }
        else
        {
            chgEv_GW_3AF_HU_SpeedLimitDistance = 0;
        }    
        //update the signal value
        Msg_GW_3AF.HU_SpeedLimitDistance=rawValue;        
    }                                                                           
}
/*@@end*/

/*@@envVar:E_pubc_GW_GW_3AF_HU_SpeedLimitDistance_Pv:*/
on envVar E_pubc_GW_GW_3AF_HU_SpeedLimitDistance_Pv
{
    int64 rawValue = 0ll;
    float phyValue = 0.0;
    
    //update the raw value with physical value 
    if(getValue(E_pubc_GW_GW_3AF_HU_SpeedLimitDistance_SetVt)==0)
    {
        if(chgEv_GW_3AF_HU_SpeedLimitDistance == 0)
        {
            phyValue = getvalue(this);
            // physical to raw conversion
            rawValue = ((phyValue -(0))/10);
            putValue(E_pubc_GW_GW_3AF_HU_SpeedLimitDistance_Rv, rawValue);
            chgEv_GW_3AF_HU_SpeedLimitDistance = 1;  
        }
        else
        {
            chgEv_GW_3AF_HU_SpeedLimitDistance = 0;
        }
    }
}
/*@@end*/

/*@@envVar:E_pubc_GW_GW_3AF_HU_SpeedLimitDistance_Vt:*/
on envVar E_pubc_GW_GW_3AF_HU_SpeedLimitDistance_Vt
{
    qword rawValue = 0ll;
    if(getValue(E_pubc_GW_GW_3AF_HU_SpeedLimitDistance_SetVt))
    {
        //update the signal value
        Msg_GW_3AF.HU_SpeedLimitDistance=getValue(this);
    }
}
/*@@end*/

/*@@envVar:E_pubc_GW_GW_3AF_HU_SpeedLimitDistance_SetVt:*/
on envVar E_pubc_GW_GW_3AF_HU_SpeedLimitDistance_SetVt
{
    if(getValue(E_pubc_GW_GW_3AF_HU_SpeedLimitDistance_SetVt))
    {
        //update the signal value
        Msg_GW_3AF.HU_SpeedLimitDistance=getvalue(E_pubc_GW_GW_3AF_HU_SpeedLimitDistance_Vt);
    }
    else
    {
        Msg_GW_3AF.HU_SpeedLimitDistance=getValue(E_pubc_GW_GW_3AF_HU_SpeedLimitDistance_Rv);
    }
}
/*@@end*/
 
/*@@envVar:E_pubc_GW_GW_3AF_HU_NavSpeedLimitType_Rv:*/
on envVar E_pubc_GW_GW_3AF_HU_NavSpeedLimitType_Rv
{
    int64 rawValue = 0ll;
    float rawValue_float = 0.0;
    float phyValue = 0.0;        

    //set the signal with updated raw value
    if(getValue(E_pubc_GW_GW_3AF_HU_NavSpeedLimitType_SetVt)==0)
    {
        rawValue = getvalue(this);
        if(chgEv_GW_3AF_HU_NavSpeedLimitType == 0)
        {
            //type conversion to float
            rawValue_float = rawValue;        
            // raw to physical conversion
            phyValue = ((rawValue_float *1)+(0));
            putValue(E_pubc_GW_GW_3AF_HU_NavSpeedLimitType_Pv, phyValue);
            chgEv_GW_3AF_HU_NavSpeedLimitType = 1;
        }
        else
        {
            chgEv_GW_3AF_HU_NavSpeedLimitType = 0;
        }    
        //update the signal value
        Msg_GW_3AF.HU_NavSpeedLimitType=rawValue;        
    }                                                                           
}
/*@@end*/

/*@@envVar:E_pubc_GW_GW_3AF_HU_NavSpeedLimitType_Pv:*/
on envVar E_pubc_GW_GW_3AF_HU_NavSpeedLimitType_Pv
{
    int64 rawValue = 0ll;
    float phyValue = 0.0;
    
    //update the raw value with physical value 
    if(getValue(E_pubc_GW_GW_3AF_HU_NavSpeedLimitType_SetVt)==0)
    {
        if(chgEv_GW_3AF_HU_NavSpeedLimitType == 0)
        {
            phyValue = getvalue(this);
            // physical to raw conversion
            rawValue = ((phyValue -(0))/1);
            putValue(E_pubc_GW_GW_3AF_HU_NavSpeedLimitType_Rv, rawValue);
            chgEv_GW_3AF_HU_NavSpeedLimitType = 1;  
        }
        else
        {
            chgEv_GW_3AF_HU_NavSpeedLimitType = 0;
        }
    }
}
/*@@end*/

/*@@envVar:E_pubc_GW_GW_3AF_HU_NavSpeedLimitType_Vt:*/
on envVar E_pubc_GW_GW_3AF_HU_NavSpeedLimitType_Vt
{
    qword rawValue = 0ll;
    if(getValue(E_pubc_GW_GW_3AF_HU_NavSpeedLimitType_SetVt))
    {
        //update the signal value
        Msg_GW_3AF.HU_NavSpeedLimitType=getValue(this);
    }
}
/*@@end*/

/*@@envVar:E_pubc_GW_GW_3AF_HU_NavSpeedLimitType_SetVt:*/
on envVar E_pubc_GW_GW_3AF_HU_NavSpeedLimitType_SetVt
{
    if(getValue(E_pubc_GW_GW_3AF_HU_NavSpeedLimitType_SetVt))
    {
        //update the signal value
        Msg_GW_3AF.HU_NavSpeedLimitType=getvalue(E_pubc_GW_GW_3AF_HU_NavSpeedLimitType_Vt);
    }
    else
    {
        Msg_GW_3AF.HU_NavSpeedLimitType=getValue(E_pubc_GW_GW_3AF_HU_NavSpeedLimitType_Rv);
    }
}
/*@@end*/
 
/*@@envVar:E_pubc_GW_GW_3AF_HU_NavSpeedLimitUnits_Rv:*/
on envVar E_pubc_GW_GW_3AF_HU_NavSpeedLimitUnits_Rv
{
    int64 rawValue = 0ll;
    float rawValue_float = 0.0;
    float phyValue = 0.0;        

    //set the signal with updated raw value
    if(getValue(E_pubc_GW_GW_3AF_HU_NavSpeedLimitUnits_SetVt)==0)
    {
        rawValue = getvalue(this);
        if(chgEv_GW_3AF_HU_NavSpeedLimitUnits == 0)
        {
            //type conversion to float
            rawValue_float = rawValue;        
            // raw to physical conversion
            phyValue = ((rawValue_float *1)+(0));
            putValue(E_pubc_GW_GW_3AF_HU_NavSpeedLimitUnits_Pv, phyValue);
            chgEv_GW_3AF_HU_NavSpeedLimitUnits = 1;
        }
        else
        {
            chgEv_GW_3AF_HU_NavSpeedLimitUnits = 0;
        }    
        //update the signal value
        Msg_GW_3AF.HU_NavSpeedLimitUnits=rawValue;        
    }                                                                           
}
/*@@end*/

/*@@envVar:E_pubc_GW_GW_3AF_HU_NavSpeedLimitUnits_Pv:*/
on envVar E_pubc_GW_GW_3AF_HU_NavSpeedLimitUnits_Pv
{
    int64 rawValue = 0ll;
    float phyValue = 0.0;
    
    //update the raw value with physical value 
    if(getValue(E_pubc_GW_GW_3AF_HU_NavSpeedLimitUnits_SetVt)==0)
    {
        if(chgEv_GW_3AF_HU_NavSpeedLimitUnits == 0)
        {
            phyValue = getvalue(this);
            // physical to raw conversion
            rawValue = ((phyValue -(0))/1);
            putValue(E_pubc_GW_GW_3AF_HU_NavSpeedLimitUnits_Rv, rawValue);
            chgEv_GW_3AF_HU_NavSpeedLimitUnits = 1;  
        }
        else
        {
            chgEv_GW_3AF_HU_NavSpeedLimitUnits = 0;
        }
    }
}
/*@@end*/

/*@@envVar:E_pubc_GW_GW_3AF_HU_NavSpeedLimitUnits_Vt:*/
on envVar E_pubc_GW_GW_3AF_HU_NavSpeedLimitUnits_Vt
{
    qword rawValue = 0ll;
    if(getValue(E_pubc_GW_GW_3AF_HU_NavSpeedLimitUnits_SetVt))
    {
        //update the signal value
        Msg_GW_3AF.HU_NavSpeedLimitUnits=getValue(this);
    }
}
/*@@end*/

/*@@envVar:E_pubc_GW_GW_3AF_HU_NavSpeedLimitUnits_SetVt:*/
on envVar E_pubc_GW_GW_3AF_HU_NavSpeedLimitUnits_SetVt
{
    if(getValue(E_pubc_GW_GW_3AF_HU_NavSpeedLimitUnits_SetVt))
    {
        //update the signal value
        Msg_GW_3AF.HU_NavSpeedLimitUnits=getvalue(E_pubc_GW_GW_3AF_HU_NavSpeedLimitUnits_Vt);
    }
    else
    {
        Msg_GW_3AF.HU_NavSpeedLimitUnits=getValue(E_pubc_GW_GW_3AF_HU_NavSpeedLimitUnits_Rv);
    }
}
/*@@end*/
 
/*@@envVar:E_pubc_GW_GW_3AF_HU_ServiceRoadDis_Rv:*/
on envVar E_pubc_GW_GW_3AF_HU_ServiceRoadDis_Rv
{
    int64 rawValue = 0ll;
    float rawValue_float = 0.0;
    float phyValue = 0.0;        

    //set the signal with updated raw value
    if(getValue(E_pubc_GW_GW_3AF_HU_ServiceRoadDis_SetVt)==0)
    {
        rawValue = getvalue(this);
        if(chgEv_GW_3AF_HU_ServiceRoadDis == 0)
        {
            //type conversion to float
            rawValue_float = rawValue;        
            // raw to physical conversion
            phyValue = ((rawValue_float *10)+(0));
            putValue(E_pubc_GW_GW_3AF_HU_ServiceRoadDis_Pv, phyValue);
            chgEv_GW_3AF_HU_ServiceRoadDis = 1;
        }
        else
        {
            chgEv_GW_3AF_HU_ServiceRoadDis = 0;
        }    
        //update the signal value
        Msg_GW_3AF.HU_ServiceRoadDis=rawValue;        
    }                                                                           
}
/*@@end*/

/*@@envVar:E_pubc_GW_GW_3AF_HU_ServiceRoadDis_Pv:*/
on envVar E_pubc_GW_GW_3AF_HU_ServiceRoadDis_Pv
{
    int64 rawValue = 0ll;
    float phyValue = 0.0;
    
    //update the raw value with physical value 
    if(getValue(E_pubc_GW_GW_3AF_HU_ServiceRoadDis_SetVt)==0)
    {
        if(chgEv_GW_3AF_HU_ServiceRoadDis == 0)
        {
            phyValue = getvalue(this);
            // physical to raw conversion
            rawValue = ((phyValue -(0))/10);
            putValue(E_pubc_GW_GW_3AF_HU_ServiceRoadDis_Rv, rawValue);
            chgEv_GW_3AF_HU_ServiceRoadDis = 1;  
        }
        else
        {
            chgEv_GW_3AF_HU_ServiceRoadDis = 0;
        }
    }
}
/*@@end*/

/*@@envVar:E_pubc_GW_GW_3AF_HU_ServiceRoadDis_Vt:*/
on envVar E_pubc_GW_GW_3AF_HU_ServiceRoadDis_Vt
{
    qword rawValue = 0ll;
    if(getValue(E_pubc_GW_GW_3AF_HU_ServiceRoadDis_SetVt))
    {
        //update the signal value
        Msg_GW_3AF.HU_ServiceRoadDis=getValue(this);
    }
}
/*@@end*/

/*@@envVar:E_pubc_GW_GW_3AF_HU_ServiceRoadDis_SetVt:*/
on envVar E_pubc_GW_GW_3AF_HU_ServiceRoadDis_SetVt
{
    if(getValue(E_pubc_GW_GW_3AF_HU_ServiceRoadDis_SetVt))
    {
        //update the signal value
        Msg_GW_3AF.HU_ServiceRoadDis=getvalue(E_pubc_GW_GW_3AF_HU_ServiceRoadDis_Vt);
    }
    else
    {
        Msg_GW_3AF.HU_ServiceRoadDis=getValue(E_pubc_GW_GW_3AF_HU_ServiceRoadDis_Rv);
    }
}
/*@@end*/
 
/*@@envVar:E_pubc_GW_GW_3AF_HU_WeatherType_Rv:*/
on envVar E_pubc_GW_GW_3AF_HU_WeatherType_Rv
{
    int64 rawValue = 0ll;
    float rawValue_float = 0.0;
    float phyValue = 0.0;        

    //set the signal with updated raw value
    {
        rawValue = getvalue(this);
        if(chgEv_GW_3AF_HU_WeatherType == 0)
        {
            //type conversion to float
            rawValue_float = rawValue;        
            // raw to physical conversion
            phyValue = ((rawValue_float *1)+(0));
            putValue(E_pubc_GW_GW_3AF_HU_WeatherType_Pv, phyValue);
            chgEv_GW_3AF_HU_WeatherType = 1;
        }
        else
        {
            chgEv_GW_3AF_HU_WeatherType = 0;
        }    
        //update the signal value
        Msg_GW_3AF.HU_WeatherType=rawValue;        
    }                                                                           
}
/*@@end*/

/*@@envVar:E_pubc_GW_GW_3AF_HU_WeatherType_Pv:*/
on envVar E_pubc_GW_GW_3AF_HU_WeatherType_Pv
{
    int64 rawValue = 0ll;
    float phyValue = 0.0;
    
    //update the raw value with physical value 
    {
        if(chgEv_GW_3AF_HU_WeatherType == 0)
        {
            phyValue = getvalue(this);
            // physical to raw conversion
            rawValue = ((phyValue -(0))/1);
            putValue(E_pubc_GW_GW_3AF_HU_WeatherType_Rv, rawValue);
            chgEv_GW_3AF_HU_WeatherType = 1;  
        }
        else
        {
            chgEv_GW_3AF_HU_WeatherType = 0;
        }
    }
}
/*@@end*/


 
/*@@envVar:E_pubc_GW_GW_3AF_HU_EnterCurveInfo_Rv:*/
on envVar E_pubc_GW_GW_3AF_HU_EnterCurveInfo_Rv
{
    int64 rawValue = 0ll;
    float rawValue_float = 0.0;
    float phyValue = 0.0;        

    //set the signal with updated raw value
    if(getValue(E_pubc_GW_GW_3AF_HU_EnterCurveInfo_SetVt)==0)
    {
        rawValue = getvalue(this);
        if(chgEv_GW_3AF_HU_EnterCurveInfo == 0)
        {
            //type conversion to float
            rawValue_float = rawValue;        
            // raw to physical conversion
            phyValue = ((rawValue_float *1)+(0));
            putValue(E_pubc_GW_GW_3AF_HU_EnterCurveInfo_Pv, phyValue);
            chgEv_GW_3AF_HU_EnterCurveInfo = 1;
        }
        else
        {
            chgEv_GW_3AF_HU_EnterCurveInfo = 0;
        }    
        //update the signal value
        Msg_GW_3AF.HU_EnterCurveInfo=rawValue;        
    }                                                                           
}
/*@@end*/

/*@@envVar:E_pubc_GW_GW_3AF_HU_EnterCurveInfo_Pv:*/
on envVar E_pubc_GW_GW_3AF_HU_EnterCurveInfo_Pv
{
    int64 rawValue = 0ll;
    float phyValue = 0.0;
    
    //update the raw value with physical value 
    if(getValue(E_pubc_GW_GW_3AF_HU_EnterCurveInfo_SetVt)==0)
    {
        if(chgEv_GW_3AF_HU_EnterCurveInfo == 0)
        {
            phyValue = getvalue(this);
            // physical to raw conversion
            rawValue = ((phyValue -(0))/1);
            putValue(E_pubc_GW_GW_3AF_HU_EnterCurveInfo_Rv, rawValue);
            chgEv_GW_3AF_HU_EnterCurveInfo = 1;  
        }
        else
        {
            chgEv_GW_3AF_HU_EnterCurveInfo = 0;
        }
    }
}
/*@@end*/

/*@@envVar:E_pubc_GW_GW_3AF_HU_EnterCurveInfo_Vt:*/
on envVar E_pubc_GW_GW_3AF_HU_EnterCurveInfo_Vt
{
    qword rawValue = 0ll;
    if(getValue(E_pubc_GW_GW_3AF_HU_EnterCurveInfo_SetVt))
    {
        //update the signal value
        Msg_GW_3AF.HU_EnterCurveInfo=getValue(this);
    }
}
/*@@end*/

/*@@envVar:E_pubc_GW_GW_3AF_HU_EnterCurveInfo_SetVt:*/
on envVar E_pubc_GW_GW_3AF_HU_EnterCurveInfo_SetVt
{
    if(getValue(E_pubc_GW_GW_3AF_HU_EnterCurveInfo_SetVt))
    {
        //update the signal value
        Msg_GW_3AF.HU_EnterCurveInfo=getvalue(E_pubc_GW_GW_3AF_HU_EnterCurveInfo_Vt);
    }
    else
    {
        Msg_GW_3AF.HU_EnterCurveInfo=getValue(E_pubc_GW_GW_3AF_HU_EnterCurveInfo_Rv);
    }
}
/*@@end*/
 
/*@@envVar:E_pubc_GW_GW_3AF_HU_ServiceRoad_Rv:*/
on envVar E_pubc_GW_GW_3AF_HU_ServiceRoad_Rv
{
    int64 rawValue = 0ll;
    float rawValue_float = 0.0;
    float phyValue = 0.0;        

    //set the signal with updated raw value
    if(getValue(E_pubc_GW_GW_3AF_HU_ServiceRoad_SetVt)==0)
    {
        rawValue = getvalue(this);
        if(chgEv_GW_3AF_HU_ServiceRoad == 0)
        {
            //type conversion to float
            rawValue_float = rawValue;        
            // raw to physical conversion
            phyValue = ((rawValue_float *1)+(0));
            putValue(E_pubc_GW_GW_3AF_HU_ServiceRoad_Pv, phyValue);
            chgEv_GW_3AF_HU_ServiceRoad = 1;
        }
        else
        {
            chgEv_GW_3AF_HU_ServiceRoad = 0;
        }    
        //update the signal value
        Msg_GW_3AF.HU_ServiceRoad=rawValue;        
    }                                                                           
}
/*@@end*/

/*@@envVar:E_pubc_GW_GW_3AF_HU_ServiceRoad_Pv:*/
on envVar E_pubc_GW_GW_3AF_HU_ServiceRoad_Pv
{
    int64 rawValue = 0ll;
    float phyValue = 0.0;
    
    //update the raw value with physical value 
    if(getValue(E_pubc_GW_GW_3AF_HU_ServiceRoad_SetVt)==0)
    {
        if(chgEv_GW_3AF_HU_ServiceRoad == 0)
        {
            phyValue = getvalue(this);
            // physical to raw conversion
            rawValue = ((phyValue -(0))/1);
            putValue(E_pubc_GW_GW_3AF_HU_ServiceRoad_Rv, rawValue);
            chgEv_GW_3AF_HU_ServiceRoad = 1;  
        }
        else
        {
            chgEv_GW_3AF_HU_ServiceRoad = 0;
        }
    }
}
/*@@end*/

/*@@envVar:E_pubc_GW_GW_3AF_HU_ServiceRoad_Vt:*/
on envVar E_pubc_GW_GW_3AF_HU_ServiceRoad_Vt
{
    qword rawValue = 0ll;
    if(getValue(E_pubc_GW_GW_3AF_HU_ServiceRoad_SetVt))
    {
        //update the signal value
        Msg_GW_3AF.HU_ServiceRoad=getValue(this);
    }
}
/*@@end*/

/*@@envVar:E_pubc_GW_GW_3AF_HU_ServiceRoad_SetVt:*/
on envVar E_pubc_GW_GW_3AF_HU_ServiceRoad_SetVt
{
    if(getValue(E_pubc_GW_GW_3AF_HU_ServiceRoad_SetVt))
    {
        //update the signal value
        Msg_GW_3AF.HU_ServiceRoad=getvalue(E_pubc_GW_GW_3AF_HU_ServiceRoad_Vt);
    }
    else
    {
        Msg_GW_3AF.HU_ServiceRoad=getValue(E_pubc_GW_GW_3AF_HU_ServiceRoad_Rv);
    }
}
/*@@end*/
 
/*@@envVar:E_pubc_GW_GW_3AF_HU_SlopeGradient_100m_Rv:*/
on envVar E_pubc_GW_GW_3AF_HU_SlopeGradient_100m_Rv
{
    int64 rawValue = 0ll;
    float rawValue_float = 0.0;
    float phyValue = 0.0;        

    //set the signal with updated raw value
    {
        rawValue = getvalue(this);
        if(chgEv_GW_3AF_HU_SlopeGradient_100m == 0)
        {
            //type conversion to float
            rawValue_float = rawValue;        
            // raw to physical conversion
            phyValue = ((rawValue_float *0.1)+(-51.1));
            putValue(E_pubc_GW_GW_3AF_HU_SlopeGradient_100m_Pv, phyValue);
            chgEv_GW_3AF_HU_SlopeGradient_100m = 1;
        }
        else
        {
            chgEv_GW_3AF_HU_SlopeGradient_100m = 0;
        }    
        //update the signal value
        Msg_GW_3AF.HU_SlopeGradient_100m=rawValue;        
    }                                                                           
}
/*@@end*/

/*@@envVar:E_pubc_GW_GW_3AF_HU_SlopeGradient_100m_Pv:*/
on envVar E_pubc_GW_GW_3AF_HU_SlopeGradient_100m_Pv
{
    int64 rawValue = 0ll;
    float phyValue = 0.0;
    
    //update the raw value with physical value 
    {
        if(chgEv_GW_3AF_HU_SlopeGradient_100m == 0)
        {
            phyValue = getvalue(this);
            // physical to raw conversion
            rawValue = ((phyValue -(-51.1))/0.1);
            putValue(E_pubc_GW_GW_3AF_HU_SlopeGradient_100m_Rv, rawValue);
            chgEv_GW_3AF_HU_SlopeGradient_100m = 1;  
        }
        else
        {
            chgEv_GW_3AF_HU_SlopeGradient_100m = 0;
        }
    }
}
/*@@end*/


 
/*@@envVar:E_pubc_GW_GW_3AF_HU_LaneConfluenceDis_Rv:*/
on envVar E_pubc_GW_GW_3AF_HU_LaneConfluenceDis_Rv
{
    int64 rawValue = 0ll;
    float rawValue_float = 0.0;
    float phyValue = 0.0;        

    //set the signal with updated raw value
    if(getValue(E_pubc_GW_GW_3AF_HU_LaneConfluenceDis_SetVt)==0)
    {
        rawValue = getvalue(this);
        if(chgEv_GW_3AF_HU_LaneConfluenceDis == 0)
        {
            //type conversion to float
            rawValue_float = rawValue;        
            // raw to physical conversion
            phyValue = ((rawValue_float *10)+(0));
            putValue(E_pubc_GW_GW_3AF_HU_LaneConfluenceDis_Pv, phyValue);
            chgEv_GW_3AF_HU_LaneConfluenceDis = 1;
        }
        else
        {
            chgEv_GW_3AF_HU_LaneConfluenceDis = 0;
        }    
        //update the signal value
        Msg_GW_3AF.HU_LaneConfluenceDis=rawValue;        
    }                                                                           
}
/*@@end*/

/*@@envVar:E_pubc_GW_GW_3AF_HU_LaneConfluenceDis_Pv:*/
on envVar E_pubc_GW_GW_3AF_HU_LaneConfluenceDis_Pv
{
    int64 rawValue = 0ll;
    float phyValue = 0.0;
    
    //update the raw value with physical value 
    if(getValue(E_pubc_GW_GW_3AF_HU_LaneConfluenceDis_SetVt)==0)
    {
        if(chgEv_GW_3AF_HU_LaneConfluenceDis == 0)
        {
            phyValue = getvalue(this);
            // physical to raw conversion
            rawValue = ((phyValue -(0))/10);
            putValue(E_pubc_GW_GW_3AF_HU_LaneConfluenceDis_Rv, rawValue);
            chgEv_GW_3AF_HU_LaneConfluenceDis = 1;  
        }
        else
        {
            chgEv_GW_3AF_HU_LaneConfluenceDis = 0;
        }
    }
}
/*@@end*/

/*@@envVar:E_pubc_GW_GW_3AF_HU_LaneConfluenceDis_Vt:*/
on envVar E_pubc_GW_GW_3AF_HU_LaneConfluenceDis_Vt
{
    qword rawValue = 0ll;
    if(getValue(E_pubc_GW_GW_3AF_HU_LaneConfluenceDis_SetVt))
    {
        //update the signal value
        Msg_GW_3AF.HU_LaneConfluenceDis=getValue(this);
    }
}
/*@@end*/

/*@@envVar:E_pubc_GW_GW_3AF_HU_LaneConfluenceDis_SetVt:*/
on envVar E_pubc_GW_GW_3AF_HU_LaneConfluenceDis_SetVt
{
    if(getValue(E_pubc_GW_GW_3AF_HU_LaneConfluenceDis_SetVt))
    {
        //update the signal value
        Msg_GW_3AF.HU_LaneConfluenceDis=getvalue(E_pubc_GW_GW_3AF_HU_LaneConfluenceDis_Vt);
    }
    else
    {
        Msg_GW_3AF.HU_LaneConfluenceDis=getValue(E_pubc_GW_GW_3AF_HU_LaneConfluenceDis_Rv);
    }
}
/*@@end*/
 
/*@@envVar:E_pubc_GW_GW_3AF_HU_AccidentProneDistance_Rv:*/
on envVar E_pubc_GW_GW_3AF_HU_AccidentProneDistance_Rv
{
    int64 rawValue = 0ll;
    float rawValue_float = 0.0;
    float phyValue = 0.0;        

    //set the signal with updated raw value
    if(getValue(E_pubc_GW_GW_3AF_HU_AccidentProneDistance_SetVt)==0)
    {
        rawValue = getvalue(this);
        if(chgEv_GW_3AF_HU_AccidentProneDistance == 0)
        {
            //type conversion to float
            rawValue_float = rawValue;        
            // raw to physical conversion
            phyValue = ((rawValue_float *10)+(0));
            putValue(E_pubc_GW_GW_3AF_HU_AccidentProneDistance_Pv, phyValue);
            chgEv_GW_3AF_HU_AccidentProneDistance = 1;
        }
        else
        {
            chgEv_GW_3AF_HU_AccidentProneDistance = 0;
        }    
        //update the signal value
        Msg_GW_3AF.HU_AccidentProneDistance=rawValue;        
    }                                                                           
}
/*@@end*/

/*@@envVar:E_pubc_GW_GW_3AF_HU_AccidentProneDistance_Pv:*/
on envVar E_pubc_GW_GW_3AF_HU_AccidentProneDistance_Pv
{
    int64 rawValue = 0ll;
    float phyValue = 0.0;
    
    //update the raw value with physical value 
    if(getValue(E_pubc_GW_GW_3AF_HU_AccidentProneDistance_SetVt)==0)
    {
        if(chgEv_GW_3AF_HU_AccidentProneDistance == 0)
        {
            phyValue = getvalue(this);
            // physical to raw conversion
            rawValue = ((phyValue -(0))/10);
            putValue(E_pubc_GW_GW_3AF_HU_AccidentProneDistance_Rv, rawValue);
            chgEv_GW_3AF_HU_AccidentProneDistance = 1;  
        }
        else
        {
            chgEv_GW_3AF_HU_AccidentProneDistance = 0;
        }
    }
}
/*@@end*/

/*@@envVar:E_pubc_GW_GW_3AF_HU_AccidentProneDistance_Vt:*/
on envVar E_pubc_GW_GW_3AF_HU_AccidentProneDistance_Vt
{
    qword rawValue = 0ll;
    if(getValue(E_pubc_GW_GW_3AF_HU_AccidentProneDistance_SetVt))
    {
        //update the signal value
        Msg_GW_3AF.HU_AccidentProneDistance=getValue(this);
    }
}
/*@@end*/

/*@@envVar:E_pubc_GW_GW_3AF_HU_AccidentProneDistance_SetVt:*/
on envVar E_pubc_GW_GW_3AF_HU_AccidentProneDistance_SetVt
{
    if(getValue(E_pubc_GW_GW_3AF_HU_AccidentProneDistance_SetVt))
    {
        //update the signal value
        Msg_GW_3AF.HU_AccidentProneDistance=getvalue(E_pubc_GW_GW_3AF_HU_AccidentProneDistance_Vt);
    }
    else
    {
        Msg_GW_3AF.HU_AccidentProneDistance=getValue(E_pubc_GW_GW_3AF_HU_AccidentProneDistance_Rv);
    }
}
/*@@end*/
 
/*@@envVar:E_pubc_GW_GW_3AF_HU_SlopeGradient_30m_Rv:*/
on envVar E_pubc_GW_GW_3AF_HU_SlopeGradient_30m_Rv
{
    int64 rawValue = 0ll;
    float rawValue_float = 0.0;
    float phyValue = 0.0;        

    //set the signal with updated raw value
    {
        rawValue = getvalue(this);
        if(chgEv_GW_3AF_HU_SlopeGradient_30m == 0)
        {
            //type conversion to float
            rawValue_float = rawValue;        
            // raw to physical conversion
            phyValue = ((rawValue_float *0.1)+(-51.1));
            putValue(E_pubc_GW_GW_3AF_HU_SlopeGradient_30m_Pv, phyValue);
            chgEv_GW_3AF_HU_SlopeGradient_30m = 1;
        }
        else
        {
            chgEv_GW_3AF_HU_SlopeGradient_30m = 0;
        }    
        //update the signal value
        Msg_GW_3AF.HU_SlopeGradient_30m=rawValue;        
    }                                                                           
}
/*@@end*/

/*@@envVar:E_pubc_GW_GW_3AF_HU_SlopeGradient_30m_Pv:*/
on envVar E_pubc_GW_GW_3AF_HU_SlopeGradient_30m_Pv
{
    int64 rawValue = 0ll;
    float phyValue = 0.0;
    
    //update the raw value with physical value 
    {
        if(chgEv_GW_3AF_HU_SlopeGradient_30m == 0)
        {
            phyValue = getvalue(this);
            // physical to raw conversion
            rawValue = ((phyValue -(-51.1))/0.1);
            putValue(E_pubc_GW_GW_3AF_HU_SlopeGradient_30m_Rv, rawValue);
            chgEv_GW_3AF_HU_SlopeGradient_30m = 1;  
        }
        else
        {
            chgEv_GW_3AF_HU_SlopeGradient_30m = 0;
        }
    }
}
/*@@end*/


 
/*@@envVar:E_pubc_GW_GW_3AF_HU_LaneConfluence_Rv:*/
on envVar E_pubc_GW_GW_3AF_HU_LaneConfluence_Rv
{
    int64 rawValue = 0ll;
    float rawValue_float = 0.0;
    float phyValue = 0.0;        

    //set the signal with updated raw value
    if(getValue(E_pubc_GW_GW_3AF_HU_LaneConfluence_SetVt)==0)
    {
        rawValue = getvalue(this);
        if(chgEv_GW_3AF_HU_LaneConfluence == 0)
        {
            //type conversion to float
            rawValue_float = rawValue;        
            // raw to physical conversion
            phyValue = ((rawValue_float *1)+(0));
            putValue(E_pubc_GW_GW_3AF_HU_LaneConfluence_Pv, phyValue);
            chgEv_GW_3AF_HU_LaneConfluence = 1;
        }
        else
        {
            chgEv_GW_3AF_HU_LaneConfluence = 0;
        }    
        //update the signal value
        Msg_GW_3AF.HU_LaneConfluence=rawValue;        
    }                                                                           
}
/*@@end*/

/*@@envVar:E_pubc_GW_GW_3AF_HU_LaneConfluence_Pv:*/
on envVar E_pubc_GW_GW_3AF_HU_LaneConfluence_Pv
{
    int64 rawValue = 0ll;
    float phyValue = 0.0;
    
    //update the raw value with physical value 
    if(getValue(E_pubc_GW_GW_3AF_HU_LaneConfluence_SetVt)==0)
    {
        if(chgEv_GW_3AF_HU_LaneConfluence == 0)
        {
            phyValue = getvalue(this);
            // physical to raw conversion
            rawValue = ((phyValue -(0))/1);
            putValue(E_pubc_GW_GW_3AF_HU_LaneConfluence_Rv, rawValue);
            chgEv_GW_3AF_HU_LaneConfluence = 1;  
        }
        else
        {
            chgEv_GW_3AF_HU_LaneConfluence = 0;
        }
    }
}
/*@@end*/

/*@@envVar:E_pubc_GW_GW_3AF_HU_LaneConfluence_Vt:*/
on envVar E_pubc_GW_GW_3AF_HU_LaneConfluence_Vt
{
    qword rawValue = 0ll;
    if(getValue(E_pubc_GW_GW_3AF_HU_LaneConfluence_SetVt))
    {
        //update the signal value
        Msg_GW_3AF.HU_LaneConfluence=getValue(this);
    }
}
/*@@end*/

/*@@envVar:E_pubc_GW_GW_3AF_HU_LaneConfluence_SetVt:*/
on envVar E_pubc_GW_GW_3AF_HU_LaneConfluence_SetVt
{
    if(getValue(E_pubc_GW_GW_3AF_HU_LaneConfluence_SetVt))
    {
        //update the signal value
        Msg_GW_3AF.HU_LaneConfluence=getvalue(E_pubc_GW_GW_3AF_HU_LaneConfluence_Vt);
    }
    else
    {
        Msg_GW_3AF.HU_LaneConfluence=getValue(E_pubc_GW_GW_3AF_HU_LaneConfluence_Rv);
    }
}
/*@@end*/
 
/*@@envVar:E_pubc_GW_GW_3AF_HU_BridgeInfo_Rv:*/
on envVar E_pubc_GW_GW_3AF_HU_BridgeInfo_Rv
{
    int64 rawValue = 0ll;
    float rawValue_float = 0.0;
    float phyValue = 0.0;        

    //set the signal with updated raw value
    if(getValue(E_pubc_GW_GW_3AF_HU_BridgeInfo_SetVt)==0)
    {
        rawValue = getvalue(this);
        if(chgEv_GW_3AF_HU_BridgeInfo == 0)
        {
            //type conversion to float
            rawValue_float = rawValue;        
            // raw to physical conversion
            phyValue = ((rawValue_float *1)+(0));
            putValue(E_pubc_GW_GW_3AF_HU_BridgeInfo_Pv, phyValue);
            chgEv_GW_3AF_HU_BridgeInfo = 1;
        }
        else
        {
            chgEv_GW_3AF_HU_BridgeInfo = 0;
        }    
        //update the signal value
        Msg_GW_3AF.HU_BridgeInfo=rawValue;        
    }                                                                           
}
/*@@end*/

/*@@envVar:E_pubc_GW_GW_3AF_HU_BridgeInfo_Pv:*/
on envVar E_pubc_GW_GW_3AF_HU_BridgeInfo_Pv
{
    int64 rawValue = 0ll;
    float phyValue = 0.0;
    
    //update the raw value with physical value 
    if(getValue(E_pubc_GW_GW_3AF_HU_BridgeInfo_SetVt)==0)
    {
        if(chgEv_GW_3AF_HU_BridgeInfo == 0)
        {
            phyValue = getvalue(this);
            // physical to raw conversion
            rawValue = ((phyValue -(0))/1);
            putValue(E_pubc_GW_GW_3AF_HU_BridgeInfo_Rv, rawValue);
            chgEv_GW_3AF_HU_BridgeInfo = 1;  
        }
        else
        {
            chgEv_GW_3AF_HU_BridgeInfo = 0;
        }
    }
}
/*@@end*/

/*@@envVar:E_pubc_GW_GW_3AF_HU_BridgeInfo_Vt:*/
on envVar E_pubc_GW_GW_3AF_HU_BridgeInfo_Vt
{
    qword rawValue = 0ll;
    if(getValue(E_pubc_GW_GW_3AF_HU_BridgeInfo_SetVt))
    {
        //update the signal value
        Msg_GW_3AF.HU_BridgeInfo=getValue(this);
    }
}
/*@@end*/

/*@@envVar:E_pubc_GW_GW_3AF_HU_BridgeInfo_SetVt:*/
on envVar E_pubc_GW_GW_3AF_HU_BridgeInfo_SetVt
{
    if(getValue(E_pubc_GW_GW_3AF_HU_BridgeInfo_SetVt))
    {
        //update the signal value
        Msg_GW_3AF.HU_BridgeInfo=getvalue(E_pubc_GW_GW_3AF_HU_BridgeInfo_Vt);
    }
    else
    {
        Msg_GW_3AF.HU_BridgeInfo=getValue(E_pubc_GW_GW_3AF_HU_BridgeInfo_Rv);
    }
}
/*@@end*/
 
/*@@envVar:E_pubc_GW_GW_3AF_HU_SlopeGradient_20m_Rv:*/
on envVar E_pubc_GW_GW_3AF_HU_SlopeGradient_20m_Rv
{
    int64 rawValue = 0ll;
    float rawValue_float = 0.0;
    float phyValue = 0.0;        

    //set the signal with updated raw value
    {
        rawValue = getvalue(this);
        if(chgEv_GW_3AF_HU_SlopeGradient_20m == 0)
        {
            //type conversion to float
            rawValue_float = rawValue;        
            // raw to physical conversion
            phyValue = ((rawValue_float *0.1)+(-51.1));
            putValue(E_pubc_GW_GW_3AF_HU_SlopeGradient_20m_Pv, phyValue);
            chgEv_GW_3AF_HU_SlopeGradient_20m = 1;
        }
        else
        {
            chgEv_GW_3AF_HU_SlopeGradient_20m = 0;
        }    
        //update the signal value
        Msg_GW_3AF.HU_SlopeGradient_20m=rawValue;        
    }                                                                           
}
/*@@end*/

/*@@envVar:E_pubc_GW_GW_3AF_HU_SlopeGradient_20m_Pv:*/
on envVar E_pubc_GW_GW_3AF_HU_SlopeGradient_20m_Pv
{
    int64 rawValue = 0ll;
    float phyValue = 0.0;
    
    //update the raw value with physical value 
    {
        if(chgEv_GW_3AF_HU_SlopeGradient_20m == 0)
        {
            phyValue = getvalue(this);
            // physical to raw conversion
            rawValue = ((phyValue -(-51.1))/0.1);
            putValue(E_pubc_GW_GW_3AF_HU_SlopeGradient_20m_Rv, rawValue);
            chgEv_GW_3AF_HU_SlopeGradient_20m = 1;  
        }
        else
        {
            chgEv_GW_3AF_HU_SlopeGradient_20m = 0;
        }
    }
}
/*@@end*/


 
/*@@envVar:E_pubc_GW_GW_3AF_HU_NavSpeedLimit_Rv:*/
on envVar E_pubc_GW_GW_3AF_HU_NavSpeedLimit_Rv
{
    int64 rawValue = 0ll;
    float rawValue_float = 0.0;
    float phyValue = 0.0;        

    //set the signal with updated raw value
    if(getValue(E_pubc_GW_GW_3AF_HU_NavSpeedLimit_SetVt)==0)
    {
        rawValue = getvalue(this);
        if(chgEv_GW_3AF_HU_NavSpeedLimit == 0)
        {
            //type conversion to float
            rawValue_float = rawValue;        
            // raw to physical conversion
            phyValue = ((rawValue_float *1)+(0));
            putValue(E_pubc_GW_GW_3AF_HU_NavSpeedLimit_Pv, phyValue);
            chgEv_GW_3AF_HU_NavSpeedLimit = 1;
        }
        else
        {
            chgEv_GW_3AF_HU_NavSpeedLimit = 0;
        }    
        //update the signal value
        Msg_GW_3AF.HU_NavSpeedLimit=rawValue;        
    }                                                                           
}
/*@@end*/

/*@@envVar:E_pubc_GW_GW_3AF_HU_NavSpeedLimit_Pv:*/
on envVar E_pubc_GW_GW_3AF_HU_NavSpeedLimit_Pv
{
    int64 rawValue = 0ll;
    float phyValue = 0.0;
    
    //update the raw value with physical value 
    if(getValue(E_pubc_GW_GW_3AF_HU_NavSpeedLimit_SetVt)==0)
    {
        if(chgEv_GW_3AF_HU_NavSpeedLimit == 0)
        {
            phyValue = getvalue(this);
            // physical to raw conversion
            rawValue = ((phyValue -(0))/1);
            putValue(E_pubc_GW_GW_3AF_HU_NavSpeedLimit_Rv, rawValue);
            chgEv_GW_3AF_HU_NavSpeedLimit = 1;  
        }
        else
        {
            chgEv_GW_3AF_HU_NavSpeedLimit = 0;
        }
    }
}
/*@@end*/

/*@@envVar:E_pubc_GW_GW_3AF_HU_NavSpeedLimit_Vt:*/
on envVar E_pubc_GW_GW_3AF_HU_NavSpeedLimit_Vt
{
    qword rawValue = 0ll;
    if(getValue(E_pubc_GW_GW_3AF_HU_NavSpeedLimit_SetVt))
    {
        //update the signal value
        Msg_GW_3AF.HU_NavSpeedLimit=getValue(this);
    }
}
/*@@end*/

/*@@envVar:E_pubc_GW_GW_3AF_HU_NavSpeedLimit_SetVt:*/
on envVar E_pubc_GW_GW_3AF_HU_NavSpeedLimit_SetVt
{
    if(getValue(E_pubc_GW_GW_3AF_HU_NavSpeedLimit_SetVt))
    {
        //update the signal value
        Msg_GW_3AF.HU_NavSpeedLimit=getvalue(E_pubc_GW_GW_3AF_HU_NavSpeedLimit_Vt);
    }
    else
    {
        Msg_GW_3AF.HU_NavSpeedLimit=getValue(E_pubc_GW_GW_3AF_HU_NavSpeedLimit_Rv);
    }
}
/*@@end*/
 
/*@@envVar:E_pubc_GW_GW_3AF_HU_SlopeGradient_10m_Rv:*/
on envVar E_pubc_GW_GW_3AF_HU_SlopeGradient_10m_Rv
{
    int64 rawValue = 0ll;
    float rawValue_float = 0.0;
    float phyValue = 0.0;        

    //set the signal with updated raw value
    {
        rawValue = getvalue(this);
        if(chgEv_GW_3AF_HU_SlopeGradient_10m == 0)
        {
            //type conversion to float
            rawValue_float = rawValue;        
            // raw to physical conversion
            phyValue = ((rawValue_float *0.1)+(-51.1));
            putValue(E_pubc_GW_GW_3AF_HU_SlopeGradient_10m_Pv, phyValue);
            chgEv_GW_3AF_HU_SlopeGradient_10m = 1;
        }
        else
        {
            chgEv_GW_3AF_HU_SlopeGradient_10m = 0;
        }    
        //update the signal value
        Msg_GW_3AF.HU_SlopeGradient_10m=rawValue;        
    }                                                                           
}
/*@@end*/

/*@@envVar:E_pubc_GW_GW_3AF_HU_SlopeGradient_10m_Pv:*/
on envVar E_pubc_GW_GW_3AF_HU_SlopeGradient_10m_Pv
{
    int64 rawValue = 0ll;
    float phyValue = 0.0;
    
    //update the raw value with physical value 
    {
        if(chgEv_GW_3AF_HU_SlopeGradient_10m == 0)
        {
            phyValue = getvalue(this);
            // physical to raw conversion
            rawValue = ((phyValue -(-51.1))/0.1);
            putValue(E_pubc_GW_GW_3AF_HU_SlopeGradient_10m_Rv, rawValue);
            chgEv_GW_3AF_HU_SlopeGradient_10m = 1;  
        }
        else
        {
            chgEv_GW_3AF_HU_SlopeGradient_10m = 0;
        }
    }
}
/*@@end*/


 
/*@@envVar:E_pubc_GW_GW_3AF_HU_RampDistance_Rv:*/
on envVar E_pubc_GW_GW_3AF_HU_RampDistance_Rv
{
    int64 rawValue = 0ll;
    float rawValue_float = 0.0;
    float phyValue = 0.0;        

    //set the signal with updated raw value
    if(getValue(E_pubc_GW_GW_3AF_HU_RampDistance_SetVt)==0)
    {
        rawValue = getvalue(this);
        if(chgEv_GW_3AF_HU_RampDistance == 0)
        {
            //type conversion to float
            rawValue_float = rawValue;        
            // raw to physical conversion
            phyValue = ((rawValue_float *10)+(0));
            putValue(E_pubc_GW_GW_3AF_HU_RampDistance_Pv, phyValue);
            chgEv_GW_3AF_HU_RampDistance = 1;
        }
        else
        {
            chgEv_GW_3AF_HU_RampDistance = 0;
        }    
        //update the signal value
        Msg_GW_3AF.HU_RampDistance=rawValue;        
    }                                                                           
}
/*@@end*/

/*@@envVar:E_pubc_GW_GW_3AF_HU_RampDistance_Pv:*/
on envVar E_pubc_GW_GW_3AF_HU_RampDistance_Pv
{
    int64 rawValue = 0ll;
    float phyValue = 0.0;
    
    //update the raw value with physical value 
    if(getValue(E_pubc_GW_GW_3AF_HU_RampDistance_SetVt)==0)
    {
        if(chgEv_GW_3AF_HU_RampDistance == 0)
        {
            phyValue = getvalue(this);
            // physical to raw conversion
            rawValue = ((phyValue -(0))/10);
            putValue(E_pubc_GW_GW_3AF_HU_RampDistance_Rv, rawValue);
            chgEv_GW_3AF_HU_RampDistance = 1;  
        }
        else
        {
            chgEv_GW_3AF_HU_RampDistance = 0;
        }
    }
}
/*@@end*/

/*@@envVar:E_pubc_GW_GW_3AF_HU_RampDistance_Vt:*/
on envVar E_pubc_GW_GW_3AF_HU_RampDistance_Vt
{
    qword rawValue = 0ll;
    if(getValue(E_pubc_GW_GW_3AF_HU_RampDistance_SetVt))
    {
        //update the signal value
        Msg_GW_3AF.HU_RampDistance=getValue(this);
    }
}
/*@@end*/

/*@@envVar:E_pubc_GW_GW_3AF_HU_RampDistance_SetVt:*/
on envVar E_pubc_GW_GW_3AF_HU_RampDistance_SetVt
{
    if(getValue(E_pubc_GW_GW_3AF_HU_RampDistance_SetVt))
    {
        //update the signal value
        Msg_GW_3AF.HU_RampDistance=getvalue(E_pubc_GW_GW_3AF_HU_RampDistance_Vt);
    }
    else
    {
        Msg_GW_3AF.HU_RampDistance=getValue(E_pubc_GW_GW_3AF_HU_RampDistance_Rv);
    }
}
/*@@end*/
 
/*@@envVar:E_pubc_GW_GW_3AF_HU_NavSpeedLimitStatus_Rv:*/
on envVar E_pubc_GW_GW_3AF_HU_NavSpeedLimitStatus_Rv
{
    int64 rawValue = 0ll;
    float rawValue_float = 0.0;
    float phyValue = 0.0;        

    //set the signal with updated raw value
    if(getValue(E_pubc_GW_GW_3AF_HU_NavSpeedLimitStatus_SetVt)==0)
    {
        rawValue = getvalue(this);
        if(chgEv_GW_3AF_HU_NavSpeedLimitStatus == 0)
        {
            //type conversion to float
            rawValue_float = rawValue;        
            // raw to physical conversion
            phyValue = ((rawValue_float *1)+(0));
            putValue(E_pubc_GW_GW_3AF_HU_NavSpeedLimitStatus_Pv, phyValue);
            chgEv_GW_3AF_HU_NavSpeedLimitStatus = 1;
        }
        else
        {
            chgEv_GW_3AF_HU_NavSpeedLimitStatus = 0;
        }    
        //update the signal value
        Msg_GW_3AF.HU_NavSpeedLimitStatus=rawValue;        
    }                                                                           
}
/*@@end*/

/*@@envVar:E_pubc_GW_GW_3AF_HU_NavSpeedLimitStatus_Pv:*/
on envVar E_pubc_GW_GW_3AF_HU_NavSpeedLimitStatus_Pv
{
    int64 rawValue = 0ll;
    float phyValue = 0.0;
    
    //update the raw value with physical value 
    if(getValue(E_pubc_GW_GW_3AF_HU_NavSpeedLimitStatus_SetVt)==0)
    {
        if(chgEv_GW_3AF_HU_NavSpeedLimitStatus == 0)
        {
            phyValue = getvalue(this);
            // physical to raw conversion
            rawValue = ((phyValue -(0))/1);
            putValue(E_pubc_GW_GW_3AF_HU_NavSpeedLimitStatus_Rv, rawValue);
            chgEv_GW_3AF_HU_NavSpeedLimitStatus = 1;  
        }
        else
        {
            chgEv_GW_3AF_HU_NavSpeedLimitStatus = 0;
        }
    }
}
/*@@end*/

/*@@envVar:E_pubc_GW_GW_3AF_HU_NavSpeedLimitStatus_Vt:*/
on envVar E_pubc_GW_GW_3AF_HU_NavSpeedLimitStatus_Vt
{
    qword rawValue = 0ll;
    if(getValue(E_pubc_GW_GW_3AF_HU_NavSpeedLimitStatus_SetVt))
    {
        //update the signal value
        Msg_GW_3AF.HU_NavSpeedLimitStatus=getValue(this);
    }
}
/*@@end*/

/*@@envVar:E_pubc_GW_GW_3AF_HU_NavSpeedLimitStatus_SetVt:*/
on envVar E_pubc_GW_GW_3AF_HU_NavSpeedLimitStatus_SetVt
{
    if(getValue(E_pubc_GW_GW_3AF_HU_NavSpeedLimitStatus_SetVt))
    {
        //update the signal value
        Msg_GW_3AF.HU_NavSpeedLimitStatus=getvalue(E_pubc_GW_GW_3AF_HU_NavSpeedLimitStatus_Vt);
    }
    else
    {
        Msg_GW_3AF.HU_NavSpeedLimitStatus=getValue(E_pubc_GW_GW_3AF_HU_NavSpeedLimitStatus_Rv);
    }
}
/*@@end*/
 
/*@@envVar:E_pubc_GW_GW_3AF_HU_LaneType_ID2_Rv:*/
on envVar E_pubc_GW_GW_3AF_HU_LaneType_ID2_Rv
{
    int64 rawValue = 0ll;
    float rawValue_float = 0.0;
    float phyValue = 0.0;        

    //set the signal with updated raw value
    {
        rawValue = getvalue(this);
        if(chgEv_GW_3AF_HU_LaneType_ID2 == 0)
        {
            //type conversion to float
            rawValue_float = rawValue;        
            // raw to physical conversion
            phyValue = ((rawValue_float *1)+(0));
            putValue(E_pubc_GW_GW_3AF_HU_LaneType_ID2_Pv, phyValue);
            chgEv_GW_3AF_HU_LaneType_ID2 = 1;
        }
        else
        {
            chgEv_GW_3AF_HU_LaneType_ID2 = 0;
        }    
        //update the signal value
        Msg_GW_3AF.HU_LaneType_ID2=rawValue;        
    }                                                                           
}
/*@@end*/

/*@@envVar:E_pubc_GW_GW_3AF_HU_LaneType_ID2_Pv:*/
on envVar E_pubc_GW_GW_3AF_HU_LaneType_ID2_Pv
{
    int64 rawValue = 0ll;
    float phyValue = 0.0;
    
    //update the raw value with physical value 
    {
        if(chgEv_GW_3AF_HU_LaneType_ID2 == 0)
        {
            phyValue = getvalue(this);
            // physical to raw conversion
            rawValue = ((phyValue -(0))/1);
            putValue(E_pubc_GW_GW_3AF_HU_LaneType_ID2_Rv, rawValue);
            chgEv_GW_3AF_HU_LaneType_ID2 = 1;  
        }
        else
        {
            chgEv_GW_3AF_HU_LaneType_ID2 = 0;
        }
    }
}
/*@@end*/


 
/*@@envVar:E_pubc_GW_GW_3AF_HU_EnterRampInfo_Rv:*/
on envVar E_pubc_GW_GW_3AF_HU_EnterRampInfo_Rv
{
    int64 rawValue = 0ll;
    float rawValue_float = 0.0;
    float phyValue = 0.0;        

    //set the signal with updated raw value
    if(getValue(E_pubc_GW_GW_3AF_HU_EnterRampInfo_SetVt)==0)
    {
        rawValue = getvalue(this);
        if(chgEv_GW_3AF_HU_EnterRampInfo == 0)
        {
            //type conversion to float
            rawValue_float = rawValue;        
            // raw to physical conversion
            phyValue = ((rawValue_float *1)+(0));
            putValue(E_pubc_GW_GW_3AF_HU_EnterRampInfo_Pv, phyValue);
            chgEv_GW_3AF_HU_EnterRampInfo = 1;
        }
        else
        {
            chgEv_GW_3AF_HU_EnterRampInfo = 0;
        }    
        //update the signal value
        Msg_GW_3AF.HU_EnterRampInfo=rawValue;        
    }                                                                           
}
/*@@end*/

/*@@envVar:E_pubc_GW_GW_3AF_HU_EnterRampInfo_Pv:*/
on envVar E_pubc_GW_GW_3AF_HU_EnterRampInfo_Pv
{
    int64 rawValue = 0ll;
    float phyValue = 0.0;
    
    //update the raw value with physical value 
    if(getValue(E_pubc_GW_GW_3AF_HU_EnterRampInfo_SetVt)==0)
    {
        if(chgEv_GW_3AF_HU_EnterRampInfo == 0)
        {
            phyValue = getvalue(this);
            // physical to raw conversion
            rawValue = ((phyValue -(0))/1);
            putValue(E_pubc_GW_GW_3AF_HU_EnterRampInfo_Rv, rawValue);
            chgEv_GW_3AF_HU_EnterRampInfo = 1;  
        }
        else
        {
            chgEv_GW_3AF_HU_EnterRampInfo = 0;
        }
    }
}
/*@@end*/

/*@@envVar:E_pubc_GW_GW_3AF_HU_EnterRampInfo_Vt:*/
on envVar E_pubc_GW_GW_3AF_HU_EnterRampInfo_Vt
{
    qword rawValue = 0ll;
    if(getValue(E_pubc_GW_GW_3AF_HU_EnterRampInfo_SetVt))
    {
        //update the signal value
        Msg_GW_3AF.HU_EnterRampInfo=getValue(this);
    }
}
/*@@end*/

/*@@envVar:E_pubc_GW_GW_3AF_HU_EnterRampInfo_SetVt:*/
on envVar E_pubc_GW_GW_3AF_HU_EnterRampInfo_SetVt
{
    if(getValue(E_pubc_GW_GW_3AF_HU_EnterRampInfo_SetVt))
    {
        //update the signal value
        Msg_GW_3AF.HU_EnterRampInfo=getvalue(E_pubc_GW_GW_3AF_HU_EnterRampInfo_Vt);
    }
    else
    {
        Msg_GW_3AF.HU_EnterRampInfo=getValue(E_pubc_GW_GW_3AF_HU_EnterRampInfo_Rv);
    }
}
/*@@end*/
 
/*@@envVar:E_pubc_GW_GW_2AD_tx:*/
on envVar E_pubc_GW_GW_2AD_tx
{
    if(getValue(this))
    {       
        

        output(Msg_GW_2AD);        
    }
}
/*@@end*/

/*@@envVar:E_pubc_GW_GW_2AD_Range:*/
on envVar E_pubc_GW_GW_2AD_Range
{
    qword rawstatus = 0ll;
    qword rawValue = 0ll;    
    
    rawstatus = getvalue(this);    
    // set all the signals with min raw /max raw /init raw
    switch (rawstatus) 
    {
     case(0) :
        rawValue= 0;
        putValue(E_pubc_GW_GW_2AD_LCDAL_SystemStatus_Rv, rawValue);
        break;
     case(1) :
        rawValue= 7;
        putValue(E_pubc_GW_GW_2AD_LCDAL_SystemStatus_Rv, rawValue);
        break;
     default :
        rawValue= 0;
        putValue(E_pubc_GW_GW_2AD_LCDAL_SystemStatus_Rv, rawValue);
      break;
   }
}
/*@@end*/

/*@@envVar:E_pubc_GW_GW_2AD_Dlc:*/
on envVar E_pubc_GW_GW_2AD_Dlc
{
    if(getValue(E_pubc_GW_GW_2AD_enDlc))
    {
        Msg_GW_2AD.dlc =getValue(this);
    }
    else
    {
       Dbc_dlc = 64;
	   Msg_GW_2AD.dlc = Calc_Canfd_dlc(Dbc_dlc);
	   // Msg_GW_2AD.dlc = 64;
	   	
  }
}
/*@@end*/

/*@@envVar:E_pubc_GW_GW_2AD_enDlc:*/
on envVar E_pubc_GW_GW_2AD_enDlc
{
    //For Messages with DLC = 8, set wrong DLC to smaller than defined DLC
    //For Messages with DLC < 8 set wrong DLC to smaller/longer than defined DLC
    if(getValue(this))
    {
        Msg_GW_2AD.dlc =getValue(E_pubc_GW_GW_2AD_Dlc);
    }
    else
    {
       Dbc_dlc = 64;
	   Msg_GW_2AD.dlc = Calc_Canfd_dlc(Dbc_dlc);
	   // Msg_GW_2AD.dlc = 64;
    }
}
/*@@end*/


/*@@envVar:E_pubc_GW_GW_2AD_LCDAL_SystemStatus_Rv:*/
on envVar E_pubc_GW_GW_2AD_LCDAL_SystemStatus_Rv
{
    int64 rawValue = 0ll;
    float rawValue_float = 0.0;
    float phyValue = 0.0;        

    //set the signal with updated raw value
    if(getValue(E_pubc_GW_GW_2AD_LCDAL_SystemStatus_SetVt)==0)
    {
        rawValue = getvalue(this);
        if(chgEv_GW_2AD_LCDAL_SystemStatus == 0)
        {
            //type conversion to float
            rawValue_float = rawValue;        
            // raw to physical conversion
            phyValue = ((rawValue_float *1)+(0));
            putValue(E_pubc_GW_GW_2AD_LCDAL_SystemStatus_Pv, phyValue);
            chgEv_GW_2AD_LCDAL_SystemStatus = 1;
        }
        else
        {
            chgEv_GW_2AD_LCDAL_SystemStatus = 0;
        }    
        //update the signal value
        Msg_GW_2AD.LCDAL_SystemStatus=rawValue;        
    }                                                                           
}
/*@@end*/

/*@@envVar:E_pubc_GW_GW_2AD_LCDAL_SystemStatus_Pv:*/
on envVar E_pubc_GW_GW_2AD_LCDAL_SystemStatus_Pv
{
    int64 rawValue = 0ll;
    float phyValue = 0.0;
    
    //update the raw value with physical value 
    if(getValue(E_pubc_GW_GW_2AD_LCDAL_SystemStatus_SetVt)==0)
    {
        if(chgEv_GW_2AD_LCDAL_SystemStatus == 0)
        {
            phyValue = getvalue(this);
            // physical to raw conversion
            rawValue = ((phyValue -(0))/1);
            putValue(E_pubc_GW_GW_2AD_LCDAL_SystemStatus_Rv, rawValue);
            chgEv_GW_2AD_LCDAL_SystemStatus = 1;  
        }
        else
        {
            chgEv_GW_2AD_LCDAL_SystemStatus = 0;
        }
    }
}
/*@@end*/

/*@@envVar:E_pubc_GW_GW_2AD_LCDAL_SystemStatus_Vt:*/
on envVar E_pubc_GW_GW_2AD_LCDAL_SystemStatus_Vt
{
    qword rawValue = 0ll;
    if(getValue(E_pubc_GW_GW_2AD_LCDAL_SystemStatus_SetVt))
    {
        //update the signal value
        Msg_GW_2AD.LCDAL_SystemStatus=getValue(this);
    }
}
/*@@end*/

/*@@envVar:E_pubc_GW_GW_2AD_LCDAL_SystemStatus_SetVt:*/
on envVar E_pubc_GW_GW_2AD_LCDAL_SystemStatus_SetVt
{
    if(getValue(E_pubc_GW_GW_2AD_LCDAL_SystemStatus_SetVt))
    {
        //update the signal value
        Msg_GW_2AD.LCDAL_SystemStatus=getvalue(E_pubc_GW_GW_2AD_LCDAL_SystemStatus_Vt);
    }
    else
    {
        Msg_GW_2AD.LCDAL_SystemStatus=getValue(E_pubc_GW_GW_2AD_LCDAL_SystemStatus_Rv);
    }
}
/*@@end*/
 
/*@@envVar:E_pubc_GW_GW_170_tx:*/
on envVar E_pubc_GW_GW_170_tx
{
    if(getValue(this))
    {       
        
        //update the BZ Signal
        if(GW_170_EPS_RollingCounter_170_wrongvalctr == 0)
        {
            update_GW_170_EPS_RollingCounter_170_counter();
            Msg_GW_170.EPS_RollingCounter_170= GW_170_EPS_RollingCounter_170_counter;
        }
        else if(GW_170_EPS_RollingCounter_170_wrongvalctr > 0)
        {
			GW_170_EPS_RollingCounter_170_counter=GW_170_EPS_RollingCounter_170_counter + GW_170_EPS_RollingCounter_170_wrongvalctr;
			 Msg_GW_170.EPS_RollingCounter_170= GW_170_EPS_RollingCounter_170_counter;
            /* GW_170_EPS_RollingCounter_170_wrongvalctr--;
              // if counter becomes zero, update panel controller to zero
             if(GW_170_EPS_RollingCounter_170_wrongvalctr == 0)
             {
                 putValue(E_pubc_GW_GW_170_EPS_RollingCounter_170_wrongvalctr,0);
             } */
        }
        else
        { 
			// do nothing
        }    
        //calculate the CRC CheckSum
        update_GW_170_CRC_CheckSum();

        output(Msg_GW_170);        
    }
}
/*@@end*/

/*@@envVar:E_pubc_GW_GW_170_Range:*/
on envVar E_pubc_GW_GW_170_Range
{
    qword rawstatus = 0ll;
    qword rawValue = 0ll;    
    
    rawstatus = getvalue(this);    
    // set all the signals with min raw /max raw /init raw
    switch (rawstatus) 
    {
     case(0) :
        rawValue= 0;
        putValue(E_pubc_GW_GW_170_EPS_ActualTorsionBarTorq_Rv, rawValue);
        rawValue= 0;
        putValue(E_pubc_GW_GW_170_EPS_MinSafetyTorsionBarTorq_Rv, rawValue);
        rawValue= 0;
        putValue(E_pubc_GW_GW_170_EPS_MaxSafetyTorsionBarTorq_Rv, rawValue);
        break;
     case(1) :
        rawValue= 2046;
        putValue(E_pubc_GW_GW_170_EPS_ActualTorsionBarTorq_Rv, rawValue);
        rawValue= 2046;
        putValue(E_pubc_GW_GW_170_EPS_MinSafetyTorsionBarTorq_Rv, rawValue);
        rawValue= 2046;
        putValue(E_pubc_GW_GW_170_EPS_MaxSafetyTorsionBarTorq_Rv, rawValue);
        break;
     default :
        rawValue= 0;
        putValue(E_pubc_GW_GW_170_EPS_ActualTorsionBarTorq_Rv, rawValue);
        rawValue= 0;
        putValue(E_pubc_GW_GW_170_EPS_MinSafetyTorsionBarTorq_Rv, rawValue);
        rawValue= 0;
        putValue(E_pubc_GW_GW_170_EPS_MaxSafetyTorsionBarTorq_Rv, rawValue);
      break;
   }
}
/*@@end*/

/*@@envVar:E_pubc_GW_GW_170_Dlc:*/
on envVar E_pubc_GW_GW_170_Dlc
{
    if(getValue(E_pubc_GW_GW_170_enDlc))
    {
        Msg_GW_170.dlc =getValue(this);
    }
    else
    {
       Dbc_dlc = 8;
	   Msg_GW_170.dlc = Calc_Canfd_dlc(Dbc_dlc);
	   // Msg_GW_170.dlc = 8;
	   	
  }
}
/*@@end*/

/*@@envVar:E_pubc_GW_GW_170_enDlc:*/
on envVar E_pubc_GW_GW_170_enDlc
{
    //For Messages with DLC = 8, set wrong DLC to smaller than defined DLC
    //For Messages with DLC < 8 set wrong DLC to smaller/longer than defined DLC
    if(getValue(this))
    {
        Msg_GW_170.dlc =getValue(E_pubc_GW_GW_170_Dlc);
    }
    else
    {
       Dbc_dlc = 8;
	   Msg_GW_170.dlc = Calc_Canfd_dlc(Dbc_dlc);
	   // Msg_GW_170.dlc = 8;
    }
}
/*@@end*/

/*@@envVar:E_pubc_GW_GW_170_EPS_CRCCheck_170_wrongvalctr:*/
on envVar E_pubc_GW_GW_170_EPS_CRCCheck_170_wrongvalctr
{
    //update disturb count
    //disturb value range:(-1 = always send wrong value),( X>0 ,x is the number of Messages with wrong CHK sent)
    GW_170_EPS_CRCCheck_170_wrongvalctr =getValue(this);    
}
/*@@end*/
/*@@envVar:E_pubc_GW_GW_170_EPS_RollingCounter_170_wrongvalctr:*/
on envVar E_pubc_GW_GW_170_EPS_RollingCounter_170_wrongvalctr
{
    //update disturb count
    //disturb value range:(-1 = always send wrong value),( X>0 ,x is the number of Messages with wrong CHK sent)
    GW_170_EPS_RollingCounter_170_wrongvalctr =getValue(this);    
}
/*@@end*/

/*@@envVar:E_pubc_GW_GW_170_EPS_ActualTorsionBarTorq_Rv:*/
on envVar E_pubc_GW_GW_170_EPS_ActualTorsionBarTorq_Rv
{
    int64 rawValue = 0ll;
    float rawValue_float = 0.0;
    float phyValue = 0.0;        

    //set the signal with updated raw value
    {
        rawValue = getvalue(this);
        if(chgEv_GW_170_EPS_ActualTorsionBarTorq == 0)
        {
            //type conversion to float
            rawValue_float = rawValue;        
            // raw to physical conversion
            phyValue = ((rawValue_float *0.02)+(-20.48));
            putValue(E_pubc_GW_GW_170_EPS_ActualTorsionBarTorq_Pv, phyValue);
            chgEv_GW_170_EPS_ActualTorsionBarTorq = 1;
        }
        else
        {
            chgEv_GW_170_EPS_ActualTorsionBarTorq = 0;
        }    
        //update the signal value
        Msg_GW_170.EPS_ActualTorsionBarTorq=rawValue;        
    }                                                                           
}
/*@@end*/

/*@@envVar:E_pubc_GW_GW_170_EPS_ActualTorsionBarTorq_Pv:*/
on envVar E_pubc_GW_GW_170_EPS_ActualTorsionBarTorq_Pv
{
    int64 rawValue = 0ll;
    float phyValue = 0.0;
    
    //update the raw value with physical value 
    {
        if(chgEv_GW_170_EPS_ActualTorsionBarTorq == 0)
        {
            phyValue = getvalue(this);
            // physical to raw conversion
            rawValue = ((phyValue -(-20.48))/0.02);
            putValue(E_pubc_GW_GW_170_EPS_ActualTorsionBarTorq_Rv, rawValue);
            chgEv_GW_170_EPS_ActualTorsionBarTorq = 1;  
        }
        else
        {
            chgEv_GW_170_EPS_ActualTorsionBarTorq = 0;
        }
    }
}
/*@@end*/


 
/*@@envVar:E_pubc_GW_GW_170_EPS_MinSafetyTorsionBarTorq_Rv:*/
on envVar E_pubc_GW_GW_170_EPS_MinSafetyTorsionBarTorq_Rv
{
    int64 rawValue = 0ll;
    float rawValue_float = 0.0;
    float phyValue = 0.0;        

    //set the signal with updated raw value
    {
        rawValue = getvalue(this);
        if(chgEv_GW_170_EPS_MinSafetyTorsionBarTorq == 0)
        {
            //type conversion to float
            rawValue_float = rawValue;        
            // raw to physical conversion
            phyValue = ((rawValue_float *0.02)+(-20.48));
            putValue(E_pubc_GW_GW_170_EPS_MinSafetyTorsionBarTorq_Pv, phyValue);
            chgEv_GW_170_EPS_MinSafetyTorsionBarTorq = 1;
        }
        else
        {
            chgEv_GW_170_EPS_MinSafetyTorsionBarTorq = 0;
        }    
        //update the signal value
        Msg_GW_170.EPS_MinSafetyTorsionBarTorq=rawValue;        
    }                                                                           
}
/*@@end*/

/*@@envVar:E_pubc_GW_GW_170_EPS_MinSafetyTorsionBarTorq_Pv:*/
on envVar E_pubc_GW_GW_170_EPS_MinSafetyTorsionBarTorq_Pv
{
    int64 rawValue = 0ll;
    float phyValue = 0.0;
    
    //update the raw value with physical value 
    {
        if(chgEv_GW_170_EPS_MinSafetyTorsionBarTorq == 0)
        {
            phyValue = getvalue(this);
            // physical to raw conversion
            rawValue = ((phyValue -(-20.48))/0.02);
            putValue(E_pubc_GW_GW_170_EPS_MinSafetyTorsionBarTorq_Rv, rawValue);
            chgEv_GW_170_EPS_MinSafetyTorsionBarTorq = 1;  
        }
        else
        {
            chgEv_GW_170_EPS_MinSafetyTorsionBarTorq = 0;
        }
    }
}
/*@@end*/


 
/*@@envVar:E_pubc_GW_GW_170_EPS_MaxSafetyTorsionBarTorq_Rv:*/
on envVar E_pubc_GW_GW_170_EPS_MaxSafetyTorsionBarTorq_Rv
{
    int64 rawValue = 0ll;
    float rawValue_float = 0.0;
    float phyValue = 0.0;        

    //set the signal with updated raw value
    {
        rawValue = getvalue(this);
        if(chgEv_GW_170_EPS_MaxSafetyTorsionBarTorq == 0)
        {
            //type conversion to float
            rawValue_float = rawValue;        
            // raw to physical conversion
            phyValue = ((rawValue_float *0.02)+(-20.48));
            putValue(E_pubc_GW_GW_170_EPS_MaxSafetyTorsionBarTorq_Pv, phyValue);
            chgEv_GW_170_EPS_MaxSafetyTorsionBarTorq = 1;
        }
        else
        {
            chgEv_GW_170_EPS_MaxSafetyTorsionBarTorq = 0;
        }    
        //update the signal value
        Msg_GW_170.EPS_MaxSafetyTorsionBarTorq=rawValue;        
    }                                                                           
}
/*@@end*/

/*@@envVar:E_pubc_GW_GW_170_EPS_MaxSafetyTorsionBarTorq_Pv:*/
on envVar E_pubc_GW_GW_170_EPS_MaxSafetyTorsionBarTorq_Pv
{
    int64 rawValue = 0ll;
    float phyValue = 0.0;
    
    //update the raw value with physical value 
    {
        if(chgEv_GW_170_EPS_MaxSafetyTorsionBarTorq == 0)
        {
            phyValue = getvalue(this);
            // physical to raw conversion
            rawValue = ((phyValue -(-20.48))/0.02);
            putValue(E_pubc_GW_GW_170_EPS_MaxSafetyTorsionBarTorq_Rv, rawValue);
            chgEv_GW_170_EPS_MaxSafetyTorsionBarTorq = 1;  
        }
        else
        {
            chgEv_GW_170_EPS_MaxSafetyTorsionBarTorq = 0;
        }
    }
}
/*@@end*/


 
/*@@envVar:E_pubc_GW_GW_2A8_tx:*/
on envVar E_pubc_GW_GW_2A8_tx
{
    if(getValue(this))
    {       
        

        output(Msg_GW_2A8);        
    }
}
/*@@end*/

/*@@envVar:E_pubc_GW_GW_2A8_Range:*/
on envVar E_pubc_GW_GW_2A8_Range
{
    qword rawstatus = 0ll;
    qword rawValue = 0ll;    
    
    rawstatus = getvalue(this);    
    // set all the signals with min raw /max raw /init raw
    switch (rawstatus) 
    {
     case(0) :
        rawValue= 0;
        putValue(E_pubc_GW_GW_2A8_TmsAcEnvtlT_Rv, rawValue);
        rawValue= 0;
        putValue(E_pubc_GW_GW_2A8_TmsAcEnvtlTVld_Rv, rawValue);
        rawValue= 0;
        putValue(E_pubc_GW_GW_2A8_TmsActPwr_Rv, rawValue);
        rawValue= 0;
        putValue(E_pubc_GW_GW_2A8_TmsFrntBlowMod_Rv, rawValue);
        break;
     case(1) :
        rawValue= 255;
        putValue(E_pubc_GW_GW_2A8_TmsAcEnvtlT_Rv, rawValue);
        rawValue= 1;
        putValue(E_pubc_GW_GW_2A8_TmsAcEnvtlTVld_Rv, rawValue);
        rawValue= 2046;
        putValue(E_pubc_GW_GW_2A8_TmsActPwr_Rv, rawValue);
        rawValue= 7;
        putValue(E_pubc_GW_GW_2A8_TmsFrntBlowMod_Rv, rawValue);
        break;
     default :
        rawValue= 0;
        putValue(E_pubc_GW_GW_2A8_TmsAcEnvtlT_Rv, rawValue);
        rawValue= 0;
        putValue(E_pubc_GW_GW_2A8_TmsAcEnvtlTVld_Rv, rawValue);
        rawValue= 0;
        putValue(E_pubc_GW_GW_2A8_TmsActPwr_Rv, rawValue);
        rawValue= 0;
        putValue(E_pubc_GW_GW_2A8_TmsFrntBlowMod_Rv, rawValue);
      break;
   }
}
/*@@end*/

/*@@envVar:E_pubc_GW_GW_2A8_Dlc:*/
on envVar E_pubc_GW_GW_2A8_Dlc
{
    if(getValue(E_pubc_GW_GW_2A8_enDlc))
    {
        Msg_GW_2A8.dlc =getValue(this);
    }
    else
    {
       Dbc_dlc = 64;
	   Msg_GW_2A8.dlc = Calc_Canfd_dlc(Dbc_dlc);
	   // Msg_GW_2A8.dlc = 64;
	   	
  }
}
/*@@end*/

/*@@envVar:E_pubc_GW_GW_2A8_enDlc:*/
on envVar E_pubc_GW_GW_2A8_enDlc
{
    //For Messages with DLC = 8, set wrong DLC to smaller than defined DLC
    //For Messages with DLC < 8 set wrong DLC to smaller/longer than defined DLC
    if(getValue(this))
    {
        Msg_GW_2A8.dlc =getValue(E_pubc_GW_GW_2A8_Dlc);
    }
    else
    {
       Dbc_dlc = 64;
	   Msg_GW_2A8.dlc = Calc_Canfd_dlc(Dbc_dlc);
	   // Msg_GW_2A8.dlc = 64;
    }
}
/*@@end*/


/*@@envVar:E_pubc_GW_GW_2A8_TmsAcEnvtlT_Rv:*/
on envVar E_pubc_GW_GW_2A8_TmsAcEnvtlT_Rv
{
    int64 rawValue = 0ll;
    float rawValue_float = 0.0;
    float phyValue = 0.0;        

    //set the signal with updated raw value
    {
        rawValue = getvalue(this);
        if(chgEv_GW_2A8_TmsAcEnvtlT == 0)
        {
            //type conversion to float
            rawValue_float = rawValue;        
            // raw to physical conversion
            phyValue = ((rawValue_float *0.5)+(-40));
            putValue(E_pubc_GW_GW_2A8_TmsAcEnvtlT_Pv, phyValue);
            chgEv_GW_2A8_TmsAcEnvtlT = 1;
        }
        else
        {
            chgEv_GW_2A8_TmsAcEnvtlT = 0;
        }    
        //update the signal value
        Msg_GW_2A8.TmsAcEnvtlT=rawValue;        
    }                                                                           
}
/*@@end*/

/*@@envVar:E_pubc_GW_GW_2A8_TmsAcEnvtlT_Pv:*/
on envVar E_pubc_GW_GW_2A8_TmsAcEnvtlT_Pv
{
    int64 rawValue = 0ll;
    float phyValue = 0.0;
    
    //update the raw value with physical value 
    {
        if(chgEv_GW_2A8_TmsAcEnvtlT == 0)
        {
            phyValue = getvalue(this);
            // physical to raw conversion
            rawValue = ((phyValue -(-40))/0.5);
            putValue(E_pubc_GW_GW_2A8_TmsAcEnvtlT_Rv, rawValue);
            chgEv_GW_2A8_TmsAcEnvtlT = 1;  
        }
        else
        {
            chgEv_GW_2A8_TmsAcEnvtlT = 0;
        }
    }
}
/*@@end*/


 
/*@@envVar:E_pubc_GW_GW_2A8_TmsAcEnvtlTVld_Rv:*/
on envVar E_pubc_GW_GW_2A8_TmsAcEnvtlTVld_Rv
{
    int64 rawValue = 0ll;
    float rawValue_float = 0.0;
    float phyValue = 0.0;        

    //set the signal with updated raw value
    if(getValue(E_pubc_GW_GW_2A8_TmsAcEnvtlTVld_SetVt)==0)
    {
        rawValue = getvalue(this);
        if(chgEv_GW_2A8_TmsAcEnvtlTVld == 0)
        {
            //type conversion to float
            rawValue_float = rawValue;        
            // raw to physical conversion
            phyValue = ((rawValue_float *1)+(0));
            putValue(E_pubc_GW_GW_2A8_TmsAcEnvtlTVld_Pv, phyValue);
            chgEv_GW_2A8_TmsAcEnvtlTVld = 1;
        }
        else
        {
            chgEv_GW_2A8_TmsAcEnvtlTVld = 0;
        }    
        //update the signal value
        Msg_GW_2A8.TmsAcEnvtlTVld=rawValue;        
    }                                                                           
}
/*@@end*/

/*@@envVar:E_pubc_GW_GW_2A8_TmsAcEnvtlTVld_Pv:*/
on envVar E_pubc_GW_GW_2A8_TmsAcEnvtlTVld_Pv
{
    int64 rawValue = 0ll;
    float phyValue = 0.0;
    
    //update the raw value with physical value 
    if(getValue(E_pubc_GW_GW_2A8_TmsAcEnvtlTVld_SetVt)==0)
    {
        if(chgEv_GW_2A8_TmsAcEnvtlTVld == 0)
        {
            phyValue = getvalue(this);
            // physical to raw conversion
            rawValue = ((phyValue -(0))/1);
            putValue(E_pubc_GW_GW_2A8_TmsAcEnvtlTVld_Rv, rawValue);
            chgEv_GW_2A8_TmsAcEnvtlTVld = 1;  
        }
        else
        {
            chgEv_GW_2A8_TmsAcEnvtlTVld = 0;
        }
    }
}
/*@@end*/

/*@@envVar:E_pubc_GW_GW_2A8_TmsAcEnvtlTVld_Vt:*/
on envVar E_pubc_GW_GW_2A8_TmsAcEnvtlTVld_Vt
{
    qword rawValue = 0ll;
    if(getValue(E_pubc_GW_GW_2A8_TmsAcEnvtlTVld_SetVt))
    {
        //update the signal value
        Msg_GW_2A8.TmsAcEnvtlTVld=getValue(this);
    }
}
/*@@end*/

/*@@envVar:E_pubc_GW_GW_2A8_TmsAcEnvtlTVld_SetVt:*/
on envVar E_pubc_GW_GW_2A8_TmsAcEnvtlTVld_SetVt
{
    if(getValue(E_pubc_GW_GW_2A8_TmsAcEnvtlTVld_SetVt))
    {
        //update the signal value
        Msg_GW_2A8.TmsAcEnvtlTVld=getvalue(E_pubc_GW_GW_2A8_TmsAcEnvtlTVld_Vt);
    }
    else
    {
        Msg_GW_2A8.TmsAcEnvtlTVld=getValue(E_pubc_GW_GW_2A8_TmsAcEnvtlTVld_Rv);
    }
}
/*@@end*/
 
/*@@envVar:E_pubc_GW_GW_2A8_TmsActPwr_Rv:*/
on envVar E_pubc_GW_GW_2A8_TmsActPwr_Rv
{
    int64 rawValue = 0ll;
    float rawValue_float = 0.0;
    float phyValue = 0.0;        

    //set the signal with updated raw value
    {
        rawValue = getvalue(this);
        if(chgEv_GW_2A8_TmsActPwr == 0)
        {
            //type conversion to float
            rawValue_float = rawValue;        
            // raw to physical conversion
            phyValue = ((rawValue_float *0.01)+(0));
            putValue(E_pubc_GW_GW_2A8_TmsActPwr_Pv, phyValue);
            chgEv_GW_2A8_TmsActPwr = 1;
        }
        else
        {
            chgEv_GW_2A8_TmsActPwr = 0;
        }    
        //update the signal value
        Msg_GW_2A8.TmsActPwr=rawValue;        
    }                                                                           
}
/*@@end*/

/*@@envVar:E_pubc_GW_GW_2A8_TmsActPwr_Pv:*/
on envVar E_pubc_GW_GW_2A8_TmsActPwr_Pv
{
    int64 rawValue = 0ll;
    float phyValue = 0.0;
    
    //update the raw value with physical value 
    {
        if(chgEv_GW_2A8_TmsActPwr == 0)
        {
            phyValue = getvalue(this);
            // physical to raw conversion
            rawValue = ((phyValue -(0))/0.01);
            putValue(E_pubc_GW_GW_2A8_TmsActPwr_Rv, rawValue);
            chgEv_GW_2A8_TmsActPwr = 1;  
        }
        else
        {
            chgEv_GW_2A8_TmsActPwr = 0;
        }
    }
}
/*@@end*/


 
/*@@envVar:E_pubc_GW_GW_2A8_TmsFrntBlowMod_Rv:*/
on envVar E_pubc_GW_GW_2A8_TmsFrntBlowMod_Rv
{
    int64 rawValue = 0ll;
    float rawValue_float = 0.0;
    float phyValue = 0.0;        

    //set the signal with updated raw value
    if(getValue(E_pubc_GW_GW_2A8_TmsFrntBlowMod_SetVt)==0)
    {
        rawValue = getvalue(this);
        if(chgEv_GW_2A8_TmsFrntBlowMod == 0)
        {
            //type conversion to float
            rawValue_float = rawValue;        
            // raw to physical conversion
            phyValue = ((rawValue_float *1)+(0));
            putValue(E_pubc_GW_GW_2A8_TmsFrntBlowMod_Pv, phyValue);
            chgEv_GW_2A8_TmsFrntBlowMod = 1;
        }
        else
        {
            chgEv_GW_2A8_TmsFrntBlowMod = 0;
        }    
        //update the signal value
        Msg_GW_2A8.TmsFrntBlowMod=rawValue;        
    }                                                                           
}
/*@@end*/

/*@@envVar:E_pubc_GW_GW_2A8_TmsFrntBlowMod_Pv:*/
on envVar E_pubc_GW_GW_2A8_TmsFrntBlowMod_Pv
{
    int64 rawValue = 0ll;
    float phyValue = 0.0;
    
    //update the raw value with physical value 
    if(getValue(E_pubc_GW_GW_2A8_TmsFrntBlowMod_SetVt)==0)
    {
        if(chgEv_GW_2A8_TmsFrntBlowMod == 0)
        {
            phyValue = getvalue(this);
            // physical to raw conversion
            rawValue = ((phyValue -(0))/1);
            putValue(E_pubc_GW_GW_2A8_TmsFrntBlowMod_Rv, rawValue);
            chgEv_GW_2A8_TmsFrntBlowMod = 1;  
        }
        else
        {
            chgEv_GW_2A8_TmsFrntBlowMod = 0;
        }
    }
}
/*@@end*/

/*@@envVar:E_pubc_GW_GW_2A8_TmsFrntBlowMod_Vt:*/
on envVar E_pubc_GW_GW_2A8_TmsFrntBlowMod_Vt
{
    qword rawValue = 0ll;
    if(getValue(E_pubc_GW_GW_2A8_TmsFrntBlowMod_SetVt))
    {
        //update the signal value
        Msg_GW_2A8.TmsFrntBlowMod=getValue(this);
    }
}
/*@@end*/

/*@@envVar:E_pubc_GW_GW_2A8_TmsFrntBlowMod_SetVt:*/
on envVar E_pubc_GW_GW_2A8_TmsFrntBlowMod_SetVt
{
    if(getValue(E_pubc_GW_GW_2A8_TmsFrntBlowMod_SetVt))
    {
        //update the signal value
        Msg_GW_2A8.TmsFrntBlowMod=getvalue(E_pubc_GW_GW_2A8_TmsFrntBlowMod_Vt);
    }
    else
    {
        Msg_GW_2A8.TmsFrntBlowMod=getValue(E_pubc_GW_GW_2A8_TmsFrntBlowMod_Rv);
    }
}
/*@@end*/
 
/*@@envVar:E_pubc_GW_GW_3EE_tx:*/
on envVar E_pubc_GW_GW_3EE_tx
{
    if(getValue(this))
    {       
        

        output(Msg_GW_3EE);        
    }
}
/*@@end*/

/*@@envVar:E_pubc_GW_GW_3EE_Range:*/
on envVar E_pubc_GW_GW_3EE_Range
{
    qword rawstatus = 0ll;
    qword rawValue = 0ll;    
    
    rawstatus = getvalue(this);    
    // set all the signals with min raw /max raw /init raw
    switch (rawstatus) 
    {
     case(0) :
        rawValue= 0;
        putValue(E_pubc_GW_GW_3EE_GW_SafCertSts_Rv, rawValue);
        break;
     case(1) :
        rawValue= 3;
        putValue(E_pubc_GW_GW_3EE_GW_SafCertSts_Rv, rawValue);
        break;
     default :
        rawValue= 0;
        putValue(E_pubc_GW_GW_3EE_GW_SafCertSts_Rv, rawValue);
      break;
   }
}
/*@@end*/

/*@@envVar:E_pubc_GW_GW_3EE_Dlc:*/
on envVar E_pubc_GW_GW_3EE_Dlc
{
    if(getValue(E_pubc_GW_GW_3EE_enDlc))
    {
        Msg_GW_3EE.dlc =getValue(this);
    }
    else
    {
       Dbc_dlc = 8;
	   Msg_GW_3EE.dlc = Calc_Canfd_dlc(Dbc_dlc);
	   // Msg_GW_3EE.dlc = 8;
	   	
  }
}
/*@@end*/

/*@@envVar:E_pubc_GW_GW_3EE_enDlc:*/
on envVar E_pubc_GW_GW_3EE_enDlc
{
    //For Messages with DLC = 8, set wrong DLC to smaller than defined DLC
    //For Messages with DLC < 8 set wrong DLC to smaller/longer than defined DLC
    if(getValue(this))
    {
        Msg_GW_3EE.dlc =getValue(E_pubc_GW_GW_3EE_Dlc);
    }
    else
    {
       Dbc_dlc = 8;
	   Msg_GW_3EE.dlc = Calc_Canfd_dlc(Dbc_dlc);
	   // Msg_GW_3EE.dlc = 8;
    }
}
/*@@end*/


/*@@envVar:E_pubc_GW_GW_3EE_GW_SafCertSts_Rv:*/
on envVar E_pubc_GW_GW_3EE_GW_SafCertSts_Rv
{
    int64 rawValue = 0ll;
    float rawValue_float = 0.0;
    float phyValue = 0.0;        

    //set the signal with updated raw value
    if(getValue(E_pubc_GW_GW_3EE_GW_SafCertSts_SetVt)==0)
    {
        rawValue = getvalue(this);
        if(chgEv_GW_3EE_GW_SafCertSts == 0)
        {
            //type conversion to float
            rawValue_float = rawValue;        
            // raw to physical conversion
            phyValue = ((rawValue_float *1)+(0));
            putValue(E_pubc_GW_GW_3EE_GW_SafCertSts_Pv, phyValue);
            chgEv_GW_3EE_GW_SafCertSts = 1;
        }
        else
        {
            chgEv_GW_3EE_GW_SafCertSts = 0;
        }    
        //update the signal value
        Msg_GW_3EE.GW_SafCertSts=rawValue;        
    }                                                                           
}
/*@@end*/

/*@@envVar:E_pubc_GW_GW_3EE_GW_SafCertSts_Pv:*/
on envVar E_pubc_GW_GW_3EE_GW_SafCertSts_Pv
{
    int64 rawValue = 0ll;
    float phyValue = 0.0;
    
    //update the raw value with physical value 
    if(getValue(E_pubc_GW_GW_3EE_GW_SafCertSts_SetVt)==0)
    {
        if(chgEv_GW_3EE_GW_SafCertSts == 0)
        {
            phyValue = getvalue(this);
            // physical to raw conversion
            rawValue = ((phyValue -(0))/1);
            putValue(E_pubc_GW_GW_3EE_GW_SafCertSts_Rv, rawValue);
            chgEv_GW_3EE_GW_SafCertSts = 1;  
        }
        else
        {
            chgEv_GW_3EE_GW_SafCertSts = 0;
        }
    }
}
/*@@end*/

/*@@envVar:E_pubc_GW_GW_3EE_GW_SafCertSts_Vt:*/
on envVar E_pubc_GW_GW_3EE_GW_SafCertSts_Vt
{
    qword rawValue = 0ll;
    if(getValue(E_pubc_GW_GW_3EE_GW_SafCertSts_SetVt))
    {
        //update the signal value
        Msg_GW_3EE.GW_SafCertSts=getValue(this);
    }
}
/*@@end*/

/*@@envVar:E_pubc_GW_GW_3EE_GW_SafCertSts_SetVt:*/
on envVar E_pubc_GW_GW_3EE_GW_SafCertSts_SetVt
{
    if(getValue(E_pubc_GW_GW_3EE_GW_SafCertSts_SetVt))
    {
        //update the signal value
        Msg_GW_3EE.GW_SafCertSts=getvalue(E_pubc_GW_GW_3EE_GW_SafCertSts_Vt);
    }
    else
    {
        Msg_GW_3EE.GW_SafCertSts=getValue(E_pubc_GW_GW_3EE_GW_SafCertSts_Rv);
    }
}
/*@@end*/
 
/*@@envVar:E_pubc_GW_GW_2C8_tx:*/
on envVar E_pubc_GW_GW_2C8_tx
{
    if(getValue(this))
    {       
        
        //update the BZ Signal
        if(GW_2C8_RRC_RollingCounter_2C8_wrongvalctr == 0)
        {
            update_GW_2C8_RRC_RollingCounter_2C8_counter();
            Msg_GW_2C8.RRC_RollingCounter_2C8= GW_2C8_RRC_RollingCounter_2C8_counter;
        }
        else if(GW_2C8_RRC_RollingCounter_2C8_wrongvalctr > 0)
        {
			GW_2C8_RRC_RollingCounter_2C8_counter=GW_2C8_RRC_RollingCounter_2C8_counter + GW_2C8_RRC_RollingCounter_2C8_wrongvalctr;
			 Msg_GW_2C8.RRC_RollingCounter_2C8= GW_2C8_RRC_RollingCounter_2C8_counter;
            /* GW_2C8_RRC_RollingCounter_2C8_wrongvalctr--;
              // if counter becomes zero, update panel controller to zero
             if(GW_2C8_RRC_RollingCounter_2C8_wrongvalctr == 0)
             {
                 putValue(E_pubc_GW_GW_2C8_RRC_RollingCounter_2C8_wrongvalctr,0);
             } */
        }
        else
        { 
			// do nothing
        }    
        //calculate the CRC CheckSum
        update_GW_2C8_CRC_CheckSum();

        output(Msg_GW_2C8);        
    }
}
/*@@end*/

/*@@envVar:E_pubc_GW_GW_2C8_Range:*/
on envVar E_pubc_GW_GW_2C8_Range
{
    qword rawstatus = 0ll;
    qword rawValue = 0ll;    
    
    rawstatus = getvalue(this);    
    // set all the signals with min raw /max raw /init raw
    switch (rawstatus) 
    {
     case(0) :
        rawValue= 0;
        putValue(E_pubc_GW_GW_2C8_RRC_OBJ3_Height_Rv, rawValue);
        rawValue= 0;
        putValue(E_pubc_GW_GW_2C8_RRC_OBJ5_Length_Rv, rawValue);
        rawValue= 0;
        putValue(E_pubc_GW_GW_2C8_RRC_OBJ1_Height_Rv, rawValue);
        rawValue= 0;
        putValue(E_pubc_GW_GW_2C8_RRC_OBJ10_Track_ID_Rv, rawValue);
        rawValue= 0;
        putValue(E_pubc_GW_GW_2C8_RRC_OBJ10_Type_Rv, rawValue);
        rawValue= 0;
        putValue(E_pubc_GW_GW_2C8_RRC_OBJ5_Track_ID_Rv, rawValue);
        rawValue= 0;
        putValue(E_pubc_GW_GW_2C8_RRC_TiStamp_Rv, rawValue);
        rawValue= 0;
        putValue(E_pubc_GW_GW_2C8_RRC_OBJ5_Ay_Rv, rawValue);
        rawValue= 0;
        putValue(E_pubc_GW_GW_2C8_RRC_OBJ5_Ax_Rv, rawValue);
        rawValue= 0;
        putValue(E_pubc_GW_GW_2C8_RRC_OBJ10_Location_Rv, rawValue);
        rawValue= 0;
        putValue(E_pubc_GW_GW_2C8_RRC_OBJ5_ExistProb_Rv, rawValue);
        rawValue= 0;
        putValue(E_pubc_GW_GW_2C8_RRC_OBJ5_Height_Rv, rawValue);
        rawValue= 0;
        putValue(E_pubc_GW_GW_2C8_RRC_OBJ10_Height_Rv, rawValue);
        rawValue= 0;
        putValue(E_pubc_GW_GW_2C8_RRC_OBJ10_ObstacleProb_Rv, rawValue);
        rawValue= 0;
        putValue(E_pubc_GW_GW_2C8_RRC_OBJ5_Width_Rv, rawValue);
        rawValue= 0;
        putValue(E_pubc_GW_GW_2C8_RRC_OBJ5_Location_Rv, rawValue);
        rawValue= 0;
        putValue(E_pubc_GW_GW_2C8_RRC_OBJ4_Height_Rv, rawValue);
        rawValue= 0;
        putValue(E_pubc_GW_GW_2C8_RRC_OBJ6_Height_Rv, rawValue);
        rawValue= 0;
        putValue(E_pubc_GW_GW_2C8_RRC_OBJ8_Height_Rv, rawValue);
        rawValue= 0;
        putValue(E_pubc_GW_GW_2C8_RRC_TiBas_Rv, rawValue);
        rawValue= 0;
        putValue(E_pubc_GW_GW_2C8_RRC_OBJ5_Vx_Rv, rawValue);
        rawValue= 0;
        putValue(E_pubc_GW_GW_2C8_RRC_OBJ5_Vy_Rv, rawValue);
        rawValue= 0;
        putValue(E_pubc_GW_GW_2C8_RRC_OBJ2_Height_Rv, rawValue);
        rawValue= 0;
        putValue(E_pubc_GW_GW_2C8_RRC_OBJ10_Measured_Rv, rawValue);
        rawValue= 0;
        putValue(E_pubc_GW_GW_2C8_RRC_TiOut_Rv, rawValue);
        rawValue= 0;
        putValue(E_pubc_GW_GW_2C8_RRC_OBJ10_Ax_Rv, rawValue);
        rawValue= 0;
        putValue(E_pubc_GW_GW_2C8_RRC_OBJ10_Ay_Rv, rawValue);
        rawValue= 0;
        putValue(E_pubc_GW_GW_2C8_RRC_OBJ10_Dy_Rv, rawValue);
        rawValue= 0;
        putValue(E_pubc_GW_GW_2C8_RRC_OBJ10_Dx_Rv, rawValue);
        rawValue= 0;
        putValue(E_pubc_GW_GW_2C8_RRC_OBJ10_Length_Rv, rawValue);
        rawValue= 0;
        putValue(E_pubc_GW_GW_2C8_RRC_OBJ5_Measured_Rv, rawValue);
        rawValue= 0;
        putValue(E_pubc_GW_GW_2C8_RRC_OBJ9_Height_Rv, rawValue);
        rawValue= 0;
        putValue(E_pubc_GW_GW_2C8_RRC_OBJ5_HeadingAngle_Rv, rawValue);
        rawValue= 0;
        putValue(E_pubc_GW_GW_2C8_RRC_OBJ5_ObstacleProb_Rv, rawValue);
        rawValue= 0;
        putValue(E_pubc_GW_GW_2C8_RRC_OBJ10_Width_Rv, rawValue);
        rawValue= 0;
        putValue(E_pubc_GW_GW_2C8_RRC_ObjDelay_Rv, rawValue);
        rawValue= 0;
        putValue(E_pubc_GW_GW_2C8_RRC_TiLeap_Rv, rawValue);
        rawValue= 0;
        putValue(E_pubc_GW_GW_2C8_RRC_OBJ10_HeadingAngle_Rv, rawValue);
        rawValue= 0;
        putValue(E_pubc_GW_GW_2C8_RRC_OBJ10_ExistProb_Rv, rawValue);
        rawValue= 0;
        putValue(E_pubc_GW_GW_2C8_RRC_OBJ7_Height_Rv, rawValue);
        rawValue= 0;
        putValue(E_pubc_GW_GW_2C8_RRC_OBJ10_Vy_Rv, rawValue);
        rawValue= 0;
        putValue(E_pubc_GW_GW_2C8_RRC_OBJ10_Vx_Rv, rawValue);
        rawValue= 0;
        putValue(E_pubc_GW_GW_2C8_RRC_OBJ5_Type_Rv, rawValue);
        rawValue= 0;
        putValue(E_pubc_GW_GW_2C8_RRC_OBJ5_Dx_Rv, rawValue);
        rawValue= 0;
        putValue(E_pubc_GW_GW_2C8_RRC_OBJ5_Dy_Rv, rawValue);
        break;
     case(1) :
        rawValue= 511;
        putValue(E_pubc_GW_GW_2C8_RRC_OBJ3_Height_Rv, rawValue);
        rawValue= 510;
        putValue(E_pubc_GW_GW_2C8_RRC_OBJ5_Length_Rv, rawValue);
        rawValue= 511;
        putValue(E_pubc_GW_GW_2C8_RRC_OBJ1_Height_Rv, rawValue);
        rawValue= 127;
        putValue(E_pubc_GW_GW_2C8_RRC_OBJ10_Track_ID_Rv, rawValue);
        rawValue= 7;
        putValue(E_pubc_GW_GW_2C8_RRC_OBJ10_Type_Rv, rawValue);
        rawValue= 127;
        putValue(E_pubc_GW_GW_2C8_RRC_OBJ5_Track_ID_Rv, rawValue);
        rawValue= 4294967295;
        putValue(E_pubc_GW_GW_2C8_RRC_TiStamp_Rv, rawValue);
        rawValue= 1023;
        putValue(E_pubc_GW_GW_2C8_RRC_OBJ5_Ay_Rv, rawValue);
        rawValue= 511;
        putValue(E_pubc_GW_GW_2C8_RRC_OBJ5_Ax_Rv, rawValue);
        rawValue= 3;
        putValue(E_pubc_GW_GW_2C8_RRC_OBJ10_Location_Rv, rawValue);
        rawValue= 50;
        putValue(E_pubc_GW_GW_2C8_RRC_OBJ5_ExistProb_Rv, rawValue);
        rawValue= 511;
        putValue(E_pubc_GW_GW_2C8_RRC_OBJ5_Height_Rv, rawValue);
        rawValue= 511;
        putValue(E_pubc_GW_GW_2C8_RRC_OBJ10_Height_Rv, rawValue);
        rawValue= 50;
        putValue(E_pubc_GW_GW_2C8_RRC_OBJ10_ObstacleProb_Rv, rawValue);
        rawValue= 1200;
        putValue(E_pubc_GW_GW_2C8_RRC_OBJ5_Width_Rv, rawValue);
        rawValue= 3;
        putValue(E_pubc_GW_GW_2C8_RRC_OBJ5_Location_Rv, rawValue);
        rawValue= 511;
        putValue(E_pubc_GW_GW_2C8_RRC_OBJ4_Height_Rv, rawValue);
        rawValue= 511;
        putValue(E_pubc_GW_GW_2C8_RRC_OBJ6_Height_Rv, rawValue);
        rawValue= 511;
        putValue(E_pubc_GW_GW_2C8_RRC_OBJ8_Height_Rv, rawValue);
        rawValue= 1;
        putValue(E_pubc_GW_GW_2C8_RRC_TiBas_Rv, rawValue);
        rawValue= 4095;
        putValue(E_pubc_GW_GW_2C8_RRC_OBJ5_Vx_Rv, rawValue);
        rawValue= 1023;
        putValue(E_pubc_GW_GW_2C8_RRC_OBJ5_Vy_Rv, rawValue);
        rawValue= 511;
        putValue(E_pubc_GW_GW_2C8_RRC_OBJ2_Height_Rv, rawValue);
        rawValue= 3;
        putValue(E_pubc_GW_GW_2C8_RRC_OBJ10_Measured_Rv, rawValue);
        rawValue= 1;
        putValue(E_pubc_GW_GW_2C8_RRC_TiOut_Rv, rawValue);
        rawValue= 511;
        putValue(E_pubc_GW_GW_2C8_RRC_OBJ10_Ax_Rv, rawValue);
        rawValue= 1023;
        putValue(E_pubc_GW_GW_2C8_RRC_OBJ10_Ay_Rv, rawValue);
        rawValue= 2047;
        putValue(E_pubc_GW_GW_2C8_RRC_OBJ10_Dy_Rv, rawValue);
        rawValue= 8191;
        putValue(E_pubc_GW_GW_2C8_RRC_OBJ10_Dx_Rv, rawValue);
        rawValue= 510;
        putValue(E_pubc_GW_GW_2C8_RRC_OBJ10_Length_Rv, rawValue);
        rawValue= 3;
        putValue(E_pubc_GW_GW_2C8_RRC_OBJ5_Measured_Rv, rawValue);
        rawValue= 511;
        putValue(E_pubc_GW_GW_2C8_RRC_OBJ9_Height_Rv, rawValue);
        rawValue= 628;
        putValue(E_pubc_GW_GW_2C8_RRC_OBJ5_HeadingAngle_Rv, rawValue);
        rawValue= 50;
        putValue(E_pubc_GW_GW_2C8_RRC_OBJ5_ObstacleProb_Rv, rawValue);
        rawValue= 1200;
        putValue(E_pubc_GW_GW_2C8_RRC_OBJ10_Width_Rv, rawValue);
        rawValue= 255;
        putValue(E_pubc_GW_GW_2C8_RRC_ObjDelay_Rv, rawValue);
        rawValue= 1;
        putValue(E_pubc_GW_GW_2C8_RRC_TiLeap_Rv, rawValue);
        rawValue= 628;
        putValue(E_pubc_GW_GW_2C8_RRC_OBJ10_HeadingAngle_Rv, rawValue);
        rawValue= 50;
        putValue(E_pubc_GW_GW_2C8_RRC_OBJ10_ExistProb_Rv, rawValue);
        rawValue= 511;
        putValue(E_pubc_GW_GW_2C8_RRC_OBJ7_Height_Rv, rawValue);
        rawValue= 1023;
        putValue(E_pubc_GW_GW_2C8_RRC_OBJ10_Vy_Rv, rawValue);
        rawValue= 4095;
        putValue(E_pubc_GW_GW_2C8_RRC_OBJ10_Vx_Rv, rawValue);
        rawValue= 7;
        putValue(E_pubc_GW_GW_2C8_RRC_OBJ5_Type_Rv, rawValue);
        rawValue= 8191;
        putValue(E_pubc_GW_GW_2C8_RRC_OBJ5_Dx_Rv, rawValue);
        rawValue= 2047;
        putValue(E_pubc_GW_GW_2C8_RRC_OBJ5_Dy_Rv, rawValue);
        break;
     default :
        rawValue= 0;
        putValue(E_pubc_GW_GW_2C8_RRC_OBJ3_Height_Rv, rawValue);
        rawValue= 0;
        putValue(E_pubc_GW_GW_2C8_RRC_OBJ5_Length_Rv, rawValue);
        rawValue= 0;
        putValue(E_pubc_GW_GW_2C8_RRC_OBJ1_Height_Rv, rawValue);
        rawValue= 0;
        putValue(E_pubc_GW_GW_2C8_RRC_OBJ10_Track_ID_Rv, rawValue);
        rawValue= 0;
        putValue(E_pubc_GW_GW_2C8_RRC_OBJ10_Type_Rv, rawValue);
        rawValue= 0;
        putValue(E_pubc_GW_GW_2C8_RRC_OBJ5_Track_ID_Rv, rawValue);
        rawValue= 0;
        putValue(E_pubc_GW_GW_2C8_RRC_TiStamp_Rv, rawValue);
        rawValue= 0;
        putValue(E_pubc_GW_GW_2C8_RRC_OBJ5_Ay_Rv, rawValue);
        rawValue= 0;
        putValue(E_pubc_GW_GW_2C8_RRC_OBJ5_Ax_Rv, rawValue);
        rawValue= 0;
        putValue(E_pubc_GW_GW_2C8_RRC_OBJ10_Location_Rv, rawValue);
        rawValue= 0;
        putValue(E_pubc_GW_GW_2C8_RRC_OBJ5_ExistProb_Rv, rawValue);
        rawValue= 0;
        putValue(E_pubc_GW_GW_2C8_RRC_OBJ5_Height_Rv, rawValue);
        rawValue= 0;
        putValue(E_pubc_GW_GW_2C8_RRC_OBJ10_Height_Rv, rawValue);
        rawValue= 0;
        putValue(E_pubc_GW_GW_2C8_RRC_OBJ10_ObstacleProb_Rv, rawValue);
        rawValue= 0;
        putValue(E_pubc_GW_GW_2C8_RRC_OBJ5_Width_Rv, rawValue);
        rawValue= 0;
        putValue(E_pubc_GW_GW_2C8_RRC_OBJ5_Location_Rv, rawValue);
        rawValue= 0;
        putValue(E_pubc_GW_GW_2C8_RRC_OBJ4_Height_Rv, rawValue);
        rawValue= 0;
        putValue(E_pubc_GW_GW_2C8_RRC_OBJ6_Height_Rv, rawValue);
        rawValue= 0;
        putValue(E_pubc_GW_GW_2C8_RRC_OBJ8_Height_Rv, rawValue);
        rawValue= 0;
        putValue(E_pubc_GW_GW_2C8_RRC_TiBas_Rv, rawValue);
        rawValue= 0;
        putValue(E_pubc_GW_GW_2C8_RRC_OBJ5_Vx_Rv, rawValue);
        rawValue= 0;
        putValue(E_pubc_GW_GW_2C8_RRC_OBJ5_Vy_Rv, rawValue);
        rawValue= 0;
        putValue(E_pubc_GW_GW_2C8_RRC_OBJ2_Height_Rv, rawValue);
        rawValue= 0;
        putValue(E_pubc_GW_GW_2C8_RRC_OBJ10_Measured_Rv, rawValue);
        rawValue= 0;
        putValue(E_pubc_GW_GW_2C8_RRC_TiOut_Rv, rawValue);
        rawValue= 0;
        putValue(E_pubc_GW_GW_2C8_RRC_OBJ10_Ax_Rv, rawValue);
        rawValue= 0;
        putValue(E_pubc_GW_GW_2C8_RRC_OBJ10_Ay_Rv, rawValue);
        rawValue= 0;
        putValue(E_pubc_GW_GW_2C8_RRC_OBJ10_Dy_Rv, rawValue);
        rawValue= 0;
        putValue(E_pubc_GW_GW_2C8_RRC_OBJ10_Dx_Rv, rawValue);
        rawValue= 0;
        putValue(E_pubc_GW_GW_2C8_RRC_OBJ10_Length_Rv, rawValue);
        rawValue= 0;
        putValue(E_pubc_GW_GW_2C8_RRC_OBJ5_Measured_Rv, rawValue);
        rawValue= 0;
        putValue(E_pubc_GW_GW_2C8_RRC_OBJ9_Height_Rv, rawValue);
        rawValue= 0;
        putValue(E_pubc_GW_GW_2C8_RRC_OBJ5_HeadingAngle_Rv, rawValue);
        rawValue= 0;
        putValue(E_pubc_GW_GW_2C8_RRC_OBJ5_ObstacleProb_Rv, rawValue);
        rawValue= 0;
        putValue(E_pubc_GW_GW_2C8_RRC_OBJ10_Width_Rv, rawValue);
        rawValue= 0;
        putValue(E_pubc_GW_GW_2C8_RRC_ObjDelay_Rv, rawValue);
        rawValue= 0;
        putValue(E_pubc_GW_GW_2C8_RRC_TiLeap_Rv, rawValue);
        rawValue= 0;
        putValue(E_pubc_GW_GW_2C8_RRC_OBJ10_HeadingAngle_Rv, rawValue);
        rawValue= 0;
        putValue(E_pubc_GW_GW_2C8_RRC_OBJ10_ExistProb_Rv, rawValue);
        rawValue= 0;
        putValue(E_pubc_GW_GW_2C8_RRC_OBJ7_Height_Rv, rawValue);
        rawValue= 0;
        putValue(E_pubc_GW_GW_2C8_RRC_OBJ10_Vy_Rv, rawValue);
        rawValue= 0;
        putValue(E_pubc_GW_GW_2C8_RRC_OBJ10_Vx_Rv, rawValue);
        rawValue= 0;
        putValue(E_pubc_GW_GW_2C8_RRC_OBJ5_Type_Rv, rawValue);
        rawValue= 0;
        putValue(E_pubc_GW_GW_2C8_RRC_OBJ5_Dx_Rv, rawValue);
        rawValue= 0;
        putValue(E_pubc_GW_GW_2C8_RRC_OBJ5_Dy_Rv, rawValue);
      break;
   }
}
/*@@end*/

/*@@envVar:E_pubc_GW_GW_2C8_Dlc:*/
on envVar E_pubc_GW_GW_2C8_Dlc
{
    if(getValue(E_pubc_GW_GW_2C8_enDlc))
    {
        Msg_GW_2C8.dlc =getValue(this);
    }
    else
    {
       Dbc_dlc = 64;
	   Msg_GW_2C8.dlc = Calc_Canfd_dlc(Dbc_dlc);
	   // Msg_GW_2C8.dlc = 64;
	   	
  }
}
/*@@end*/

/*@@envVar:E_pubc_GW_GW_2C8_enDlc:*/
on envVar E_pubc_GW_GW_2C8_enDlc
{
    //For Messages with DLC = 8, set wrong DLC to smaller than defined DLC
    //For Messages with DLC < 8 set wrong DLC to smaller/longer than defined DLC
    if(getValue(this))
    {
        Msg_GW_2C8.dlc =getValue(E_pubc_GW_GW_2C8_Dlc);
    }
    else
    {
       Dbc_dlc = 64;
	   Msg_GW_2C8.dlc = Calc_Canfd_dlc(Dbc_dlc);
	   // Msg_GW_2C8.dlc = 64;
    }
}
/*@@end*/

/*@@envVar:E_pubc_GW_GW_2C8_RRC_CRCCheck_2C8_wrongvalctr:*/
on envVar E_pubc_GW_GW_2C8_RRC_CRCCheck_2C8_wrongvalctr
{
    //update disturb count
    //disturb value range:(-1 = always send wrong value),( X>0 ,x is the number of Messages with wrong CHK sent)
    GW_2C8_RRC_CRCCheck_2C8_wrongvalctr =getValue(this);    
}
/*@@end*/
/*@@envVar:E_pubc_GW_GW_2C8_RRC_RollingCounter_2C8_wrongvalctr:*/
on envVar E_pubc_GW_GW_2C8_RRC_RollingCounter_2C8_wrongvalctr
{
    //update disturb count
    //disturb value range:(-1 = always send wrong value),( X>0 ,x is the number of Messages with wrong CHK sent)
    GW_2C8_RRC_RollingCounter_2C8_wrongvalctr =getValue(this);    
}
/*@@end*/

/*@@envVar:E_pubc_GW_GW_2C8_RRC_OBJ3_Height_Rv:*/
on envVar E_pubc_GW_GW_2C8_RRC_OBJ3_Height_Rv
{
    int64 rawValue = 0ll;
    float rawValue_float = 0.0;
    float phyValue = 0.0;        

    //set the signal with updated raw value
    {
        rawValue = getvalue(this);
        if(chgEv_GW_2C8_RRC_OBJ3_Height == 0)
        {
            //type conversion to float
            rawValue_float = rawValue;        
            // raw to physical conversion
            phyValue = ((rawValue_float *0.01)+(0));
            putValue(E_pubc_GW_GW_2C8_RRC_OBJ3_Height_Pv, phyValue);
            chgEv_GW_2C8_RRC_OBJ3_Height = 1;
        }
        else
        {
            chgEv_GW_2C8_RRC_OBJ3_Height = 0;
        }    
        //update the signal value
        Msg_GW_2C8.RRC_OBJ3_Height=rawValue;        
    }                                                                           
}
/*@@end*/

/*@@envVar:E_pubc_GW_GW_2C8_RRC_OBJ3_Height_Pv:*/
on envVar E_pubc_GW_GW_2C8_RRC_OBJ3_Height_Pv
{
    int64 rawValue = 0ll;
    float phyValue = 0.0;
    
    //update the raw value with physical value 
    {
        if(chgEv_GW_2C8_RRC_OBJ3_Height == 0)
        {
            phyValue = getvalue(this);
            // physical to raw conversion
            rawValue = ((phyValue -(0))/0.01);
            putValue(E_pubc_GW_GW_2C8_RRC_OBJ3_Height_Rv, rawValue);
            chgEv_GW_2C8_RRC_OBJ3_Height = 1;  
        }
        else
        {
            chgEv_GW_2C8_RRC_OBJ3_Height = 0;
        }
    }
}
/*@@end*/


 
/*@@envVar:E_pubc_GW_GW_2C8_RRC_OBJ5_Length_Rv:*/
on envVar E_pubc_GW_GW_2C8_RRC_OBJ5_Length_Rv
{
    int64 rawValue = 0ll;
    float rawValue_float = 0.0;
    float phyValue = 0.0;        

    //set the signal with updated raw value
    {
        rawValue = getvalue(this);
        if(chgEv_GW_2C8_RRC_OBJ5_Length == 0)
        {
            //type conversion to float
            rawValue_float = rawValue;        
            // raw to physical conversion
            phyValue = ((rawValue_float *0.05)+(0));
            putValue(E_pubc_GW_GW_2C8_RRC_OBJ5_Length_Pv, phyValue);
            chgEv_GW_2C8_RRC_OBJ5_Length = 1;
        }
        else
        {
            chgEv_GW_2C8_RRC_OBJ5_Length = 0;
        }    
        //update the signal value
        Msg_GW_2C8.RRC_OBJ5_Length=rawValue;        
    }                                                                           
}
/*@@end*/

/*@@envVar:E_pubc_GW_GW_2C8_RRC_OBJ5_Length_Pv:*/
on envVar E_pubc_GW_GW_2C8_RRC_OBJ5_Length_Pv
{
    int64 rawValue = 0ll;
    float phyValue = 0.0;
    
    //update the raw value with physical value 
    {
        if(chgEv_GW_2C8_RRC_OBJ5_Length == 0)
        {
            phyValue = getvalue(this);
            // physical to raw conversion
            rawValue = ((phyValue -(0))/0.05);
            putValue(E_pubc_GW_GW_2C8_RRC_OBJ5_Length_Rv, rawValue);
            chgEv_GW_2C8_RRC_OBJ5_Length = 1;  
        }
        else
        {
            chgEv_GW_2C8_RRC_OBJ5_Length = 0;
        }
    }
}
/*@@end*/


 
/*@@envVar:E_pubc_GW_GW_2C8_RRC_OBJ1_Height_Rv:*/
on envVar E_pubc_GW_GW_2C8_RRC_OBJ1_Height_Rv
{
    int64 rawValue = 0ll;
    float rawValue_float = 0.0;
    float phyValue = 0.0;        

    //set the signal with updated raw value
    {
        rawValue = getvalue(this);
        if(chgEv_GW_2C8_RRC_OBJ1_Height == 0)
        {
            //type conversion to float
            rawValue_float = rawValue;        
            // raw to physical conversion
            phyValue = ((rawValue_float *0.01)+(0));
            putValue(E_pubc_GW_GW_2C8_RRC_OBJ1_Height_Pv, phyValue);
            chgEv_GW_2C8_RRC_OBJ1_Height = 1;
        }
        else
        {
            chgEv_GW_2C8_RRC_OBJ1_Height = 0;
        }    
        //update the signal value
        Msg_GW_2C8.RRC_OBJ1_Height=rawValue;        
    }                                                                           
}
/*@@end*/

/*@@envVar:E_pubc_GW_GW_2C8_RRC_OBJ1_Height_Pv:*/
on envVar E_pubc_GW_GW_2C8_RRC_OBJ1_Height_Pv
{
    int64 rawValue = 0ll;
    float phyValue = 0.0;
    
    //update the raw value with physical value 
    {
        if(chgEv_GW_2C8_RRC_OBJ1_Height == 0)
        {
            phyValue = getvalue(this);
            // physical to raw conversion
            rawValue = ((phyValue -(0))/0.01);
            putValue(E_pubc_GW_GW_2C8_RRC_OBJ1_Height_Rv, rawValue);
            chgEv_GW_2C8_RRC_OBJ1_Height = 1;  
        }
        else
        {
            chgEv_GW_2C8_RRC_OBJ1_Height = 0;
        }
    }
}
/*@@end*/


 
/*@@envVar:E_pubc_GW_GW_2C8_RRC_OBJ10_Track_ID_Rv:*/
on envVar E_pubc_GW_GW_2C8_RRC_OBJ10_Track_ID_Rv
{
    int64 rawValue = 0ll;
    float rawValue_float = 0.0;
    float phyValue = 0.0;        

    //set the signal with updated raw value
    {
        rawValue = getvalue(this);
        if(chgEv_GW_2C8_RRC_OBJ10_Track_ID == 0)
        {
            //type conversion to float
            rawValue_float = rawValue;        
            // raw to physical conversion
            phyValue = ((rawValue_float *1)+(0));
            putValue(E_pubc_GW_GW_2C8_RRC_OBJ10_Track_ID_Pv, phyValue);
            chgEv_GW_2C8_RRC_OBJ10_Track_ID = 1;
        }
        else
        {
            chgEv_GW_2C8_RRC_OBJ10_Track_ID = 0;
        }    
        //update the signal value
        Msg_GW_2C8.RRC_OBJ10_Track_ID=rawValue;        
    }                                                                           
}
/*@@end*/

/*@@envVar:E_pubc_GW_GW_2C8_RRC_OBJ10_Track_ID_Pv:*/
on envVar E_pubc_GW_GW_2C8_RRC_OBJ10_Track_ID_Pv
{
    int64 rawValue = 0ll;
    float phyValue = 0.0;
    
    //update the raw value with physical value 
    {
        if(chgEv_GW_2C8_RRC_OBJ10_Track_ID == 0)
        {
            phyValue = getvalue(this);
            // physical to raw conversion
            rawValue = ((phyValue -(0))/1);
            putValue(E_pubc_GW_GW_2C8_RRC_OBJ10_Track_ID_Rv, rawValue);
            chgEv_GW_2C8_RRC_OBJ10_Track_ID = 1;  
        }
        else
        {
            chgEv_GW_2C8_RRC_OBJ10_Track_ID = 0;
        }
    }
}
/*@@end*/


 
/*@@envVar:E_pubc_GW_GW_2C8_RRC_OBJ10_Type_Rv:*/
on envVar E_pubc_GW_GW_2C8_RRC_OBJ10_Type_Rv
{
    int64 rawValue = 0ll;
    float rawValue_float = 0.0;
    float phyValue = 0.0;        

    //set the signal with updated raw value
    if(getValue(E_pubc_GW_GW_2C8_RRC_OBJ10_Type_SetVt)==0)
    {
        rawValue = getvalue(this);
        if(chgEv_GW_2C8_RRC_OBJ10_Type == 0)
        {
            //type conversion to float
            rawValue_float = rawValue;        
            // raw to physical conversion
            phyValue = ((rawValue_float *1)+(0));
            putValue(E_pubc_GW_GW_2C8_RRC_OBJ10_Type_Pv, phyValue);
            chgEv_GW_2C8_RRC_OBJ10_Type = 1;
        }
        else
        {
            chgEv_GW_2C8_RRC_OBJ10_Type = 0;
        }    
        //update the signal value
        Msg_GW_2C8.RRC_OBJ10_Type=rawValue;        
    }                                                                           
}
/*@@end*/

/*@@envVar:E_pubc_GW_GW_2C8_RRC_OBJ10_Type_Pv:*/
on envVar E_pubc_GW_GW_2C8_RRC_OBJ10_Type_Pv
{
    int64 rawValue = 0ll;
    float phyValue = 0.0;
    
    //update the raw value with physical value 
    if(getValue(E_pubc_GW_GW_2C8_RRC_OBJ10_Type_SetVt)==0)
    {
        if(chgEv_GW_2C8_RRC_OBJ10_Type == 0)
        {
            phyValue = getvalue(this);
            // physical to raw conversion
            rawValue = ((phyValue -(0))/1);
            putValue(E_pubc_GW_GW_2C8_RRC_OBJ10_Type_Rv, rawValue);
            chgEv_GW_2C8_RRC_OBJ10_Type = 1;  
        }
        else
        {
            chgEv_GW_2C8_RRC_OBJ10_Type = 0;
        }
    }
}
/*@@end*/

/*@@envVar:E_pubc_GW_GW_2C8_RRC_OBJ10_Type_Vt:*/
on envVar E_pubc_GW_GW_2C8_RRC_OBJ10_Type_Vt
{
    qword rawValue = 0ll;
    if(getValue(E_pubc_GW_GW_2C8_RRC_OBJ10_Type_SetVt))
    {
        //update the signal value
        Msg_GW_2C8.RRC_OBJ10_Type=getValue(this);
    }
}
/*@@end*/

/*@@envVar:E_pubc_GW_GW_2C8_RRC_OBJ10_Type_SetVt:*/
on envVar E_pubc_GW_GW_2C8_RRC_OBJ10_Type_SetVt
{
    if(getValue(E_pubc_GW_GW_2C8_RRC_OBJ10_Type_SetVt))
    {
        //update the signal value
        Msg_GW_2C8.RRC_OBJ10_Type=getvalue(E_pubc_GW_GW_2C8_RRC_OBJ10_Type_Vt);
    }
    else
    {
        Msg_GW_2C8.RRC_OBJ10_Type=getValue(E_pubc_GW_GW_2C8_RRC_OBJ10_Type_Rv);
    }
}
/*@@end*/
 
/*@@envVar:E_pubc_GW_GW_2C8_RRC_OBJ5_Track_ID_Rv:*/
on envVar E_pubc_GW_GW_2C8_RRC_OBJ5_Track_ID_Rv
{
    int64 rawValue = 0ll;
    float rawValue_float = 0.0;
    float phyValue = 0.0;        

    //set the signal with updated raw value
    {
        rawValue = getvalue(this);
        if(chgEv_GW_2C8_RRC_OBJ5_Track_ID == 0)
        {
            //type conversion to float
            rawValue_float = rawValue;        
            // raw to physical conversion
            phyValue = ((rawValue_float *1)+(0));
            putValue(E_pubc_GW_GW_2C8_RRC_OBJ5_Track_ID_Pv, phyValue);
            chgEv_GW_2C8_RRC_OBJ5_Track_ID = 1;
        }
        else
        {
            chgEv_GW_2C8_RRC_OBJ5_Track_ID = 0;
        }    
        //update the signal value
        Msg_GW_2C8.RRC_OBJ5_Track_ID=rawValue;        
    }                                                                           
}
/*@@end*/

/*@@envVar:E_pubc_GW_GW_2C8_RRC_OBJ5_Track_ID_Pv:*/
on envVar E_pubc_GW_GW_2C8_RRC_OBJ5_Track_ID_Pv
{
    int64 rawValue = 0ll;
    float phyValue = 0.0;
    
    //update the raw value with physical value 
    {
        if(chgEv_GW_2C8_RRC_OBJ5_Track_ID == 0)
        {
            phyValue = getvalue(this);
            // physical to raw conversion
            rawValue = ((phyValue -(0))/1);
            putValue(E_pubc_GW_GW_2C8_RRC_OBJ5_Track_ID_Rv, rawValue);
            chgEv_GW_2C8_RRC_OBJ5_Track_ID = 1;  
        }
        else
        {
            chgEv_GW_2C8_RRC_OBJ5_Track_ID = 0;
        }
    }
}
/*@@end*/


 
/*@@envVar:E_pubc_GW_GW_2C8_RRC_TiStamp_Rv:*/
on envVar E_pubc_GW_GW_2C8_RRC_TiStamp_Rv
{
    int64 rawValue = 0ll;
    float rawValue_float = 0.0;
    float phyValue = 0.0;        

    //set the signal with updated raw value
    {
        rawValue = getvalue(this);
        if(chgEv_GW_2C8_RRC_TiStamp == 0)
        {
            //type conversion to float
            rawValue_float = rawValue;        
            // raw to physical conversion
            phyValue = ((rawValue_float *0.0001)+(0));
            putValue(E_pubc_GW_GW_2C8_RRC_TiStamp_Pv, phyValue);
            chgEv_GW_2C8_RRC_TiStamp = 1;
        }
        else
        {
            chgEv_GW_2C8_RRC_TiStamp = 0;
        }    
        //update the signal value
        Msg_GW_2C8.RRC_TiStamp=rawValue;        
    }                                                                           
}
/*@@end*/

/*@@envVar:E_pubc_GW_GW_2C8_RRC_TiStamp_Pv:*/
on envVar E_pubc_GW_GW_2C8_RRC_TiStamp_Pv
{
    int64 rawValue = 0ll;
    float phyValue = 0.0;
    
    //update the raw value with physical value 
    {
        if(chgEv_GW_2C8_RRC_TiStamp == 0)
        {
            phyValue = getvalue(this);
            // physical to raw conversion
            rawValue = ((phyValue -(0))/0.0001);
            putValue(E_pubc_GW_GW_2C8_RRC_TiStamp_Rv, rawValue);
            chgEv_GW_2C8_RRC_TiStamp = 1;  
        }
        else
        {
            chgEv_GW_2C8_RRC_TiStamp = 0;
        }
    }
}
/*@@end*/


 
/*@@envVar:E_pubc_GW_GW_2C8_RRC_OBJ5_Ay_Rv:*/
on envVar E_pubc_GW_GW_2C8_RRC_OBJ5_Ay_Rv
{
    int64 rawValue = 0ll;
    float rawValue_float = 0.0;
    float phyValue = 0.0;        

    //set the signal with updated raw value
    {
        rawValue = getvalue(this);
        if(chgEv_GW_2C8_RRC_OBJ5_Ay == 0)
        {
            //type conversion to float
            rawValue_float = rawValue;        
            // raw to physical conversion
            phyValue = ((rawValue_float *0.03125)+(-16));
            putValue(E_pubc_GW_GW_2C8_RRC_OBJ5_Ay_Pv, phyValue);
            chgEv_GW_2C8_RRC_OBJ5_Ay = 1;
        }
        else
        {
            chgEv_GW_2C8_RRC_OBJ5_Ay = 0;
        }    
        //update the signal value
        Msg_GW_2C8.RRC_OBJ5_Ay=rawValue;        
    }                                                                           
}
/*@@end*/

/*@@envVar:E_pubc_GW_GW_2C8_RRC_OBJ5_Ay_Pv:*/
on envVar E_pubc_GW_GW_2C8_RRC_OBJ5_Ay_Pv
{
    int64 rawValue = 0ll;
    float phyValue = 0.0;
    
    //update the raw value with physical value 
    {
        if(chgEv_GW_2C8_RRC_OBJ5_Ay == 0)
        {
            phyValue = getvalue(this);
            // physical to raw conversion
            rawValue = ((phyValue -(-16))/0.03125);
            putValue(E_pubc_GW_GW_2C8_RRC_OBJ5_Ay_Rv, rawValue);
            chgEv_GW_2C8_RRC_OBJ5_Ay = 1;  
        }
        else
        {
            chgEv_GW_2C8_RRC_OBJ5_Ay = 0;
        }
    }
}
/*@@end*/


 
/*@@envVar:E_pubc_GW_GW_2C8_RRC_OBJ5_Ax_Rv:*/
on envVar E_pubc_GW_GW_2C8_RRC_OBJ5_Ax_Rv
{
    int64 rawValue = 0ll;
    float rawValue_float = 0.0;
    float phyValue = 0.0;        

    //set the signal with updated raw value
    {
        rawValue = getvalue(this);
        if(chgEv_GW_2C8_RRC_OBJ5_Ax == 0)
        {
            //type conversion to float
            rawValue_float = rawValue;        
            // raw to physical conversion
            phyValue = ((rawValue_float *0.0625)+(-16));
            putValue(E_pubc_GW_GW_2C8_RRC_OBJ5_Ax_Pv, phyValue);
            chgEv_GW_2C8_RRC_OBJ5_Ax = 1;
        }
        else
        {
            chgEv_GW_2C8_RRC_OBJ5_Ax = 0;
        }    
        //update the signal value
        Msg_GW_2C8.RRC_OBJ5_Ax=rawValue;        
    }                                                                           
}
/*@@end*/

/*@@envVar:E_pubc_GW_GW_2C8_RRC_OBJ5_Ax_Pv:*/
on envVar E_pubc_GW_GW_2C8_RRC_OBJ5_Ax_Pv
{
    int64 rawValue = 0ll;
    float phyValue = 0.0;
    
    //update the raw value with physical value 
    {
        if(chgEv_GW_2C8_RRC_OBJ5_Ax == 0)
        {
            phyValue = getvalue(this);
            // physical to raw conversion
            rawValue = ((phyValue -(-16))/0.0625);
            putValue(E_pubc_GW_GW_2C8_RRC_OBJ5_Ax_Rv, rawValue);
            chgEv_GW_2C8_RRC_OBJ5_Ax = 1;  
        }
        else
        {
            chgEv_GW_2C8_RRC_OBJ5_Ax = 0;
        }
    }
}
/*@@end*/


 
/*@@envVar:E_pubc_GW_GW_2C8_RRC_OBJ10_Location_Rv:*/
on envVar E_pubc_GW_GW_2C8_RRC_OBJ10_Location_Rv
{
    int64 rawValue = 0ll;
    float rawValue_float = 0.0;
    float phyValue = 0.0;        

    //set the signal with updated raw value
    if(getValue(E_pubc_GW_GW_2C8_RRC_OBJ10_Location_SetVt)==0)
    {
        rawValue = getvalue(this);
        if(chgEv_GW_2C8_RRC_OBJ10_Location == 0)
        {
            //type conversion to float
            rawValue_float = rawValue;        
            // raw to physical conversion
            phyValue = ((rawValue_float *1)+(0));
            putValue(E_pubc_GW_GW_2C8_RRC_OBJ10_Location_Pv, phyValue);
            chgEv_GW_2C8_RRC_OBJ10_Location = 1;
        }
        else
        {
            chgEv_GW_2C8_RRC_OBJ10_Location = 0;
        }    
        //update the signal value
        Msg_GW_2C8.RRC_OBJ10_Location=rawValue;        
    }                                                                           
}
/*@@end*/

/*@@envVar:E_pubc_GW_GW_2C8_RRC_OBJ10_Location_Pv:*/
on envVar E_pubc_GW_GW_2C8_RRC_OBJ10_Location_Pv
{
    int64 rawValue = 0ll;
    float phyValue = 0.0;
    
    //update the raw value with physical value 
    if(getValue(E_pubc_GW_GW_2C8_RRC_OBJ10_Location_SetVt)==0)
    {
        if(chgEv_GW_2C8_RRC_OBJ10_Location == 0)
        {
            phyValue = getvalue(this);
            // physical to raw conversion
            rawValue = ((phyValue -(0))/1);
            putValue(E_pubc_GW_GW_2C8_RRC_OBJ10_Location_Rv, rawValue);
            chgEv_GW_2C8_RRC_OBJ10_Location = 1;  
        }
        else
        {
            chgEv_GW_2C8_RRC_OBJ10_Location = 0;
        }
    }
}
/*@@end*/

/*@@envVar:E_pubc_GW_GW_2C8_RRC_OBJ10_Location_Vt:*/
on envVar E_pubc_GW_GW_2C8_RRC_OBJ10_Location_Vt
{
    qword rawValue = 0ll;
    if(getValue(E_pubc_GW_GW_2C8_RRC_OBJ10_Location_SetVt))
    {
        //update the signal value
        Msg_GW_2C8.RRC_OBJ10_Location=getValue(this);
    }
}
/*@@end*/

/*@@envVar:E_pubc_GW_GW_2C8_RRC_OBJ10_Location_SetVt:*/
on envVar E_pubc_GW_GW_2C8_RRC_OBJ10_Location_SetVt
{
    if(getValue(E_pubc_GW_GW_2C8_RRC_OBJ10_Location_SetVt))
    {
        //update the signal value
        Msg_GW_2C8.RRC_OBJ10_Location=getvalue(E_pubc_GW_GW_2C8_RRC_OBJ10_Location_Vt);
    }
    else
    {
        Msg_GW_2C8.RRC_OBJ10_Location=getValue(E_pubc_GW_GW_2C8_RRC_OBJ10_Location_Rv);
    }
}
/*@@end*/
 
/*@@envVar:E_pubc_GW_GW_2C8_RRC_OBJ5_ExistProb_Rv:*/
on envVar E_pubc_GW_GW_2C8_RRC_OBJ5_ExistProb_Rv
{
    int64 rawValue = 0ll;
    float rawValue_float = 0.0;
    float phyValue = 0.0;        

    //set the signal with updated raw value
    {
        rawValue = getvalue(this);
        if(chgEv_GW_2C8_RRC_OBJ5_ExistProb == 0)
        {
            //type conversion to float
            rawValue_float = rawValue;        
            // raw to physical conversion
            phyValue = ((rawValue_float *2)+(0));
            putValue(E_pubc_GW_GW_2C8_RRC_OBJ5_ExistProb_Pv, phyValue);
            chgEv_GW_2C8_RRC_OBJ5_ExistProb = 1;
        }
        else
        {
            chgEv_GW_2C8_RRC_OBJ5_ExistProb = 0;
        }    
        //update the signal value
        Msg_GW_2C8.RRC_OBJ5_ExistProb=rawValue;        
    }                                                                           
}
/*@@end*/

/*@@envVar:E_pubc_GW_GW_2C8_RRC_OBJ5_ExistProb_Pv:*/
on envVar E_pubc_GW_GW_2C8_RRC_OBJ5_ExistProb_Pv
{
    int64 rawValue = 0ll;
    float phyValue = 0.0;
    
    //update the raw value with physical value 
    {
        if(chgEv_GW_2C8_RRC_OBJ5_ExistProb == 0)
        {
            phyValue = getvalue(this);
            // physical to raw conversion
            rawValue = ((phyValue -(0))/2);
            putValue(E_pubc_GW_GW_2C8_RRC_OBJ5_ExistProb_Rv, rawValue);
            chgEv_GW_2C8_RRC_OBJ5_ExistProb = 1;  
        }
        else
        {
            chgEv_GW_2C8_RRC_OBJ5_ExistProb = 0;
        }
    }
}
/*@@end*/


 
/*@@envVar:E_pubc_GW_GW_2C8_RRC_OBJ5_Height_Rv:*/
on envVar E_pubc_GW_GW_2C8_RRC_OBJ5_Height_Rv
{
    int64 rawValue = 0ll;
    float rawValue_float = 0.0;
    float phyValue = 0.0;        

    //set the signal with updated raw value
    {
        rawValue = getvalue(this);
        if(chgEv_GW_2C8_RRC_OBJ5_Height == 0)
        {
            //type conversion to float
            rawValue_float = rawValue;        
            // raw to physical conversion
            phyValue = ((rawValue_float *0.01)+(0));
            putValue(E_pubc_GW_GW_2C8_RRC_OBJ5_Height_Pv, phyValue);
            chgEv_GW_2C8_RRC_OBJ5_Height = 1;
        }
        else
        {
            chgEv_GW_2C8_RRC_OBJ5_Height = 0;
        }    
        //update the signal value
        Msg_GW_2C8.RRC_OBJ5_Height=rawValue;        
    }                                                                           
}
/*@@end*/

/*@@envVar:E_pubc_GW_GW_2C8_RRC_OBJ5_Height_Pv:*/
on envVar E_pubc_GW_GW_2C8_RRC_OBJ5_Height_Pv
{
    int64 rawValue = 0ll;
    float phyValue = 0.0;
    
    //update the raw value with physical value 
    {
        if(chgEv_GW_2C8_RRC_OBJ5_Height == 0)
        {
            phyValue = getvalue(this);
            // physical to raw conversion
            rawValue = ((phyValue -(0))/0.01);
            putValue(E_pubc_GW_GW_2C8_RRC_OBJ5_Height_Rv, rawValue);
            chgEv_GW_2C8_RRC_OBJ5_Height = 1;  
        }
        else
        {
            chgEv_GW_2C8_RRC_OBJ5_Height = 0;
        }
    }
}
/*@@end*/


 
/*@@envVar:E_pubc_GW_GW_2C8_RRC_OBJ10_Height_Rv:*/
on envVar E_pubc_GW_GW_2C8_RRC_OBJ10_Height_Rv
{
    int64 rawValue = 0ll;
    float rawValue_float = 0.0;
    float phyValue = 0.0;        

    //set the signal with updated raw value
    {
        rawValue = getvalue(this);
        if(chgEv_GW_2C8_RRC_OBJ10_Height == 0)
        {
            //type conversion to float
            rawValue_float = rawValue;        
            // raw to physical conversion
            phyValue = ((rawValue_float *0.01)+(0));
            putValue(E_pubc_GW_GW_2C8_RRC_OBJ10_Height_Pv, phyValue);
            chgEv_GW_2C8_RRC_OBJ10_Height = 1;
        }
        else
        {
            chgEv_GW_2C8_RRC_OBJ10_Height = 0;
        }    
        //update the signal value
        Msg_GW_2C8.RRC_OBJ10_Height=rawValue;        
    }                                                                           
}
/*@@end*/

/*@@envVar:E_pubc_GW_GW_2C8_RRC_OBJ10_Height_Pv:*/
on envVar E_pubc_GW_GW_2C8_RRC_OBJ10_Height_Pv
{
    int64 rawValue = 0ll;
    float phyValue = 0.0;
    
    //update the raw value with physical value 
    {
        if(chgEv_GW_2C8_RRC_OBJ10_Height == 0)
        {
            phyValue = getvalue(this);
            // physical to raw conversion
            rawValue = ((phyValue -(0))/0.01);
            putValue(E_pubc_GW_GW_2C8_RRC_OBJ10_Height_Rv, rawValue);
            chgEv_GW_2C8_RRC_OBJ10_Height = 1;  
        }
        else
        {
            chgEv_GW_2C8_RRC_OBJ10_Height = 0;
        }
    }
}
/*@@end*/


 
/*@@envVar:E_pubc_GW_GW_2C8_RRC_OBJ10_ObstacleProb_Rv:*/
on envVar E_pubc_GW_GW_2C8_RRC_OBJ10_ObstacleProb_Rv
{
    int64 rawValue = 0ll;
    float rawValue_float = 0.0;
    float phyValue = 0.0;        

    //set the signal with updated raw value
    {
        rawValue = getvalue(this);
        if(chgEv_GW_2C8_RRC_OBJ10_ObstacleProb == 0)
        {
            //type conversion to float
            rawValue_float = rawValue;        
            // raw to physical conversion
            phyValue = ((rawValue_float *2)+(0));
            putValue(E_pubc_GW_GW_2C8_RRC_OBJ10_ObstacleProb_Pv, phyValue);
            chgEv_GW_2C8_RRC_OBJ10_ObstacleProb = 1;
        }
        else
        {
            chgEv_GW_2C8_RRC_OBJ10_ObstacleProb = 0;
        }    
        //update the signal value
        Msg_GW_2C8.RRC_OBJ10_ObstacleProb=rawValue;        
    }                                                                           
}
/*@@end*/

/*@@envVar:E_pubc_GW_GW_2C8_RRC_OBJ10_ObstacleProb_Pv:*/
on envVar E_pubc_GW_GW_2C8_RRC_OBJ10_ObstacleProb_Pv
{
    int64 rawValue = 0ll;
    float phyValue = 0.0;
    
    //update the raw value with physical value 
    {
        if(chgEv_GW_2C8_RRC_OBJ10_ObstacleProb == 0)
        {
            phyValue = getvalue(this);
            // physical to raw conversion
            rawValue = ((phyValue -(0))/2);
            putValue(E_pubc_GW_GW_2C8_RRC_OBJ10_ObstacleProb_Rv, rawValue);
            chgEv_GW_2C8_RRC_OBJ10_ObstacleProb = 1;  
        }
        else
        {
            chgEv_GW_2C8_RRC_OBJ10_ObstacleProb = 0;
        }
    }
}
/*@@end*/


 
/*@@envVar:E_pubc_GW_GW_2C8_RRC_OBJ5_Width_Rv:*/
on envVar E_pubc_GW_GW_2C8_RRC_OBJ5_Width_Rv
{
    int64 rawValue = 0ll;
    float rawValue_float = 0.0;
    float phyValue = 0.0;        

    //set the signal with updated raw value
    {
        rawValue = getvalue(this);
        if(chgEv_GW_2C8_RRC_OBJ5_Width == 0)
        {
            //type conversion to float
            rawValue_float = rawValue;        
            // raw to physical conversion
            phyValue = ((rawValue_float *0.01)+(0));
            putValue(E_pubc_GW_GW_2C8_RRC_OBJ5_Width_Pv, phyValue);
            chgEv_GW_2C8_RRC_OBJ5_Width = 1;
        }
        else
        {
            chgEv_GW_2C8_RRC_OBJ5_Width = 0;
        }    
        //update the signal value
        Msg_GW_2C8.RRC_OBJ5_Width=rawValue;        
    }                                                                           
}
/*@@end*/

/*@@envVar:E_pubc_GW_GW_2C8_RRC_OBJ5_Width_Pv:*/
on envVar E_pubc_GW_GW_2C8_RRC_OBJ5_Width_Pv
{
    int64 rawValue = 0ll;
    float phyValue = 0.0;
    
    //update the raw value with physical value 
    {
        if(chgEv_GW_2C8_RRC_OBJ5_Width == 0)
        {
            phyValue = getvalue(this);
            // physical to raw conversion
            rawValue = ((phyValue -(0))/0.01);
            putValue(E_pubc_GW_GW_2C8_RRC_OBJ5_Width_Rv, rawValue);
            chgEv_GW_2C8_RRC_OBJ5_Width = 1;  
        }
        else
        {
            chgEv_GW_2C8_RRC_OBJ5_Width = 0;
        }
    }
}
/*@@end*/


 
/*@@envVar:E_pubc_GW_GW_2C8_RRC_OBJ5_Location_Rv:*/
on envVar E_pubc_GW_GW_2C8_RRC_OBJ5_Location_Rv
{
    int64 rawValue = 0ll;
    float rawValue_float = 0.0;
    float phyValue = 0.0;        

    //set the signal with updated raw value
    if(getValue(E_pubc_GW_GW_2C8_RRC_OBJ5_Location_SetVt)==0)
    {
        rawValue = getvalue(this);
        if(chgEv_GW_2C8_RRC_OBJ5_Location == 0)
        {
            //type conversion to float
            rawValue_float = rawValue;        
            // raw to physical conversion
            phyValue = ((rawValue_float *1)+(0));
            putValue(E_pubc_GW_GW_2C8_RRC_OBJ5_Location_Pv, phyValue);
            chgEv_GW_2C8_RRC_OBJ5_Location = 1;
        }
        else
        {
            chgEv_GW_2C8_RRC_OBJ5_Location = 0;
        }    
        //update the signal value
        Msg_GW_2C8.RRC_OBJ5_Location=rawValue;        
    }                                                                           
}
/*@@end*/

/*@@envVar:E_pubc_GW_GW_2C8_RRC_OBJ5_Location_Pv:*/
on envVar E_pubc_GW_GW_2C8_RRC_OBJ5_Location_Pv
{
    int64 rawValue = 0ll;
    float phyValue = 0.0;
    
    //update the raw value with physical value 
    if(getValue(E_pubc_GW_GW_2C8_RRC_OBJ5_Location_SetVt)==0)
    {
        if(chgEv_GW_2C8_RRC_OBJ5_Location == 0)
        {
            phyValue = getvalue(this);
            // physical to raw conversion
            rawValue = ((phyValue -(0))/1);
            putValue(E_pubc_GW_GW_2C8_RRC_OBJ5_Location_Rv, rawValue);
            chgEv_GW_2C8_RRC_OBJ5_Location = 1;  
        }
        else
        {
            chgEv_GW_2C8_RRC_OBJ5_Location = 0;
        }
    }
}
/*@@end*/

/*@@envVar:E_pubc_GW_GW_2C8_RRC_OBJ5_Location_Vt:*/
on envVar E_pubc_GW_GW_2C8_RRC_OBJ5_Location_Vt
{
    qword rawValue = 0ll;
    if(getValue(E_pubc_GW_GW_2C8_RRC_OBJ5_Location_SetVt))
    {
        //update the signal value
        Msg_GW_2C8.RRC_OBJ5_Location=getValue(this);
    }
}
/*@@end*/

/*@@envVar:E_pubc_GW_GW_2C8_RRC_OBJ5_Location_SetVt:*/
on envVar E_pubc_GW_GW_2C8_RRC_OBJ5_Location_SetVt
{
    if(getValue(E_pubc_GW_GW_2C8_RRC_OBJ5_Location_SetVt))
    {
        //update the signal value
        Msg_GW_2C8.RRC_OBJ5_Location=getvalue(E_pubc_GW_GW_2C8_RRC_OBJ5_Location_Vt);
    }
    else
    {
        Msg_GW_2C8.RRC_OBJ5_Location=getValue(E_pubc_GW_GW_2C8_RRC_OBJ5_Location_Rv);
    }
}
/*@@end*/
 
/*@@envVar:E_pubc_GW_GW_2C8_RRC_OBJ4_Height_Rv:*/
on envVar E_pubc_GW_GW_2C8_RRC_OBJ4_Height_Rv
{
    int64 rawValue = 0ll;
    float rawValue_float = 0.0;
    float phyValue = 0.0;        

    //set the signal with updated raw value
    {
        rawValue = getvalue(this);
        if(chgEv_GW_2C8_RRC_OBJ4_Height == 0)
        {
            //type conversion to float
            rawValue_float = rawValue;        
            // raw to physical conversion
            phyValue = ((rawValue_float *0.01)+(0));
            putValue(E_pubc_GW_GW_2C8_RRC_OBJ4_Height_Pv, phyValue);
            chgEv_GW_2C8_RRC_OBJ4_Height = 1;
        }
        else
        {
            chgEv_GW_2C8_RRC_OBJ4_Height = 0;
        }    
        //update the signal value
        Msg_GW_2C8.RRC_OBJ4_Height=rawValue;        
    }                                                                           
}
/*@@end*/

/*@@envVar:E_pubc_GW_GW_2C8_RRC_OBJ4_Height_Pv:*/
on envVar E_pubc_GW_GW_2C8_RRC_OBJ4_Height_Pv
{
    int64 rawValue = 0ll;
    float phyValue = 0.0;
    
    //update the raw value with physical value 
    {
        if(chgEv_GW_2C8_RRC_OBJ4_Height == 0)
        {
            phyValue = getvalue(this);
            // physical to raw conversion
            rawValue = ((phyValue -(0))/0.01);
            putValue(E_pubc_GW_GW_2C8_RRC_OBJ4_Height_Rv, rawValue);
            chgEv_GW_2C8_RRC_OBJ4_Height = 1;  
        }
        else
        {
            chgEv_GW_2C8_RRC_OBJ4_Height = 0;
        }
    }
}
/*@@end*/


 
/*@@envVar:E_pubc_GW_GW_2C8_RRC_OBJ6_Height_Rv:*/
on envVar E_pubc_GW_GW_2C8_RRC_OBJ6_Height_Rv
{
    int64 rawValue = 0ll;
    float rawValue_float = 0.0;
    float phyValue = 0.0;        

    //set the signal with updated raw value
    {
        rawValue = getvalue(this);
        if(chgEv_GW_2C8_RRC_OBJ6_Height == 0)
        {
            //type conversion to float
            rawValue_float = rawValue;        
            // raw to physical conversion
            phyValue = ((rawValue_float *0.01)+(0));
            putValue(E_pubc_GW_GW_2C8_RRC_OBJ6_Height_Pv, phyValue);
            chgEv_GW_2C8_RRC_OBJ6_Height = 1;
        }
        else
        {
            chgEv_GW_2C8_RRC_OBJ6_Height = 0;
        }    
        //update the signal value
        Msg_GW_2C8.RRC_OBJ6_Height=rawValue;        
    }                                                                           
}
/*@@end*/

/*@@envVar:E_pubc_GW_GW_2C8_RRC_OBJ6_Height_Pv:*/
on envVar E_pubc_GW_GW_2C8_RRC_OBJ6_Height_Pv
{
    int64 rawValue = 0ll;
    float phyValue = 0.0;
    
    //update the raw value with physical value 
    {
        if(chgEv_GW_2C8_RRC_OBJ6_Height == 0)
        {
            phyValue = getvalue(this);
            // physical to raw conversion
            rawValue = ((phyValue -(0))/0.01);
            putValue(E_pubc_GW_GW_2C8_RRC_OBJ6_Height_Rv, rawValue);
            chgEv_GW_2C8_RRC_OBJ6_Height = 1;  
        }
        else
        {
            chgEv_GW_2C8_RRC_OBJ6_Height = 0;
        }
    }
}
/*@@end*/


 
/*@@envVar:E_pubc_GW_GW_2C8_RRC_OBJ8_Height_Rv:*/
on envVar E_pubc_GW_GW_2C8_RRC_OBJ8_Height_Rv
{
    int64 rawValue = 0ll;
    float rawValue_float = 0.0;
    float phyValue = 0.0;        

    //set the signal with updated raw value
    {
        rawValue = getvalue(this);
        if(chgEv_GW_2C8_RRC_OBJ8_Height == 0)
        {
            //type conversion to float
            rawValue_float = rawValue;        
            // raw to physical conversion
            phyValue = ((rawValue_float *0.01)+(0));
            putValue(E_pubc_GW_GW_2C8_RRC_OBJ8_Height_Pv, phyValue);
            chgEv_GW_2C8_RRC_OBJ8_Height = 1;
        }
        else
        {
            chgEv_GW_2C8_RRC_OBJ8_Height = 0;
        }    
        //update the signal value
        Msg_GW_2C8.RRC_OBJ8_Height=rawValue;        
    }                                                                           
}
/*@@end*/

/*@@envVar:E_pubc_GW_GW_2C8_RRC_OBJ8_Height_Pv:*/
on envVar E_pubc_GW_GW_2C8_RRC_OBJ8_Height_Pv
{
    int64 rawValue = 0ll;
    float phyValue = 0.0;
    
    //update the raw value with physical value 
    {
        if(chgEv_GW_2C8_RRC_OBJ8_Height == 0)
        {
            phyValue = getvalue(this);
            // physical to raw conversion
            rawValue = ((phyValue -(0))/0.01);
            putValue(E_pubc_GW_GW_2C8_RRC_OBJ8_Height_Rv, rawValue);
            chgEv_GW_2C8_RRC_OBJ8_Height = 1;  
        }
        else
        {
            chgEv_GW_2C8_RRC_OBJ8_Height = 0;
        }
    }
}
/*@@end*/


 
/*@@envVar:E_pubc_GW_GW_2C8_RRC_TiBas_Rv:*/
on envVar E_pubc_GW_GW_2C8_RRC_TiBas_Rv
{
    int64 rawValue = 0ll;
    float rawValue_float = 0.0;
    float phyValue = 0.0;        

    //set the signal with updated raw value
    {
        rawValue = getvalue(this);
        if(chgEv_GW_2C8_RRC_TiBas == 0)
        {
            //type conversion to float
            rawValue_float = rawValue;        
            // raw to physical conversion
            phyValue = ((rawValue_float *1)+(0));
            putValue(E_pubc_GW_GW_2C8_RRC_TiBas_Pv, phyValue);
            chgEv_GW_2C8_RRC_TiBas = 1;
        }
        else
        {
            chgEv_GW_2C8_RRC_TiBas = 0;
        }    
        //update the signal value
        Msg_GW_2C8.RRC_TiBas=rawValue;        
    }                                                                           
}
/*@@end*/

/*@@envVar:E_pubc_GW_GW_2C8_RRC_TiBas_Pv:*/
on envVar E_pubc_GW_GW_2C8_RRC_TiBas_Pv
{
    int64 rawValue = 0ll;
    float phyValue = 0.0;
    
    //update the raw value with physical value 
    {
        if(chgEv_GW_2C8_RRC_TiBas == 0)
        {
            phyValue = getvalue(this);
            // physical to raw conversion
            rawValue = ((phyValue -(0))/1);
            putValue(E_pubc_GW_GW_2C8_RRC_TiBas_Rv, rawValue);
            chgEv_GW_2C8_RRC_TiBas = 1;  
        }
        else
        {
            chgEv_GW_2C8_RRC_TiBas = 0;
        }
    }
}
/*@@end*/


 
/*@@envVar:E_pubc_GW_GW_2C8_RRC_OBJ5_Vx_Rv:*/
on envVar E_pubc_GW_GW_2C8_RRC_OBJ5_Vx_Rv
{
    int64 rawValue = 0ll;
    float rawValue_float = 0.0;
    float phyValue = 0.0;        

    //set the signal with updated raw value
    {
        rawValue = getvalue(this);
        if(chgEv_GW_2C8_RRC_OBJ5_Vx == 0)
        {
            //type conversion to float
            rawValue_float = rawValue;        
            // raw to physical conversion
            phyValue = ((rawValue_float *0.0625)+(-128));
            putValue(E_pubc_GW_GW_2C8_RRC_OBJ5_Vx_Pv, phyValue);
            chgEv_GW_2C8_RRC_OBJ5_Vx = 1;
        }
        else
        {
            chgEv_GW_2C8_RRC_OBJ5_Vx = 0;
        }    
        //update the signal value
        Msg_GW_2C8.RRC_OBJ5_Vx=rawValue;        
    }                                                                           
}
/*@@end*/

/*@@envVar:E_pubc_GW_GW_2C8_RRC_OBJ5_Vx_Pv:*/
on envVar E_pubc_GW_GW_2C8_RRC_OBJ5_Vx_Pv
{
    int64 rawValue = 0ll;
    float phyValue = 0.0;
    
    //update the raw value with physical value 
    {
        if(chgEv_GW_2C8_RRC_OBJ5_Vx == 0)
        {
            phyValue = getvalue(this);
            // physical to raw conversion
            rawValue = ((phyValue -(-128))/0.0625);
            putValue(E_pubc_GW_GW_2C8_RRC_OBJ5_Vx_Rv, rawValue);
            chgEv_GW_2C8_RRC_OBJ5_Vx = 1;  
        }
        else
        {
            chgEv_GW_2C8_RRC_OBJ5_Vx = 0;
        }
    }
}
/*@@end*/


 
/*@@envVar:E_pubc_GW_GW_2C8_RRC_OBJ5_Vy_Rv:*/
on envVar E_pubc_GW_GW_2C8_RRC_OBJ5_Vy_Rv
{
    int64 rawValue = 0ll;
    float rawValue_float = 0.0;
    float phyValue = 0.0;        

    //set the signal with updated raw value
    {
        rawValue = getvalue(this);
        if(chgEv_GW_2C8_RRC_OBJ5_Vy == 0)
        {
            //type conversion to float
            rawValue_float = rawValue;        
            // raw to physical conversion
            phyValue = ((rawValue_float *0.125)+(-64));
            putValue(E_pubc_GW_GW_2C8_RRC_OBJ5_Vy_Pv, phyValue);
            chgEv_GW_2C8_RRC_OBJ5_Vy = 1;
        }
        else
        {
            chgEv_GW_2C8_RRC_OBJ5_Vy = 0;
        }    
        //update the signal value
        Msg_GW_2C8.RRC_OBJ5_Vy=rawValue;        
    }                                                                           
}
/*@@end*/

/*@@envVar:E_pubc_GW_GW_2C8_RRC_OBJ5_Vy_Pv:*/
on envVar E_pubc_GW_GW_2C8_RRC_OBJ5_Vy_Pv
{
    int64 rawValue = 0ll;
    float phyValue = 0.0;
    
    //update the raw value with physical value 
    {
        if(chgEv_GW_2C8_RRC_OBJ5_Vy == 0)
        {
            phyValue = getvalue(this);
            // physical to raw conversion
            rawValue = ((phyValue -(-64))/0.125);
            putValue(E_pubc_GW_GW_2C8_RRC_OBJ5_Vy_Rv, rawValue);
            chgEv_GW_2C8_RRC_OBJ5_Vy = 1;  
        }
        else
        {
            chgEv_GW_2C8_RRC_OBJ5_Vy = 0;
        }
    }
}
/*@@end*/


 
/*@@envVar:E_pubc_GW_GW_2C8_RRC_OBJ2_Height_Rv:*/
on envVar E_pubc_GW_GW_2C8_RRC_OBJ2_Height_Rv
{
    int64 rawValue = 0ll;
    float rawValue_float = 0.0;
    float phyValue = 0.0;        

    //set the signal with updated raw value
    {
        rawValue = getvalue(this);
        if(chgEv_GW_2C8_RRC_OBJ2_Height == 0)
        {
            //type conversion to float
            rawValue_float = rawValue;        
            // raw to physical conversion
            phyValue = ((rawValue_float *0.01)+(0));
            putValue(E_pubc_GW_GW_2C8_RRC_OBJ2_Height_Pv, phyValue);
            chgEv_GW_2C8_RRC_OBJ2_Height = 1;
        }
        else
        {
            chgEv_GW_2C8_RRC_OBJ2_Height = 0;
        }    
        //update the signal value
        Msg_GW_2C8.RRC_OBJ2_Height=rawValue;        
    }                                                                           
}
/*@@end*/

/*@@envVar:E_pubc_GW_GW_2C8_RRC_OBJ2_Height_Pv:*/
on envVar E_pubc_GW_GW_2C8_RRC_OBJ2_Height_Pv
{
    int64 rawValue = 0ll;
    float phyValue = 0.0;
    
    //update the raw value with physical value 
    {
        if(chgEv_GW_2C8_RRC_OBJ2_Height == 0)
        {
            phyValue = getvalue(this);
            // physical to raw conversion
            rawValue = ((phyValue -(0))/0.01);
            putValue(E_pubc_GW_GW_2C8_RRC_OBJ2_Height_Rv, rawValue);
            chgEv_GW_2C8_RRC_OBJ2_Height = 1;  
        }
        else
        {
            chgEv_GW_2C8_RRC_OBJ2_Height = 0;
        }
    }
}
/*@@end*/


 
/*@@envVar:E_pubc_GW_GW_2C8_RRC_OBJ10_Measured_Rv:*/
on envVar E_pubc_GW_GW_2C8_RRC_OBJ10_Measured_Rv
{
    int64 rawValue = 0ll;
    float rawValue_float = 0.0;
    float phyValue = 0.0;        

    //set the signal with updated raw value
    if(getValue(E_pubc_GW_GW_2C8_RRC_OBJ10_Measured_SetVt)==0)
    {
        rawValue = getvalue(this);
        if(chgEv_GW_2C8_RRC_OBJ10_Measured == 0)
        {
            //type conversion to float
            rawValue_float = rawValue;        
            // raw to physical conversion
            phyValue = ((rawValue_float *1)+(0));
            putValue(E_pubc_GW_GW_2C8_RRC_OBJ10_Measured_Pv, phyValue);
            chgEv_GW_2C8_RRC_OBJ10_Measured = 1;
        }
        else
        {
            chgEv_GW_2C8_RRC_OBJ10_Measured = 0;
        }    
        //update the signal value
        Msg_GW_2C8.RRC_OBJ10_Measured=rawValue;        
    }                                                                           
}
/*@@end*/

/*@@envVar:E_pubc_GW_GW_2C8_RRC_OBJ10_Measured_Pv:*/
on envVar E_pubc_GW_GW_2C8_RRC_OBJ10_Measured_Pv
{
    int64 rawValue = 0ll;
    float phyValue = 0.0;
    
    //update the raw value with physical value 
    if(getValue(E_pubc_GW_GW_2C8_RRC_OBJ10_Measured_SetVt)==0)
    {
        if(chgEv_GW_2C8_RRC_OBJ10_Measured == 0)
        {
            phyValue = getvalue(this);
            // physical to raw conversion
            rawValue = ((phyValue -(0))/1);
            putValue(E_pubc_GW_GW_2C8_RRC_OBJ10_Measured_Rv, rawValue);
            chgEv_GW_2C8_RRC_OBJ10_Measured = 1;  
        }
        else
        {
            chgEv_GW_2C8_RRC_OBJ10_Measured = 0;
        }
    }
}
/*@@end*/

/*@@envVar:E_pubc_GW_GW_2C8_RRC_OBJ10_Measured_Vt:*/
on envVar E_pubc_GW_GW_2C8_RRC_OBJ10_Measured_Vt
{
    qword rawValue = 0ll;
    if(getValue(E_pubc_GW_GW_2C8_RRC_OBJ10_Measured_SetVt))
    {
        //update the signal value
        Msg_GW_2C8.RRC_OBJ10_Measured=getValue(this);
    }
}
/*@@end*/

/*@@envVar:E_pubc_GW_GW_2C8_RRC_OBJ10_Measured_SetVt:*/
on envVar E_pubc_GW_GW_2C8_RRC_OBJ10_Measured_SetVt
{
    if(getValue(E_pubc_GW_GW_2C8_RRC_OBJ10_Measured_SetVt))
    {
        //update the signal value
        Msg_GW_2C8.RRC_OBJ10_Measured=getvalue(E_pubc_GW_GW_2C8_RRC_OBJ10_Measured_Vt);
    }
    else
    {
        Msg_GW_2C8.RRC_OBJ10_Measured=getValue(E_pubc_GW_GW_2C8_RRC_OBJ10_Measured_Rv);
    }
}
/*@@end*/
 
/*@@envVar:E_pubc_GW_GW_2C8_RRC_TiOut_Rv:*/
on envVar E_pubc_GW_GW_2C8_RRC_TiOut_Rv
{
    int64 rawValue = 0ll;
    float rawValue_float = 0.0;
    float phyValue = 0.0;        

    //set the signal with updated raw value
    if(getValue(E_pubc_GW_GW_2C8_RRC_TiOut_SetVt)==0)
    {
        rawValue = getvalue(this);
        if(chgEv_GW_2C8_RRC_TiOut == 0)
        {
            //type conversion to float
            rawValue_float = rawValue;        
            // raw to physical conversion
            phyValue = ((rawValue_float *1)+(0));
            putValue(E_pubc_GW_GW_2C8_RRC_TiOut_Pv, phyValue);
            chgEv_GW_2C8_RRC_TiOut = 1;
        }
        else
        {
            chgEv_GW_2C8_RRC_TiOut = 0;
        }    
        //update the signal value
        Msg_GW_2C8.RRC_TiOut=rawValue;        
    }                                                                           
}
/*@@end*/

/*@@envVar:E_pubc_GW_GW_2C8_RRC_TiOut_Pv:*/
on envVar E_pubc_GW_GW_2C8_RRC_TiOut_Pv
{
    int64 rawValue = 0ll;
    float phyValue = 0.0;
    
    //update the raw value with physical value 
    if(getValue(E_pubc_GW_GW_2C8_RRC_TiOut_SetVt)==0)
    {
        if(chgEv_GW_2C8_RRC_TiOut == 0)
        {
            phyValue = getvalue(this);
            // physical to raw conversion
            rawValue = ((phyValue -(0))/1);
            putValue(E_pubc_GW_GW_2C8_RRC_TiOut_Rv, rawValue);
            chgEv_GW_2C8_RRC_TiOut = 1;  
        }
        else
        {
            chgEv_GW_2C8_RRC_TiOut = 0;
        }
    }
}
/*@@end*/

/*@@envVar:E_pubc_GW_GW_2C8_RRC_TiOut_Vt:*/
on envVar E_pubc_GW_GW_2C8_RRC_TiOut_Vt
{
    qword rawValue = 0ll;
    if(getValue(E_pubc_GW_GW_2C8_RRC_TiOut_SetVt))
    {
        //update the signal value
        Msg_GW_2C8.RRC_TiOut=getValue(this);
    }
}
/*@@end*/

/*@@envVar:E_pubc_GW_GW_2C8_RRC_TiOut_SetVt:*/
on envVar E_pubc_GW_GW_2C8_RRC_TiOut_SetVt
{
    if(getValue(E_pubc_GW_GW_2C8_RRC_TiOut_SetVt))
    {
        //update the signal value
        Msg_GW_2C8.RRC_TiOut=getvalue(E_pubc_GW_GW_2C8_RRC_TiOut_Vt);
    }
    else
    {
        Msg_GW_2C8.RRC_TiOut=getValue(E_pubc_GW_GW_2C8_RRC_TiOut_Rv);
    }
}
/*@@end*/
 
/*@@envVar:E_pubc_GW_GW_2C8_RRC_OBJ10_Ax_Rv:*/
on envVar E_pubc_GW_GW_2C8_RRC_OBJ10_Ax_Rv
{
    int64 rawValue = 0ll;
    float rawValue_float = 0.0;
    float phyValue = 0.0;        

    //set the signal with updated raw value
    {
        rawValue = getvalue(this);
        if(chgEv_GW_2C8_RRC_OBJ10_Ax == 0)
        {
            //type conversion to float
            rawValue_float = rawValue;        
            // raw to physical conversion
            phyValue = ((rawValue_float *0.0625)+(-16));
            putValue(E_pubc_GW_GW_2C8_RRC_OBJ10_Ax_Pv, phyValue);
            chgEv_GW_2C8_RRC_OBJ10_Ax = 1;
        }
        else
        {
            chgEv_GW_2C8_RRC_OBJ10_Ax = 0;
        }    
        //update the signal value
        Msg_GW_2C8.RRC_OBJ10_Ax=rawValue;        
    }                                                                           
}
/*@@end*/

/*@@envVar:E_pubc_GW_GW_2C8_RRC_OBJ10_Ax_Pv:*/
on envVar E_pubc_GW_GW_2C8_RRC_OBJ10_Ax_Pv
{
    int64 rawValue = 0ll;
    float phyValue = 0.0;
    
    //update the raw value with physical value 
    {
        if(chgEv_GW_2C8_RRC_OBJ10_Ax == 0)
        {
            phyValue = getvalue(this);
            // physical to raw conversion
            rawValue = ((phyValue -(-16))/0.0625);
            putValue(E_pubc_GW_GW_2C8_RRC_OBJ10_Ax_Rv, rawValue);
            chgEv_GW_2C8_RRC_OBJ10_Ax = 1;  
        }
        else
        {
            chgEv_GW_2C8_RRC_OBJ10_Ax = 0;
        }
    }
}
/*@@end*/


 
/*@@envVar:E_pubc_GW_GW_2C8_RRC_OBJ10_Ay_Rv:*/
on envVar E_pubc_GW_GW_2C8_RRC_OBJ10_Ay_Rv
{
    int64 rawValue = 0ll;
    float rawValue_float = 0.0;
    float phyValue = 0.0;        

    //set the signal with updated raw value
    {
        rawValue = getvalue(this);
        if(chgEv_GW_2C8_RRC_OBJ10_Ay == 0)
        {
            //type conversion to float
            rawValue_float = rawValue;        
            // raw to physical conversion
            phyValue = ((rawValue_float *0.03125)+(-16));
            putValue(E_pubc_GW_GW_2C8_RRC_OBJ10_Ay_Pv, phyValue);
            chgEv_GW_2C8_RRC_OBJ10_Ay = 1;
        }
        else
        {
            chgEv_GW_2C8_RRC_OBJ10_Ay = 0;
        }    
        //update the signal value
        Msg_GW_2C8.RRC_OBJ10_Ay=rawValue;        
    }                                                                           
}
/*@@end*/

/*@@envVar:E_pubc_GW_GW_2C8_RRC_OBJ10_Ay_Pv:*/
on envVar E_pubc_GW_GW_2C8_RRC_OBJ10_Ay_Pv
{
    int64 rawValue = 0ll;
    float phyValue = 0.0;
    
    //update the raw value with physical value 
    {
        if(chgEv_GW_2C8_RRC_OBJ10_Ay == 0)
        {
            phyValue = getvalue(this);
            // physical to raw conversion
            rawValue = ((phyValue -(-16))/0.03125);
            putValue(E_pubc_GW_GW_2C8_RRC_OBJ10_Ay_Rv, rawValue);
            chgEv_GW_2C8_RRC_OBJ10_Ay = 1;  
        }
        else
        {
            chgEv_GW_2C8_RRC_OBJ10_Ay = 0;
        }
    }
}
/*@@end*/


 
/*@@envVar:E_pubc_GW_GW_2C8_RRC_OBJ10_Dy_Rv:*/
on envVar E_pubc_GW_GW_2C8_RRC_OBJ10_Dy_Rv
{
    int64 rawValue = 0ll;
    float rawValue_float = 0.0;
    float phyValue = 0.0;        

    //set the signal with updated raw value
    {
        rawValue = getvalue(this);
        if(chgEv_GW_2C8_RRC_OBJ10_Dy == 0)
        {
            //type conversion to float
            rawValue_float = rawValue;        
            // raw to physical conversion
            phyValue = ((rawValue_float *0.125)+(-128));
            putValue(E_pubc_GW_GW_2C8_RRC_OBJ10_Dy_Pv, phyValue);
            chgEv_GW_2C8_RRC_OBJ10_Dy = 1;
        }
        else
        {
            chgEv_GW_2C8_RRC_OBJ10_Dy = 0;
        }    
        //update the signal value
        Msg_GW_2C8.RRC_OBJ10_Dy=rawValue;        
    }                                                                           
}
/*@@end*/

/*@@envVar:E_pubc_GW_GW_2C8_RRC_OBJ10_Dy_Pv:*/
on envVar E_pubc_GW_GW_2C8_RRC_OBJ10_Dy_Pv
{
    int64 rawValue = 0ll;
    float phyValue = 0.0;
    
    //update the raw value with physical value 
    {
        if(chgEv_GW_2C8_RRC_OBJ10_Dy == 0)
        {
            phyValue = getvalue(this);
            // physical to raw conversion
            rawValue = ((phyValue -(-128))/0.125);
            putValue(E_pubc_GW_GW_2C8_RRC_OBJ10_Dy_Rv, rawValue);
            chgEv_GW_2C8_RRC_OBJ10_Dy = 1;  
        }
        else
        {
            chgEv_GW_2C8_RRC_OBJ10_Dy = 0;
        }
    }
}
/*@@end*/


 
/*@@envVar:E_pubc_GW_GW_2C8_RRC_OBJ10_Dx_Rv:*/
on envVar E_pubc_GW_GW_2C8_RRC_OBJ10_Dx_Rv
{
    int64 rawValue = 0ll;
    float rawValue_float = 0.0;
    float phyValue = 0.0;        

    //set the signal with updated raw value
    {
        rawValue = getvalue(this);
        if(chgEv_GW_2C8_RRC_OBJ10_Dx == 0)
        {
            //type conversion to float
            rawValue_float = rawValue;        
            // raw to physical conversion
            phyValue = ((rawValue_float *0.0625)+(-256));
            putValue(E_pubc_GW_GW_2C8_RRC_OBJ10_Dx_Pv, phyValue);
            chgEv_GW_2C8_RRC_OBJ10_Dx = 1;
        }
        else
        {
            chgEv_GW_2C8_RRC_OBJ10_Dx = 0;
        }    
        //update the signal value
        Msg_GW_2C8.RRC_OBJ10_Dx=rawValue;        
    }                                                                           
}
/*@@end*/

/*@@envVar:E_pubc_GW_GW_2C8_RRC_OBJ10_Dx_Pv:*/
on envVar E_pubc_GW_GW_2C8_RRC_OBJ10_Dx_Pv
{
    int64 rawValue = 0ll;
    float phyValue = 0.0;
    
    //update the raw value with physical value 
    {
        if(chgEv_GW_2C8_RRC_OBJ10_Dx == 0)
        {
            phyValue = getvalue(this);
            // physical to raw conversion
            rawValue = ((phyValue -(-256))/0.0625);
            putValue(E_pubc_GW_GW_2C8_RRC_OBJ10_Dx_Rv, rawValue);
            chgEv_GW_2C8_RRC_OBJ10_Dx = 1;  
        }
        else
        {
            chgEv_GW_2C8_RRC_OBJ10_Dx = 0;
        }
    }
}
/*@@end*/


 
/*@@envVar:E_pubc_GW_GW_2C8_RRC_OBJ10_Length_Rv:*/
on envVar E_pubc_GW_GW_2C8_RRC_OBJ10_Length_Rv
{
    int64 rawValue = 0ll;
    float rawValue_float = 0.0;
    float phyValue = 0.0;        

    //set the signal with updated raw value
    {
        rawValue = getvalue(this);
        if(chgEv_GW_2C8_RRC_OBJ10_Length == 0)
        {
            //type conversion to float
            rawValue_float = rawValue;        
            // raw to physical conversion
            phyValue = ((rawValue_float *0.05)+(0));
            putValue(E_pubc_GW_GW_2C8_RRC_OBJ10_Length_Pv, phyValue);
            chgEv_GW_2C8_RRC_OBJ10_Length = 1;
        }
        else
        {
            chgEv_GW_2C8_RRC_OBJ10_Length = 0;
        }    
        //update the signal value
        Msg_GW_2C8.RRC_OBJ10_Length=rawValue;        
    }                                                                           
}
/*@@end*/

/*@@envVar:E_pubc_GW_GW_2C8_RRC_OBJ10_Length_Pv:*/
on envVar E_pubc_GW_GW_2C8_RRC_OBJ10_Length_Pv
{
    int64 rawValue = 0ll;
    float phyValue = 0.0;
    
    //update the raw value with physical value 
    {
        if(chgEv_GW_2C8_RRC_OBJ10_Length == 0)
        {
            phyValue = getvalue(this);
            // physical to raw conversion
            rawValue = ((phyValue -(0))/0.05);
            putValue(E_pubc_GW_GW_2C8_RRC_OBJ10_Length_Rv, rawValue);
            chgEv_GW_2C8_RRC_OBJ10_Length = 1;  
        }
        else
        {
            chgEv_GW_2C8_RRC_OBJ10_Length = 0;
        }
    }
}
/*@@end*/


 
/*@@envVar:E_pubc_GW_GW_2C8_RRC_OBJ5_Measured_Rv:*/
on envVar E_pubc_GW_GW_2C8_RRC_OBJ5_Measured_Rv
{
    int64 rawValue = 0ll;
    float rawValue_float = 0.0;
    float phyValue = 0.0;        

    //set the signal with updated raw value
    if(getValue(E_pubc_GW_GW_2C8_RRC_OBJ5_Measured_SetVt)==0)
    {
        rawValue = getvalue(this);
        if(chgEv_GW_2C8_RRC_OBJ5_Measured == 0)
        {
            //type conversion to float
            rawValue_float = rawValue;        
            // raw to physical conversion
            phyValue = ((rawValue_float *1)+(0));
            putValue(E_pubc_GW_GW_2C8_RRC_OBJ5_Measured_Pv, phyValue);
            chgEv_GW_2C8_RRC_OBJ5_Measured = 1;
        }
        else
        {
            chgEv_GW_2C8_RRC_OBJ5_Measured = 0;
        }    
        //update the signal value
        Msg_GW_2C8.RRC_OBJ5_Measured=rawValue;        
    }                                                                           
}
/*@@end*/

/*@@envVar:E_pubc_GW_GW_2C8_RRC_OBJ5_Measured_Pv:*/
on envVar E_pubc_GW_GW_2C8_RRC_OBJ5_Measured_Pv
{
    int64 rawValue = 0ll;
    float phyValue = 0.0;
    
    //update the raw value with physical value 
    if(getValue(E_pubc_GW_GW_2C8_RRC_OBJ5_Measured_SetVt)==0)
    {
        if(chgEv_GW_2C8_RRC_OBJ5_Measured == 0)
        {
            phyValue = getvalue(this);
            // physical to raw conversion
            rawValue = ((phyValue -(0))/1);
            putValue(E_pubc_GW_GW_2C8_RRC_OBJ5_Measured_Rv, rawValue);
            chgEv_GW_2C8_RRC_OBJ5_Measured = 1;  
        }
        else
        {
            chgEv_GW_2C8_RRC_OBJ5_Measured = 0;
        }
    }
}
/*@@end*/

/*@@envVar:E_pubc_GW_GW_2C8_RRC_OBJ5_Measured_Vt:*/
on envVar E_pubc_GW_GW_2C8_RRC_OBJ5_Measured_Vt
{
    qword rawValue = 0ll;
    if(getValue(E_pubc_GW_GW_2C8_RRC_OBJ5_Measured_SetVt))
    {
        //update the signal value
        Msg_GW_2C8.RRC_OBJ5_Measured=getValue(this);
    }
}
/*@@end*/

/*@@envVar:E_pubc_GW_GW_2C8_RRC_OBJ5_Measured_SetVt:*/
on envVar E_pubc_GW_GW_2C8_RRC_OBJ5_Measured_SetVt
{
    if(getValue(E_pubc_GW_GW_2C8_RRC_OBJ5_Measured_SetVt))
    {
        //update the signal value
        Msg_GW_2C8.RRC_OBJ5_Measured=getvalue(E_pubc_GW_GW_2C8_RRC_OBJ5_Measured_Vt);
    }
    else
    {
        Msg_GW_2C8.RRC_OBJ5_Measured=getValue(E_pubc_GW_GW_2C8_RRC_OBJ5_Measured_Rv);
    }
}
/*@@end*/
 
/*@@envVar:E_pubc_GW_GW_2C8_RRC_OBJ9_Height_Rv:*/
on envVar E_pubc_GW_GW_2C8_RRC_OBJ9_Height_Rv
{
    int64 rawValue = 0ll;
    float rawValue_float = 0.0;
    float phyValue = 0.0;        

    //set the signal with updated raw value
    {
        rawValue = getvalue(this);
        if(chgEv_GW_2C8_RRC_OBJ9_Height == 0)
        {
            //type conversion to float
            rawValue_float = rawValue;        
            // raw to physical conversion
            phyValue = ((rawValue_float *0.01)+(0));
            putValue(E_pubc_GW_GW_2C8_RRC_OBJ9_Height_Pv, phyValue);
            chgEv_GW_2C8_RRC_OBJ9_Height = 1;
        }
        else
        {
            chgEv_GW_2C8_RRC_OBJ9_Height = 0;
        }    
        //update the signal value
        Msg_GW_2C8.RRC_OBJ9_Height=rawValue;        
    }                                                                           
}
/*@@end*/

/*@@envVar:E_pubc_GW_GW_2C8_RRC_OBJ9_Height_Pv:*/
on envVar E_pubc_GW_GW_2C8_RRC_OBJ9_Height_Pv
{
    int64 rawValue = 0ll;
    float phyValue = 0.0;
    
    //update the raw value with physical value 
    {
        if(chgEv_GW_2C8_RRC_OBJ9_Height == 0)
        {
            phyValue = getvalue(this);
            // physical to raw conversion
            rawValue = ((phyValue -(0))/0.01);
            putValue(E_pubc_GW_GW_2C8_RRC_OBJ9_Height_Rv, rawValue);
            chgEv_GW_2C8_RRC_OBJ9_Height = 1;  
        }
        else
        {
            chgEv_GW_2C8_RRC_OBJ9_Height = 0;
        }
    }
}
/*@@end*/


 
/*@@envVar:E_pubc_GW_GW_2C8_RRC_OBJ5_HeadingAngle_Rv:*/
on envVar E_pubc_GW_GW_2C8_RRC_OBJ5_HeadingAngle_Rv
{
    int64 rawValue = 0ll;
    float rawValue_float = 0.0;
    float phyValue = 0.0;        

    //set the signal with updated raw value
    {
        rawValue = getvalue(this);
        if(chgEv_GW_2C8_RRC_OBJ5_HeadingAngle == 0)
        {
            //type conversion to float
            rawValue_float = rawValue;        
            // raw to physical conversion
            phyValue = ((rawValue_float *0.01)+(-3.14));
            putValue(E_pubc_GW_GW_2C8_RRC_OBJ5_HeadingAngle_Pv, phyValue);
            chgEv_GW_2C8_RRC_OBJ5_HeadingAngle = 1;
        }
        else
        {
            chgEv_GW_2C8_RRC_OBJ5_HeadingAngle = 0;
        }    
        //update the signal value
        Msg_GW_2C8.RRC_OBJ5_HeadingAngle=rawValue;        
    }                                                                           
}
/*@@end*/

/*@@envVar:E_pubc_GW_GW_2C8_RRC_OBJ5_HeadingAngle_Pv:*/
on envVar E_pubc_GW_GW_2C8_RRC_OBJ5_HeadingAngle_Pv
{
    int64 rawValue = 0ll;
    float phyValue = 0.0;
    
    //update the raw value with physical value 
    {
        if(chgEv_GW_2C8_RRC_OBJ5_HeadingAngle == 0)
        {
            phyValue = getvalue(this);
            // physical to raw conversion
            rawValue = ((phyValue -(-3.14))/0.01);
            putValue(E_pubc_GW_GW_2C8_RRC_OBJ5_HeadingAngle_Rv, rawValue);
            chgEv_GW_2C8_RRC_OBJ5_HeadingAngle = 1;  
        }
        else
        {
            chgEv_GW_2C8_RRC_OBJ5_HeadingAngle = 0;
        }
    }
}
/*@@end*/


 
/*@@envVar:E_pubc_GW_GW_2C8_RRC_OBJ5_ObstacleProb_Rv:*/
on envVar E_pubc_GW_GW_2C8_RRC_OBJ5_ObstacleProb_Rv
{
    int64 rawValue = 0ll;
    float rawValue_float = 0.0;
    float phyValue = 0.0;        

    //set the signal with updated raw value
    {
        rawValue = getvalue(this);
        if(chgEv_GW_2C8_RRC_OBJ5_ObstacleProb == 0)
        {
            //type conversion to float
            rawValue_float = rawValue;        
            // raw to physical conversion
            phyValue = ((rawValue_float *2)+(0));
            putValue(E_pubc_GW_GW_2C8_RRC_OBJ5_ObstacleProb_Pv, phyValue);
            chgEv_GW_2C8_RRC_OBJ5_ObstacleProb = 1;
        }
        else
        {
            chgEv_GW_2C8_RRC_OBJ5_ObstacleProb = 0;
        }    
        //update the signal value
        Msg_GW_2C8.RRC_OBJ5_ObstacleProb=rawValue;        
    }                                                                           
}
/*@@end*/

/*@@envVar:E_pubc_GW_GW_2C8_RRC_OBJ5_ObstacleProb_Pv:*/
on envVar E_pubc_GW_GW_2C8_RRC_OBJ5_ObstacleProb_Pv
{
    int64 rawValue = 0ll;
    float phyValue = 0.0;
    
    //update the raw value with physical value 
    {
        if(chgEv_GW_2C8_RRC_OBJ5_ObstacleProb == 0)
        {
            phyValue = getvalue(this);
            // physical to raw conversion
            rawValue = ((phyValue -(0))/2);
            putValue(E_pubc_GW_GW_2C8_RRC_OBJ5_ObstacleProb_Rv, rawValue);
            chgEv_GW_2C8_RRC_OBJ5_ObstacleProb = 1;  
        }
        else
        {
            chgEv_GW_2C8_RRC_OBJ5_ObstacleProb = 0;
        }
    }
}
/*@@end*/


 
/*@@envVar:E_pubc_GW_GW_2C8_RRC_OBJ10_Width_Rv:*/
on envVar E_pubc_GW_GW_2C8_RRC_OBJ10_Width_Rv
{
    int64 rawValue = 0ll;
    float rawValue_float = 0.0;
    float phyValue = 0.0;        

    //set the signal with updated raw value
    {
        rawValue = getvalue(this);
        if(chgEv_GW_2C8_RRC_OBJ10_Width == 0)
        {
            //type conversion to float
            rawValue_float = rawValue;        
            // raw to physical conversion
            phyValue = ((rawValue_float *0.01)+(0));
            putValue(E_pubc_GW_GW_2C8_RRC_OBJ10_Width_Pv, phyValue);
            chgEv_GW_2C8_RRC_OBJ10_Width = 1;
        }
        else
        {
            chgEv_GW_2C8_RRC_OBJ10_Width = 0;
        }    
        //update the signal value
        Msg_GW_2C8.RRC_OBJ10_Width=rawValue;        
    }                                                                           
}
/*@@end*/

/*@@envVar:E_pubc_GW_GW_2C8_RRC_OBJ10_Width_Pv:*/
on envVar E_pubc_GW_GW_2C8_RRC_OBJ10_Width_Pv
{
    int64 rawValue = 0ll;
    float phyValue = 0.0;
    
    //update the raw value with physical value 
    {
        if(chgEv_GW_2C8_RRC_OBJ10_Width == 0)
        {
            phyValue = getvalue(this);
            // physical to raw conversion
            rawValue = ((phyValue -(0))/0.01);
            putValue(E_pubc_GW_GW_2C8_RRC_OBJ10_Width_Rv, rawValue);
            chgEv_GW_2C8_RRC_OBJ10_Width = 1;  
        }
        else
        {
            chgEv_GW_2C8_RRC_OBJ10_Width = 0;
        }
    }
}
/*@@end*/


 
/*@@envVar:E_pubc_GW_GW_2C8_RRC_ObjDelay_Rv:*/
on envVar E_pubc_GW_GW_2C8_RRC_ObjDelay_Rv
{
    int64 rawValue = 0ll;
    float rawValue_float = 0.0;
    float phyValue = 0.0;        

    //set the signal with updated raw value
    {
        rawValue = getvalue(this);
        if(chgEv_GW_2C8_RRC_ObjDelay == 0)
        {
            //type conversion to float
            rawValue_float = rawValue;        
            // raw to physical conversion
            phyValue = ((rawValue_float *1)+(0));
            putValue(E_pubc_GW_GW_2C8_RRC_ObjDelay_Pv, phyValue);
            chgEv_GW_2C8_RRC_ObjDelay = 1;
        }
        else
        {
            chgEv_GW_2C8_RRC_ObjDelay = 0;
        }    
        //update the signal value
        Msg_GW_2C8.RRC_ObjDelay=rawValue;        
    }                                                                           
}
/*@@end*/

/*@@envVar:E_pubc_GW_GW_2C8_RRC_ObjDelay_Pv:*/
on envVar E_pubc_GW_GW_2C8_RRC_ObjDelay_Pv
{
    int64 rawValue = 0ll;
    float phyValue = 0.0;
    
    //update the raw value with physical value 
    {
        if(chgEv_GW_2C8_RRC_ObjDelay == 0)
        {
            phyValue = getvalue(this);
            // physical to raw conversion
            rawValue = ((phyValue -(0))/1);
            putValue(E_pubc_GW_GW_2C8_RRC_ObjDelay_Rv, rawValue);
            chgEv_GW_2C8_RRC_ObjDelay = 1;  
        }
        else
        {
            chgEv_GW_2C8_RRC_ObjDelay = 0;
        }
    }
}
/*@@end*/


 
/*@@envVar:E_pubc_GW_GW_2C8_RRC_TiLeap_Rv:*/
on envVar E_pubc_GW_GW_2C8_RRC_TiLeap_Rv
{
    int64 rawValue = 0ll;
    float rawValue_float = 0.0;
    float phyValue = 0.0;        

    //set the signal with updated raw value
    {
        rawValue = getvalue(this);
        if(chgEv_GW_2C8_RRC_TiLeap == 0)
        {
            //type conversion to float
            rawValue_float = rawValue;        
            // raw to physical conversion
            phyValue = ((rawValue_float *1)+(0));
            putValue(E_pubc_GW_GW_2C8_RRC_TiLeap_Pv, phyValue);
            chgEv_GW_2C8_RRC_TiLeap = 1;
        }
        else
        {
            chgEv_GW_2C8_RRC_TiLeap = 0;
        }    
        //update the signal value
        Msg_GW_2C8.RRC_TiLeap=rawValue;        
    }                                                                           
}
/*@@end*/

/*@@envVar:E_pubc_GW_GW_2C8_RRC_TiLeap_Pv:*/
on envVar E_pubc_GW_GW_2C8_RRC_TiLeap_Pv
{
    int64 rawValue = 0ll;
    float phyValue = 0.0;
    
    //update the raw value with physical value 
    {
        if(chgEv_GW_2C8_RRC_TiLeap == 0)
        {
            phyValue = getvalue(this);
            // physical to raw conversion
            rawValue = ((phyValue -(0))/1);
            putValue(E_pubc_GW_GW_2C8_RRC_TiLeap_Rv, rawValue);
            chgEv_GW_2C8_RRC_TiLeap = 1;  
        }
        else
        {
            chgEv_GW_2C8_RRC_TiLeap = 0;
        }
    }
}
/*@@end*/


 
/*@@envVar:E_pubc_GW_GW_2C8_RRC_OBJ10_HeadingAngle_Rv:*/
on envVar E_pubc_GW_GW_2C8_RRC_OBJ10_HeadingAngle_Rv
{
    int64 rawValue = 0ll;
    float rawValue_float = 0.0;
    float phyValue = 0.0;        

    //set the signal with updated raw value
    {
        rawValue = getvalue(this);
        if(chgEv_GW_2C8_RRC_OBJ10_HeadingAngle == 0)
        {
            //type conversion to float
            rawValue_float = rawValue;        
            // raw to physical conversion
            phyValue = ((rawValue_float *0.01)+(-3.14));
            putValue(E_pubc_GW_GW_2C8_RRC_OBJ10_HeadingAngle_Pv, phyValue);
            chgEv_GW_2C8_RRC_OBJ10_HeadingAngle = 1;
        }
        else
        {
            chgEv_GW_2C8_RRC_OBJ10_HeadingAngle = 0;
        }    
        //update the signal value
        Msg_GW_2C8.RRC_OBJ10_HeadingAngle=rawValue;        
    }                                                                           
}
/*@@end*/

/*@@envVar:E_pubc_GW_GW_2C8_RRC_OBJ10_HeadingAngle_Pv:*/
on envVar E_pubc_GW_GW_2C8_RRC_OBJ10_HeadingAngle_Pv
{
    int64 rawValue = 0ll;
    float phyValue = 0.0;
    
    //update the raw value with physical value 
    {
        if(chgEv_GW_2C8_RRC_OBJ10_HeadingAngle == 0)
        {
            phyValue = getvalue(this);
            // physical to raw conversion
            rawValue = ((phyValue -(-3.14))/0.01);
            putValue(E_pubc_GW_GW_2C8_RRC_OBJ10_HeadingAngle_Rv, rawValue);
            chgEv_GW_2C8_RRC_OBJ10_HeadingAngle = 1;  
        }
        else
        {
            chgEv_GW_2C8_RRC_OBJ10_HeadingAngle = 0;
        }
    }
}
/*@@end*/


 
/*@@envVar:E_pubc_GW_GW_2C8_RRC_OBJ10_ExistProb_Rv:*/
on envVar E_pubc_GW_GW_2C8_RRC_OBJ10_ExistProb_Rv
{
    int64 rawValue = 0ll;
    float rawValue_float = 0.0;
    float phyValue = 0.0;        

    //set the signal with updated raw value
    {
        rawValue = getvalue(this);
        if(chgEv_GW_2C8_RRC_OBJ10_ExistProb == 0)
        {
            //type conversion to float
            rawValue_float = rawValue;        
            // raw to physical conversion
            phyValue = ((rawValue_float *2)+(0));
            putValue(E_pubc_GW_GW_2C8_RRC_OBJ10_ExistProb_Pv, phyValue);
            chgEv_GW_2C8_RRC_OBJ10_ExistProb = 1;
        }
        else
        {
            chgEv_GW_2C8_RRC_OBJ10_ExistProb = 0;
        }    
        //update the signal value
        Msg_GW_2C8.RRC_OBJ10_ExistProb=rawValue;        
    }                                                                           
}
/*@@end*/

/*@@envVar:E_pubc_GW_GW_2C8_RRC_OBJ10_ExistProb_Pv:*/
on envVar E_pubc_GW_GW_2C8_RRC_OBJ10_ExistProb_Pv
{
    int64 rawValue = 0ll;
    float phyValue = 0.0;
    
    //update the raw value with physical value 
    {
        if(chgEv_GW_2C8_RRC_OBJ10_ExistProb == 0)
        {
            phyValue = getvalue(this);
            // physical to raw conversion
            rawValue = ((phyValue -(0))/2);
            putValue(E_pubc_GW_GW_2C8_RRC_OBJ10_ExistProb_Rv, rawValue);
            chgEv_GW_2C8_RRC_OBJ10_ExistProb = 1;  
        }
        else
        {
            chgEv_GW_2C8_RRC_OBJ10_ExistProb = 0;
        }
    }
}
/*@@end*/


 
/*@@envVar:E_pubc_GW_GW_2C8_RRC_OBJ7_Height_Rv:*/
on envVar E_pubc_GW_GW_2C8_RRC_OBJ7_Height_Rv
{
    int64 rawValue = 0ll;
    float rawValue_float = 0.0;
    float phyValue = 0.0;        

    //set the signal with updated raw value
    {
        rawValue = getvalue(this);
        if(chgEv_GW_2C8_RRC_OBJ7_Height == 0)
        {
            //type conversion to float
            rawValue_float = rawValue;        
            // raw to physical conversion
            phyValue = ((rawValue_float *0.01)+(0));
            putValue(E_pubc_GW_GW_2C8_RRC_OBJ7_Height_Pv, phyValue);
            chgEv_GW_2C8_RRC_OBJ7_Height = 1;
        }
        else
        {
            chgEv_GW_2C8_RRC_OBJ7_Height = 0;
        }    
        //update the signal value
        Msg_GW_2C8.RRC_OBJ7_Height=rawValue;        
    }                                                                           
}
/*@@end*/

/*@@envVar:E_pubc_GW_GW_2C8_RRC_OBJ7_Height_Pv:*/
on envVar E_pubc_GW_GW_2C8_RRC_OBJ7_Height_Pv
{
    int64 rawValue = 0ll;
    float phyValue = 0.0;
    
    //update the raw value with physical value 
    {
        if(chgEv_GW_2C8_RRC_OBJ7_Height == 0)
        {
            phyValue = getvalue(this);
            // physical to raw conversion
            rawValue = ((phyValue -(0))/0.01);
            putValue(E_pubc_GW_GW_2C8_RRC_OBJ7_Height_Rv, rawValue);
            chgEv_GW_2C8_RRC_OBJ7_Height = 1;  
        }
        else
        {
            chgEv_GW_2C8_RRC_OBJ7_Height = 0;
        }
    }
}
/*@@end*/


 
/*@@envVar:E_pubc_GW_GW_2C8_RRC_OBJ10_Vy_Rv:*/
on envVar E_pubc_GW_GW_2C8_RRC_OBJ10_Vy_Rv
{
    int64 rawValue = 0ll;
    float rawValue_float = 0.0;
    float phyValue = 0.0;        

    //set the signal with updated raw value
    {
        rawValue = getvalue(this);
        if(chgEv_GW_2C8_RRC_OBJ10_Vy == 0)
        {
            //type conversion to float
            rawValue_float = rawValue;        
            // raw to physical conversion
            phyValue = ((rawValue_float *0.125)+(-64));
            putValue(E_pubc_GW_GW_2C8_RRC_OBJ10_Vy_Pv, phyValue);
            chgEv_GW_2C8_RRC_OBJ10_Vy = 1;
        }
        else
        {
            chgEv_GW_2C8_RRC_OBJ10_Vy = 0;
        }    
        //update the signal value
        Msg_GW_2C8.RRC_OBJ10_Vy=rawValue;        
    }                                                                           
}
/*@@end*/

/*@@envVar:E_pubc_GW_GW_2C8_RRC_OBJ10_Vy_Pv:*/
on envVar E_pubc_GW_GW_2C8_RRC_OBJ10_Vy_Pv
{
    int64 rawValue = 0ll;
    float phyValue = 0.0;
    
    //update the raw value with physical value 
    {
        if(chgEv_GW_2C8_RRC_OBJ10_Vy == 0)
        {
            phyValue = getvalue(this);
            // physical to raw conversion
            rawValue = ((phyValue -(-64))/0.125);
            putValue(E_pubc_GW_GW_2C8_RRC_OBJ10_Vy_Rv, rawValue);
            chgEv_GW_2C8_RRC_OBJ10_Vy = 1;  
        }
        else
        {
            chgEv_GW_2C8_RRC_OBJ10_Vy = 0;
        }
    }
}
/*@@end*/


 
/*@@envVar:E_pubc_GW_GW_2C8_RRC_OBJ10_Vx_Rv:*/
on envVar E_pubc_GW_GW_2C8_RRC_OBJ10_Vx_Rv
{
    int64 rawValue = 0ll;
    float rawValue_float = 0.0;
    float phyValue = 0.0;        

    //set the signal with updated raw value
    {
        rawValue = getvalue(this);
        if(chgEv_GW_2C8_RRC_OBJ10_Vx == 0)
        {
            //type conversion to float
            rawValue_float = rawValue;        
            // raw to physical conversion
            phyValue = ((rawValue_float *0.0625)+(-128));
            putValue(E_pubc_GW_GW_2C8_RRC_OBJ10_Vx_Pv, phyValue);
            chgEv_GW_2C8_RRC_OBJ10_Vx = 1;
        }
        else
        {
            chgEv_GW_2C8_RRC_OBJ10_Vx = 0;
        }    
        //update the signal value
        Msg_GW_2C8.RRC_OBJ10_Vx=rawValue;        
    }                                                                           
}
/*@@end*/

/*@@envVar:E_pubc_GW_GW_2C8_RRC_OBJ10_Vx_Pv:*/
on envVar E_pubc_GW_GW_2C8_RRC_OBJ10_Vx_Pv
{
    int64 rawValue = 0ll;
    float phyValue = 0.0;
    
    //update the raw value with physical value 
    {
        if(chgEv_GW_2C8_RRC_OBJ10_Vx == 0)
        {
            phyValue = getvalue(this);
            // physical to raw conversion
            rawValue = ((phyValue -(-128))/0.0625);
            putValue(E_pubc_GW_GW_2C8_RRC_OBJ10_Vx_Rv, rawValue);
            chgEv_GW_2C8_RRC_OBJ10_Vx = 1;  
        }
        else
        {
            chgEv_GW_2C8_RRC_OBJ10_Vx = 0;
        }
    }
}
/*@@end*/


 
/*@@envVar:E_pubc_GW_GW_2C8_RRC_OBJ5_Type_Rv:*/
on envVar E_pubc_GW_GW_2C8_RRC_OBJ5_Type_Rv
{
    int64 rawValue = 0ll;
    float rawValue_float = 0.0;
    float phyValue = 0.0;        

    //set the signal with updated raw value
    if(getValue(E_pubc_GW_GW_2C8_RRC_OBJ5_Type_SetVt)==0)
    {
        rawValue = getvalue(this);
        if(chgEv_GW_2C8_RRC_OBJ5_Type == 0)
        {
            //type conversion to float
            rawValue_float = rawValue;        
            // raw to physical conversion
            phyValue = ((rawValue_float *1)+(0));
            putValue(E_pubc_GW_GW_2C8_RRC_OBJ5_Type_Pv, phyValue);
            chgEv_GW_2C8_RRC_OBJ5_Type = 1;
        }
        else
        {
            chgEv_GW_2C8_RRC_OBJ5_Type = 0;
        }    
        //update the signal value
        Msg_GW_2C8.RRC_OBJ5_Type=rawValue;        
    }                                                                           
}
/*@@end*/

/*@@envVar:E_pubc_GW_GW_2C8_RRC_OBJ5_Type_Pv:*/
on envVar E_pubc_GW_GW_2C8_RRC_OBJ5_Type_Pv
{
    int64 rawValue = 0ll;
    float phyValue = 0.0;
    
    //update the raw value with physical value 
    if(getValue(E_pubc_GW_GW_2C8_RRC_OBJ5_Type_SetVt)==0)
    {
        if(chgEv_GW_2C8_RRC_OBJ5_Type == 0)
        {
            phyValue = getvalue(this);
            // physical to raw conversion
            rawValue = ((phyValue -(0))/1);
            putValue(E_pubc_GW_GW_2C8_RRC_OBJ5_Type_Rv, rawValue);
            chgEv_GW_2C8_RRC_OBJ5_Type = 1;  
        }
        else
        {
            chgEv_GW_2C8_RRC_OBJ5_Type = 0;
        }
    }
}
/*@@end*/

/*@@envVar:E_pubc_GW_GW_2C8_RRC_OBJ5_Type_Vt:*/
on envVar E_pubc_GW_GW_2C8_RRC_OBJ5_Type_Vt
{
    qword rawValue = 0ll;
    if(getValue(E_pubc_GW_GW_2C8_RRC_OBJ5_Type_SetVt))
    {
        //update the signal value
        Msg_GW_2C8.RRC_OBJ5_Type=getValue(this);
    }
}
/*@@end*/

/*@@envVar:E_pubc_GW_GW_2C8_RRC_OBJ5_Type_SetVt:*/
on envVar E_pubc_GW_GW_2C8_RRC_OBJ5_Type_SetVt
{
    if(getValue(E_pubc_GW_GW_2C8_RRC_OBJ5_Type_SetVt))
    {
        //update the signal value
        Msg_GW_2C8.RRC_OBJ5_Type=getvalue(E_pubc_GW_GW_2C8_RRC_OBJ5_Type_Vt);
    }
    else
    {
        Msg_GW_2C8.RRC_OBJ5_Type=getValue(E_pubc_GW_GW_2C8_RRC_OBJ5_Type_Rv);
    }
}
/*@@end*/
 
/*@@envVar:E_pubc_GW_GW_2C8_RRC_OBJ5_Dx_Rv:*/
on envVar E_pubc_GW_GW_2C8_RRC_OBJ5_Dx_Rv
{
    int64 rawValue = 0ll;
    float rawValue_float = 0.0;
    float phyValue = 0.0;        

    //set the signal with updated raw value
    {
        rawValue = getvalue(this);
        if(chgEv_GW_2C8_RRC_OBJ5_Dx == 0)
        {
            //type conversion to float
            rawValue_float = rawValue;        
            // raw to physical conversion
            phyValue = ((rawValue_float *0.0625)+(-256));
            putValue(E_pubc_GW_GW_2C8_RRC_OBJ5_Dx_Pv, phyValue);
            chgEv_GW_2C8_RRC_OBJ5_Dx = 1;
        }
        else
        {
            chgEv_GW_2C8_RRC_OBJ5_Dx = 0;
        }    
        //update the signal value
        Msg_GW_2C8.RRC_OBJ5_Dx=rawValue;        
    }                                                                           
}
/*@@end*/

/*@@envVar:E_pubc_GW_GW_2C8_RRC_OBJ5_Dx_Pv:*/
on envVar E_pubc_GW_GW_2C8_RRC_OBJ5_Dx_Pv
{
    int64 rawValue = 0ll;
    float phyValue = 0.0;
    
    //update the raw value with physical value 
    {
        if(chgEv_GW_2C8_RRC_OBJ5_Dx == 0)
        {
            phyValue = getvalue(this);
            // physical to raw conversion
            rawValue = ((phyValue -(-256))/0.0625);
            putValue(E_pubc_GW_GW_2C8_RRC_OBJ5_Dx_Rv, rawValue);
            chgEv_GW_2C8_RRC_OBJ5_Dx = 1;  
        }
        else
        {
            chgEv_GW_2C8_RRC_OBJ5_Dx = 0;
        }
    }
}
/*@@end*/


 
/*@@envVar:E_pubc_GW_GW_2C8_RRC_OBJ5_Dy_Rv:*/
on envVar E_pubc_GW_GW_2C8_RRC_OBJ5_Dy_Rv
{
    int64 rawValue = 0ll;
    float rawValue_float = 0.0;
    float phyValue = 0.0;        

    //set the signal with updated raw value
    {
        rawValue = getvalue(this);
        if(chgEv_GW_2C8_RRC_OBJ5_Dy == 0)
        {
            //type conversion to float
            rawValue_float = rawValue;        
            // raw to physical conversion
            phyValue = ((rawValue_float *0.125)+(-128));
            putValue(E_pubc_GW_GW_2C8_RRC_OBJ5_Dy_Pv, phyValue);
            chgEv_GW_2C8_RRC_OBJ5_Dy = 1;
        }
        else
        {
            chgEv_GW_2C8_RRC_OBJ5_Dy = 0;
        }    
        //update the signal value
        Msg_GW_2C8.RRC_OBJ5_Dy=rawValue;        
    }                                                                           
}
/*@@end*/

/*@@envVar:E_pubc_GW_GW_2C8_RRC_OBJ5_Dy_Pv:*/
on envVar E_pubc_GW_GW_2C8_RRC_OBJ5_Dy_Pv
{
    int64 rawValue = 0ll;
    float phyValue = 0.0;
    
    //update the raw value with physical value 
    {
        if(chgEv_GW_2C8_RRC_OBJ5_Dy == 0)
        {
            phyValue = getvalue(this);
            // physical to raw conversion
            rawValue = ((phyValue -(-128))/0.125);
            putValue(E_pubc_GW_GW_2C8_RRC_OBJ5_Dy_Rv, rawValue);
            chgEv_GW_2C8_RRC_OBJ5_Dy = 1;  
        }
        else
        {
            chgEv_GW_2C8_RRC_OBJ5_Dy = 0;
        }
    }
}
/*@@end*/


 
/*@@envVar:E_pubc_GW_GW_NM_tx:*/
on envVar E_pubc_GW_GW_NM_tx
{
    if(getValue(this))
    {       
        

        output(Msg_GW_NM);        
    }
}
/*@@end*/

/*@@envVar:E_pubc_GW_GW_NM_Range:*/
on envVar E_pubc_GW_GW_NM_Range
{
    qword rawstatus = 0ll;
    qword rawValue = 0ll;    
    
    rawstatus = getvalue(this);    
    // set all the signals with min raw /max raw /init raw
    switch (rawstatus) 
    {
     case(0) :
        rawValue= 0;
        putValue(E_pubc_GW_GW_NM_GW_NMSourceAddress_Rv, rawValue);
        break;
     case(1) :
        rawValue= 255;
        putValue(E_pubc_GW_GW_NM_GW_NMSourceAddress_Rv, rawValue);
        break;
     default :
        rawValue= 0;
        putValue(E_pubc_GW_GW_NM_GW_NMSourceAddress_Rv, rawValue);
      break;
   }
}
/*@@end*/

/*@@envVar:E_pubc_GW_GW_NM_Dlc:*/
on envVar E_pubc_GW_GW_NM_Dlc
{
    if(getValue(E_pubc_GW_GW_NM_enDlc))
    {
        Msg_GW_NM.dlc =getValue(this);
    }
    else
    {   
	   Msg_GW_NM.dlc = 8;
	   	
  }
}
/*@@end*/

/*@@envVar:E_pubc_GW_GW_NM_enDlc:*/
on envVar E_pubc_GW_GW_NM_enDlc
{
    //For Messages with DLC = 8, set wrong DLC to smaller than defined DLC
    //For Messages with DLC < 8 set wrong DLC to smaller/longer than defined DLC
    if(getValue(this))
    {
        Msg_GW_NM.dlc =getValue(E_pubc_GW_GW_NM_Dlc);
    }
    else
    {
	   Msg_GW_NM.dlc = 8;
			
    }
}
/*@@end*/


/*@@envVar:E_pubc_GW_GW_NM_GW_NMSourceAddress_Rv:*/
on envVar E_pubc_GW_GW_NM_GW_NMSourceAddress_Rv
{
    int64 rawValue = 0ll;
    float rawValue_float = 0.0;
    float phyValue = 0.0;        

    //set the signal with updated raw value
    {
        rawValue = getvalue(this);
        if(chgEv_GW_NM_GW_NMSourceAddress == 0)
        {
            //type conversion to float
            rawValue_float = rawValue;        
            // raw to physical conversion
            phyValue = ((rawValue_float *1)+(0));
            putValue(E_pubc_GW_GW_NM_GW_NMSourceAddress_Pv, phyValue);
            chgEv_GW_NM_GW_NMSourceAddress = 1;
        }
        else
        {
            chgEv_GW_NM_GW_NMSourceAddress = 0;
        }    
        //update the signal value
        Msg_GW_NM.GW_NMSourceAddress=rawValue;        
    }                                                                           
}
/*@@end*/

/*@@envVar:E_pubc_GW_GW_NM_GW_NMSourceAddress_Pv:*/
on envVar E_pubc_GW_GW_NM_GW_NMSourceAddress_Pv
{
    int64 rawValue = 0ll;
    float phyValue = 0.0;
    
    //update the raw value with physical value 
    {
        if(chgEv_GW_NM_GW_NMSourceAddress == 0)
        {
            phyValue = getvalue(this);
            // physical to raw conversion
            rawValue = ((phyValue -(0))/1);
            putValue(E_pubc_GW_GW_NM_GW_NMSourceAddress_Rv, rawValue);
            chgEv_GW_NM_GW_NMSourceAddress = 1;  
        }
        else
        {
            chgEv_GW_NM_GW_NMSourceAddress = 0;
        }
    }
}
/*@@end*/


 
/*@@envVar:E_pubc_GW_GW_17E_tx:*/
on envVar E_pubc_GW_GW_17E_tx
{
    if(getValue(this))
    {       
        
        //update the BZ Signal
        if(GW_17E_EPS_RollingCounter_17E_wrongvalctr == 0)
        {
            update_GW_17E_EPS_RollingCounter_17E_counter();
            Msg_GW_17E.EPS_RollingCounter_17E= GW_17E_EPS_RollingCounter_17E_counter;
        }
        else if(GW_17E_EPS_RollingCounter_17E_wrongvalctr > 0)
        {
			GW_17E_EPS_RollingCounter_17E_counter=GW_17E_EPS_RollingCounter_17E_counter + GW_17E_EPS_RollingCounter_17E_wrongvalctr;
			 Msg_GW_17E.EPS_RollingCounter_17E= GW_17E_EPS_RollingCounter_17E_counter;
            /* GW_17E_EPS_RollingCounter_17E_wrongvalctr--;
              // if counter becomes zero, update panel controller to zero
             if(GW_17E_EPS_RollingCounter_17E_wrongvalctr == 0)
             {
                 putValue(E_pubc_GW_GW_17E_EPS_RollingCounter_17E_wrongvalctr,0);
             } */
        }
        else
        { 
			// do nothing
        }    
        //calculate the CRC CheckSum
        update_GW_17E_CRC_CheckSum();

        output(Msg_GW_17E);        
    }
}
/*@@end*/

/*@@envVar:E_pubc_GW_GW_17E_Range:*/
on envVar E_pubc_GW_GW_17E_Range
{
    qword rawstatus = 0ll;
    qword rawValue = 0ll;    
    
    rawstatus = getvalue(this);    
    // set all the signals with min raw /max raw /init raw
    switch (rawstatus) 
    {
     case(0) :
        rawValue= 0;
        putValue(E_pubc_GW_GW_17E_EPS_LatCtrlActive_Rv, rawValue);
        rawValue= 0;
        putValue(E_pubc_GW_GW_17E_EPS_MeasuredTorsionBarTorqValid_Rv, rawValue);
        rawValue= 0;
        putValue(E_pubc_GW_GW_17E_EPS_MeasuredTorsionBarTorque_Rv, rawValue);
        rawValue= 0;
        putValue(E_pubc_GW_GW_17E_EPS_LatCtrlAvailabilityStatus_Rv, rawValue);
        break;
     case(1) :
        rawValue= 1;
        putValue(E_pubc_GW_GW_17E_EPS_LatCtrlActive_Rv, rawValue);
        rawValue= 1;
        putValue(E_pubc_GW_GW_17E_EPS_MeasuredTorsionBarTorqValid_Rv, rawValue);
        rawValue= 2046;
        putValue(E_pubc_GW_GW_17E_EPS_MeasuredTorsionBarTorque_Rv, rawValue);
        rawValue= 3;
        putValue(E_pubc_GW_GW_17E_EPS_LatCtrlAvailabilityStatus_Rv, rawValue);
        break;
     default :
        rawValue= 0;
        putValue(E_pubc_GW_GW_17E_EPS_LatCtrlActive_Rv, rawValue);
        rawValue= 0;
        putValue(E_pubc_GW_GW_17E_EPS_MeasuredTorsionBarTorqValid_Rv, rawValue);
        rawValue= 0;
        putValue(E_pubc_GW_GW_17E_EPS_MeasuredTorsionBarTorque_Rv, rawValue);
        rawValue= 0;
        putValue(E_pubc_GW_GW_17E_EPS_LatCtrlAvailabilityStatus_Rv, rawValue);
      break;
   }
}
/*@@end*/

/*@@envVar:E_pubc_GW_GW_17E_Dlc:*/
on envVar E_pubc_GW_GW_17E_Dlc
{
    if(getValue(E_pubc_GW_GW_17E_enDlc))
    {
        Msg_GW_17E.dlc =getValue(this);
    }
    else
    {
       Dbc_dlc = 8;
	   Msg_GW_17E.dlc = Calc_Canfd_dlc(Dbc_dlc);
	   // Msg_GW_17E.dlc = 8;
	   	
  }
}
/*@@end*/

/*@@envVar:E_pubc_GW_GW_17E_enDlc:*/
on envVar E_pubc_GW_GW_17E_enDlc
{
    //For Messages with DLC = 8, set wrong DLC to smaller than defined DLC
    //For Messages with DLC < 8 set wrong DLC to smaller/longer than defined DLC
    if(getValue(this))
    {
        Msg_GW_17E.dlc =getValue(E_pubc_GW_GW_17E_Dlc);
    }
    else
    {
       Dbc_dlc = 8;
	   Msg_GW_17E.dlc = Calc_Canfd_dlc(Dbc_dlc);
	   // Msg_GW_17E.dlc = 8;
    }
}
/*@@end*/

/*@@envVar:E_pubc_GW_GW_17E_EPS_CRCCheck_17E_wrongvalctr:*/
on envVar E_pubc_GW_GW_17E_EPS_CRCCheck_17E_wrongvalctr
{
    //update disturb count
    //disturb value range:(-1 = always send wrong value),( X>0 ,x is the number of Messages with wrong CHK sent)
    GW_17E_EPS_CRCCheck_17E_wrongvalctr =getValue(this);    
}
/*@@end*/
/*@@envVar:E_pubc_GW_GW_17E_EPS_RollingCounter_17E_wrongvalctr:*/
on envVar E_pubc_GW_GW_17E_EPS_RollingCounter_17E_wrongvalctr
{
    //update disturb count
    //disturb value range:(-1 = always send wrong value),( X>0 ,x is the number of Messages with wrong CHK sent)
    GW_17E_EPS_RollingCounter_17E_wrongvalctr =getValue(this);    
}
/*@@end*/

/*@@envVar:E_pubc_GW_GW_17E_EPS_LatCtrlActive_Rv:*/
on envVar E_pubc_GW_GW_17E_EPS_LatCtrlActive_Rv
{
    int64 rawValue = 0ll;
    float rawValue_float = 0.0;
    float phyValue = 0.0;        

    //set the signal with updated raw value
    if(getValue(E_pubc_GW_GW_17E_EPS_LatCtrlActive_SetVt)==0)
    {
        rawValue = getvalue(this);
        if(chgEv_GW_17E_EPS_LatCtrlActive == 0)
        {
            //type conversion to float
            rawValue_float = rawValue;        
            // raw to physical conversion
            phyValue = ((rawValue_float *1)+(0));
            putValue(E_pubc_GW_GW_17E_EPS_LatCtrlActive_Pv, phyValue);
            chgEv_GW_17E_EPS_LatCtrlActive = 1;
        }
        else
        {
            chgEv_GW_17E_EPS_LatCtrlActive = 0;
        }    
        //update the signal value
        Msg_GW_17E.EPS_LatCtrlActive=rawValue;        
    }                                                                           
}
/*@@end*/

/*@@envVar:E_pubc_GW_GW_17E_EPS_LatCtrlActive_Pv:*/
on envVar E_pubc_GW_GW_17E_EPS_LatCtrlActive_Pv
{
    int64 rawValue = 0ll;
    float phyValue = 0.0;
    
    //update the raw value with physical value 
    if(getValue(E_pubc_GW_GW_17E_EPS_LatCtrlActive_SetVt)==0)
    {
        if(chgEv_GW_17E_EPS_LatCtrlActive == 0)
        {
            phyValue = getvalue(this);
            // physical to raw conversion
            rawValue = ((phyValue -(0))/1);
            putValue(E_pubc_GW_GW_17E_EPS_LatCtrlActive_Rv, rawValue);
            chgEv_GW_17E_EPS_LatCtrlActive = 1;  
        }
        else
        {
            chgEv_GW_17E_EPS_LatCtrlActive = 0;
        }
    }
}
/*@@end*/

/*@@envVar:E_pubc_GW_GW_17E_EPS_LatCtrlActive_Vt:*/
on envVar E_pubc_GW_GW_17E_EPS_LatCtrlActive_Vt
{
    qword rawValue = 0ll;
    if(getValue(E_pubc_GW_GW_17E_EPS_LatCtrlActive_SetVt))
    {
        //update the signal value
        Msg_GW_17E.EPS_LatCtrlActive=getValue(this);
    }
}
/*@@end*/

/*@@envVar:E_pubc_GW_GW_17E_EPS_LatCtrlActive_SetVt:*/
on envVar E_pubc_GW_GW_17E_EPS_LatCtrlActive_SetVt
{
    if(getValue(E_pubc_GW_GW_17E_EPS_LatCtrlActive_SetVt))
    {
        //update the signal value
        Msg_GW_17E.EPS_LatCtrlActive=getvalue(E_pubc_GW_GW_17E_EPS_LatCtrlActive_Vt);
    }
    else
    {
        Msg_GW_17E.EPS_LatCtrlActive=getValue(E_pubc_GW_GW_17E_EPS_LatCtrlActive_Rv);
    }
}
/*@@end*/
 
/*@@envVar:E_pubc_GW_GW_17E_EPS_MeasuredTorsionBarTorqValid_Rv:*/
on envVar E_pubc_GW_GW_17E_EPS_MeasuredTorsionBarTorqValid_Rv
{
    int64 rawValue = 0ll;
    float rawValue_float = 0.0;
    float phyValue = 0.0;        

    //set the signal with updated raw value
    {
        rawValue = getvalue(this);
        if(chgEv_GW_17E_EPS_MeasuredTorsionBarTorqValid == 0)
        {
            //type conversion to float
            rawValue_float = rawValue;        
            // raw to physical conversion
            phyValue = ((rawValue_float *1)+(0));
            putValue(E_pubc_GW_GW_17E_EPS_MeasuredTorsionBarTorqValid_Pv, phyValue);
            chgEv_GW_17E_EPS_MeasuredTorsionBarTorqValid = 1;
        }
        else
        {
            chgEv_GW_17E_EPS_MeasuredTorsionBarTorqValid = 0;
        }    
        //update the signal value
        Msg_GW_17E.EPS_MeasuredTorsionBarTorqValid=rawValue;        
    }                                                                           
}
/*@@end*/

/*@@envVar:E_pubc_GW_GW_17E_EPS_MeasuredTorsionBarTorqValid_Pv:*/
on envVar E_pubc_GW_GW_17E_EPS_MeasuredTorsionBarTorqValid_Pv
{
    int64 rawValue = 0ll;
    float phyValue = 0.0;
    
    //update the raw value with physical value 
    {
        if(chgEv_GW_17E_EPS_MeasuredTorsionBarTorqValid == 0)
        {
            phyValue = getvalue(this);
            // physical to raw conversion
            rawValue = ((phyValue -(0))/1);
            putValue(E_pubc_GW_GW_17E_EPS_MeasuredTorsionBarTorqValid_Rv, rawValue);
            chgEv_GW_17E_EPS_MeasuredTorsionBarTorqValid = 1;  
        }
        else
        {
            chgEv_GW_17E_EPS_MeasuredTorsionBarTorqValid = 0;
        }
    }
}
/*@@end*/


 
/*@@envVar:E_pubc_GW_GW_17E_EPS_MeasuredTorsionBarTorque_Rv:*/
on envVar E_pubc_GW_GW_17E_EPS_MeasuredTorsionBarTorque_Rv
{
    int64 rawValue = 0ll;
    float rawValue_float = 0.0;
    float phyValue = 0.0;        

    //set the signal with updated raw value
    {
        rawValue = getvalue(this);
        if(chgEv_GW_17E_EPS_MeasuredTorsionBarTorque == 0)
        {
            //type conversion to float
            rawValue_float = rawValue;        
            // raw to physical conversion
            phyValue = ((rawValue_float *0.01)+(-10.23));
            putValue(E_pubc_GW_GW_17E_EPS_MeasuredTorsionBarTorque_Pv, phyValue);
            chgEv_GW_17E_EPS_MeasuredTorsionBarTorque = 1;
        }
        else
        {
            chgEv_GW_17E_EPS_MeasuredTorsionBarTorque = 0;
        }    
        //update the signal value
        Msg_GW_17E.EPS_MeasuredTorsionBarTorque=rawValue;        
    }                                                                           
}
/*@@end*/

/*@@envVar:E_pubc_GW_GW_17E_EPS_MeasuredTorsionBarTorque_Pv:*/
on envVar E_pubc_GW_GW_17E_EPS_MeasuredTorsionBarTorque_Pv
{
    int64 rawValue = 0ll;
    float phyValue = 0.0;
    
    //update the raw value with physical value 
    {
        if(chgEv_GW_17E_EPS_MeasuredTorsionBarTorque == 0)
        {
            phyValue = getvalue(this);
            // physical to raw conversion
            rawValue = ((phyValue -(-10.23))/0.01);
            putValue(E_pubc_GW_GW_17E_EPS_MeasuredTorsionBarTorque_Rv, rawValue);
            chgEv_GW_17E_EPS_MeasuredTorsionBarTorque = 1;  
        }
        else
        {
            chgEv_GW_17E_EPS_MeasuredTorsionBarTorque = 0;
        }
    }
}
/*@@end*/


 
/*@@envVar:E_pubc_GW_GW_17E_EPS_LatCtrlAvailabilityStatus_Rv:*/
on envVar E_pubc_GW_GW_17E_EPS_LatCtrlAvailabilityStatus_Rv
{
    int64 rawValue = 0ll;
    float rawValue_float = 0.0;
    float phyValue = 0.0;        

    //set the signal with updated raw value
    if(getValue(E_pubc_GW_GW_17E_EPS_LatCtrlAvailabilityStatus_SetVt)==0)
    {
        rawValue = getvalue(this);
        if(chgEv_GW_17E_EPS_LatCtrlAvailabilityStatus == 0)
        {
            //type conversion to float
            rawValue_float = rawValue;        
            // raw to physical conversion
            phyValue = ((rawValue_float *1)+(0));
            putValue(E_pubc_GW_GW_17E_EPS_LatCtrlAvailabilityStatus_Pv, phyValue);
            chgEv_GW_17E_EPS_LatCtrlAvailabilityStatus = 1;
        }
        else
        {
            chgEv_GW_17E_EPS_LatCtrlAvailabilityStatus = 0;
        }    
        //update the signal value
        Msg_GW_17E.EPS_LatCtrlAvailabilityStatus=rawValue;        
    }                                                                           
}
/*@@end*/

/*@@envVar:E_pubc_GW_GW_17E_EPS_LatCtrlAvailabilityStatus_Pv:*/
on envVar E_pubc_GW_GW_17E_EPS_LatCtrlAvailabilityStatus_Pv
{
    int64 rawValue = 0ll;
    float phyValue = 0.0;
    
    //update the raw value with physical value 
    if(getValue(E_pubc_GW_GW_17E_EPS_LatCtrlAvailabilityStatus_SetVt)==0)
    {
        if(chgEv_GW_17E_EPS_LatCtrlAvailabilityStatus == 0)
        {
            phyValue = getvalue(this);
            // physical to raw conversion
            rawValue = ((phyValue -(0))/1);
            putValue(E_pubc_GW_GW_17E_EPS_LatCtrlAvailabilityStatus_Rv, rawValue);
            chgEv_GW_17E_EPS_LatCtrlAvailabilityStatus = 1;  
        }
        else
        {
            chgEv_GW_17E_EPS_LatCtrlAvailabilityStatus = 0;
        }
    }
}
/*@@end*/

/*@@envVar:E_pubc_GW_GW_17E_EPS_LatCtrlAvailabilityStatus_Vt:*/
on envVar E_pubc_GW_GW_17E_EPS_LatCtrlAvailabilityStatus_Vt
{
    qword rawValue = 0ll;
    if(getValue(E_pubc_GW_GW_17E_EPS_LatCtrlAvailabilityStatus_SetVt))
    {
        //update the signal value
        Msg_GW_17E.EPS_LatCtrlAvailabilityStatus=getValue(this);
    }
}
/*@@end*/

/*@@envVar:E_pubc_GW_GW_17E_EPS_LatCtrlAvailabilityStatus_SetVt:*/
on envVar E_pubc_GW_GW_17E_EPS_LatCtrlAvailabilityStatus_SetVt
{
    if(getValue(E_pubc_GW_GW_17E_EPS_LatCtrlAvailabilityStatus_SetVt))
    {
        //update the signal value
        Msg_GW_17E.EPS_LatCtrlAvailabilityStatus=getvalue(E_pubc_GW_GW_17E_EPS_LatCtrlAvailabilityStatus_Vt);
    }
    else
    {
        Msg_GW_17E.EPS_LatCtrlAvailabilityStatus=getValue(E_pubc_GW_GW_17E_EPS_LatCtrlAvailabilityStatus_Rv);
    }
}
/*@@end*/
 
/*@@envVar:E_pubc_GW_GW_2C2_tx:*/
on envVar E_pubc_GW_GW_2C2_tx
{
    if(getValue(this))
    {       
        
        //update the BZ Signal
        if(GW_2C2_IbCycCntr2C2_wrongvalctr == 0)
        {
            update_GW_2C2_IbCycCntr2C2_counter();
            Msg_GW_2C2.IbCycCntr2C2= GW_2C2_IbCycCntr2C2_counter;
        }
        else if(GW_2C2_IbCycCntr2C2_wrongvalctr > 0)
        {
			GW_2C2_IbCycCntr2C2_counter=GW_2C2_IbCycCntr2C2_counter + GW_2C2_IbCycCntr2C2_wrongvalctr;
			 Msg_GW_2C2.IbCycCntr2C2= GW_2C2_IbCycCntr2C2_counter;
            /* GW_2C2_IbCycCntr2C2_wrongvalctr--;
              // if counter becomes zero, update panel controller to zero
             if(GW_2C2_IbCycCntr2C2_wrongvalctr == 0)
             {
                 putValue(E_pubc_GW_GW_2C2_IbCycCntr2C2_wrongvalctr,0);
             } */
        }
        else
        { 
			// do nothing
        }    
        //calculate the CRC CheckSum
        update_GW_2C2_CRC_CheckSum();

        output(Msg_GW_2C2);        
    }
}
/*@@end*/

/*@@envVar:E_pubc_GW_GW_2C2_Range:*/
on envVar E_pubc_GW_GW_2C2_Range
{
    qword rawstatus = 0ll;
    qword rawValue = 0ll;    
    
    rawstatus = getvalue(this);    
    // set all the signals with min raw /max raw /init raw
    switch (rawstatus) 
    {
     case(0) :
        rawValue= 0;
        putValue(E_pubc_GW_GW_2C2_IbBrkPedlStsGbVld_Rv, rawValue);
        rawValue= 0;
        putValue(E_pubc_GW_GW_2C2_IB_EPBrequestValid_Rv, rawValue);
        rawValue= 0;
        putValue(E_pubc_GW_GW_2C2_IbBrkPedlStsGb_Rv, rawValue);
        rawValue= 0;
        putValue(E_pubc_GW_GW_2C2_IB_EPBrequest_Rv, rawValue);
        break;
     case(1) :
        rawValue= 2;
        putValue(E_pubc_GW_GW_2C2_IbBrkPedlStsGbVld_Rv, rawValue);
        rawValue= 1;
        putValue(E_pubc_GW_GW_2C2_IB_EPBrequestValid_Rv, rawValue);
        rawValue= 255;
        putValue(E_pubc_GW_GW_2C2_IbBrkPedlStsGb_Rv, rawValue);
        rawValue= 3;
        putValue(E_pubc_GW_GW_2C2_IB_EPBrequest_Rv, rawValue);
        break;
     default :
        rawValue= 0;
        putValue(E_pubc_GW_GW_2C2_IbBrkPedlStsGbVld_Rv, rawValue);
        rawValue= 0;
        putValue(E_pubc_GW_GW_2C2_IB_EPBrequestValid_Rv, rawValue);
        rawValue= 0;
        putValue(E_pubc_GW_GW_2C2_IbBrkPedlStsGb_Rv, rawValue);
        rawValue= 0;
        putValue(E_pubc_GW_GW_2C2_IB_EPBrequest_Rv, rawValue);
      break;
   }
}
/*@@end*/

/*@@envVar:E_pubc_GW_GW_2C2_Dlc:*/
on envVar E_pubc_GW_GW_2C2_Dlc
{
    if(getValue(E_pubc_GW_GW_2C2_enDlc))
    {
        Msg_GW_2C2.dlc =getValue(this);
    }
    else
    {
       Dbc_dlc = 64;
	   Msg_GW_2C2.dlc = Calc_Canfd_dlc(Dbc_dlc);
	   // Msg_GW_2C2.dlc = 64;
	   	
  }
}
/*@@end*/

/*@@envVar:E_pubc_GW_GW_2C2_enDlc:*/
on envVar E_pubc_GW_GW_2C2_enDlc
{
    //For Messages with DLC = 8, set wrong DLC to smaller than defined DLC
    //For Messages with DLC < 8 set wrong DLC to smaller/longer than defined DLC
    if(getValue(this))
    {
        Msg_GW_2C2.dlc =getValue(E_pubc_GW_GW_2C2_Dlc);
    }
    else
    {
       Dbc_dlc = 64;
	   Msg_GW_2C2.dlc = Calc_Canfd_dlc(Dbc_dlc);
	   // Msg_GW_2C2.dlc = 64;
    }
}
/*@@end*/

/*@@envVar:E_pubc_GW_GW_2C2_IbCrcChk2C2_wrongvalctr:*/
on envVar E_pubc_GW_GW_2C2_IbCrcChk2C2_wrongvalctr
{
    //update disturb count
    //disturb value range:(-1 = always send wrong value),( X>0 ,x is the number of Messages with wrong CHK sent)
    GW_2C2_IbCrcChk2C2_wrongvalctr =getValue(this);    
}
/*@@end*/
/*@@envVar:E_pubc_GW_GW_2C2_IbCycCntr2C2_wrongvalctr:*/
on envVar E_pubc_GW_GW_2C2_IbCycCntr2C2_wrongvalctr
{
    //update disturb count
    //disturb value range:(-1 = always send wrong value),( X>0 ,x is the number of Messages with wrong CHK sent)
    GW_2C2_IbCycCntr2C2_wrongvalctr =getValue(this);    
}
/*@@end*/

/*@@envVar:E_pubc_GW_GW_2C2_IbBrkPedlStsGbVld_Rv:*/
on envVar E_pubc_GW_GW_2C2_IbBrkPedlStsGbVld_Rv
{
    int64 rawValue = 0ll;
    float rawValue_float = 0.0;
    float phyValue = 0.0;        

    //set the signal with updated raw value
    if(getValue(E_pubc_GW_GW_2C2_IbBrkPedlStsGbVld_SetVt)==0)
    {
        rawValue = getvalue(this);
        if(chgEv_GW_2C2_IbBrkPedlStsGbVld == 0)
        {
            //type conversion to float
            rawValue_float = rawValue;        
            // raw to physical conversion
            phyValue = ((rawValue_float *1)+(0));
            putValue(E_pubc_GW_GW_2C2_IbBrkPedlStsGbVld_Pv, phyValue);
            chgEv_GW_2C2_IbBrkPedlStsGbVld = 1;
        }
        else
        {
            chgEv_GW_2C2_IbBrkPedlStsGbVld = 0;
        }    
        //update the signal value
        Msg_GW_2C2.IbBrkPedlStsGbVld=rawValue;        
    }                                                                           
}
/*@@end*/

/*@@envVar:E_pubc_GW_GW_2C2_IbBrkPedlStsGbVld_Pv:*/
on envVar E_pubc_GW_GW_2C2_IbBrkPedlStsGbVld_Pv
{
    int64 rawValue = 0ll;
    float phyValue = 0.0;
    
    //update the raw value with physical value 
    if(getValue(E_pubc_GW_GW_2C2_IbBrkPedlStsGbVld_SetVt)==0)
    {
        if(chgEv_GW_2C2_IbBrkPedlStsGbVld == 0)
        {
            phyValue = getvalue(this);
            // physical to raw conversion
            rawValue = ((phyValue -(0))/1);
            putValue(E_pubc_GW_GW_2C2_IbBrkPedlStsGbVld_Rv, rawValue);
            chgEv_GW_2C2_IbBrkPedlStsGbVld = 1;  
        }
        else
        {
            chgEv_GW_2C2_IbBrkPedlStsGbVld = 0;
        }
    }
}
/*@@end*/

/*@@envVar:E_pubc_GW_GW_2C2_IbBrkPedlStsGbVld_Vt:*/
on envVar E_pubc_GW_GW_2C2_IbBrkPedlStsGbVld_Vt
{
    qword rawValue = 0ll;
    if(getValue(E_pubc_GW_GW_2C2_IbBrkPedlStsGbVld_SetVt))
    {
        //update the signal value
        Msg_GW_2C2.IbBrkPedlStsGbVld=getValue(this);
    }
}
/*@@end*/

/*@@envVar:E_pubc_GW_GW_2C2_IbBrkPedlStsGbVld_SetVt:*/
on envVar E_pubc_GW_GW_2C2_IbBrkPedlStsGbVld_SetVt
{
    if(getValue(E_pubc_GW_GW_2C2_IbBrkPedlStsGbVld_SetVt))
    {
        //update the signal value
        Msg_GW_2C2.IbBrkPedlStsGbVld=getvalue(E_pubc_GW_GW_2C2_IbBrkPedlStsGbVld_Vt);
    }
    else
    {
        Msg_GW_2C2.IbBrkPedlStsGbVld=getValue(E_pubc_GW_GW_2C2_IbBrkPedlStsGbVld_Rv);
    }
}
/*@@end*/
 
/*@@envVar:E_pubc_GW_GW_2C2_IB_EPBrequestValid_Rv:*/
on envVar E_pubc_GW_GW_2C2_IB_EPBrequestValid_Rv
{
    int64 rawValue = 0ll;
    float rawValue_float = 0.0;
    float phyValue = 0.0;        

    //set the signal with updated raw value
    if(getValue(E_pubc_GW_GW_2C2_IB_EPBrequestValid_SetVt)==0)
    {
        rawValue = getvalue(this);
        if(chgEv_GW_2C2_IB_EPBrequestValid == 0)
        {
            //type conversion to float
            rawValue_float = rawValue;        
            // raw to physical conversion
            phyValue = ((rawValue_float *1)+(0));
            putValue(E_pubc_GW_GW_2C2_IB_EPBrequestValid_Pv, phyValue);
            chgEv_GW_2C2_IB_EPBrequestValid = 1;
        }
        else
        {
            chgEv_GW_2C2_IB_EPBrequestValid = 0;
        }    
        //update the signal value
        Msg_GW_2C2.IB_EPBrequestValid=rawValue;        
    }                                                                           
}
/*@@end*/

/*@@envVar:E_pubc_GW_GW_2C2_IB_EPBrequestValid_Pv:*/
on envVar E_pubc_GW_GW_2C2_IB_EPBrequestValid_Pv
{
    int64 rawValue = 0ll;
    float phyValue = 0.0;
    
    //update the raw value with physical value 
    if(getValue(E_pubc_GW_GW_2C2_IB_EPBrequestValid_SetVt)==0)
    {
        if(chgEv_GW_2C2_IB_EPBrequestValid == 0)
        {
            phyValue = getvalue(this);
            // physical to raw conversion
            rawValue = ((phyValue -(0))/1);
            putValue(E_pubc_GW_GW_2C2_IB_EPBrequestValid_Rv, rawValue);
            chgEv_GW_2C2_IB_EPBrequestValid = 1;  
        }
        else
        {
            chgEv_GW_2C2_IB_EPBrequestValid = 0;
        }
    }
}
/*@@end*/

/*@@envVar:E_pubc_GW_GW_2C2_IB_EPBrequestValid_Vt:*/
on envVar E_pubc_GW_GW_2C2_IB_EPBrequestValid_Vt
{
    qword rawValue = 0ll;
    if(getValue(E_pubc_GW_GW_2C2_IB_EPBrequestValid_SetVt))
    {
        //update the signal value
        Msg_GW_2C2.IB_EPBrequestValid=getValue(this);
    }
}
/*@@end*/

/*@@envVar:E_pubc_GW_GW_2C2_IB_EPBrequestValid_SetVt:*/
on envVar E_pubc_GW_GW_2C2_IB_EPBrequestValid_SetVt
{
    if(getValue(E_pubc_GW_GW_2C2_IB_EPBrequestValid_SetVt))
    {
        //update the signal value
        Msg_GW_2C2.IB_EPBrequestValid=getvalue(E_pubc_GW_GW_2C2_IB_EPBrequestValid_Vt);
    }
    else
    {
        Msg_GW_2C2.IB_EPBrequestValid=getValue(E_pubc_GW_GW_2C2_IB_EPBrequestValid_Rv);
    }
}
/*@@end*/
 
/*@@envVar:E_pubc_GW_GW_2C2_IbBrkPedlStsGb_Rv:*/
on envVar E_pubc_GW_GW_2C2_IbBrkPedlStsGb_Rv
{
    int64 rawValue = 0ll;
    float rawValue_float = 0.0;
    float phyValue = 0.0;        

    //set the signal with updated raw value
    {
        rawValue = getvalue(this);
        if(chgEv_GW_2C2_IbBrkPedlStsGb == 0)
        {
            //type conversion to float
            rawValue_float = rawValue;        
            // raw to physical conversion
            phyValue = ((rawValue_float *1)+(0));
            putValue(E_pubc_GW_GW_2C2_IbBrkPedlStsGb_Pv, phyValue);
            chgEv_GW_2C2_IbBrkPedlStsGb = 1;
        }
        else
        {
            chgEv_GW_2C2_IbBrkPedlStsGb = 0;
        }    
        //update the signal value
        Msg_GW_2C2.IbBrkPedlStsGb=rawValue;        
    }                                                                           
}
/*@@end*/

/*@@envVar:E_pubc_GW_GW_2C2_IbBrkPedlStsGb_Pv:*/
on envVar E_pubc_GW_GW_2C2_IbBrkPedlStsGb_Pv
{
    int64 rawValue = 0ll;
    float phyValue = 0.0;
    
    //update the raw value with physical value 
    {
        if(chgEv_GW_2C2_IbBrkPedlStsGb == 0)
        {
            phyValue = getvalue(this);
            // physical to raw conversion
            rawValue = ((phyValue -(0))/1);
            putValue(E_pubc_GW_GW_2C2_IbBrkPedlStsGb_Rv, rawValue);
            chgEv_GW_2C2_IbBrkPedlStsGb = 1;  
        }
        else
        {
            chgEv_GW_2C2_IbBrkPedlStsGb = 0;
        }
    }
}
/*@@end*/


 
/*@@envVar:E_pubc_GW_GW_2C2_IB_EPBrequest_Rv:*/
on envVar E_pubc_GW_GW_2C2_IB_EPBrequest_Rv
{
    int64 rawValue = 0ll;
    float rawValue_float = 0.0;
    float phyValue = 0.0;        

    //set the signal with updated raw value
    if(getValue(E_pubc_GW_GW_2C2_IB_EPBrequest_SetVt)==0)
    {
        rawValue = getvalue(this);
        if(chgEv_GW_2C2_IB_EPBrequest == 0)
        {
            //type conversion to float
            rawValue_float = rawValue;        
            // raw to physical conversion
            phyValue = ((rawValue_float *1)+(0));
            putValue(E_pubc_GW_GW_2C2_IB_EPBrequest_Pv, phyValue);
            chgEv_GW_2C2_IB_EPBrequest = 1;
        }
        else
        {
            chgEv_GW_2C2_IB_EPBrequest = 0;
        }    
        //update the signal value
        Msg_GW_2C2.IB_EPBrequest=rawValue;        
    }                                                                           
}
/*@@end*/

/*@@envVar:E_pubc_GW_GW_2C2_IB_EPBrequest_Pv:*/
on envVar E_pubc_GW_GW_2C2_IB_EPBrequest_Pv
{
    int64 rawValue = 0ll;
    float phyValue = 0.0;
    
    //update the raw value with physical value 
    if(getValue(E_pubc_GW_GW_2C2_IB_EPBrequest_SetVt)==0)
    {
        if(chgEv_GW_2C2_IB_EPBrequest == 0)
        {
            phyValue = getvalue(this);
            // physical to raw conversion
            rawValue = ((phyValue -(0))/1);
            putValue(E_pubc_GW_GW_2C2_IB_EPBrequest_Rv, rawValue);
            chgEv_GW_2C2_IB_EPBrequest = 1;  
        }
        else
        {
            chgEv_GW_2C2_IB_EPBrequest = 0;
        }
    }
}
/*@@end*/

/*@@envVar:E_pubc_GW_GW_2C2_IB_EPBrequest_Vt:*/
on envVar E_pubc_GW_GW_2C2_IB_EPBrequest_Vt
{
    qword rawValue = 0ll;
    if(getValue(E_pubc_GW_GW_2C2_IB_EPBrequest_SetVt))
    {
        //update the signal value
        Msg_GW_2C2.IB_EPBrequest=getValue(this);
    }
}
/*@@end*/

/*@@envVar:E_pubc_GW_GW_2C2_IB_EPBrequest_SetVt:*/
on envVar E_pubc_GW_GW_2C2_IB_EPBrequest_SetVt
{
    if(getValue(E_pubc_GW_GW_2C2_IB_EPBrequest_SetVt))
    {
        //update the signal value
        Msg_GW_2C2.IB_EPBrequest=getvalue(E_pubc_GW_GW_2C2_IB_EPBrequest_Vt);
    }
    else
    {
        Msg_GW_2C2.IB_EPBrequest=getValue(E_pubc_GW_GW_2C2_IB_EPBrequest_Rv);
    }
}
/*@@end*/
 
/*@@envVar:E_pubc_GW_GW_2A4_tx:*/
on envVar E_pubc_GW_GW_2A4_tx
{
    if(getValue(this))
    {       
        
        //update the BZ Signal
        if(GW_2A4_LCDAR_RollingCounter_2AF_wrongvalctr == 0)
        {
            update_GW_2A4_LCDAR_RollingCounter_2AF_counter();
            Msg_GW_2A4.LCDAR_RollingCounter_2AF= GW_2A4_LCDAR_RollingCounter_2AF_counter;
        }
        else if(GW_2A4_LCDAR_RollingCounter_2AF_wrongvalctr > 0)
        {
			GW_2A4_LCDAR_RollingCounter_2AF_counter=GW_2A4_LCDAR_RollingCounter_2AF_counter + GW_2A4_LCDAR_RollingCounter_2AF_wrongvalctr;
			 Msg_GW_2A4.LCDAR_RollingCounter_2AF= GW_2A4_LCDAR_RollingCounter_2AF_counter;
            /* GW_2A4_LCDAR_RollingCounter_2AF_wrongvalctr--;
              // if counter becomes zero, update panel controller to zero
             if(GW_2A4_LCDAR_RollingCounter_2AF_wrongvalctr == 0)
             {
                 putValue(E_pubc_GW_GW_2A4_LCDAR_RollingCounter_2AF_wrongvalctr,0);
             } */
        }
        else
        { 
			// do nothing
        }    
        //update the BZ Signal
        if(GW_2A4_RRC_RollingCounter_2A4_wrongvalctr == 0)
        {
            update_GW_2A4_RRC_RollingCounter_2A4_counter();
            Msg_GW_2A4.RRC_RollingCounter_2A4= GW_2A4_RRC_RollingCounter_2A4_counter;
        }
        else if(GW_2A4_RRC_RollingCounter_2A4_wrongvalctr > 0)
        {
			GW_2A4_RRC_RollingCounter_2A4_counter=GW_2A4_RRC_RollingCounter_2A4_counter + GW_2A4_RRC_RollingCounter_2A4_wrongvalctr;
			 Msg_GW_2A4.RRC_RollingCounter_2A4= GW_2A4_RRC_RollingCounter_2A4_counter;
            /* GW_2A4_RRC_RollingCounter_2A4_wrongvalctr--;
              // if counter becomes zero, update panel controller to zero
             if(GW_2A4_RRC_RollingCounter_2A4_wrongvalctr == 0)
             {
                 putValue(E_pubc_GW_GW_2A4_RRC_RollingCounter_2A4_wrongvalctr,0);
             } */
        }
        else
        { 
			// do nothing
        }    
        //calculate the CRC CheckSum
        update_GW_2A4_CRC_CheckSum();

        output(Msg_GW_2A4);        
    }
}
/*@@end*/

/*@@envVar:E_pubc_GW_GW_2A4_Range:*/
on envVar E_pubc_GW_GW_2A4_Range
{
    qword rawstatus = 0ll;
    qword rawValue = 0ll;    
    
    rawstatus = getvalue(this);    
    // set all the signals with min raw /max raw /init raw
    switch (rawstatus) 
    {
     case(0) :
        rawValue= 0;
        putValue(E_pubc_GW_GW_2A4_LCDAR_Left_ELK_oAlert_Rv, rawValue);
        rawValue= 0;
        putValue(E_pubc_GW_GW_2A4_LCDAR_RCTBEnable_Rv, rawValue);
        rawValue= 0;
        putValue(E_pubc_GW_GW_2A4_LCDAR_ELK_oAlert_Rv, rawValue);
        rawValue= 0;
        putValue(E_pubc_GW_GW_2A4_LCDAR_ELK_oStatus_Rv, rawValue);
        rawValue= 0;
        putValue(E_pubc_GW_GW_2A4_LCDAR_RCTBTargetDecel_Rv, rawValue);
        rawValue= 0;
        putValue(E_pubc_GW_GW_2A4_LCDAR_SystemStatus_Rv, rawValue);
        rawValue= 0;
        putValue(E_pubc_GW_GW_2A4_LCDAR_RCTBActive_Rv, rawValue);
        rawValue= 0;
        putValue(E_pubc_GW_GW_2A4_LCDAR_Left_RCTAAlert_Rv, rawValue);
        break;
     case(1) :
        rawValue= 3;
        putValue(E_pubc_GW_GW_2A4_LCDAR_Left_ELK_oAlert_Rv, rawValue);
        rawValue= 1;
        putValue(E_pubc_GW_GW_2A4_LCDAR_RCTBEnable_Rv, rawValue);
        rawValue= 3;
        putValue(E_pubc_GW_GW_2A4_LCDAR_ELK_oAlert_Rv, rawValue);
        rawValue= 3;
        putValue(E_pubc_GW_GW_2A4_LCDAR_ELK_oStatus_Rv, rawValue);
        rawValue= 64000;
        putValue(E_pubc_GW_GW_2A4_LCDAR_RCTBTargetDecel_Rv, rawValue);
        rawValue= 7;
        putValue(E_pubc_GW_GW_2A4_LCDAR_SystemStatus_Rv, rawValue);
        rawValue= 1;
        putValue(E_pubc_GW_GW_2A4_LCDAR_RCTBActive_Rv, rawValue);
        rawValue= 3;
        putValue(E_pubc_GW_GW_2A4_LCDAR_Left_RCTAAlert_Rv, rawValue);
        break;
     default :
        rawValue= 0;
        putValue(E_pubc_GW_GW_2A4_LCDAR_Left_ELK_oAlert_Rv, rawValue);
        rawValue= 0;
        putValue(E_pubc_GW_GW_2A4_LCDAR_RCTBEnable_Rv, rawValue);
        rawValue= 0;
        putValue(E_pubc_GW_GW_2A4_LCDAR_ELK_oAlert_Rv, rawValue);
        rawValue= 0;
        putValue(E_pubc_GW_GW_2A4_LCDAR_ELK_oStatus_Rv, rawValue);
        rawValue= 0;
        putValue(E_pubc_GW_GW_2A4_LCDAR_RCTBTargetDecel_Rv, rawValue);
        rawValue= 0;
        putValue(E_pubc_GW_GW_2A4_LCDAR_SystemStatus_Rv, rawValue);
        rawValue= 0;
        putValue(E_pubc_GW_GW_2A4_LCDAR_RCTBActive_Rv, rawValue);
        rawValue= 0;
        putValue(E_pubc_GW_GW_2A4_LCDAR_Left_RCTAAlert_Rv, rawValue);
      break;
   }
}
/*@@end*/

/*@@envVar:E_pubc_GW_GW_2A4_Dlc:*/
on envVar E_pubc_GW_GW_2A4_Dlc
{
    if(getValue(E_pubc_GW_GW_2A4_enDlc))
    {
        Msg_GW_2A4.dlc =getValue(this);
    }
    else
    {
       Dbc_dlc = 64;
	   Msg_GW_2A4.dlc = Calc_Canfd_dlc(Dbc_dlc);
	   // Msg_GW_2A4.dlc = 64;
	   	
  }
}
/*@@end*/

/*@@envVar:E_pubc_GW_GW_2A4_enDlc:*/
on envVar E_pubc_GW_GW_2A4_enDlc
{
    //For Messages with DLC = 8, set wrong DLC to smaller than defined DLC
    //For Messages with DLC < 8 set wrong DLC to smaller/longer than defined DLC
    if(getValue(this))
    {
        Msg_GW_2A4.dlc =getValue(E_pubc_GW_GW_2A4_Dlc);
    }
    else
    {
       Dbc_dlc = 64;
	   Msg_GW_2A4.dlc = Calc_Canfd_dlc(Dbc_dlc);
	   // Msg_GW_2A4.dlc = 64;
    }
}
/*@@end*/

/*@@envVar:E_pubc_GW_GW_2A4_LCDAR_CRCCheck_2AF_wrongvalctr:*/
on envVar E_pubc_GW_GW_2A4_LCDAR_CRCCheck_2AF_wrongvalctr
{
    //update disturb count
    //disturb value range:(-1 = always send wrong value),( X>0 ,x is the number of Messages with wrong CHK sent)
    GW_2A4_LCDAR_CRCCheck_2AF_wrongvalctr =getValue(this);    
}
/*@@end*/
/*@@envVar:E_pubc_GW_GW_2A4_LCDAR_RollingCounter_2AF_wrongvalctr:*/
on envVar E_pubc_GW_GW_2A4_LCDAR_RollingCounter_2AF_wrongvalctr
{
    //update disturb count
    //disturb value range:(-1 = always send wrong value),( X>0 ,x is the number of Messages with wrong CHK sent)
    GW_2A4_LCDAR_RollingCounter_2AF_wrongvalctr =getValue(this);    
}
/*@@end*/
/*@@envVar:E_pubc_GW_GW_2A4_RRC_CRCCheck_2A4_wrongvalctr:*/
on envVar E_pubc_GW_GW_2A4_RRC_CRCCheck_2A4_wrongvalctr
{
    //update disturb count
    //disturb value range:(-1 = always send wrong value),( X>0 ,x is the number of Messages with wrong CHK sent)
    GW_2A4_RRC_CRCCheck_2A4_wrongvalctr =getValue(this);    
}
/*@@end*/
/*@@envVar:E_pubc_GW_GW_2A4_RRC_RollingCounter_2A4_wrongvalctr:*/
on envVar E_pubc_GW_GW_2A4_RRC_RollingCounter_2A4_wrongvalctr
{
    //update disturb count
    //disturb value range:(-1 = always send wrong value),( X>0 ,x is the number of Messages with wrong CHK sent)
    GW_2A4_RRC_RollingCounter_2A4_wrongvalctr =getValue(this);    
}
/*@@end*/

/*@@envVar:E_pubc_GW_GW_2A4_LCDAR_Left_ELK_oAlert_Rv:*/
on envVar E_pubc_GW_GW_2A4_LCDAR_Left_ELK_oAlert_Rv
{
    int64 rawValue = 0ll;
    float rawValue_float = 0.0;
    float phyValue = 0.0;        

    //set the signal with updated raw value
    if(getValue(E_pubc_GW_GW_2A4_LCDAR_Left_ELK_oAlert_SetVt)==0)
    {
        rawValue = getvalue(this);
        if(chgEv_GW_2A4_LCDAR_Left_ELK_oAlert == 0)
        {
            //type conversion to float
            rawValue_float = rawValue;        
            // raw to physical conversion
            phyValue = ((rawValue_float *1)+(0));
            putValue(E_pubc_GW_GW_2A4_LCDAR_Left_ELK_oAlert_Pv, phyValue);
            chgEv_GW_2A4_LCDAR_Left_ELK_oAlert = 1;
        }
        else
        {
            chgEv_GW_2A4_LCDAR_Left_ELK_oAlert = 0;
        }    
        //update the signal value
        Msg_GW_2A4.LCDAR_Left_ELK_oAlert=rawValue;        
    }                                                                           
}
/*@@end*/

/*@@envVar:E_pubc_GW_GW_2A4_LCDAR_Left_ELK_oAlert_Pv:*/
on envVar E_pubc_GW_GW_2A4_LCDAR_Left_ELK_oAlert_Pv
{
    int64 rawValue = 0ll;
    float phyValue = 0.0;
    
    //update the raw value with physical value 
    if(getValue(E_pubc_GW_GW_2A4_LCDAR_Left_ELK_oAlert_SetVt)==0)
    {
        if(chgEv_GW_2A4_LCDAR_Left_ELK_oAlert == 0)
        {
            phyValue = getvalue(this);
            // physical to raw conversion
            rawValue = ((phyValue -(0))/1);
            putValue(E_pubc_GW_GW_2A4_LCDAR_Left_ELK_oAlert_Rv, rawValue);
            chgEv_GW_2A4_LCDAR_Left_ELK_oAlert = 1;  
        }
        else
        {
            chgEv_GW_2A4_LCDAR_Left_ELK_oAlert = 0;
        }
    }
}
/*@@end*/

/*@@envVar:E_pubc_GW_GW_2A4_LCDAR_Left_ELK_oAlert_Vt:*/
on envVar E_pubc_GW_GW_2A4_LCDAR_Left_ELK_oAlert_Vt
{
    qword rawValue = 0ll;
    if(getValue(E_pubc_GW_GW_2A4_LCDAR_Left_ELK_oAlert_SetVt))
    {
        //update the signal value
        Msg_GW_2A4.LCDAR_Left_ELK_oAlert=getValue(this);
    }
}
/*@@end*/

/*@@envVar:E_pubc_GW_GW_2A4_LCDAR_Left_ELK_oAlert_SetVt:*/
on envVar E_pubc_GW_GW_2A4_LCDAR_Left_ELK_oAlert_SetVt
{
    if(getValue(E_pubc_GW_GW_2A4_LCDAR_Left_ELK_oAlert_SetVt))
    {
        //update the signal value
        Msg_GW_2A4.LCDAR_Left_ELK_oAlert=getvalue(E_pubc_GW_GW_2A4_LCDAR_Left_ELK_oAlert_Vt);
    }
    else
    {
        Msg_GW_2A4.LCDAR_Left_ELK_oAlert=getValue(E_pubc_GW_GW_2A4_LCDAR_Left_ELK_oAlert_Rv);
    }
}
/*@@end*/
 
/*@@envVar:E_pubc_GW_GW_2A4_LCDAR_RCTBEnable_Rv:*/
on envVar E_pubc_GW_GW_2A4_LCDAR_RCTBEnable_Rv
{
    int64 rawValue = 0ll;
    float rawValue_float = 0.0;
    float phyValue = 0.0;        

    //set the signal with updated raw value
    if(getValue(E_pubc_GW_GW_2A4_LCDAR_RCTBEnable_SetVt)==0)
    {
        rawValue = getvalue(this);
        if(chgEv_GW_2A4_LCDAR_RCTBEnable == 0)
        {
            //type conversion to float
            rawValue_float = rawValue;        
            // raw to physical conversion
            phyValue = ((rawValue_float *1)+(0));
            putValue(E_pubc_GW_GW_2A4_LCDAR_RCTBEnable_Pv, phyValue);
            chgEv_GW_2A4_LCDAR_RCTBEnable = 1;
        }
        else
        {
            chgEv_GW_2A4_LCDAR_RCTBEnable = 0;
        }    
        //update the signal value
        Msg_GW_2A4.LCDAR_RCTBEnable=rawValue;        
    }                                                                           
}
/*@@end*/

/*@@envVar:E_pubc_GW_GW_2A4_LCDAR_RCTBEnable_Pv:*/
on envVar E_pubc_GW_GW_2A4_LCDAR_RCTBEnable_Pv
{
    int64 rawValue = 0ll;
    float phyValue = 0.0;
    
    //update the raw value with physical value 
    if(getValue(E_pubc_GW_GW_2A4_LCDAR_RCTBEnable_SetVt)==0)
    {
        if(chgEv_GW_2A4_LCDAR_RCTBEnable == 0)
        {
            phyValue = getvalue(this);
            // physical to raw conversion
            rawValue = ((phyValue -(0))/1);
            putValue(E_pubc_GW_GW_2A4_LCDAR_RCTBEnable_Rv, rawValue);
            chgEv_GW_2A4_LCDAR_RCTBEnable = 1;  
        }
        else
        {
            chgEv_GW_2A4_LCDAR_RCTBEnable = 0;
        }
    }
}
/*@@end*/

/*@@envVar:E_pubc_GW_GW_2A4_LCDAR_RCTBEnable_Vt:*/
on envVar E_pubc_GW_GW_2A4_LCDAR_RCTBEnable_Vt
{
    qword rawValue = 0ll;
    if(getValue(E_pubc_GW_GW_2A4_LCDAR_RCTBEnable_SetVt))
    {
        //update the signal value
        Msg_GW_2A4.LCDAR_RCTBEnable=getValue(this);
    }
}
/*@@end*/

/*@@envVar:E_pubc_GW_GW_2A4_LCDAR_RCTBEnable_SetVt:*/
on envVar E_pubc_GW_GW_2A4_LCDAR_RCTBEnable_SetVt
{
    if(getValue(E_pubc_GW_GW_2A4_LCDAR_RCTBEnable_SetVt))
    {
        //update the signal value
        Msg_GW_2A4.LCDAR_RCTBEnable=getvalue(E_pubc_GW_GW_2A4_LCDAR_RCTBEnable_Vt);
    }
    else
    {
        Msg_GW_2A4.LCDAR_RCTBEnable=getValue(E_pubc_GW_GW_2A4_LCDAR_RCTBEnable_Rv);
    }
}
/*@@end*/
 
/*@@envVar:E_pubc_GW_GW_2A4_LCDAR_ELK_oAlert_Rv:*/
on envVar E_pubc_GW_GW_2A4_LCDAR_ELK_oAlert_Rv
{
    int64 rawValue = 0ll;
    float rawValue_float = 0.0;
    float phyValue = 0.0;        

    //set the signal with updated raw value
    if(getValue(E_pubc_GW_GW_2A4_LCDAR_ELK_oAlert_SetVt)==0)
    {
        rawValue = getvalue(this);
        if(chgEv_GW_2A4_LCDAR_ELK_oAlert == 0)
        {
            //type conversion to float
            rawValue_float = rawValue;        
            // raw to physical conversion
            phyValue = ((rawValue_float *1)+(0));
            putValue(E_pubc_GW_GW_2A4_LCDAR_ELK_oAlert_Pv, phyValue);
            chgEv_GW_2A4_LCDAR_ELK_oAlert = 1;
        }
        else
        {
            chgEv_GW_2A4_LCDAR_ELK_oAlert = 0;
        }    
        //update the signal value
        Msg_GW_2A4.LCDAR_ELK_oAlert=rawValue;        
    }                                                                           
}
/*@@end*/

/*@@envVar:E_pubc_GW_GW_2A4_LCDAR_ELK_oAlert_Pv:*/
on envVar E_pubc_GW_GW_2A4_LCDAR_ELK_oAlert_Pv
{
    int64 rawValue = 0ll;
    float phyValue = 0.0;
    
    //update the raw value with physical value 
    if(getValue(E_pubc_GW_GW_2A4_LCDAR_ELK_oAlert_SetVt)==0)
    {
        if(chgEv_GW_2A4_LCDAR_ELK_oAlert == 0)
        {
            phyValue = getvalue(this);
            // physical to raw conversion
            rawValue = ((phyValue -(0))/1);
            putValue(E_pubc_GW_GW_2A4_LCDAR_ELK_oAlert_Rv, rawValue);
            chgEv_GW_2A4_LCDAR_ELK_oAlert = 1;  
        }
        else
        {
            chgEv_GW_2A4_LCDAR_ELK_oAlert = 0;
        }
    }
}
/*@@end*/

/*@@envVar:E_pubc_GW_GW_2A4_LCDAR_ELK_oAlert_Vt:*/
on envVar E_pubc_GW_GW_2A4_LCDAR_ELK_oAlert_Vt
{
    qword rawValue = 0ll;
    if(getValue(E_pubc_GW_GW_2A4_LCDAR_ELK_oAlert_SetVt))
    {
        //update the signal value
        Msg_GW_2A4.LCDAR_ELK_oAlert=getValue(this);
    }
}
/*@@end*/

/*@@envVar:E_pubc_GW_GW_2A4_LCDAR_ELK_oAlert_SetVt:*/
on envVar E_pubc_GW_GW_2A4_LCDAR_ELK_oAlert_SetVt
{
    if(getValue(E_pubc_GW_GW_2A4_LCDAR_ELK_oAlert_SetVt))
    {
        //update the signal value
        Msg_GW_2A4.LCDAR_ELK_oAlert=getvalue(E_pubc_GW_GW_2A4_LCDAR_ELK_oAlert_Vt);
    }
    else
    {
        Msg_GW_2A4.LCDAR_ELK_oAlert=getValue(E_pubc_GW_GW_2A4_LCDAR_ELK_oAlert_Rv);
    }
}
/*@@end*/
 
/*@@envVar:E_pubc_GW_GW_2A4_LCDAR_ELK_oStatus_Rv:*/
on envVar E_pubc_GW_GW_2A4_LCDAR_ELK_oStatus_Rv
{
    int64 rawValue = 0ll;
    float rawValue_float = 0.0;
    float phyValue = 0.0;        

    //set the signal with updated raw value
    if(getValue(E_pubc_GW_GW_2A4_LCDAR_ELK_oStatus_SetVt)==0)
    {
        rawValue = getvalue(this);
        if(chgEv_GW_2A4_LCDAR_ELK_oStatus == 0)
        {
            //type conversion to float
            rawValue_float = rawValue;        
            // raw to physical conversion
            phyValue = ((rawValue_float *1)+(0));
            putValue(E_pubc_GW_GW_2A4_LCDAR_ELK_oStatus_Pv, phyValue);
            chgEv_GW_2A4_LCDAR_ELK_oStatus = 1;
        }
        else
        {
            chgEv_GW_2A4_LCDAR_ELK_oStatus = 0;
        }    
        //update the signal value
        Msg_GW_2A4.LCDAR_ELK_oStatus=rawValue;        
    }                                                                           
}
/*@@end*/

/*@@envVar:E_pubc_GW_GW_2A4_LCDAR_ELK_oStatus_Pv:*/
on envVar E_pubc_GW_GW_2A4_LCDAR_ELK_oStatus_Pv
{
    int64 rawValue = 0ll;
    float phyValue = 0.0;
    
    //update the raw value with physical value 
    if(getValue(E_pubc_GW_GW_2A4_LCDAR_ELK_oStatus_SetVt)==0)
    {
        if(chgEv_GW_2A4_LCDAR_ELK_oStatus == 0)
        {
            phyValue = getvalue(this);
            // physical to raw conversion
            rawValue = ((phyValue -(0))/1);
            putValue(E_pubc_GW_GW_2A4_LCDAR_ELK_oStatus_Rv, rawValue);
            chgEv_GW_2A4_LCDAR_ELK_oStatus = 1;  
        }
        else
        {
            chgEv_GW_2A4_LCDAR_ELK_oStatus = 0;
        }
    }
}
/*@@end*/

/*@@envVar:E_pubc_GW_GW_2A4_LCDAR_ELK_oStatus_Vt:*/
on envVar E_pubc_GW_GW_2A4_LCDAR_ELK_oStatus_Vt
{
    qword rawValue = 0ll;
    if(getValue(E_pubc_GW_GW_2A4_LCDAR_ELK_oStatus_SetVt))
    {
        //update the signal value
        Msg_GW_2A4.LCDAR_ELK_oStatus=getValue(this);
    }
}
/*@@end*/

/*@@envVar:E_pubc_GW_GW_2A4_LCDAR_ELK_oStatus_SetVt:*/
on envVar E_pubc_GW_GW_2A4_LCDAR_ELK_oStatus_SetVt
{
    if(getValue(E_pubc_GW_GW_2A4_LCDAR_ELK_oStatus_SetVt))
    {
        //update the signal value
        Msg_GW_2A4.LCDAR_ELK_oStatus=getvalue(E_pubc_GW_GW_2A4_LCDAR_ELK_oStatus_Vt);
    }
    else
    {
        Msg_GW_2A4.LCDAR_ELK_oStatus=getValue(E_pubc_GW_GW_2A4_LCDAR_ELK_oStatus_Rv);
    }
}
/*@@end*/
 
/*@@envVar:E_pubc_GW_GW_2A4_LCDAR_RCTBTargetDecel_Rv:*/
on envVar E_pubc_GW_GW_2A4_LCDAR_RCTBTargetDecel_Rv
{
    int64 rawValue = 0ll;
    float rawValue_float = 0.0;
    float phyValue = 0.0;        

    //set the signal with updated raw value
    {
        rawValue = getvalue(this);
        if(chgEv_GW_2A4_LCDAR_RCTBTargetDecel == 0)
        {
            //type conversion to float
            rawValue_float = rawValue;        
            // raw to physical conversion
            phyValue = ((rawValue_float *0.0005)+(-16));
            putValue(E_pubc_GW_GW_2A4_LCDAR_RCTBTargetDecel_Pv, phyValue);
            chgEv_GW_2A4_LCDAR_RCTBTargetDecel = 1;
        }
        else
        {
            chgEv_GW_2A4_LCDAR_RCTBTargetDecel = 0;
        }    
        //update the signal value
        Msg_GW_2A4.LCDAR_RCTBTargetDecel=rawValue;        
    }                                                                           
}
/*@@end*/

/*@@envVar:E_pubc_GW_GW_2A4_LCDAR_RCTBTargetDecel_Pv:*/
on envVar E_pubc_GW_GW_2A4_LCDAR_RCTBTargetDecel_Pv
{
    int64 rawValue = 0ll;
    float phyValue = 0.0;
    
    //update the raw value with physical value 
    {
        if(chgEv_GW_2A4_LCDAR_RCTBTargetDecel == 0)
        {
            phyValue = getvalue(this);
            // physical to raw conversion
            rawValue = ((phyValue -(-16))/0.0005);
            putValue(E_pubc_GW_GW_2A4_LCDAR_RCTBTargetDecel_Rv, rawValue);
            chgEv_GW_2A4_LCDAR_RCTBTargetDecel = 1;  
        }
        else
        {
            chgEv_GW_2A4_LCDAR_RCTBTargetDecel = 0;
        }
    }
}
/*@@end*/


 
/*@@envVar:E_pubc_GW_GW_2A4_LCDAR_SystemStatus_Rv:*/
on envVar E_pubc_GW_GW_2A4_LCDAR_SystemStatus_Rv
{
    int64 rawValue = 0ll;
    float rawValue_float = 0.0;
    float phyValue = 0.0;        

    //set the signal with updated raw value
    if(getValue(E_pubc_GW_GW_2A4_LCDAR_SystemStatus_SetVt)==0)
    {
        rawValue = getvalue(this);
        if(chgEv_GW_2A4_LCDAR_SystemStatus == 0)
        {
            //type conversion to float
            rawValue_float = rawValue;        
            // raw to physical conversion
            phyValue = ((rawValue_float *1)+(0));
            putValue(E_pubc_GW_GW_2A4_LCDAR_SystemStatus_Pv, phyValue);
            chgEv_GW_2A4_LCDAR_SystemStatus = 1;
        }
        else
        {
            chgEv_GW_2A4_LCDAR_SystemStatus = 0;
        }    
        //update the signal value
        Msg_GW_2A4.LCDAR_SystemStatus=rawValue;        
    }                                                                           
}
/*@@end*/

/*@@envVar:E_pubc_GW_GW_2A4_LCDAR_SystemStatus_Pv:*/
on envVar E_pubc_GW_GW_2A4_LCDAR_SystemStatus_Pv
{
    int64 rawValue = 0ll;
    float phyValue = 0.0;
    
    //update the raw value with physical value 
    if(getValue(E_pubc_GW_GW_2A4_LCDAR_SystemStatus_SetVt)==0)
    {
        if(chgEv_GW_2A4_LCDAR_SystemStatus == 0)
        {
            phyValue = getvalue(this);
            // physical to raw conversion
            rawValue = ((phyValue -(0))/1);
            putValue(E_pubc_GW_GW_2A4_LCDAR_SystemStatus_Rv, rawValue);
            chgEv_GW_2A4_LCDAR_SystemStatus = 1;  
        }
        else
        {
            chgEv_GW_2A4_LCDAR_SystemStatus = 0;
        }
    }
}
/*@@end*/

/*@@envVar:E_pubc_GW_GW_2A4_LCDAR_SystemStatus_Vt:*/
on envVar E_pubc_GW_GW_2A4_LCDAR_SystemStatus_Vt
{
    qword rawValue = 0ll;
    if(getValue(E_pubc_GW_GW_2A4_LCDAR_SystemStatus_SetVt))
    {
        //update the signal value
        Msg_GW_2A4.LCDAR_SystemStatus=getValue(this);
    }
}
/*@@end*/

/*@@envVar:E_pubc_GW_GW_2A4_LCDAR_SystemStatus_SetVt:*/
on envVar E_pubc_GW_GW_2A4_LCDAR_SystemStatus_SetVt
{
    if(getValue(E_pubc_GW_GW_2A4_LCDAR_SystemStatus_SetVt))
    {
        //update the signal value
        Msg_GW_2A4.LCDAR_SystemStatus=getvalue(E_pubc_GW_GW_2A4_LCDAR_SystemStatus_Vt);
    }
    else
    {
        Msg_GW_2A4.LCDAR_SystemStatus=getValue(E_pubc_GW_GW_2A4_LCDAR_SystemStatus_Rv);
    }
}
/*@@end*/
 
/*@@envVar:E_pubc_GW_GW_2A4_LCDAR_RCTBActive_Rv:*/
on envVar E_pubc_GW_GW_2A4_LCDAR_RCTBActive_Rv
{
    int64 rawValue = 0ll;
    float rawValue_float = 0.0;
    float phyValue = 0.0;        

    //set the signal with updated raw value
    if(getValue(E_pubc_GW_GW_2A4_LCDAR_RCTBActive_SetVt)==0)
    {
        rawValue = getvalue(this);
        if(chgEv_GW_2A4_LCDAR_RCTBActive == 0)
        {
            //type conversion to float
            rawValue_float = rawValue;        
            // raw to physical conversion
            phyValue = ((rawValue_float *1)+(0));
            putValue(E_pubc_GW_GW_2A4_LCDAR_RCTBActive_Pv, phyValue);
            chgEv_GW_2A4_LCDAR_RCTBActive = 1;
        }
        else
        {
            chgEv_GW_2A4_LCDAR_RCTBActive = 0;
        }    
        //update the signal value
        Msg_GW_2A4.LCDAR_RCTBActive=rawValue;        
    }                                                                           
}
/*@@end*/

/*@@envVar:E_pubc_GW_GW_2A4_LCDAR_RCTBActive_Pv:*/
on envVar E_pubc_GW_GW_2A4_LCDAR_RCTBActive_Pv
{
    int64 rawValue = 0ll;
    float phyValue = 0.0;
    
    //update the raw value with physical value 
    if(getValue(E_pubc_GW_GW_2A4_LCDAR_RCTBActive_SetVt)==0)
    {
        if(chgEv_GW_2A4_LCDAR_RCTBActive == 0)
        {
            phyValue = getvalue(this);
            // physical to raw conversion
            rawValue = ((phyValue -(0))/1);
            putValue(E_pubc_GW_GW_2A4_LCDAR_RCTBActive_Rv, rawValue);
            chgEv_GW_2A4_LCDAR_RCTBActive = 1;  
        }
        else
        {
            chgEv_GW_2A4_LCDAR_RCTBActive = 0;
        }
    }
}
/*@@end*/

/*@@envVar:E_pubc_GW_GW_2A4_LCDAR_RCTBActive_Vt:*/
on envVar E_pubc_GW_GW_2A4_LCDAR_RCTBActive_Vt
{
    qword rawValue = 0ll;
    if(getValue(E_pubc_GW_GW_2A4_LCDAR_RCTBActive_SetVt))
    {
        //update the signal value
        Msg_GW_2A4.LCDAR_RCTBActive=getValue(this);
    }
}
/*@@end*/

/*@@envVar:E_pubc_GW_GW_2A4_LCDAR_RCTBActive_SetVt:*/
on envVar E_pubc_GW_GW_2A4_LCDAR_RCTBActive_SetVt
{
    if(getValue(E_pubc_GW_GW_2A4_LCDAR_RCTBActive_SetVt))
    {
        //update the signal value
        Msg_GW_2A4.LCDAR_RCTBActive=getvalue(E_pubc_GW_GW_2A4_LCDAR_RCTBActive_Vt);
    }
    else
    {
        Msg_GW_2A4.LCDAR_RCTBActive=getValue(E_pubc_GW_GW_2A4_LCDAR_RCTBActive_Rv);
    }
}
/*@@end*/
 
/*@@envVar:E_pubc_GW_GW_2A4_LCDAR_Left_RCTAAlert_Rv:*/
on envVar E_pubc_GW_GW_2A4_LCDAR_Left_RCTAAlert_Rv
{
    int64 rawValue = 0ll;
    float rawValue_float = 0.0;
    float phyValue = 0.0;        

    //set the signal with updated raw value
    if(getValue(E_pubc_GW_GW_2A4_LCDAR_Left_RCTAAlert_SetVt)==0)
    {
        rawValue = getvalue(this);
        if(chgEv_GW_2A4_LCDAR_Left_RCTAAlert == 0)
        {
            //type conversion to float
            rawValue_float = rawValue;        
            // raw to physical conversion
            phyValue = ((rawValue_float *1)+(0));
            putValue(E_pubc_GW_GW_2A4_LCDAR_Left_RCTAAlert_Pv, phyValue);
            chgEv_GW_2A4_LCDAR_Left_RCTAAlert = 1;
        }
        else
        {
            chgEv_GW_2A4_LCDAR_Left_RCTAAlert = 0;
        }    
        //update the signal value
        Msg_GW_2A4.LCDAR_Left_RCTAAlert=rawValue;        
    }                                                                           
}
/*@@end*/

/*@@envVar:E_pubc_GW_GW_2A4_LCDAR_Left_RCTAAlert_Pv:*/
on envVar E_pubc_GW_GW_2A4_LCDAR_Left_RCTAAlert_Pv
{
    int64 rawValue = 0ll;
    float phyValue = 0.0;
    
    //update the raw value with physical value 
    if(getValue(E_pubc_GW_GW_2A4_LCDAR_Left_RCTAAlert_SetVt)==0)
    {
        if(chgEv_GW_2A4_LCDAR_Left_RCTAAlert == 0)
        {
            phyValue = getvalue(this);
            // physical to raw conversion
            rawValue = ((phyValue -(0))/1);
            putValue(E_pubc_GW_GW_2A4_LCDAR_Left_RCTAAlert_Rv, rawValue);
            chgEv_GW_2A4_LCDAR_Left_RCTAAlert = 1;  
        }
        else
        {
            chgEv_GW_2A4_LCDAR_Left_RCTAAlert = 0;
        }
    }
}
/*@@end*/

/*@@envVar:E_pubc_GW_GW_2A4_LCDAR_Left_RCTAAlert_Vt:*/
on envVar E_pubc_GW_GW_2A4_LCDAR_Left_RCTAAlert_Vt
{
    qword rawValue = 0ll;
    if(getValue(E_pubc_GW_GW_2A4_LCDAR_Left_RCTAAlert_SetVt))
    {
        //update the signal value
        Msg_GW_2A4.LCDAR_Left_RCTAAlert=getValue(this);
    }
}
/*@@end*/

/*@@envVar:E_pubc_GW_GW_2A4_LCDAR_Left_RCTAAlert_SetVt:*/
on envVar E_pubc_GW_GW_2A4_LCDAR_Left_RCTAAlert_SetVt
{
    if(getValue(E_pubc_GW_GW_2A4_LCDAR_Left_RCTAAlert_SetVt))
    {
        //update the signal value
        Msg_GW_2A4.LCDAR_Left_RCTAAlert=getvalue(E_pubc_GW_GW_2A4_LCDAR_Left_RCTAAlert_Vt);
    }
    else
    {
        Msg_GW_2A4.LCDAR_Left_RCTAAlert=getValue(E_pubc_GW_GW_2A4_LCDAR_Left_RCTAAlert_Rv);
    }
}
/*@@end*/
 
/*@@envVar:E_pubc_GW_GW_516_tx:*/
on envVar E_pubc_GW_GW_516_tx
{
    if(getValue(this))
    {       
        

        output(Msg_GW_516);        
    }
}
/*@@end*/

/*@@envVar:E_pubc_GW_GW_516_Range:*/
on envVar E_pubc_GW_GW_516_Range
{
    qword rawstatus = 0ll;
    qword rawValue = 0ll;    
    
    rawstatus = getvalue(this);    
    // set all the signals with min raw /max raw /init raw
    switch (rawstatus) 
    {
     case(0) :
        rawValue= 44217727;
        putValue(E_pubc_GW_GW_516_HU_CurrentLocationLatitude_Rv, rawValue);
        rawValue= 88435455;
        putValue(E_pubc_GW_GW_516_HU_CurrentLocationLongitude_Rv, rawValue);
        rawValue= 0;
        putValue(E_pubc_GW_GW_516_HU_CurrentLocationValid_Rv, rawValue);
        break;
     case(1) :
        rawValue= 224217727;
        putValue(E_pubc_GW_GW_516_HU_CurrentLocationLatitude_Rv, rawValue);
        rawValue= 448435455;
        putValue(E_pubc_GW_GW_516_HU_CurrentLocationLongitude_Rv, rawValue);
        rawValue= 1;
        putValue(E_pubc_GW_GW_516_HU_CurrentLocationValid_Rv, rawValue);
        break;
     default :
        rawValue= 44217727;
        putValue(E_pubc_GW_GW_516_HU_CurrentLocationLatitude_Rv, rawValue);
        rawValue= 88435455;
        putValue(E_pubc_GW_GW_516_HU_CurrentLocationLongitude_Rv, rawValue);
        rawValue= 0;
        putValue(E_pubc_GW_GW_516_HU_CurrentLocationValid_Rv, rawValue);
      break;
   }
}
/*@@end*/

/*@@envVar:E_pubc_GW_GW_516_Dlc:*/
on envVar E_pubc_GW_GW_516_Dlc
{
    if(getValue(E_pubc_GW_GW_516_enDlc))
    {
        Msg_GW_516.dlc =getValue(this);
    }
    else
    {
       Dbc_dlc = 32;
	   Msg_GW_516.dlc = Calc_Canfd_dlc(Dbc_dlc);
	   // Msg_GW_516.dlc = 32;
	   	
  }
}
/*@@end*/

/*@@envVar:E_pubc_GW_GW_516_enDlc:*/
on envVar E_pubc_GW_GW_516_enDlc
{
    //For Messages with DLC = 8, set wrong DLC to smaller than defined DLC
    //For Messages with DLC < 8 set wrong DLC to smaller/longer than defined DLC
    if(getValue(this))
    {
        Msg_GW_516.dlc =getValue(E_pubc_GW_GW_516_Dlc);
    }
    else
    {
       Dbc_dlc = 32;
	   Msg_GW_516.dlc = Calc_Canfd_dlc(Dbc_dlc);
	   // Msg_GW_516.dlc = 32;
    }
}
/*@@end*/


/*@@envVar:E_pubc_GW_GW_516_HU_CurrentLocationLatitude_Rv:*/
on envVar E_pubc_GW_GW_516_HU_CurrentLocationLatitude_Rv
{
    int64 rawValue = 0ll;
    float rawValue_float = 0.0;
    float phyValue = 0.0;        

    //set the signal with updated raw value
    {
        rawValue = getvalue(this);
        if(chgEv_GW_516_HU_CurrentLocationLatitude == 0)
        {
            //type conversion to float
            rawValue_float = rawValue;        
            // raw to physical conversion
            phyValue = ((rawValue_float *1e-006)+(-134.217727));
            putValue(E_pubc_GW_GW_516_HU_CurrentLocationLatitude_Pv, phyValue);
            chgEv_GW_516_HU_CurrentLocationLatitude = 1;
        }
        else
        {
            chgEv_GW_516_HU_CurrentLocationLatitude = 0;
        }    
        //update the signal value
        Msg_GW_516.HU_CurrentLocationLatitude=rawValue;        
    }                                                                           
}
/*@@end*/

/*@@envVar:E_pubc_GW_GW_516_HU_CurrentLocationLatitude_Pv:*/
on envVar E_pubc_GW_GW_516_HU_CurrentLocationLatitude_Pv
{
    int64 rawValue = 0ll;
    float phyValue = 0.0;
    
    //update the raw value with physical value 
    {
        if(chgEv_GW_516_HU_CurrentLocationLatitude == 0)
        {
            phyValue = getvalue(this);
            // physical to raw conversion
            rawValue = ((phyValue -(-134.217727))/1e-006);
            putValue(E_pubc_GW_GW_516_HU_CurrentLocationLatitude_Rv, rawValue);
            chgEv_GW_516_HU_CurrentLocationLatitude = 1;  
        }
        else
        {
            chgEv_GW_516_HU_CurrentLocationLatitude = 0;
        }
    }
}
/*@@end*/


 
/*@@envVar:E_pubc_GW_GW_516_HU_CurrentLocationLongitude_Rv:*/
on envVar E_pubc_GW_GW_516_HU_CurrentLocationLongitude_Rv
{
    int64 rawValue = 0ll;
    float rawValue_float = 0.0;
    float phyValue = 0.0;        

    //set the signal with updated raw value
    {
        rawValue = getvalue(this);
        if(chgEv_GW_516_HU_CurrentLocationLongitude == 0)
        {
            //type conversion to float
            rawValue_float = rawValue;        
            // raw to physical conversion
            phyValue = ((rawValue_float *1e-006)+(-268.435455));
            putValue(E_pubc_GW_GW_516_HU_CurrentLocationLongitude_Pv, phyValue);
            chgEv_GW_516_HU_CurrentLocationLongitude = 1;
        }
        else
        {
            chgEv_GW_516_HU_CurrentLocationLongitude = 0;
        }    
        //update the signal value
        Msg_GW_516.HU_CurrentLocationLongitude=rawValue;        
    }                                                                           
}
/*@@end*/

/*@@envVar:E_pubc_GW_GW_516_HU_CurrentLocationLongitude_Pv:*/
on envVar E_pubc_GW_GW_516_HU_CurrentLocationLongitude_Pv
{
    int64 rawValue = 0ll;
    float phyValue = 0.0;
    
    //update the raw value with physical value 
    {
        if(chgEv_GW_516_HU_CurrentLocationLongitude == 0)
        {
            phyValue = getvalue(this);
            // physical to raw conversion
            rawValue = ((phyValue -(-268.435455))/1e-006);
            putValue(E_pubc_GW_GW_516_HU_CurrentLocationLongitude_Rv, rawValue);
            chgEv_GW_516_HU_CurrentLocationLongitude = 1;  
        }
        else
        {
            chgEv_GW_516_HU_CurrentLocationLongitude = 0;
        }
    }
}
/*@@end*/


 
/*@@envVar:E_pubc_GW_GW_516_HU_CurrentLocationValid_Rv:*/
on envVar E_pubc_GW_GW_516_HU_CurrentLocationValid_Rv
{
    int64 rawValue = 0ll;
    float rawValue_float = 0.0;
    float phyValue = 0.0;        

    //set the signal with updated raw value
    if(getValue(E_pubc_GW_GW_516_HU_CurrentLocationValid_SetVt)==0)
    {
        rawValue = getvalue(this);
        if(chgEv_GW_516_HU_CurrentLocationValid == 0)
        {
            //type conversion to float
            rawValue_float = rawValue;        
            // raw to physical conversion
            phyValue = ((rawValue_float *1)+(0));
            putValue(E_pubc_GW_GW_516_HU_CurrentLocationValid_Pv, phyValue);
            chgEv_GW_516_HU_CurrentLocationValid = 1;
        }
        else
        {
            chgEv_GW_516_HU_CurrentLocationValid = 0;
        }    
        //update the signal value
        Msg_GW_516.HU_CurrentLocationValid=rawValue;        
    }                                                                           
}
/*@@end*/

/*@@envVar:E_pubc_GW_GW_516_HU_CurrentLocationValid_Pv:*/
on envVar E_pubc_GW_GW_516_HU_CurrentLocationValid_Pv
{
    int64 rawValue = 0ll;
    float phyValue = 0.0;
    
    //update the raw value with physical value 
    if(getValue(E_pubc_GW_GW_516_HU_CurrentLocationValid_SetVt)==0)
    {
        if(chgEv_GW_516_HU_CurrentLocationValid == 0)
        {
            phyValue = getvalue(this);
            // physical to raw conversion
            rawValue = ((phyValue -(0))/1);
            putValue(E_pubc_GW_GW_516_HU_CurrentLocationValid_Rv, rawValue);
            chgEv_GW_516_HU_CurrentLocationValid = 1;  
        }
        else
        {
            chgEv_GW_516_HU_CurrentLocationValid = 0;
        }
    }
}
/*@@end*/

/*@@envVar:E_pubc_GW_GW_516_HU_CurrentLocationValid_Vt:*/
on envVar E_pubc_GW_GW_516_HU_CurrentLocationValid_Vt
{
    qword rawValue = 0ll;
    if(getValue(E_pubc_GW_GW_516_HU_CurrentLocationValid_SetVt))
    {
        //update the signal value
        Msg_GW_516.HU_CurrentLocationValid=getValue(this);
    }
}
/*@@end*/

/*@@envVar:E_pubc_GW_GW_516_HU_CurrentLocationValid_SetVt:*/
on envVar E_pubc_GW_GW_516_HU_CurrentLocationValid_SetVt
{
    if(getValue(E_pubc_GW_GW_516_HU_CurrentLocationValid_SetVt))
    {
        //update the signal value
        Msg_GW_516.HU_CurrentLocationValid=getvalue(E_pubc_GW_GW_516_HU_CurrentLocationValid_Vt);
    }
    else
    {
        Msg_GW_516.HU_CurrentLocationValid=getValue(E_pubc_GW_GW_516_HU_CurrentLocationValid_Rv);
    }
}
/*@@end*/
 
/*@@envVar:E_pubc_GW_GW_2D2_tx:*/
on envVar E_pubc_GW_GW_2D2_tx
{
    if(getValue(this))
    {       
        
        //update the BZ Signal
        if(GW_2D2_CdcCycCntr2D2_wrongvalctr == 0)
        {
            update_GW_2D2_CdcCycCntr2D2_counter();
            Msg_GW_2D2.CdcCycCntr2D2= GW_2D2_CdcCycCntr2D2_counter;
        }
        else if(GW_2D2_CdcCycCntr2D2_wrongvalctr > 0)
        {
			GW_2D2_CdcCycCntr2D2_counter=GW_2D2_CdcCycCntr2D2_counter + GW_2D2_CdcCycCntr2D2_wrongvalctr;
			 Msg_GW_2D2.CdcCycCntr2D2= GW_2D2_CdcCycCntr2D2_counter;
            /* GW_2D2_CdcCycCntr2D2_wrongvalctr--;
              // if counter becomes zero, update panel controller to zero
             if(GW_2D2_CdcCycCntr2D2_wrongvalctr == 0)
             {
                 putValue(E_pubc_GW_GW_2D2_CdcCycCntr2D2_wrongvalctr,0);
             } */
        }
        else
        { 
			// do nothing
        }    
        //calculate the CRC CheckSum
        update_GW_2D2_CRC_CheckSum();

        output(Msg_GW_2D2);        
    }
}
/*@@end*/

/*@@envVar:E_pubc_GW_GW_2D2_Range:*/
on envVar E_pubc_GW_GW_2D2_Range
{
    qword rawstatus = 0ll;
    qword rawValue = 0ll;    
    
    rawstatus = getvalue(this);    
    // set all the signals with min raw /max raw /init raw
    switch (rawstatus) 
    {
     case(0) :
        rawValue= 0;
        putValue(E_pubc_GW_GW_2D2_CdcTotMilg_Rv, rawValue);
        break;
     case(1) :
        rawValue= 16777215;
        putValue(E_pubc_GW_GW_2D2_CdcTotMilg_Rv, rawValue);
        break;
     default :
        rawValue= 0;
        putValue(E_pubc_GW_GW_2D2_CdcTotMilg_Rv, rawValue);
      break;
   }
}
/*@@end*/

/*@@envVar:E_pubc_GW_GW_2D2_Dlc:*/
on envVar E_pubc_GW_GW_2D2_Dlc
{
    if(getValue(E_pubc_GW_GW_2D2_enDlc))
    {
        Msg_GW_2D2.dlc =getValue(this);
    }
    else
    {
       Dbc_dlc = 64;
	   Msg_GW_2D2.dlc = Calc_Canfd_dlc(Dbc_dlc);
	   // Msg_GW_2D2.dlc = 64;
	   	
  }
}
/*@@end*/

/*@@envVar:E_pubc_GW_GW_2D2_enDlc:*/
on envVar E_pubc_GW_GW_2D2_enDlc
{
    //For Messages with DLC = 8, set wrong DLC to smaller than defined DLC
    //For Messages with DLC < 8 set wrong DLC to smaller/longer than defined DLC
    if(getValue(this))
    {
        Msg_GW_2D2.dlc =getValue(E_pubc_GW_GW_2D2_Dlc);
    }
    else
    {
       Dbc_dlc = 64;
	   Msg_GW_2D2.dlc = Calc_Canfd_dlc(Dbc_dlc);
	   // Msg_GW_2D2.dlc = 64;
    }
}
/*@@end*/

/*@@envVar:E_pubc_GW_GW_2D2_CdcCycChk2D2_wrongvalctr:*/
on envVar E_pubc_GW_GW_2D2_CdcCycChk2D2_wrongvalctr
{
    //update disturb count
    //disturb value range:(-1 = always send wrong value),( X>0 ,x is the number of Messages with wrong CHK sent)
    GW_2D2_CdcCycChk2D2_wrongvalctr =getValue(this);    
}
/*@@end*/
/*@@envVar:E_pubc_GW_GW_2D2_CdcCycCntr2D2_wrongvalctr:*/
on envVar E_pubc_GW_GW_2D2_CdcCycCntr2D2_wrongvalctr
{
    //update disturb count
    //disturb value range:(-1 = always send wrong value),( X>0 ,x is the number of Messages with wrong CHK sent)
    GW_2D2_CdcCycCntr2D2_wrongvalctr =getValue(this);    
}
/*@@end*/

/*@@envVar:E_pubc_GW_GW_2D2_CdcTotMilg_Rv:*/
on envVar E_pubc_GW_GW_2D2_CdcTotMilg_Rv
{
    int64 rawValue = 0ll;
    float rawValue_float = 0.0;
    float phyValue = 0.0;        

    //set the signal with updated raw value
    {
        rawValue = getvalue(this);
        if(chgEv_GW_2D2_CdcTotMilg == 0)
        {
            //type conversion to float
            rawValue_float = rawValue;        
            // raw to physical conversion
            phyValue = ((rawValue_float *0.1)+(0));
            putValue(E_pubc_GW_GW_2D2_CdcTotMilg_Pv, phyValue);
            chgEv_GW_2D2_CdcTotMilg = 1;
        }
        else
        {
            chgEv_GW_2D2_CdcTotMilg = 0;
        }    
        //update the signal value
        Msg_GW_2D2.CdcTotMilg=rawValue;        
    }                                                                           
}
/*@@end*/

/*@@envVar:E_pubc_GW_GW_2D2_CdcTotMilg_Pv:*/
on envVar E_pubc_GW_GW_2D2_CdcTotMilg_Pv
{
    int64 rawValue = 0ll;
    float phyValue = 0.0;
    
    //update the raw value with physical value 
    {
        if(chgEv_GW_2D2_CdcTotMilg == 0)
        {
            phyValue = getvalue(this);
            // physical to raw conversion
            rawValue = ((phyValue -(0))/0.1);
            putValue(E_pubc_GW_GW_2D2_CdcTotMilg_Rv, rawValue);
            chgEv_GW_2D2_CdcTotMilg = 1;  
        }
        else
        {
            chgEv_GW_2D2_CdcTotMilg = 0;
        }
    }
}
/*@@end*/


 
/*@@envVar:E_pubc_GW_GW_3D2_tx:*/
on envVar E_pubc_GW_GW_3D2_tx
{
    if(getValue(this))
    {       
        
        //update the BZ Signal
        if(GW_3D2_EspCycCntr3D2_wrongvalctr == 0)
        {
            update_GW_3D2_EspCycCntr3D2_counter();
            Msg_GW_3D2.EspCycCntr3D2= GW_3D2_EspCycCntr3D2_counter;
        }
        else if(GW_3D2_EspCycCntr3D2_wrongvalctr > 0)
        {
			GW_3D2_EspCycCntr3D2_counter=GW_3D2_EspCycCntr3D2_counter + GW_3D2_EspCycCntr3D2_wrongvalctr;
			 Msg_GW_3D2.EspCycCntr3D2= GW_3D2_EspCycCntr3D2_counter;
            /* GW_3D2_EspCycCntr3D2_wrongvalctr--;
              // if counter becomes zero, update panel controller to zero
             if(GW_3D2_EspCycCntr3D2_wrongvalctr == 0)
             {
                 putValue(E_pubc_GW_GW_3D2_EspCycCntr3D2_wrongvalctr,0);
             } */
        }
        else
        { 
			// do nothing
        }    
        //calculate the CRC CheckSum
        update_GW_3D2_CRC_CheckSum();

        output(Msg_GW_3D2);        
    }
}
/*@@end*/

/*@@envVar:E_pubc_GW_GW_3D2_Range:*/
on envVar E_pubc_GW_GW_3D2_Range
{
    qword rawstatus = 0ll;
    qword rawValue = 0ll;    
    
    rawstatus = getvalue(this);    
    // set all the signals with min raw /max raw /init raw
    switch (rawstatus) 
    {
     case(0) :
        rawValue= 0;
        putValue(E_pubc_GW_GW_3D2_EpbRiAchievedClmpF_Rv, rawValue);
        rawValue= 0;
        putValue(E_pubc_GW_GW_3D2_EpbFailrSts_Rv, rawValue);
        rawValue= 0;
        putValue(E_pubc_GW_GW_3D2_EspEpbReqAvl_Rv, rawValue);
        rawValue= 0;
        putValue(E_pubc_GW_GW_3D2_EpbLeAchievedClmpF_Rv, rawValue);
        rawValue= 0;
        putValue(E_pubc_GW_GW_3D2_EpbSts_Rv, rawValue);
        rawValue= 0;
        putValue(E_pubc_GW_GW_3D2_EpbDriverReqParkBrakeDominant_Rv, rawValue);
        break;
     case(1) :
        rawValue= 31;
        putValue(E_pubc_GW_GW_3D2_EpbRiAchievedClmpF_Rv, rawValue);
        rawValue= 3;
        putValue(E_pubc_GW_GW_3D2_EpbFailrSts_Rv, rawValue);
        rawValue= 1;
        putValue(E_pubc_GW_GW_3D2_EspEpbReqAvl_Rv, rawValue);
        rawValue= 31;
        putValue(E_pubc_GW_GW_3D2_EpbLeAchievedClmpF_Rv, rawValue);
        rawValue= 7;
        putValue(E_pubc_GW_GW_3D2_EpbSts_Rv, rawValue);
        rawValue= 1;
        putValue(E_pubc_GW_GW_3D2_EpbDriverReqParkBrakeDominant_Rv, rawValue);
        break;
     default :
        rawValue= 0;
        putValue(E_pubc_GW_GW_3D2_EpbRiAchievedClmpF_Rv, rawValue);
        rawValue= 0;
        putValue(E_pubc_GW_GW_3D2_EpbFailrSts_Rv, rawValue);
        rawValue= 0;
        putValue(E_pubc_GW_GW_3D2_EspEpbReqAvl_Rv, rawValue);
        rawValue= 0;
        putValue(E_pubc_GW_GW_3D2_EpbLeAchievedClmpF_Rv, rawValue);
        rawValue= 0;
        putValue(E_pubc_GW_GW_3D2_EpbSts_Rv, rawValue);
        rawValue= 0;
        putValue(E_pubc_GW_GW_3D2_EpbDriverReqParkBrakeDominant_Rv, rawValue);
      break;
   }
}
/*@@end*/

/*@@envVar:E_pubc_GW_GW_3D2_Dlc:*/
on envVar E_pubc_GW_GW_3D2_Dlc
{
    if(getValue(E_pubc_GW_GW_3D2_enDlc))
    {
        Msg_GW_3D2.dlc =getValue(this);
    }
    else
    {
       Dbc_dlc = 64;
	   Msg_GW_3D2.dlc = Calc_Canfd_dlc(Dbc_dlc);
	   // Msg_GW_3D2.dlc = 64;
	   	
  }
}
/*@@end*/

/*@@envVar:E_pubc_GW_GW_3D2_enDlc:*/
on envVar E_pubc_GW_GW_3D2_enDlc
{
    //For Messages with DLC = 8, set wrong DLC to smaller than defined DLC
    //For Messages with DLC < 8 set wrong DLC to smaller/longer than defined DLC
    if(getValue(this))
    {
        Msg_GW_3D2.dlc =getValue(E_pubc_GW_GW_3D2_Dlc);
    }
    else
    {
       Dbc_dlc = 64;
	   Msg_GW_3D2.dlc = Calc_Canfd_dlc(Dbc_dlc);
	   // Msg_GW_3D2.dlc = 64;
    }
}
/*@@end*/

/*@@envVar:E_pubc_GW_GW_3D2_EspCrcChk3D2_wrongvalctr:*/
on envVar E_pubc_GW_GW_3D2_EspCrcChk3D2_wrongvalctr
{
    //update disturb count
    //disturb value range:(-1 = always send wrong value),( X>0 ,x is the number of Messages with wrong CHK sent)
    GW_3D2_EspCrcChk3D2_wrongvalctr =getValue(this);    
}
/*@@end*/
/*@@envVar:E_pubc_GW_GW_3D2_EspCycCntr3D2_wrongvalctr:*/
on envVar E_pubc_GW_GW_3D2_EspCycCntr3D2_wrongvalctr
{
    //update disturb count
    //disturb value range:(-1 = always send wrong value),( X>0 ,x is the number of Messages with wrong CHK sent)
    GW_3D2_EspCycCntr3D2_wrongvalctr =getValue(this);    
}
/*@@end*/

/*@@envVar:E_pubc_GW_GW_3D2_EpbRiAchievedClmpF_Rv:*/
on envVar E_pubc_GW_GW_3D2_EpbRiAchievedClmpF_Rv
{
    int64 rawValue = 0ll;
    float rawValue_float = 0.0;
    float phyValue = 0.0;        

    //set the signal with updated raw value
    {
        rawValue = getvalue(this);
        if(chgEv_GW_3D2_EpbRiAchievedClmpF == 0)
        {
            //type conversion to float
            rawValue_float = rawValue;        
            // raw to physical conversion
            phyValue = ((rawValue_float *1)+(0));
            putValue(E_pubc_GW_GW_3D2_EpbRiAchievedClmpF_Pv, phyValue);
            chgEv_GW_3D2_EpbRiAchievedClmpF = 1;
        }
        else
        {
            chgEv_GW_3D2_EpbRiAchievedClmpF = 0;
        }    
        //update the signal value
        Msg_GW_3D2.EpbRiAchievedClmpF=rawValue;        
    }                                                                           
}
/*@@end*/

/*@@envVar:E_pubc_GW_GW_3D2_EpbRiAchievedClmpF_Pv:*/
on envVar E_pubc_GW_GW_3D2_EpbRiAchievedClmpF_Pv
{
    int64 rawValue = 0ll;
    float phyValue = 0.0;
    
    //update the raw value with physical value 
    {
        if(chgEv_GW_3D2_EpbRiAchievedClmpF == 0)
        {
            phyValue = getvalue(this);
            // physical to raw conversion
            rawValue = ((phyValue -(0))/1);
            putValue(E_pubc_GW_GW_3D2_EpbRiAchievedClmpF_Rv, rawValue);
            chgEv_GW_3D2_EpbRiAchievedClmpF = 1;  
        }
        else
        {
            chgEv_GW_3D2_EpbRiAchievedClmpF = 0;
        }
    }
}
/*@@end*/


 
/*@@envVar:E_pubc_GW_GW_3D2_EpbFailrSts_Rv:*/
on envVar E_pubc_GW_GW_3D2_EpbFailrSts_Rv
{
    int64 rawValue = 0ll;
    float rawValue_float = 0.0;
    float phyValue = 0.0;        

    //set the signal with updated raw value
    if(getValue(E_pubc_GW_GW_3D2_EpbFailrSts_SetVt)==0)
    {
        rawValue = getvalue(this);
        if(chgEv_GW_3D2_EpbFailrSts == 0)
        {
            //type conversion to float
            rawValue_float = rawValue;        
            // raw to physical conversion
            phyValue = ((rawValue_float *1)+(0));
            putValue(E_pubc_GW_GW_3D2_EpbFailrSts_Pv, phyValue);
            chgEv_GW_3D2_EpbFailrSts = 1;
        }
        else
        {
            chgEv_GW_3D2_EpbFailrSts = 0;
        }    
        //update the signal value
        Msg_GW_3D2.EpbFailrSts=rawValue;        
    }                                                                           
}
/*@@end*/

/*@@envVar:E_pubc_GW_GW_3D2_EpbFailrSts_Pv:*/
on envVar E_pubc_GW_GW_3D2_EpbFailrSts_Pv
{
    int64 rawValue = 0ll;
    float phyValue = 0.0;
    
    //update the raw value with physical value 
    if(getValue(E_pubc_GW_GW_3D2_EpbFailrSts_SetVt)==0)
    {
        if(chgEv_GW_3D2_EpbFailrSts == 0)
        {
            phyValue = getvalue(this);
            // physical to raw conversion
            rawValue = ((phyValue -(0))/1);
            putValue(E_pubc_GW_GW_3D2_EpbFailrSts_Rv, rawValue);
            chgEv_GW_3D2_EpbFailrSts = 1;  
        }
        else
        {
            chgEv_GW_3D2_EpbFailrSts = 0;
        }
    }
}
/*@@end*/

/*@@envVar:E_pubc_GW_GW_3D2_EpbFailrSts_Vt:*/
on envVar E_pubc_GW_GW_3D2_EpbFailrSts_Vt
{
    qword rawValue = 0ll;
    if(getValue(E_pubc_GW_GW_3D2_EpbFailrSts_SetVt))
    {
        //update the signal value
        Msg_GW_3D2.EpbFailrSts=getValue(this);
    }
}
/*@@end*/

/*@@envVar:E_pubc_GW_GW_3D2_EpbFailrSts_SetVt:*/
on envVar E_pubc_GW_GW_3D2_EpbFailrSts_SetVt
{
    if(getValue(E_pubc_GW_GW_3D2_EpbFailrSts_SetVt))
    {
        //update the signal value
        Msg_GW_3D2.EpbFailrSts=getvalue(E_pubc_GW_GW_3D2_EpbFailrSts_Vt);
    }
    else
    {
        Msg_GW_3D2.EpbFailrSts=getValue(E_pubc_GW_GW_3D2_EpbFailrSts_Rv);
    }
}
/*@@end*/
 
/*@@envVar:E_pubc_GW_GW_3D2_EspEpbReqAvl_Rv:*/
on envVar E_pubc_GW_GW_3D2_EspEpbReqAvl_Rv
{
    int64 rawValue = 0ll;
    float rawValue_float = 0.0;
    float phyValue = 0.0;        

    //set the signal with updated raw value
    if(getValue(E_pubc_GW_GW_3D2_EspEpbReqAvl_SetVt)==0)
    {
        rawValue = getvalue(this);
        if(chgEv_GW_3D2_EspEpbReqAvl == 0)
        {
            //type conversion to float
            rawValue_float = rawValue;        
            // raw to physical conversion
            phyValue = ((rawValue_float *1)+(0));
            putValue(E_pubc_GW_GW_3D2_EspEpbReqAvl_Pv, phyValue);
            chgEv_GW_3D2_EspEpbReqAvl = 1;
        }
        else
        {
            chgEv_GW_3D2_EspEpbReqAvl = 0;
        }    
        //update the signal value
        Msg_GW_3D2.EspEpbReqAvl=rawValue;        
    }                                                                           
}
/*@@end*/

/*@@envVar:E_pubc_GW_GW_3D2_EspEpbReqAvl_Pv:*/
on envVar E_pubc_GW_GW_3D2_EspEpbReqAvl_Pv
{
    int64 rawValue = 0ll;
    float phyValue = 0.0;
    
    //update the raw value with physical value 
    if(getValue(E_pubc_GW_GW_3D2_EspEpbReqAvl_SetVt)==0)
    {
        if(chgEv_GW_3D2_EspEpbReqAvl == 0)
        {
            phyValue = getvalue(this);
            // physical to raw conversion
            rawValue = ((phyValue -(0))/1);
            putValue(E_pubc_GW_GW_3D2_EspEpbReqAvl_Rv, rawValue);
            chgEv_GW_3D2_EspEpbReqAvl = 1;  
        }
        else
        {
            chgEv_GW_3D2_EspEpbReqAvl = 0;
        }
    }
}
/*@@end*/

/*@@envVar:E_pubc_GW_GW_3D2_EspEpbReqAvl_Vt:*/
on envVar E_pubc_GW_GW_3D2_EspEpbReqAvl_Vt
{
    qword rawValue = 0ll;
    if(getValue(E_pubc_GW_GW_3D2_EspEpbReqAvl_SetVt))
    {
        //update the signal value
        Msg_GW_3D2.EspEpbReqAvl=getValue(this);
    }
}
/*@@end*/

/*@@envVar:E_pubc_GW_GW_3D2_EspEpbReqAvl_SetVt:*/
on envVar E_pubc_GW_GW_3D2_EspEpbReqAvl_SetVt
{
    if(getValue(E_pubc_GW_GW_3D2_EspEpbReqAvl_SetVt))
    {
        //update the signal value
        Msg_GW_3D2.EspEpbReqAvl=getvalue(E_pubc_GW_GW_3D2_EspEpbReqAvl_Vt);
    }
    else
    {
        Msg_GW_3D2.EspEpbReqAvl=getValue(E_pubc_GW_GW_3D2_EspEpbReqAvl_Rv);
    }
}
/*@@end*/
 
/*@@envVar:E_pubc_GW_GW_3D2_EpbLeAchievedClmpF_Rv:*/
on envVar E_pubc_GW_GW_3D2_EpbLeAchievedClmpF_Rv
{
    int64 rawValue = 0ll;
    float rawValue_float = 0.0;
    float phyValue = 0.0;        

    //set the signal with updated raw value
    {
        rawValue = getvalue(this);
        if(chgEv_GW_3D2_EpbLeAchievedClmpF == 0)
        {
            //type conversion to float
            rawValue_float = rawValue;        
            // raw to physical conversion
            phyValue = ((rawValue_float *1)+(0));
            putValue(E_pubc_GW_GW_3D2_EpbLeAchievedClmpF_Pv, phyValue);
            chgEv_GW_3D2_EpbLeAchievedClmpF = 1;
        }
        else
        {
            chgEv_GW_3D2_EpbLeAchievedClmpF = 0;
        }    
        //update the signal value
        Msg_GW_3D2.EpbLeAchievedClmpF=rawValue;        
    }                                                                           
}
/*@@end*/

/*@@envVar:E_pubc_GW_GW_3D2_EpbLeAchievedClmpF_Pv:*/
on envVar E_pubc_GW_GW_3D2_EpbLeAchievedClmpF_Pv
{
    int64 rawValue = 0ll;
    float phyValue = 0.0;
    
    //update the raw value with physical value 
    {
        if(chgEv_GW_3D2_EpbLeAchievedClmpF == 0)
        {
            phyValue = getvalue(this);
            // physical to raw conversion
            rawValue = ((phyValue -(0))/1);
            putValue(E_pubc_GW_GW_3D2_EpbLeAchievedClmpF_Rv, rawValue);
            chgEv_GW_3D2_EpbLeAchievedClmpF = 1;  
        }
        else
        {
            chgEv_GW_3D2_EpbLeAchievedClmpF = 0;
        }
    }
}
/*@@end*/


 
/*@@envVar:E_pubc_GW_GW_3D2_EpbSts_Rv:*/
on envVar E_pubc_GW_GW_3D2_EpbSts_Rv
{
    int64 rawValue = 0ll;
    float rawValue_float = 0.0;
    float phyValue = 0.0;        

    //set the signal with updated raw value
    if(getValue(E_pubc_GW_GW_3D2_EpbSts_SetVt)==0)
    {
        rawValue = getvalue(this);
        if(chgEv_GW_3D2_EpbSts == 0)
        {
            //type conversion to float
            rawValue_float = rawValue;        
            // raw to physical conversion
            phyValue = ((rawValue_float *1)+(0));
            putValue(E_pubc_GW_GW_3D2_EpbSts_Pv, phyValue);
            chgEv_GW_3D2_EpbSts = 1;
        }
        else
        {
            chgEv_GW_3D2_EpbSts = 0;
        }    
        //update the signal value
        Msg_GW_3D2.EpbSts=rawValue;        
    }                                                                           
}
/*@@end*/

/*@@envVar:E_pubc_GW_GW_3D2_EpbSts_Pv:*/
on envVar E_pubc_GW_GW_3D2_EpbSts_Pv
{
    int64 rawValue = 0ll;
    float phyValue = 0.0;
    
    //update the raw value with physical value 
    if(getValue(E_pubc_GW_GW_3D2_EpbSts_SetVt)==0)
    {
        if(chgEv_GW_3D2_EpbSts == 0)
        {
            phyValue = getvalue(this);
            // physical to raw conversion
            rawValue = ((phyValue -(0))/1);
            putValue(E_pubc_GW_GW_3D2_EpbSts_Rv, rawValue);
            chgEv_GW_3D2_EpbSts = 1;  
        }
        else
        {
            chgEv_GW_3D2_EpbSts = 0;
        }
    }
}
/*@@end*/

/*@@envVar:E_pubc_GW_GW_3D2_EpbSts_Vt:*/
on envVar E_pubc_GW_GW_3D2_EpbSts_Vt
{
    qword rawValue = 0ll;
    if(getValue(E_pubc_GW_GW_3D2_EpbSts_SetVt))
    {
        //update the signal value
        Msg_GW_3D2.EpbSts=getValue(this);
    }
}
/*@@end*/

/*@@envVar:E_pubc_GW_GW_3D2_EpbSts_SetVt:*/
on envVar E_pubc_GW_GW_3D2_EpbSts_SetVt
{
    if(getValue(E_pubc_GW_GW_3D2_EpbSts_SetVt))
    {
        //update the signal value
        Msg_GW_3D2.EpbSts=getvalue(E_pubc_GW_GW_3D2_EpbSts_Vt);
    }
    else
    {
        Msg_GW_3D2.EpbSts=getValue(E_pubc_GW_GW_3D2_EpbSts_Rv);
    }
}
/*@@end*/
 
/*@@envVar:E_pubc_GW_GW_3D2_EpbDriverReqParkBrakeDominant_Rv:*/
on envVar E_pubc_GW_GW_3D2_EpbDriverReqParkBrakeDominant_Rv
{
    int64 rawValue = 0ll;
    float rawValue_float = 0.0;
    float phyValue = 0.0;        

    //set the signal with updated raw value
    if(getValue(E_pubc_GW_GW_3D2_EpbDriverReqParkBrakeDominant_SetVt)==0)
    {
        rawValue = getvalue(this);
        if(chgEv_GW_3D2_EpbDriverReqParkBrakeDominant == 0)
        {
            //type conversion to float
            rawValue_float = rawValue;        
            // raw to physical conversion
            phyValue = ((rawValue_float *1)+(0));
            putValue(E_pubc_GW_GW_3D2_EpbDriverReqParkBrakeDominant_Pv, phyValue);
            chgEv_GW_3D2_EpbDriverReqParkBrakeDominant = 1;
        }
        else
        {
            chgEv_GW_3D2_EpbDriverReqParkBrakeDominant = 0;
        }    
        //update the signal value
        Msg_GW_3D2.EpbDriverReqParkBrakeDominant=rawValue;        
    }                                                                           
}
/*@@end*/

/*@@envVar:E_pubc_GW_GW_3D2_EpbDriverReqParkBrakeDominant_Pv:*/
on envVar E_pubc_GW_GW_3D2_EpbDriverReqParkBrakeDominant_Pv
{
    int64 rawValue = 0ll;
    float phyValue = 0.0;
    
    //update the raw value with physical value 
    if(getValue(E_pubc_GW_GW_3D2_EpbDriverReqParkBrakeDominant_SetVt)==0)
    {
        if(chgEv_GW_3D2_EpbDriverReqParkBrakeDominant == 0)
        {
            phyValue = getvalue(this);
            // physical to raw conversion
            rawValue = ((phyValue -(0))/1);
            putValue(E_pubc_GW_GW_3D2_EpbDriverReqParkBrakeDominant_Rv, rawValue);
            chgEv_GW_3D2_EpbDriverReqParkBrakeDominant = 1;  
        }
        else
        {
            chgEv_GW_3D2_EpbDriverReqParkBrakeDominant = 0;
        }
    }
}
/*@@end*/

/*@@envVar:E_pubc_GW_GW_3D2_EpbDriverReqParkBrakeDominant_Vt:*/
on envVar E_pubc_GW_GW_3D2_EpbDriverReqParkBrakeDominant_Vt
{
    qword rawValue = 0ll;
    if(getValue(E_pubc_GW_GW_3D2_EpbDriverReqParkBrakeDominant_SetVt))
    {
        //update the signal value
        Msg_GW_3D2.EpbDriverReqParkBrakeDominant=getValue(this);
    }
}
/*@@end*/

/*@@envVar:E_pubc_GW_GW_3D2_EpbDriverReqParkBrakeDominant_SetVt:*/
on envVar E_pubc_GW_GW_3D2_EpbDriverReqParkBrakeDominant_SetVt
{
    if(getValue(E_pubc_GW_GW_3D2_EpbDriverReqParkBrakeDominant_SetVt))
    {
        //update the signal value
        Msg_GW_3D2.EpbDriverReqParkBrakeDominant=getvalue(E_pubc_GW_GW_3D2_EpbDriverReqParkBrakeDominant_Vt);
    }
    else
    {
        Msg_GW_3D2.EpbDriverReqParkBrakeDominant=getValue(E_pubc_GW_GW_3D2_EpbDriverReqParkBrakeDominant_Rv);
    }
}
/*@@end*/
 
/*@@envVar:E_pubc_GW_GW_180_tx:*/
on envVar E_pubc_GW_GW_180_tx
{
    if(getValue(this))
    {       
        
        //update the BZ Signal
        if(GW_180_EpsCycCntr180_wrongvalctr == 0)
        {
            update_GW_180_EpsCycCntr180_counter();
            Msg_GW_180.EpsCycCntr180= GW_180_EpsCycCntr180_counter;
        }
        else if(GW_180_EpsCycCntr180_wrongvalctr > 0)
        {
			GW_180_EpsCycCntr180_counter=GW_180_EpsCycCntr180_counter + GW_180_EpsCycCntr180_wrongvalctr;
			 Msg_GW_180.EpsCycCntr180= GW_180_EpsCycCntr180_counter;
            /* GW_180_EpsCycCntr180_wrongvalctr--;
              // if counter becomes zero, update panel controller to zero
             if(GW_180_EpsCycCntr180_wrongvalctr == 0)
             {
                 putValue(E_pubc_GW_GW_180_EpsCycCntr180_wrongvalctr,0);
             } */
        }
        else
        { 
			// do nothing
        }    
        //calculate the CRC CheckSum
        update_GW_180_CRC_CheckSum();

        output(Msg_GW_180);        
    }
}
/*@@end*/

/*@@envVar:E_pubc_GW_GW_180_Range:*/
on envVar E_pubc_GW_GW_180_Range
{
    qword rawstatus = 0ll;
    qword rawValue = 0ll;    
    
    rawstatus = getvalue(this);    
    // set all the signals with min raw /max raw /init raw
    switch (rawstatus) 
    {
     case(0) :
        rawValue= 0;
        putValue(E_pubc_GW_GW_180_EpsSteerAgSensFilr_Rv, rawValue);
        rawValue= -7800;
        putValue(E_pubc_GW_GW_180_EpsSasSteerAg_Rv, rawValue);
        rawValue= 0;
        putValue(E_pubc_GW_GW_180_EpsSteerAgRate_Rv, rawValue);
        rawValue= 0;
        putValue(E_pubc_GW_GW_180_EpsSasCalSts_Rv, rawValue);
        rawValue= 0;
        putValue(E_pubc_GW_GW_180_EpsSasSteerAgVld_Rv, rawValue);
        break;
     case(1) :
        rawValue= 1;
        putValue(E_pubc_GW_GW_180_EpsSteerAgSensFilr_Rv, rawValue);
        rawValue= 7800;
        putValue(E_pubc_GW_GW_180_EpsSasSteerAg_Rv, rawValue);
        rawValue= 254;
        putValue(E_pubc_GW_GW_180_EpsSteerAgRate_Rv, rawValue);
        rawValue= 1;
        putValue(E_pubc_GW_GW_180_EpsSasCalSts_Rv, rawValue);
        rawValue= 1;
        putValue(E_pubc_GW_GW_180_EpsSasSteerAgVld_Rv, rawValue);
        break;
     default :
        rawValue= 0;
        putValue(E_pubc_GW_GW_180_EpsSteerAgSensFilr_Rv, rawValue);
        rawValue= -7800;
        putValue(E_pubc_GW_GW_180_EpsSasSteerAg_Rv, rawValue);
        rawValue= 0;
        putValue(E_pubc_GW_GW_180_EpsSteerAgRate_Rv, rawValue);
        rawValue= 0;
        putValue(E_pubc_GW_GW_180_EpsSasCalSts_Rv, rawValue);
        rawValue= 0;
        putValue(E_pubc_GW_GW_180_EpsSasSteerAgVld_Rv, rawValue);
      break;
   }
}
/*@@end*/

/*@@envVar:E_pubc_GW_GW_180_Dlc:*/
on envVar E_pubc_GW_GW_180_Dlc
{
    if(getValue(E_pubc_GW_GW_180_enDlc))
    {
        Msg_GW_180.dlc =getValue(this);
    }
    else
    {
       Dbc_dlc = 8;
	   Msg_GW_180.dlc = Calc_Canfd_dlc(Dbc_dlc);
	   // Msg_GW_180.dlc = 8;
	   	
  }
}
/*@@end*/

/*@@envVar:E_pubc_GW_GW_180_enDlc:*/
on envVar E_pubc_GW_GW_180_enDlc
{
    //For Messages with DLC = 8, set wrong DLC to smaller than defined DLC
    //For Messages with DLC < 8 set wrong DLC to smaller/longer than defined DLC
    if(getValue(this))
    {
        Msg_GW_180.dlc =getValue(E_pubc_GW_GW_180_Dlc);
    }
    else
    {
       Dbc_dlc = 8;
	   Msg_GW_180.dlc = Calc_Canfd_dlc(Dbc_dlc);
	   // Msg_GW_180.dlc = 8;
    }
}
/*@@end*/

/*@@envVar:E_pubc_GW_GW_180_EpsCrcChk180_wrongvalctr:*/
on envVar E_pubc_GW_GW_180_EpsCrcChk180_wrongvalctr
{
    //update disturb count
    //disturb value range:(-1 = always send wrong value),( X>0 ,x is the number of Messages with wrong CHK sent)
    GW_180_EpsCrcChk180_wrongvalctr =getValue(this);    
}
/*@@end*/
/*@@envVar:E_pubc_GW_GW_180_EpsCycCntr180_wrongvalctr:*/
on envVar E_pubc_GW_GW_180_EpsCycCntr180_wrongvalctr
{
    //update disturb count
    //disturb value range:(-1 = always send wrong value),( X>0 ,x is the number of Messages with wrong CHK sent)
    GW_180_EpsCycCntr180_wrongvalctr =getValue(this);    
}
/*@@end*/

/*@@envVar:E_pubc_GW_GW_180_EpsSteerAgSensFilr_Rv:*/
on envVar E_pubc_GW_GW_180_EpsSteerAgSensFilr_Rv
{
    int64 rawValue = 0ll;
    float rawValue_float = 0.0;
    float phyValue = 0.0;        

    //set the signal with updated raw value
    if(getValue(E_pubc_GW_GW_180_EpsSteerAgSensFilr_SetVt)==0)
    {
        rawValue = getvalue(this);
        if(chgEv_GW_180_EpsSteerAgSensFilr == 0)
        {
            //type conversion to float
            rawValue_float = rawValue;        
            // raw to physical conversion
            phyValue = ((rawValue_float *1)+(0));
            putValue(E_pubc_GW_GW_180_EpsSteerAgSensFilr_Pv, phyValue);
            chgEv_GW_180_EpsSteerAgSensFilr = 1;
        }
        else
        {
            chgEv_GW_180_EpsSteerAgSensFilr = 0;
        }    
        //update the signal value
        Msg_GW_180.EpsSteerAgSensFilr=rawValue;        
    }                                                                           
}
/*@@end*/

/*@@envVar:E_pubc_GW_GW_180_EpsSteerAgSensFilr_Pv:*/
on envVar E_pubc_GW_GW_180_EpsSteerAgSensFilr_Pv
{
    int64 rawValue = 0ll;
    float phyValue = 0.0;
    
    //update the raw value with physical value 
    if(getValue(E_pubc_GW_GW_180_EpsSteerAgSensFilr_SetVt)==0)
    {
        if(chgEv_GW_180_EpsSteerAgSensFilr == 0)
        {
            phyValue = getvalue(this);
            // physical to raw conversion
            rawValue = ((phyValue -(0))/1);
            putValue(E_pubc_GW_GW_180_EpsSteerAgSensFilr_Rv, rawValue);
            chgEv_GW_180_EpsSteerAgSensFilr = 1;  
        }
        else
        {
            chgEv_GW_180_EpsSteerAgSensFilr = 0;
        }
    }
}
/*@@end*/

/*@@envVar:E_pubc_GW_GW_180_EpsSteerAgSensFilr_Vt:*/
on envVar E_pubc_GW_GW_180_EpsSteerAgSensFilr_Vt
{
    qword rawValue = 0ll;
    if(getValue(E_pubc_GW_GW_180_EpsSteerAgSensFilr_SetVt))
    {
        //update the signal value
        Msg_GW_180.EpsSteerAgSensFilr=getValue(this);
    }
}
/*@@end*/

/*@@envVar:E_pubc_GW_GW_180_EpsSteerAgSensFilr_SetVt:*/
on envVar E_pubc_GW_GW_180_EpsSteerAgSensFilr_SetVt
{
    if(getValue(E_pubc_GW_GW_180_EpsSteerAgSensFilr_SetVt))
    {
        //update the signal value
        Msg_GW_180.EpsSteerAgSensFilr=getvalue(E_pubc_GW_GW_180_EpsSteerAgSensFilr_Vt);
    }
    else
    {
        Msg_GW_180.EpsSteerAgSensFilr=getValue(E_pubc_GW_GW_180_EpsSteerAgSensFilr_Rv);
    }
}
/*@@end*/
 
/*@@envVar:E_pubc_GW_GW_180_EpsSasSteerAg_Rv:*/
on envVar E_pubc_GW_GW_180_EpsSasSteerAg_Rv
{
    int64 rawValue = 0ll;
    float rawValue_float = 0.0;
    float phyValue = 0.0;        

    //set the signal with updated raw value
    {
        rawValue = getvalue(this);
        if(chgEv_GW_180_EpsSasSteerAg == 0)
        {
            //type conversion to float
            rawValue_float = rawValue;        
            // raw to physical conversion
            phyValue = ((rawValue_float *0.1)+(0));
            putValue(E_pubc_GW_GW_180_EpsSasSteerAg_Pv, phyValue);
            chgEv_GW_180_EpsSasSteerAg = 1;
        }
        else
        {
            chgEv_GW_180_EpsSasSteerAg = 0;
        }    
        //update the signal value
        Msg_GW_180.EpsSasSteerAg=rawValue;        
    }                                                                           
}
/*@@end*/

/*@@envVar:E_pubc_GW_GW_180_EpsSasSteerAg_Pv:*/
on envVar E_pubc_GW_GW_180_EpsSasSteerAg_Pv
{
    int64 rawValue = 0ll;
    float phyValue = 0.0;
    
    //update the raw value with physical value 
    {
        if(chgEv_GW_180_EpsSasSteerAg == 0)
        {
            phyValue = getvalue(this);
            // physical to raw conversion
            rawValue = ((phyValue -(0))/0.1);
            putValue(E_pubc_GW_GW_180_EpsSasSteerAg_Rv, rawValue);
            chgEv_GW_180_EpsSasSteerAg = 1;  
        }
        else
        {
            chgEv_GW_180_EpsSasSteerAg = 0;
        }
    }
}
/*@@end*/


 
/*@@envVar:E_pubc_GW_GW_180_EpsSteerAgRate_Rv:*/
on envVar E_pubc_GW_GW_180_EpsSteerAgRate_Rv
{
    int64 rawValue = 0ll;
    float rawValue_float = 0.0;
    float phyValue = 0.0;        

    //set the signal with updated raw value
    {
        rawValue = getvalue(this);
        if(chgEv_GW_180_EpsSteerAgRate == 0)
        {
            //type conversion to float
            rawValue_float = rawValue;        
            // raw to physical conversion
            phyValue = ((rawValue_float *4)+(0));
            putValue(E_pubc_GW_GW_180_EpsSteerAgRate_Pv, phyValue);
            chgEv_GW_180_EpsSteerAgRate = 1;
        }
        else
        {
            chgEv_GW_180_EpsSteerAgRate = 0;
        }    
        //update the signal value
        Msg_GW_180.EpsSteerAgRate=rawValue;        
    }                                                                           
}
/*@@end*/

/*@@envVar:E_pubc_GW_GW_180_EpsSteerAgRate_Pv:*/
on envVar E_pubc_GW_GW_180_EpsSteerAgRate_Pv
{
    int64 rawValue = 0ll;
    float phyValue = 0.0;
    
    //update the raw value with physical value 
    {
        if(chgEv_GW_180_EpsSteerAgRate == 0)
        {
            phyValue = getvalue(this);
            // physical to raw conversion
            rawValue = ((phyValue -(0))/4);
            putValue(E_pubc_GW_GW_180_EpsSteerAgRate_Rv, rawValue);
            chgEv_GW_180_EpsSteerAgRate = 1;  
        }
        else
        {
            chgEv_GW_180_EpsSteerAgRate = 0;
        }
    }
}
/*@@end*/


 
/*@@envVar:E_pubc_GW_GW_180_EpsSasCalSts_Rv:*/
on envVar E_pubc_GW_GW_180_EpsSasCalSts_Rv
{
    int64 rawValue = 0ll;
    float rawValue_float = 0.0;
    float phyValue = 0.0;        

    //set the signal with updated raw value
    if(getValue(E_pubc_GW_GW_180_EpsSasCalSts_SetVt)==0)
    {
        rawValue = getvalue(this);
        if(chgEv_GW_180_EpsSasCalSts == 0)
        {
            //type conversion to float
            rawValue_float = rawValue;        
            // raw to physical conversion
            phyValue = ((rawValue_float *1)+(0));
            putValue(E_pubc_GW_GW_180_EpsSasCalSts_Pv, phyValue);
            chgEv_GW_180_EpsSasCalSts = 1;
        }
        else
        {
            chgEv_GW_180_EpsSasCalSts = 0;
        }    
        //update the signal value
        Msg_GW_180.EpsSasCalSts=rawValue;        
    }                                                                           
}
/*@@end*/

/*@@envVar:E_pubc_GW_GW_180_EpsSasCalSts_Pv:*/
on envVar E_pubc_GW_GW_180_EpsSasCalSts_Pv
{
    int64 rawValue = 0ll;
    float phyValue = 0.0;
    
    //update the raw value with physical value 
    if(getValue(E_pubc_GW_GW_180_EpsSasCalSts_SetVt)==0)
    {
        if(chgEv_GW_180_EpsSasCalSts == 0)
        {
            phyValue = getvalue(this);
            // physical to raw conversion
            rawValue = ((phyValue -(0))/1);
            putValue(E_pubc_GW_GW_180_EpsSasCalSts_Rv, rawValue);
            chgEv_GW_180_EpsSasCalSts = 1;  
        }
        else
        {
            chgEv_GW_180_EpsSasCalSts = 0;
        }
    }
}
/*@@end*/

/*@@envVar:E_pubc_GW_GW_180_EpsSasCalSts_Vt:*/
on envVar E_pubc_GW_GW_180_EpsSasCalSts_Vt
{
    qword rawValue = 0ll;
    if(getValue(E_pubc_GW_GW_180_EpsSasCalSts_SetVt))
    {
        //update the signal value
        Msg_GW_180.EpsSasCalSts=getValue(this);
    }
}
/*@@end*/

/*@@envVar:E_pubc_GW_GW_180_EpsSasCalSts_SetVt:*/
on envVar E_pubc_GW_GW_180_EpsSasCalSts_SetVt
{
    if(getValue(E_pubc_GW_GW_180_EpsSasCalSts_SetVt))
    {
        //update the signal value
        Msg_GW_180.EpsSasCalSts=getvalue(E_pubc_GW_GW_180_EpsSasCalSts_Vt);
    }
    else
    {
        Msg_GW_180.EpsSasCalSts=getValue(E_pubc_GW_GW_180_EpsSasCalSts_Rv);
    }
}
/*@@end*/
 
/*@@envVar:E_pubc_GW_GW_180_EpsSasSteerAgVld_Rv:*/
on envVar E_pubc_GW_GW_180_EpsSasSteerAgVld_Rv
{
    int64 rawValue = 0ll;
    float rawValue_float = 0.0;
    float phyValue = 0.0;        

    //set the signal with updated raw value
    if(getValue(E_pubc_GW_GW_180_EpsSasSteerAgVld_SetVt)==0)
    {
        rawValue = getvalue(this);
        if(chgEv_GW_180_EpsSasSteerAgVld == 0)
        {
            //type conversion to float
            rawValue_float = rawValue;        
            // raw to physical conversion
            phyValue = ((rawValue_float *1)+(0));
            putValue(E_pubc_GW_GW_180_EpsSasSteerAgVld_Pv, phyValue);
            chgEv_GW_180_EpsSasSteerAgVld = 1;
        }
        else
        {
            chgEv_GW_180_EpsSasSteerAgVld = 0;
        }    
        //update the signal value
        Msg_GW_180.EpsSasSteerAgVld=rawValue;        
    }                                                                           
}
/*@@end*/

/*@@envVar:E_pubc_GW_GW_180_EpsSasSteerAgVld_Pv:*/
on envVar E_pubc_GW_GW_180_EpsSasSteerAgVld_Pv
{
    int64 rawValue = 0ll;
    float phyValue = 0.0;
    
    //update the raw value with physical value 
    if(getValue(E_pubc_GW_GW_180_EpsSasSteerAgVld_SetVt)==0)
    {
        if(chgEv_GW_180_EpsSasSteerAgVld == 0)
        {
            phyValue = getvalue(this);
            // physical to raw conversion
            rawValue = ((phyValue -(0))/1);
            putValue(E_pubc_GW_GW_180_EpsSasSteerAgVld_Rv, rawValue);
            chgEv_GW_180_EpsSasSteerAgVld = 1;  
        }
        else
        {
            chgEv_GW_180_EpsSasSteerAgVld = 0;
        }
    }
}
/*@@end*/

/*@@envVar:E_pubc_GW_GW_180_EpsSasSteerAgVld_Vt:*/
on envVar E_pubc_GW_GW_180_EpsSasSteerAgVld_Vt
{
    qword rawValue = 0ll;
    if(getValue(E_pubc_GW_GW_180_EpsSasSteerAgVld_SetVt))
    {
        //update the signal value
        Msg_GW_180.EpsSasSteerAgVld=getValue(this);
    }
}
/*@@end*/

/*@@envVar:E_pubc_GW_GW_180_EpsSasSteerAgVld_SetVt:*/
on envVar E_pubc_GW_GW_180_EpsSasSteerAgVld_SetVt
{
    if(getValue(E_pubc_GW_GW_180_EpsSasSteerAgVld_SetVt))
    {
        //update the signal value
        Msg_GW_180.EpsSasSteerAgVld=getvalue(E_pubc_GW_GW_180_EpsSasSteerAgVld_Vt);
    }
    else
    {
        Msg_GW_180.EpsSasSteerAgVld=getValue(E_pubc_GW_GW_180_EpsSasSteerAgVld_Rv);
    }
}
/*@@end*/
 
/*@@envVar:E_pubc_GW_GW_2BD_tx:*/
on envVar E_pubc_GW_GW_2BD_tx
{
    if(getValue(this))
    {       
        
        //update the BZ Signal
        if(GW_2BD_RRC_RollingCounter_2BD_wrongvalctr == 0)
        {
            update_GW_2BD_RRC_RollingCounter_2BD_counter();
            Msg_GW_2BD.RRC_RollingCounter_2BD= GW_2BD_RRC_RollingCounter_2BD_counter;
        }
        else if(GW_2BD_RRC_RollingCounter_2BD_wrongvalctr > 0)
        {
			GW_2BD_RRC_RollingCounter_2BD_counter=GW_2BD_RRC_RollingCounter_2BD_counter + GW_2BD_RRC_RollingCounter_2BD_wrongvalctr;
			 Msg_GW_2BD.RRC_RollingCounter_2BD= GW_2BD_RRC_RollingCounter_2BD_counter;
            /* GW_2BD_RRC_RollingCounter_2BD_wrongvalctr--;
              // if counter becomes zero, update panel controller to zero
             if(GW_2BD_RRC_RollingCounter_2BD_wrongvalctr == 0)
             {
                 putValue(E_pubc_GW_GW_2BD_RRC_RollingCounter_2BD_wrongvalctr,0);
             } */
        }
        else
        { 
			// do nothing
        }    
        //calculate the CRC CheckSum
        update_GW_2BD_CRC_CheckSum();

        output(Msg_GW_2BD);        
    }
}
/*@@end*/

/*@@envVar:E_pubc_GW_GW_2BD_Range:*/
on envVar E_pubc_GW_GW_2BD_Range
{
    qword rawstatus = 0ll;
    qword rawValue = 0ll;    
    
    rawstatus = getvalue(this);    
    // set all the signals with min raw /max raw /init raw
    switch (rawstatus) 
    {
     case(0) :
        rawValue= 0;
        putValue(E_pubc_GW_GW_2BD_RRC_OBJ1_Measured_Rv, rawValue);
        rawValue= 0;
        putValue(E_pubc_GW_GW_2BD_RRC_OBJ3_Ay_Rv, rawValue);
        rawValue= 0;
        putValue(E_pubc_GW_GW_2BD_RRC_OBJ4_Measured_Rv, rawValue);
        rawValue= 0;
        putValue(E_pubc_GW_GW_2BD_RRC_OBJ2_Measured_Rv, rawValue);
        rawValue= 0;
        putValue(E_pubc_GW_GW_2BD_RRC_OBJ4_Vy_Rv, rawValue);
        rawValue= 0;
        putValue(E_pubc_GW_GW_2BD_RRC_OBJ4_Vx_Rv, rawValue);
        rawValue= 0;
        putValue(E_pubc_GW_GW_2BD_RRC_OBJ4_Ax_Rv, rawValue);
        rawValue= 0;
        putValue(E_pubc_GW_GW_2BD_RRC_OBJ4_Ay_Rv, rawValue);
        rawValue= 0;
        putValue(E_pubc_GW_GW_2BD_RRC_OBJ2_Width_Rv, rawValue);
        rawValue= 0;
        putValue(E_pubc_GW_GW_2BD_RRC_OBJ2_Type_Rv, rawValue);
        rawValue= 0;
        putValue(E_pubc_GW_GW_2BD_RRC_OBJ2_ObstacleProb_Rv, rawValue);
        rawValue= 0;
        putValue(E_pubc_GW_GW_2BD_RRC_OBJ4_Width_Rv, rawValue);
        rawValue= 0;
        putValue(E_pubc_GW_GW_2BD_RRC_OBJ4_ObstacleProb_Rv, rawValue);
        rawValue= 0;
        putValue(E_pubc_GW_GW_2BD_RRC_OBJ2_Dy_Rv, rawValue);
        rawValue= 0;
        putValue(E_pubc_GW_GW_2BD_RRC_OBJ2_Dx_Rv, rawValue);
        rawValue= 0;
        putValue(E_pubc_GW_GW_2BD_RRC_OBJ2_ExistProb_Rv, rawValue);
        rawValue= 0;
        putValue(E_pubc_GW_GW_2BD_RRC_OBJ4_Location_Rv, rawValue);
        rawValue= 0;
        putValue(E_pubc_GW_GW_2BD_RRC_OBJ2_Length_Rv, rawValue);
        rawValue= 0;
        putValue(E_pubc_GW_GW_2BD_RRC_OBJ1_Type_Rv, rawValue);
        rawValue= 0;
        putValue(E_pubc_GW_GW_2BD_RRC_OBJ3_Ax_Rv, rawValue);
        rawValue= 0;
        putValue(E_pubc_GW_GW_2BD_RRC_OBJ4_ExistProb_Rv, rawValue);
        rawValue= 0;
        putValue(E_pubc_GW_GW_2BD_RRC_OBJ1_ExistProb_Rv, rawValue);
        rawValue= 0;
        putValue(E_pubc_GW_GW_2BD_RRC_OBJ4_HeadingAngle_Rv, rawValue);
        rawValue= 0;
        putValue(E_pubc_GW_GW_2BD_RRC_OBJ3_Type_Rv, rawValue);
        rawValue= 0;
        putValue(E_pubc_GW_GW_2BD_RRC_OBJ1_Vx_Rv, rawValue);
        rawValue= 0;
        putValue(E_pubc_GW_GW_2BD_RRC_OBJ3_HeadingAngle_Rv, rawValue);
        rawValue= 0;
        putValue(E_pubc_GW_GW_2BD_RRC_OBJ4_Type_Rv, rawValue);
        rawValue= 0;
        putValue(E_pubc_GW_GW_2BD_RRC_OBJ2_Track_ID_Rv, rawValue);
        rawValue= 0;
        putValue(E_pubc_GW_GW_2BD_RRC_OBJ1_Ay_Rv, rawValue);
        rawValue= 0;
        putValue(E_pubc_GW_GW_2BD_RRC_OBJ1_Ax_Rv, rawValue);
        rawValue= 0;
        putValue(E_pubc_GW_GW_2BD_RRC_OBJ3_ExistProb_Rv, rawValue);
        rawValue= 0;
        putValue(E_pubc_GW_GW_2BD_RRC_OBJ3_Length_Rv, rawValue);
        rawValue= 0;
        putValue(E_pubc_GW_GW_2BD_RRC_OBJ1_Vy_Rv, rawValue);
        rawValue= 0;
        putValue(E_pubc_GW_GW_2BD_RRC_OBJ3_Measured_Rv, rawValue);
        rawValue= 0;
        putValue(E_pubc_GW_GW_2BD_RRC_OBJ3_Width_Rv, rawValue);
        rawValue= 0;
        putValue(E_pubc_GW_GW_2BD_RRC_OBJ2_Vy_Rv, rawValue);
        rawValue= 0;
        putValue(E_pubc_GW_GW_2BD_RRC_OBJ2_Vx_Rv, rawValue);
        rawValue= 0;
        putValue(E_pubc_GW_GW_2BD_RRC_OBJ1_ObstacleProb_Rv, rawValue);
        rawValue= 0;
        putValue(E_pubc_GW_GW_2BD_RRC_OBJ1_HeadingAngle_Rv, rawValue);
        rawValue= 0;
        putValue(E_pubc_GW_GW_2BD_RRC_OBJ3_Dx_Rv, rawValue);
        rawValue= 0;
        putValue(E_pubc_GW_GW_2BD_RRC_OBJ3_Dy_Rv, rawValue);
        rawValue= 0;
        putValue(E_pubc_GW_GW_2BD_RRC_OBJ3_Location_Rv, rawValue);
        rawValue= 0;
        putValue(E_pubc_GW_GW_2BD_RRC_OBJ4_Dy_Rv, rawValue);
        rawValue= 0;
        putValue(E_pubc_GW_GW_2BD_RRC_OBJ4_Dx_Rv, rawValue);
        rawValue= 0;
        putValue(E_pubc_GW_GW_2BD_RRC_OBJ2_Location_Rv, rawValue);
        rawValue= 0;
        putValue(E_pubc_GW_GW_2BD_RRC_OBJ1_Width_Rv, rawValue);
        rawValue= 0;
        putValue(E_pubc_GW_GW_2BD_RRC_OBJ1_Location_Rv, rawValue);
        rawValue= 0;
        putValue(E_pubc_GW_GW_2BD_RRC_OBJ4_Track_ID_Rv, rawValue);
        rawValue= 0;
        putValue(E_pubc_GW_GW_2BD_RRC_OBJ1_Track_ID_Rv, rawValue);
        rawValue= 0;
        putValue(E_pubc_GW_GW_2BD_RRC_OBJ2_Ax_Rv, rawValue);
        rawValue= 0;
        putValue(E_pubc_GW_GW_2BD_RRC_OBJ2_Ay_Rv, rawValue);
        rawValue= 0;
        putValue(E_pubc_GW_GW_2BD_RRC_OBJ1_Length_Rv, rawValue);
        rawValue= 0;
        putValue(E_pubc_GW_GW_2BD_RRC_OBJ3_ObstacleProb_Rv, rawValue);
        rawValue= 0;
        putValue(E_pubc_GW_GW_2BD_RRC_OBJ4_Length_Rv, rawValue);
        rawValue= 0;
        putValue(E_pubc_GW_GW_2BD_RRC_OBJ3_Vx_Rv, rawValue);
        rawValue= 0;
        putValue(E_pubc_GW_GW_2BD_RRC_OBJ3_Vy_Rv, rawValue);
        rawValue= 0;
        putValue(E_pubc_GW_GW_2BD_RRC_OBJ2_HeadingAngle_Rv, rawValue);
        rawValue= 0;
        putValue(E_pubc_GW_GW_2BD_RRC_OBJ3_Track_ID_Rv, rawValue);
        rawValue= 0;
        putValue(E_pubc_GW_GW_2BD_RRC_OBJ1_Dx_Rv, rawValue);
        rawValue= 0;
        putValue(E_pubc_GW_GW_2BD_RRC_OBJ1_Dy_Rv, rawValue);
        break;
     case(1) :
        rawValue= 3;
        putValue(E_pubc_GW_GW_2BD_RRC_OBJ1_Measured_Rv, rawValue);
        rawValue= 1023;
        putValue(E_pubc_GW_GW_2BD_RRC_OBJ3_Ay_Rv, rawValue);
        rawValue= 3;
        putValue(E_pubc_GW_GW_2BD_RRC_OBJ4_Measured_Rv, rawValue);
        rawValue= 3;
        putValue(E_pubc_GW_GW_2BD_RRC_OBJ2_Measured_Rv, rawValue);
        rawValue= 1023;
        putValue(E_pubc_GW_GW_2BD_RRC_OBJ4_Vy_Rv, rawValue);
        rawValue= 4095;
        putValue(E_pubc_GW_GW_2BD_RRC_OBJ4_Vx_Rv, rawValue);
        rawValue= 511;
        putValue(E_pubc_GW_GW_2BD_RRC_OBJ4_Ax_Rv, rawValue);
        rawValue= 1023;
        putValue(E_pubc_GW_GW_2BD_RRC_OBJ4_Ay_Rv, rawValue);
        rawValue= 1200;
        putValue(E_pubc_GW_GW_2BD_RRC_OBJ2_Width_Rv, rawValue);
        rawValue= 7;
        putValue(E_pubc_GW_GW_2BD_RRC_OBJ2_Type_Rv, rawValue);
        rawValue= 50;
        putValue(E_pubc_GW_GW_2BD_RRC_OBJ2_ObstacleProb_Rv, rawValue);
        rawValue= 1200;
        putValue(E_pubc_GW_GW_2BD_RRC_OBJ4_Width_Rv, rawValue);
        rawValue= 50;
        putValue(E_pubc_GW_GW_2BD_RRC_OBJ4_ObstacleProb_Rv, rawValue);
        rawValue= 2047;
        putValue(E_pubc_GW_GW_2BD_RRC_OBJ2_Dy_Rv, rawValue);
        rawValue= 8191;
        putValue(E_pubc_GW_GW_2BD_RRC_OBJ2_Dx_Rv, rawValue);
        rawValue= 50;
        putValue(E_pubc_GW_GW_2BD_RRC_OBJ2_ExistProb_Rv, rawValue);
        rawValue= 3;
        putValue(E_pubc_GW_GW_2BD_RRC_OBJ4_Location_Rv, rawValue);
        rawValue= 510;
        putValue(E_pubc_GW_GW_2BD_RRC_OBJ2_Length_Rv, rawValue);
        rawValue= 7;
        putValue(E_pubc_GW_GW_2BD_RRC_OBJ1_Type_Rv, rawValue);
        rawValue= 511;
        putValue(E_pubc_GW_GW_2BD_RRC_OBJ3_Ax_Rv, rawValue);
        rawValue= 50;
        putValue(E_pubc_GW_GW_2BD_RRC_OBJ4_ExistProb_Rv, rawValue);
        rawValue= 50;
        putValue(E_pubc_GW_GW_2BD_RRC_OBJ1_ExistProb_Rv, rawValue);
        rawValue= 628;
        putValue(E_pubc_GW_GW_2BD_RRC_OBJ4_HeadingAngle_Rv, rawValue);
        rawValue= 7;
        putValue(E_pubc_GW_GW_2BD_RRC_OBJ3_Type_Rv, rawValue);
        rawValue= 4095;
        putValue(E_pubc_GW_GW_2BD_RRC_OBJ1_Vx_Rv, rawValue);
        rawValue= 628;
        putValue(E_pubc_GW_GW_2BD_RRC_OBJ3_HeadingAngle_Rv, rawValue);
        rawValue= 7;
        putValue(E_pubc_GW_GW_2BD_RRC_OBJ4_Type_Rv, rawValue);
        rawValue= 127;
        putValue(E_pubc_GW_GW_2BD_RRC_OBJ2_Track_ID_Rv, rawValue);
        rawValue= 1023;
        putValue(E_pubc_GW_GW_2BD_RRC_OBJ1_Ay_Rv, rawValue);
        rawValue= 511;
        putValue(E_pubc_GW_GW_2BD_RRC_OBJ1_Ax_Rv, rawValue);
        rawValue= 50;
        putValue(E_pubc_GW_GW_2BD_RRC_OBJ3_ExistProb_Rv, rawValue);
        rawValue= 510;
        putValue(E_pubc_GW_GW_2BD_RRC_OBJ3_Length_Rv, rawValue);
        rawValue= 1023;
        putValue(E_pubc_GW_GW_2BD_RRC_OBJ1_Vy_Rv, rawValue);
        rawValue= 3;
        putValue(E_pubc_GW_GW_2BD_RRC_OBJ3_Measured_Rv, rawValue);
        rawValue= 1200;
        putValue(E_pubc_GW_GW_2BD_RRC_OBJ3_Width_Rv, rawValue);
        rawValue= 1023;
        putValue(E_pubc_GW_GW_2BD_RRC_OBJ2_Vy_Rv, rawValue);
        rawValue= 4095;
        putValue(E_pubc_GW_GW_2BD_RRC_OBJ2_Vx_Rv, rawValue);
        rawValue= 50;
        putValue(E_pubc_GW_GW_2BD_RRC_OBJ1_ObstacleProb_Rv, rawValue);
        rawValue= 628;
        putValue(E_pubc_GW_GW_2BD_RRC_OBJ1_HeadingAngle_Rv, rawValue);
        rawValue= 8191;
        putValue(E_pubc_GW_GW_2BD_RRC_OBJ3_Dx_Rv, rawValue);
        rawValue= 2047;
        putValue(E_pubc_GW_GW_2BD_RRC_OBJ3_Dy_Rv, rawValue);
        rawValue= 3;
        putValue(E_pubc_GW_GW_2BD_RRC_OBJ3_Location_Rv, rawValue);
        rawValue= 2047;
        putValue(E_pubc_GW_GW_2BD_RRC_OBJ4_Dy_Rv, rawValue);
        rawValue= 8191;
        putValue(E_pubc_GW_GW_2BD_RRC_OBJ4_Dx_Rv, rawValue);
        rawValue= 3;
        putValue(E_pubc_GW_GW_2BD_RRC_OBJ2_Location_Rv, rawValue);
        rawValue= 1200;
        putValue(E_pubc_GW_GW_2BD_RRC_OBJ1_Width_Rv, rawValue);
        rawValue= 3;
        putValue(E_pubc_GW_GW_2BD_RRC_OBJ1_Location_Rv, rawValue);
        rawValue= 127;
        putValue(E_pubc_GW_GW_2BD_RRC_OBJ4_Track_ID_Rv, rawValue);
        rawValue= 127;
        putValue(E_pubc_GW_GW_2BD_RRC_OBJ1_Track_ID_Rv, rawValue);
        rawValue= 511;
        putValue(E_pubc_GW_GW_2BD_RRC_OBJ2_Ax_Rv, rawValue);
        rawValue= 1023;
        putValue(E_pubc_GW_GW_2BD_RRC_OBJ2_Ay_Rv, rawValue);
        rawValue= 510;
        putValue(E_pubc_GW_GW_2BD_RRC_OBJ1_Length_Rv, rawValue);
        rawValue= 50;
        putValue(E_pubc_GW_GW_2BD_RRC_OBJ3_ObstacleProb_Rv, rawValue);
        rawValue= 510;
        putValue(E_pubc_GW_GW_2BD_RRC_OBJ4_Length_Rv, rawValue);
        rawValue= 4095;
        putValue(E_pubc_GW_GW_2BD_RRC_OBJ3_Vx_Rv, rawValue);
        rawValue= 1023;
        putValue(E_pubc_GW_GW_2BD_RRC_OBJ3_Vy_Rv, rawValue);
        rawValue= 628;
        putValue(E_pubc_GW_GW_2BD_RRC_OBJ2_HeadingAngle_Rv, rawValue);
        rawValue= 127;
        putValue(E_pubc_GW_GW_2BD_RRC_OBJ3_Track_ID_Rv, rawValue);
        rawValue= 8191;
        putValue(E_pubc_GW_GW_2BD_RRC_OBJ1_Dx_Rv, rawValue);
        rawValue= 2047;
        putValue(E_pubc_GW_GW_2BD_RRC_OBJ1_Dy_Rv, rawValue);
        break;
     default :
        rawValue= 0;
        putValue(E_pubc_GW_GW_2BD_RRC_OBJ1_Measured_Rv, rawValue);
        rawValue= 0;
        putValue(E_pubc_GW_GW_2BD_RRC_OBJ3_Ay_Rv, rawValue);
        rawValue= 0;
        putValue(E_pubc_GW_GW_2BD_RRC_OBJ4_Measured_Rv, rawValue);
        rawValue= 0;
        putValue(E_pubc_GW_GW_2BD_RRC_OBJ2_Measured_Rv, rawValue);
        rawValue= 0;
        putValue(E_pubc_GW_GW_2BD_RRC_OBJ4_Vy_Rv, rawValue);
        rawValue= 0;
        putValue(E_pubc_GW_GW_2BD_RRC_OBJ4_Vx_Rv, rawValue);
        rawValue= 0;
        putValue(E_pubc_GW_GW_2BD_RRC_OBJ4_Ax_Rv, rawValue);
        rawValue= 0;
        putValue(E_pubc_GW_GW_2BD_RRC_OBJ4_Ay_Rv, rawValue);
        rawValue= 0;
        putValue(E_pubc_GW_GW_2BD_RRC_OBJ2_Width_Rv, rawValue);
        rawValue= 0;
        putValue(E_pubc_GW_GW_2BD_RRC_OBJ2_Type_Rv, rawValue);
        rawValue= 0;
        putValue(E_pubc_GW_GW_2BD_RRC_OBJ2_ObstacleProb_Rv, rawValue);
        rawValue= 0;
        putValue(E_pubc_GW_GW_2BD_RRC_OBJ4_Width_Rv, rawValue);
        rawValue= 0;
        putValue(E_pubc_GW_GW_2BD_RRC_OBJ4_ObstacleProb_Rv, rawValue);
        rawValue= 0;
        putValue(E_pubc_GW_GW_2BD_RRC_OBJ2_Dy_Rv, rawValue);
        rawValue= 0;
        putValue(E_pubc_GW_GW_2BD_RRC_OBJ2_Dx_Rv, rawValue);
        rawValue= 0;
        putValue(E_pubc_GW_GW_2BD_RRC_OBJ2_ExistProb_Rv, rawValue);
        rawValue= 0;
        putValue(E_pubc_GW_GW_2BD_RRC_OBJ4_Location_Rv, rawValue);
        rawValue= 0;
        putValue(E_pubc_GW_GW_2BD_RRC_OBJ2_Length_Rv, rawValue);
        rawValue= 0;
        putValue(E_pubc_GW_GW_2BD_RRC_OBJ1_Type_Rv, rawValue);
        rawValue= 0;
        putValue(E_pubc_GW_GW_2BD_RRC_OBJ3_Ax_Rv, rawValue);
        rawValue= 0;
        putValue(E_pubc_GW_GW_2BD_RRC_OBJ4_ExistProb_Rv, rawValue);
        rawValue= 0;
        putValue(E_pubc_GW_GW_2BD_RRC_OBJ1_ExistProb_Rv, rawValue);
        rawValue= 0;
        putValue(E_pubc_GW_GW_2BD_RRC_OBJ4_HeadingAngle_Rv, rawValue);
        rawValue= 0;
        putValue(E_pubc_GW_GW_2BD_RRC_OBJ3_Type_Rv, rawValue);
        rawValue= 0;
        putValue(E_pubc_GW_GW_2BD_RRC_OBJ1_Vx_Rv, rawValue);
        rawValue= 0;
        putValue(E_pubc_GW_GW_2BD_RRC_OBJ3_HeadingAngle_Rv, rawValue);
        rawValue= 0;
        putValue(E_pubc_GW_GW_2BD_RRC_OBJ4_Type_Rv, rawValue);
        rawValue= 0;
        putValue(E_pubc_GW_GW_2BD_RRC_OBJ2_Track_ID_Rv, rawValue);
        rawValue= 0;
        putValue(E_pubc_GW_GW_2BD_RRC_OBJ1_Ay_Rv, rawValue);
        rawValue= 0;
        putValue(E_pubc_GW_GW_2BD_RRC_OBJ1_Ax_Rv, rawValue);
        rawValue= 0;
        putValue(E_pubc_GW_GW_2BD_RRC_OBJ3_ExistProb_Rv, rawValue);
        rawValue= 0;
        putValue(E_pubc_GW_GW_2BD_RRC_OBJ3_Length_Rv, rawValue);
        rawValue= 0;
        putValue(E_pubc_GW_GW_2BD_RRC_OBJ1_Vy_Rv, rawValue);
        rawValue= 0;
        putValue(E_pubc_GW_GW_2BD_RRC_OBJ3_Measured_Rv, rawValue);
        rawValue= 0;
        putValue(E_pubc_GW_GW_2BD_RRC_OBJ3_Width_Rv, rawValue);
        rawValue= 0;
        putValue(E_pubc_GW_GW_2BD_RRC_OBJ2_Vy_Rv, rawValue);
        rawValue= 0;
        putValue(E_pubc_GW_GW_2BD_RRC_OBJ2_Vx_Rv, rawValue);
        rawValue= 0;
        putValue(E_pubc_GW_GW_2BD_RRC_OBJ1_ObstacleProb_Rv, rawValue);
        rawValue= 0;
        putValue(E_pubc_GW_GW_2BD_RRC_OBJ1_HeadingAngle_Rv, rawValue);
        rawValue= 0;
        putValue(E_pubc_GW_GW_2BD_RRC_OBJ3_Dx_Rv, rawValue);
        rawValue= 0;
        putValue(E_pubc_GW_GW_2BD_RRC_OBJ3_Dy_Rv, rawValue);
        rawValue= 0;
        putValue(E_pubc_GW_GW_2BD_RRC_OBJ3_Location_Rv, rawValue);
        rawValue= 0;
        putValue(E_pubc_GW_GW_2BD_RRC_OBJ4_Dy_Rv, rawValue);
        rawValue= 0;
        putValue(E_pubc_GW_GW_2BD_RRC_OBJ4_Dx_Rv, rawValue);
        rawValue= 0;
        putValue(E_pubc_GW_GW_2BD_RRC_OBJ2_Location_Rv, rawValue);
        rawValue= 0;
        putValue(E_pubc_GW_GW_2BD_RRC_OBJ1_Width_Rv, rawValue);
        rawValue= 0;
        putValue(E_pubc_GW_GW_2BD_RRC_OBJ1_Location_Rv, rawValue);
        rawValue= 0;
        putValue(E_pubc_GW_GW_2BD_RRC_OBJ4_Track_ID_Rv, rawValue);
        rawValue= 0;
        putValue(E_pubc_GW_GW_2BD_RRC_OBJ1_Track_ID_Rv, rawValue);
        rawValue= 0;
        putValue(E_pubc_GW_GW_2BD_RRC_OBJ2_Ax_Rv, rawValue);
        rawValue= 0;
        putValue(E_pubc_GW_GW_2BD_RRC_OBJ2_Ay_Rv, rawValue);
        rawValue= 0;
        putValue(E_pubc_GW_GW_2BD_RRC_OBJ1_Length_Rv, rawValue);
        rawValue= 0;
        putValue(E_pubc_GW_GW_2BD_RRC_OBJ3_ObstacleProb_Rv, rawValue);
        rawValue= 0;
        putValue(E_pubc_GW_GW_2BD_RRC_OBJ4_Length_Rv, rawValue);
        rawValue= 0;
        putValue(E_pubc_GW_GW_2BD_RRC_OBJ3_Vx_Rv, rawValue);
        rawValue= 0;
        putValue(E_pubc_GW_GW_2BD_RRC_OBJ3_Vy_Rv, rawValue);
        rawValue= 0;
        putValue(E_pubc_GW_GW_2BD_RRC_OBJ2_HeadingAngle_Rv, rawValue);
        rawValue= 0;
        putValue(E_pubc_GW_GW_2BD_RRC_OBJ3_Track_ID_Rv, rawValue);
        rawValue= 0;
        putValue(E_pubc_GW_GW_2BD_RRC_OBJ1_Dx_Rv, rawValue);
        rawValue= 0;
        putValue(E_pubc_GW_GW_2BD_RRC_OBJ1_Dy_Rv, rawValue);
      break;
   }
}
/*@@end*/

/*@@envVar:E_pubc_GW_GW_2BD_Dlc:*/
on envVar E_pubc_GW_GW_2BD_Dlc
{
    if(getValue(E_pubc_GW_GW_2BD_enDlc))
    {
        Msg_GW_2BD.dlc =getValue(this);
    }
    else
    {
       Dbc_dlc = 64;
	   Msg_GW_2BD.dlc = Calc_Canfd_dlc(Dbc_dlc);
	   // Msg_GW_2BD.dlc = 64;
	   	
  }
}
/*@@end*/

/*@@envVar:E_pubc_GW_GW_2BD_enDlc:*/
on envVar E_pubc_GW_GW_2BD_enDlc
{
    //For Messages with DLC = 8, set wrong DLC to smaller than defined DLC
    //For Messages with DLC < 8 set wrong DLC to smaller/longer than defined DLC
    if(getValue(this))
    {
        Msg_GW_2BD.dlc =getValue(E_pubc_GW_GW_2BD_Dlc);
    }
    else
    {
       Dbc_dlc = 64;
	   Msg_GW_2BD.dlc = Calc_Canfd_dlc(Dbc_dlc);
	   // Msg_GW_2BD.dlc = 64;
    }
}
/*@@end*/

/*@@envVar:E_pubc_GW_GW_2BD_RRC_CRCCheck_2BD_wrongvalctr:*/
on envVar E_pubc_GW_GW_2BD_RRC_CRCCheck_2BD_wrongvalctr
{
    //update disturb count
    //disturb value range:(-1 = always send wrong value),( X>0 ,x is the number of Messages with wrong CHK sent)
    GW_2BD_RRC_CRCCheck_2BD_wrongvalctr =getValue(this);    
}
/*@@end*/
/*@@envVar:E_pubc_GW_GW_2BD_RRC_RollingCounter_2BD_wrongvalctr:*/
on envVar E_pubc_GW_GW_2BD_RRC_RollingCounter_2BD_wrongvalctr
{
    //update disturb count
    //disturb value range:(-1 = always send wrong value),( X>0 ,x is the number of Messages with wrong CHK sent)
    GW_2BD_RRC_RollingCounter_2BD_wrongvalctr =getValue(this);    
}
/*@@end*/

/*@@envVar:E_pubc_GW_GW_2BD_RRC_OBJ1_Measured_Rv:*/
on envVar E_pubc_GW_GW_2BD_RRC_OBJ1_Measured_Rv
{
    int64 rawValue = 0ll;
    float rawValue_float = 0.0;
    float phyValue = 0.0;        

    //set the signal with updated raw value
    if(getValue(E_pubc_GW_GW_2BD_RRC_OBJ1_Measured_SetVt)==0)
    {
        rawValue = getvalue(this);
        if(chgEv_GW_2BD_RRC_OBJ1_Measured == 0)
        {
            //type conversion to float
            rawValue_float = rawValue;        
            // raw to physical conversion
            phyValue = ((rawValue_float *1)+(0));
            putValue(E_pubc_GW_GW_2BD_RRC_OBJ1_Measured_Pv, phyValue);
            chgEv_GW_2BD_RRC_OBJ1_Measured = 1;
        }
        else
        {
            chgEv_GW_2BD_RRC_OBJ1_Measured = 0;
        }    
        //update the signal value
        Msg_GW_2BD.RRC_OBJ1_Measured=rawValue;        
    }                                                                           
}
/*@@end*/

/*@@envVar:E_pubc_GW_GW_2BD_RRC_OBJ1_Measured_Pv:*/
on envVar E_pubc_GW_GW_2BD_RRC_OBJ1_Measured_Pv
{
    int64 rawValue = 0ll;
    float phyValue = 0.0;
    
    //update the raw value with physical value 
    if(getValue(E_pubc_GW_GW_2BD_RRC_OBJ1_Measured_SetVt)==0)
    {
        if(chgEv_GW_2BD_RRC_OBJ1_Measured == 0)
        {
            phyValue = getvalue(this);
            // physical to raw conversion
            rawValue = ((phyValue -(0))/1);
            putValue(E_pubc_GW_GW_2BD_RRC_OBJ1_Measured_Rv, rawValue);
            chgEv_GW_2BD_RRC_OBJ1_Measured = 1;  
        }
        else
        {
            chgEv_GW_2BD_RRC_OBJ1_Measured = 0;
        }
    }
}
/*@@end*/

/*@@envVar:E_pubc_GW_GW_2BD_RRC_OBJ1_Measured_Vt:*/
on envVar E_pubc_GW_GW_2BD_RRC_OBJ1_Measured_Vt
{
    qword rawValue = 0ll;
    if(getValue(E_pubc_GW_GW_2BD_RRC_OBJ1_Measured_SetVt))
    {
        //update the signal value
        Msg_GW_2BD.RRC_OBJ1_Measured=getValue(this);
    }
}
/*@@end*/

/*@@envVar:E_pubc_GW_GW_2BD_RRC_OBJ1_Measured_SetVt:*/
on envVar E_pubc_GW_GW_2BD_RRC_OBJ1_Measured_SetVt
{
    if(getValue(E_pubc_GW_GW_2BD_RRC_OBJ1_Measured_SetVt))
    {
        //update the signal value
        Msg_GW_2BD.RRC_OBJ1_Measured=getvalue(E_pubc_GW_GW_2BD_RRC_OBJ1_Measured_Vt);
    }
    else
    {
        Msg_GW_2BD.RRC_OBJ1_Measured=getValue(E_pubc_GW_GW_2BD_RRC_OBJ1_Measured_Rv);
    }
}
/*@@end*/
 
/*@@envVar:E_pubc_GW_GW_2BD_RRC_OBJ3_Ay_Rv:*/
on envVar E_pubc_GW_GW_2BD_RRC_OBJ3_Ay_Rv
{
    int64 rawValue = 0ll;
    float rawValue_float = 0.0;
    float phyValue = 0.0;        

    //set the signal with updated raw value
    {
        rawValue = getvalue(this);
        if(chgEv_GW_2BD_RRC_OBJ3_Ay == 0)
        {
            //type conversion to float
            rawValue_float = rawValue;        
            // raw to physical conversion
            phyValue = ((rawValue_float *0.03125)+(-16));
            putValue(E_pubc_GW_GW_2BD_RRC_OBJ3_Ay_Pv, phyValue);
            chgEv_GW_2BD_RRC_OBJ3_Ay = 1;
        }
        else
        {
            chgEv_GW_2BD_RRC_OBJ3_Ay = 0;
        }    
        //update the signal value
        Msg_GW_2BD.RRC_OBJ3_Ay=rawValue;        
    }                                                                           
}
/*@@end*/

/*@@envVar:E_pubc_GW_GW_2BD_RRC_OBJ3_Ay_Pv:*/
on envVar E_pubc_GW_GW_2BD_RRC_OBJ3_Ay_Pv
{
    int64 rawValue = 0ll;
    float phyValue = 0.0;
    
    //update the raw value with physical value 
    {
        if(chgEv_GW_2BD_RRC_OBJ3_Ay == 0)
        {
            phyValue = getvalue(this);
            // physical to raw conversion
            rawValue = ((phyValue -(-16))/0.03125);
            putValue(E_pubc_GW_GW_2BD_RRC_OBJ3_Ay_Rv, rawValue);
            chgEv_GW_2BD_RRC_OBJ3_Ay = 1;  
        }
        else
        {
            chgEv_GW_2BD_RRC_OBJ3_Ay = 0;
        }
    }
}
/*@@end*/


 
/*@@envVar:E_pubc_GW_GW_2BD_RRC_OBJ4_Measured_Rv:*/
on envVar E_pubc_GW_GW_2BD_RRC_OBJ4_Measured_Rv
{
    int64 rawValue = 0ll;
    float rawValue_float = 0.0;
    float phyValue = 0.0;        

    //set the signal with updated raw value
    if(getValue(E_pubc_GW_GW_2BD_RRC_OBJ4_Measured_SetVt)==0)
    {
        rawValue = getvalue(this);
        if(chgEv_GW_2BD_RRC_OBJ4_Measured == 0)
        {
            //type conversion to float
            rawValue_float = rawValue;        
            // raw to physical conversion
            phyValue = ((rawValue_float *1)+(0));
            putValue(E_pubc_GW_GW_2BD_RRC_OBJ4_Measured_Pv, phyValue);
            chgEv_GW_2BD_RRC_OBJ4_Measured = 1;
        }
        else
        {
            chgEv_GW_2BD_RRC_OBJ4_Measured = 0;
        }    
        //update the signal value
        Msg_GW_2BD.RRC_OBJ4_Measured=rawValue;        
    }                                                                           
}
/*@@end*/

/*@@envVar:E_pubc_GW_GW_2BD_RRC_OBJ4_Measured_Pv:*/
on envVar E_pubc_GW_GW_2BD_RRC_OBJ4_Measured_Pv
{
    int64 rawValue = 0ll;
    float phyValue = 0.0;
    
    //update the raw value with physical value 
    if(getValue(E_pubc_GW_GW_2BD_RRC_OBJ4_Measured_SetVt)==0)
    {
        if(chgEv_GW_2BD_RRC_OBJ4_Measured == 0)
        {
            phyValue = getvalue(this);
            // physical to raw conversion
            rawValue = ((phyValue -(0))/1);
            putValue(E_pubc_GW_GW_2BD_RRC_OBJ4_Measured_Rv, rawValue);
            chgEv_GW_2BD_RRC_OBJ4_Measured = 1;  
        }
        else
        {
            chgEv_GW_2BD_RRC_OBJ4_Measured = 0;
        }
    }
}
/*@@end*/

/*@@envVar:E_pubc_GW_GW_2BD_RRC_OBJ4_Measured_Vt:*/
on envVar E_pubc_GW_GW_2BD_RRC_OBJ4_Measured_Vt
{
    qword rawValue = 0ll;
    if(getValue(E_pubc_GW_GW_2BD_RRC_OBJ4_Measured_SetVt))
    {
        //update the signal value
        Msg_GW_2BD.RRC_OBJ4_Measured=getValue(this);
    }
}
/*@@end*/

/*@@envVar:E_pubc_GW_GW_2BD_RRC_OBJ4_Measured_SetVt:*/
on envVar E_pubc_GW_GW_2BD_RRC_OBJ4_Measured_SetVt
{
    if(getValue(E_pubc_GW_GW_2BD_RRC_OBJ4_Measured_SetVt))
    {
        //update the signal value
        Msg_GW_2BD.RRC_OBJ4_Measured=getvalue(E_pubc_GW_GW_2BD_RRC_OBJ4_Measured_Vt);
    }
    else
    {
        Msg_GW_2BD.RRC_OBJ4_Measured=getValue(E_pubc_GW_GW_2BD_RRC_OBJ4_Measured_Rv);
    }
}
/*@@end*/
 
/*@@envVar:E_pubc_GW_GW_2BD_RRC_OBJ2_Measured_Rv:*/
on envVar E_pubc_GW_GW_2BD_RRC_OBJ2_Measured_Rv
{
    int64 rawValue = 0ll;
    float rawValue_float = 0.0;
    float phyValue = 0.0;        

    //set the signal with updated raw value
    if(getValue(E_pubc_GW_GW_2BD_RRC_OBJ2_Measured_SetVt)==0)
    {
        rawValue = getvalue(this);
        if(chgEv_GW_2BD_RRC_OBJ2_Measured == 0)
        {
            //type conversion to float
            rawValue_float = rawValue;        
            // raw to physical conversion
            phyValue = ((rawValue_float *1)+(0));
            putValue(E_pubc_GW_GW_2BD_RRC_OBJ2_Measured_Pv, phyValue);
            chgEv_GW_2BD_RRC_OBJ2_Measured = 1;
        }
        else
        {
            chgEv_GW_2BD_RRC_OBJ2_Measured = 0;
        }    
        //update the signal value
        Msg_GW_2BD.RRC_OBJ2_Measured=rawValue;        
    }                                                                           
}
/*@@end*/

/*@@envVar:E_pubc_GW_GW_2BD_RRC_OBJ2_Measured_Pv:*/
on envVar E_pubc_GW_GW_2BD_RRC_OBJ2_Measured_Pv
{
    int64 rawValue = 0ll;
    float phyValue = 0.0;
    
    //update the raw value with physical value 
    if(getValue(E_pubc_GW_GW_2BD_RRC_OBJ2_Measured_SetVt)==0)
    {
        if(chgEv_GW_2BD_RRC_OBJ2_Measured == 0)
        {
            phyValue = getvalue(this);
            // physical to raw conversion
            rawValue = ((phyValue -(0))/1);
            putValue(E_pubc_GW_GW_2BD_RRC_OBJ2_Measured_Rv, rawValue);
            chgEv_GW_2BD_RRC_OBJ2_Measured = 1;  
        }
        else
        {
            chgEv_GW_2BD_RRC_OBJ2_Measured = 0;
        }
    }
}
/*@@end*/

/*@@envVar:E_pubc_GW_GW_2BD_RRC_OBJ2_Measured_Vt:*/
on envVar E_pubc_GW_GW_2BD_RRC_OBJ2_Measured_Vt
{
    qword rawValue = 0ll;
    if(getValue(E_pubc_GW_GW_2BD_RRC_OBJ2_Measured_SetVt))
    {
        //update the signal value
        Msg_GW_2BD.RRC_OBJ2_Measured=getValue(this);
    }
}
/*@@end*/

/*@@envVar:E_pubc_GW_GW_2BD_RRC_OBJ2_Measured_SetVt:*/
on envVar E_pubc_GW_GW_2BD_RRC_OBJ2_Measured_SetVt
{
    if(getValue(E_pubc_GW_GW_2BD_RRC_OBJ2_Measured_SetVt))
    {
        //update the signal value
        Msg_GW_2BD.RRC_OBJ2_Measured=getvalue(E_pubc_GW_GW_2BD_RRC_OBJ2_Measured_Vt);
    }
    else
    {
        Msg_GW_2BD.RRC_OBJ2_Measured=getValue(E_pubc_GW_GW_2BD_RRC_OBJ2_Measured_Rv);
    }
}
/*@@end*/
 
/*@@envVar:E_pubc_GW_GW_2BD_RRC_OBJ4_Vy_Rv:*/
on envVar E_pubc_GW_GW_2BD_RRC_OBJ4_Vy_Rv
{
    int64 rawValue = 0ll;
    float rawValue_float = 0.0;
    float phyValue = 0.0;        

    //set the signal with updated raw value
    {
        rawValue = getvalue(this);
        if(chgEv_GW_2BD_RRC_OBJ4_Vy == 0)
        {
            //type conversion to float
            rawValue_float = rawValue;        
            // raw to physical conversion
            phyValue = ((rawValue_float *0.125)+(-64));
            putValue(E_pubc_GW_GW_2BD_RRC_OBJ4_Vy_Pv, phyValue);
            chgEv_GW_2BD_RRC_OBJ4_Vy = 1;
        }
        else
        {
            chgEv_GW_2BD_RRC_OBJ4_Vy = 0;
        }    
        //update the signal value
        Msg_GW_2BD.RRC_OBJ4_Vy=rawValue;        
    }                                                                           
}
/*@@end*/

/*@@envVar:E_pubc_GW_GW_2BD_RRC_OBJ4_Vy_Pv:*/
on envVar E_pubc_GW_GW_2BD_RRC_OBJ4_Vy_Pv
{
    int64 rawValue = 0ll;
    float phyValue = 0.0;
    
    //update the raw value with physical value 
    {
        if(chgEv_GW_2BD_RRC_OBJ4_Vy == 0)
        {
            phyValue = getvalue(this);
            // physical to raw conversion
            rawValue = ((phyValue -(-64))/0.125);
            putValue(E_pubc_GW_GW_2BD_RRC_OBJ4_Vy_Rv, rawValue);
            chgEv_GW_2BD_RRC_OBJ4_Vy = 1;  
        }
        else
        {
            chgEv_GW_2BD_RRC_OBJ4_Vy = 0;
        }
    }
}
/*@@end*/


 
/*@@envVar:E_pubc_GW_GW_2BD_RRC_OBJ4_Vx_Rv:*/
on envVar E_pubc_GW_GW_2BD_RRC_OBJ4_Vx_Rv
{
    int64 rawValue = 0ll;
    float rawValue_float = 0.0;
    float phyValue = 0.0;        

    //set the signal with updated raw value
    {
        rawValue = getvalue(this);
        if(chgEv_GW_2BD_RRC_OBJ4_Vx == 0)
        {
            //type conversion to float
            rawValue_float = rawValue;        
            // raw to physical conversion
            phyValue = ((rawValue_float *0.0625)+(-128));
            putValue(E_pubc_GW_GW_2BD_RRC_OBJ4_Vx_Pv, phyValue);
            chgEv_GW_2BD_RRC_OBJ4_Vx = 1;
        }
        else
        {
            chgEv_GW_2BD_RRC_OBJ4_Vx = 0;
        }    
        //update the signal value
        Msg_GW_2BD.RRC_OBJ4_Vx=rawValue;        
    }                                                                           
}
/*@@end*/

/*@@envVar:E_pubc_GW_GW_2BD_RRC_OBJ4_Vx_Pv:*/
on envVar E_pubc_GW_GW_2BD_RRC_OBJ4_Vx_Pv
{
    int64 rawValue = 0ll;
    float phyValue = 0.0;
    
    //update the raw value with physical value 
    {
        if(chgEv_GW_2BD_RRC_OBJ4_Vx == 0)
        {
            phyValue = getvalue(this);
            // physical to raw conversion
            rawValue = ((phyValue -(-128))/0.0625);
            putValue(E_pubc_GW_GW_2BD_RRC_OBJ4_Vx_Rv, rawValue);
            chgEv_GW_2BD_RRC_OBJ4_Vx = 1;  
        }
        else
        {
            chgEv_GW_2BD_RRC_OBJ4_Vx = 0;
        }
    }
}
/*@@end*/


 
/*@@envVar:E_pubc_GW_GW_2BD_RRC_OBJ4_Ax_Rv:*/
on envVar E_pubc_GW_GW_2BD_RRC_OBJ4_Ax_Rv
{
    int64 rawValue = 0ll;
    float rawValue_float = 0.0;
    float phyValue = 0.0;        

    //set the signal with updated raw value
    {
        rawValue = getvalue(this);
        if(chgEv_GW_2BD_RRC_OBJ4_Ax == 0)
        {
            //type conversion to float
            rawValue_float = rawValue;        
            // raw to physical conversion
            phyValue = ((rawValue_float *0.0625)+(-16));
            putValue(E_pubc_GW_GW_2BD_RRC_OBJ4_Ax_Pv, phyValue);
            chgEv_GW_2BD_RRC_OBJ4_Ax = 1;
        }
        else
        {
            chgEv_GW_2BD_RRC_OBJ4_Ax = 0;
        }    
        //update the signal value
        Msg_GW_2BD.RRC_OBJ4_Ax=rawValue;        
    }                                                                           
}
/*@@end*/

/*@@envVar:E_pubc_GW_GW_2BD_RRC_OBJ4_Ax_Pv:*/
on envVar E_pubc_GW_GW_2BD_RRC_OBJ4_Ax_Pv
{
    int64 rawValue = 0ll;
    float phyValue = 0.0;
    
    //update the raw value with physical value 
    {
        if(chgEv_GW_2BD_RRC_OBJ4_Ax == 0)
        {
            phyValue = getvalue(this);
            // physical to raw conversion
            rawValue = ((phyValue -(-16))/0.0625);
            putValue(E_pubc_GW_GW_2BD_RRC_OBJ4_Ax_Rv, rawValue);
            chgEv_GW_2BD_RRC_OBJ4_Ax = 1;  
        }
        else
        {
            chgEv_GW_2BD_RRC_OBJ4_Ax = 0;
        }
    }
}
/*@@end*/


 
/*@@envVar:E_pubc_GW_GW_2BD_RRC_OBJ4_Ay_Rv:*/
on envVar E_pubc_GW_GW_2BD_RRC_OBJ4_Ay_Rv
{
    int64 rawValue = 0ll;
    float rawValue_float = 0.0;
    float phyValue = 0.0;        

    //set the signal with updated raw value
    {
        rawValue = getvalue(this);
        if(chgEv_GW_2BD_RRC_OBJ4_Ay == 0)
        {
            //type conversion to float
            rawValue_float = rawValue;        
            // raw to physical conversion
            phyValue = ((rawValue_float *0.03125)+(-16));
            putValue(E_pubc_GW_GW_2BD_RRC_OBJ4_Ay_Pv, phyValue);
            chgEv_GW_2BD_RRC_OBJ4_Ay = 1;
        }
        else
        {
            chgEv_GW_2BD_RRC_OBJ4_Ay = 0;
        }    
        //update the signal value
        Msg_GW_2BD.RRC_OBJ4_Ay=rawValue;        
    }                                                                           
}
/*@@end*/

/*@@envVar:E_pubc_GW_GW_2BD_RRC_OBJ4_Ay_Pv:*/
on envVar E_pubc_GW_GW_2BD_RRC_OBJ4_Ay_Pv
{
    int64 rawValue = 0ll;
    float phyValue = 0.0;
    
    //update the raw value with physical value 
    {
        if(chgEv_GW_2BD_RRC_OBJ4_Ay == 0)
        {
            phyValue = getvalue(this);
            // physical to raw conversion
            rawValue = ((phyValue -(-16))/0.03125);
            putValue(E_pubc_GW_GW_2BD_RRC_OBJ4_Ay_Rv, rawValue);
            chgEv_GW_2BD_RRC_OBJ4_Ay = 1;  
        }
        else
        {
            chgEv_GW_2BD_RRC_OBJ4_Ay = 0;
        }
    }
}
/*@@end*/


 
/*@@envVar:E_pubc_GW_GW_2BD_RRC_OBJ2_Width_Rv:*/
on envVar E_pubc_GW_GW_2BD_RRC_OBJ2_Width_Rv
{
    int64 rawValue = 0ll;
    float rawValue_float = 0.0;
    float phyValue = 0.0;        

    //set the signal with updated raw value
    {
        rawValue = getvalue(this);
        if(chgEv_GW_2BD_RRC_OBJ2_Width == 0)
        {
            //type conversion to float
            rawValue_float = rawValue;        
            // raw to physical conversion
            phyValue = ((rawValue_float *0.01)+(0));
            putValue(E_pubc_GW_GW_2BD_RRC_OBJ2_Width_Pv, phyValue);
            chgEv_GW_2BD_RRC_OBJ2_Width = 1;
        }
        else
        {
            chgEv_GW_2BD_RRC_OBJ2_Width = 0;
        }    
        //update the signal value
        Msg_GW_2BD.RRC_OBJ2_Width=rawValue;        
    }                                                                           
}
/*@@end*/

/*@@envVar:E_pubc_GW_GW_2BD_RRC_OBJ2_Width_Pv:*/
on envVar E_pubc_GW_GW_2BD_RRC_OBJ2_Width_Pv
{
    int64 rawValue = 0ll;
    float phyValue = 0.0;
    
    //update the raw value with physical value 
    {
        if(chgEv_GW_2BD_RRC_OBJ2_Width == 0)
        {
            phyValue = getvalue(this);
            // physical to raw conversion
            rawValue = ((phyValue -(0))/0.01);
            putValue(E_pubc_GW_GW_2BD_RRC_OBJ2_Width_Rv, rawValue);
            chgEv_GW_2BD_RRC_OBJ2_Width = 1;  
        }
        else
        {
            chgEv_GW_2BD_RRC_OBJ2_Width = 0;
        }
    }
}
/*@@end*/


 
/*@@envVar:E_pubc_GW_GW_2BD_RRC_OBJ2_Type_Rv:*/
on envVar E_pubc_GW_GW_2BD_RRC_OBJ2_Type_Rv
{
    int64 rawValue = 0ll;
    float rawValue_float = 0.0;
    float phyValue = 0.0;        

    //set the signal with updated raw value
    if(getValue(E_pubc_GW_GW_2BD_RRC_OBJ2_Type_SetVt)==0)
    {
        rawValue = getvalue(this);
        if(chgEv_GW_2BD_RRC_OBJ2_Type == 0)
        {
            //type conversion to float
            rawValue_float = rawValue;        
            // raw to physical conversion
            phyValue = ((rawValue_float *1)+(0));
            putValue(E_pubc_GW_GW_2BD_RRC_OBJ2_Type_Pv, phyValue);
            chgEv_GW_2BD_RRC_OBJ2_Type = 1;
        }
        else
        {
            chgEv_GW_2BD_RRC_OBJ2_Type = 0;
        }    
        //update the signal value
        Msg_GW_2BD.RRC_OBJ2_Type=rawValue;        
    }                                                                           
}
/*@@end*/

/*@@envVar:E_pubc_GW_GW_2BD_RRC_OBJ2_Type_Pv:*/
on envVar E_pubc_GW_GW_2BD_RRC_OBJ2_Type_Pv
{
    int64 rawValue = 0ll;
    float phyValue = 0.0;
    
    //update the raw value with physical value 
    if(getValue(E_pubc_GW_GW_2BD_RRC_OBJ2_Type_SetVt)==0)
    {
        if(chgEv_GW_2BD_RRC_OBJ2_Type == 0)
        {
            phyValue = getvalue(this);
            // physical to raw conversion
            rawValue = ((phyValue -(0))/1);
            putValue(E_pubc_GW_GW_2BD_RRC_OBJ2_Type_Rv, rawValue);
            chgEv_GW_2BD_RRC_OBJ2_Type = 1;  
        }
        else
        {
            chgEv_GW_2BD_RRC_OBJ2_Type = 0;
        }
    }
}
/*@@end*/

/*@@envVar:E_pubc_GW_GW_2BD_RRC_OBJ2_Type_Vt:*/
on envVar E_pubc_GW_GW_2BD_RRC_OBJ2_Type_Vt
{
    qword rawValue = 0ll;
    if(getValue(E_pubc_GW_GW_2BD_RRC_OBJ2_Type_SetVt))
    {
        //update the signal value
        Msg_GW_2BD.RRC_OBJ2_Type=getValue(this);
    }
}
/*@@end*/

/*@@envVar:E_pubc_GW_GW_2BD_RRC_OBJ2_Type_SetVt:*/
on envVar E_pubc_GW_GW_2BD_RRC_OBJ2_Type_SetVt
{
    if(getValue(E_pubc_GW_GW_2BD_RRC_OBJ2_Type_SetVt))
    {
        //update the signal value
        Msg_GW_2BD.RRC_OBJ2_Type=getvalue(E_pubc_GW_GW_2BD_RRC_OBJ2_Type_Vt);
    }
    else
    {
        Msg_GW_2BD.RRC_OBJ2_Type=getValue(E_pubc_GW_GW_2BD_RRC_OBJ2_Type_Rv);
    }
}
/*@@end*/
 
/*@@envVar:E_pubc_GW_GW_2BD_RRC_OBJ2_ObstacleProb_Rv:*/
on envVar E_pubc_GW_GW_2BD_RRC_OBJ2_ObstacleProb_Rv
{
    int64 rawValue = 0ll;
    float rawValue_float = 0.0;
    float phyValue = 0.0;        

    //set the signal with updated raw value
    {
        rawValue = getvalue(this);
        if(chgEv_GW_2BD_RRC_OBJ2_ObstacleProb == 0)
        {
            //type conversion to float
            rawValue_float = rawValue;        
            // raw to physical conversion
            phyValue = ((rawValue_float *2)+(0));
            putValue(E_pubc_GW_GW_2BD_RRC_OBJ2_ObstacleProb_Pv, phyValue);
            chgEv_GW_2BD_RRC_OBJ2_ObstacleProb = 1;
        }
        else
        {
            chgEv_GW_2BD_RRC_OBJ2_ObstacleProb = 0;
        }    
        //update the signal value
        Msg_GW_2BD.RRC_OBJ2_ObstacleProb=rawValue;        
    }                                                                           
}
/*@@end*/

/*@@envVar:E_pubc_GW_GW_2BD_RRC_OBJ2_ObstacleProb_Pv:*/
on envVar E_pubc_GW_GW_2BD_RRC_OBJ2_ObstacleProb_Pv
{
    int64 rawValue = 0ll;
    float phyValue = 0.0;
    
    //update the raw value with physical value 
    {
        if(chgEv_GW_2BD_RRC_OBJ2_ObstacleProb == 0)
        {
            phyValue = getvalue(this);
            // physical to raw conversion
            rawValue = ((phyValue -(0))/2);
            putValue(E_pubc_GW_GW_2BD_RRC_OBJ2_ObstacleProb_Rv, rawValue);
            chgEv_GW_2BD_RRC_OBJ2_ObstacleProb = 1;  
        }
        else
        {
            chgEv_GW_2BD_RRC_OBJ2_ObstacleProb = 0;
        }
    }
}
/*@@end*/


 
/*@@envVar:E_pubc_GW_GW_2BD_RRC_OBJ4_Width_Rv:*/
on envVar E_pubc_GW_GW_2BD_RRC_OBJ4_Width_Rv
{
    int64 rawValue = 0ll;
    float rawValue_float = 0.0;
    float phyValue = 0.0;        

    //set the signal with updated raw value
    {
        rawValue = getvalue(this);
        if(chgEv_GW_2BD_RRC_OBJ4_Width == 0)
        {
            //type conversion to float
            rawValue_float = rawValue;        
            // raw to physical conversion
            phyValue = ((rawValue_float *0.01)+(0));
            putValue(E_pubc_GW_GW_2BD_RRC_OBJ4_Width_Pv, phyValue);
            chgEv_GW_2BD_RRC_OBJ4_Width = 1;
        }
        else
        {
            chgEv_GW_2BD_RRC_OBJ4_Width = 0;
        }    
        //update the signal value
        Msg_GW_2BD.RRC_OBJ4_Width=rawValue;        
    }                                                                           
}
/*@@end*/

/*@@envVar:E_pubc_GW_GW_2BD_RRC_OBJ4_Width_Pv:*/
on envVar E_pubc_GW_GW_2BD_RRC_OBJ4_Width_Pv
{
    int64 rawValue = 0ll;
    float phyValue = 0.0;
    
    //update the raw value with physical value 
    {
        if(chgEv_GW_2BD_RRC_OBJ4_Width == 0)
        {
            phyValue = getvalue(this);
            // physical to raw conversion
            rawValue = ((phyValue -(0))/0.01);
            putValue(E_pubc_GW_GW_2BD_RRC_OBJ4_Width_Rv, rawValue);
            chgEv_GW_2BD_RRC_OBJ4_Width = 1;  
        }
        else
        {
            chgEv_GW_2BD_RRC_OBJ4_Width = 0;
        }
    }
}
/*@@end*/


 
/*@@envVar:E_pubc_GW_GW_2BD_RRC_OBJ4_ObstacleProb_Rv:*/
on envVar E_pubc_GW_GW_2BD_RRC_OBJ4_ObstacleProb_Rv
{
    int64 rawValue = 0ll;
    float rawValue_float = 0.0;
    float phyValue = 0.0;        

    //set the signal with updated raw value
    {
        rawValue = getvalue(this);
        if(chgEv_GW_2BD_RRC_OBJ4_ObstacleProb == 0)
        {
            //type conversion to float
            rawValue_float = rawValue;        
            // raw to physical conversion
            phyValue = ((rawValue_float *2)+(0));
            putValue(E_pubc_GW_GW_2BD_RRC_OBJ4_ObstacleProb_Pv, phyValue);
            chgEv_GW_2BD_RRC_OBJ4_ObstacleProb = 1;
        }
        else
        {
            chgEv_GW_2BD_RRC_OBJ4_ObstacleProb = 0;
        }    
        //update the signal value
        Msg_GW_2BD.RRC_OBJ4_ObstacleProb=rawValue;        
    }                                                                           
}
/*@@end*/

/*@@envVar:E_pubc_GW_GW_2BD_RRC_OBJ4_ObstacleProb_Pv:*/
on envVar E_pubc_GW_GW_2BD_RRC_OBJ4_ObstacleProb_Pv
{
    int64 rawValue = 0ll;
    float phyValue = 0.0;
    
    //update the raw value with physical value 
    {
        if(chgEv_GW_2BD_RRC_OBJ4_ObstacleProb == 0)
        {
            phyValue = getvalue(this);
            // physical to raw conversion
            rawValue = ((phyValue -(0))/2);
            putValue(E_pubc_GW_GW_2BD_RRC_OBJ4_ObstacleProb_Rv, rawValue);
            chgEv_GW_2BD_RRC_OBJ4_ObstacleProb = 1;  
        }
        else
        {
            chgEv_GW_2BD_RRC_OBJ4_ObstacleProb = 0;
        }
    }
}
/*@@end*/


 
/*@@envVar:E_pubc_GW_GW_2BD_RRC_OBJ2_Dy_Rv:*/
on envVar E_pubc_GW_GW_2BD_RRC_OBJ2_Dy_Rv
{
    int64 rawValue = 0ll;
    float rawValue_float = 0.0;
    float phyValue = 0.0;        

    //set the signal with updated raw value
    {
        rawValue = getvalue(this);
        if(chgEv_GW_2BD_RRC_OBJ2_Dy == 0)
        {
            //type conversion to float
            rawValue_float = rawValue;        
            // raw to physical conversion
            phyValue = ((rawValue_float *0.125)+(-128));
            putValue(E_pubc_GW_GW_2BD_RRC_OBJ2_Dy_Pv, phyValue);
            chgEv_GW_2BD_RRC_OBJ2_Dy = 1;
        }
        else
        {
            chgEv_GW_2BD_RRC_OBJ2_Dy = 0;
        }    
        //update the signal value
        Msg_GW_2BD.RRC_OBJ2_Dy=rawValue;        
    }                                                                           
}
/*@@end*/

/*@@envVar:E_pubc_GW_GW_2BD_RRC_OBJ2_Dy_Pv:*/
on envVar E_pubc_GW_GW_2BD_RRC_OBJ2_Dy_Pv
{
    int64 rawValue = 0ll;
    float phyValue = 0.0;
    
    //update the raw value with physical value 
    {
        if(chgEv_GW_2BD_RRC_OBJ2_Dy == 0)
        {
            phyValue = getvalue(this);
            // physical to raw conversion
            rawValue = ((phyValue -(-128))/0.125);
            putValue(E_pubc_GW_GW_2BD_RRC_OBJ2_Dy_Rv, rawValue);
            chgEv_GW_2BD_RRC_OBJ2_Dy = 1;  
        }
        else
        {
            chgEv_GW_2BD_RRC_OBJ2_Dy = 0;
        }
    }
}
/*@@end*/


 
/*@@envVar:E_pubc_GW_GW_2BD_RRC_OBJ2_Dx_Rv:*/
on envVar E_pubc_GW_GW_2BD_RRC_OBJ2_Dx_Rv
{
    int64 rawValue = 0ll;
    float rawValue_float = 0.0;
    float phyValue = 0.0;        

    //set the signal with updated raw value
    {
        rawValue = getvalue(this);
        if(chgEv_GW_2BD_RRC_OBJ2_Dx == 0)
        {
            //type conversion to float
            rawValue_float = rawValue;        
            // raw to physical conversion
            phyValue = ((rawValue_float *0.0625)+(-256));
            putValue(E_pubc_GW_GW_2BD_RRC_OBJ2_Dx_Pv, phyValue);
            chgEv_GW_2BD_RRC_OBJ2_Dx = 1;
        }
        else
        {
            chgEv_GW_2BD_RRC_OBJ2_Dx = 0;
        }    
        //update the signal value
        Msg_GW_2BD.RRC_OBJ2_Dx=rawValue;        
    }                                                                           
}
/*@@end*/

/*@@envVar:E_pubc_GW_GW_2BD_RRC_OBJ2_Dx_Pv:*/
on envVar E_pubc_GW_GW_2BD_RRC_OBJ2_Dx_Pv
{
    int64 rawValue = 0ll;
    float phyValue = 0.0;
    
    //update the raw value with physical value 
    {
        if(chgEv_GW_2BD_RRC_OBJ2_Dx == 0)
        {
            phyValue = getvalue(this);
            // physical to raw conversion
            rawValue = ((phyValue -(-256))/0.0625);
            putValue(E_pubc_GW_GW_2BD_RRC_OBJ2_Dx_Rv, rawValue);
            chgEv_GW_2BD_RRC_OBJ2_Dx = 1;  
        }
        else
        {
            chgEv_GW_2BD_RRC_OBJ2_Dx = 0;
        }
    }
}
/*@@end*/


 
/*@@envVar:E_pubc_GW_GW_2BD_RRC_OBJ2_ExistProb_Rv:*/
on envVar E_pubc_GW_GW_2BD_RRC_OBJ2_ExistProb_Rv
{
    int64 rawValue = 0ll;
    float rawValue_float = 0.0;
    float phyValue = 0.0;        

    //set the signal with updated raw value
    {
        rawValue = getvalue(this);
        if(chgEv_GW_2BD_RRC_OBJ2_ExistProb == 0)
        {
            //type conversion to float
            rawValue_float = rawValue;        
            // raw to physical conversion
            phyValue = ((rawValue_float *2)+(0));
            putValue(E_pubc_GW_GW_2BD_RRC_OBJ2_ExistProb_Pv, phyValue);
            chgEv_GW_2BD_RRC_OBJ2_ExistProb = 1;
        }
        else
        {
            chgEv_GW_2BD_RRC_OBJ2_ExistProb = 0;
        }    
        //update the signal value
        Msg_GW_2BD.RRC_OBJ2_ExistProb=rawValue;        
    }                                                                           
}
/*@@end*/

/*@@envVar:E_pubc_GW_GW_2BD_RRC_OBJ2_ExistProb_Pv:*/
on envVar E_pubc_GW_GW_2BD_RRC_OBJ2_ExistProb_Pv
{
    int64 rawValue = 0ll;
    float phyValue = 0.0;
    
    //update the raw value with physical value 
    {
        if(chgEv_GW_2BD_RRC_OBJ2_ExistProb == 0)
        {
            phyValue = getvalue(this);
            // physical to raw conversion
            rawValue = ((phyValue -(0))/2);
            putValue(E_pubc_GW_GW_2BD_RRC_OBJ2_ExistProb_Rv, rawValue);
            chgEv_GW_2BD_RRC_OBJ2_ExistProb = 1;  
        }
        else
        {
            chgEv_GW_2BD_RRC_OBJ2_ExistProb = 0;
        }
    }
}
/*@@end*/


 
/*@@envVar:E_pubc_GW_GW_2BD_RRC_OBJ4_Location_Rv:*/
on envVar E_pubc_GW_GW_2BD_RRC_OBJ4_Location_Rv
{
    int64 rawValue = 0ll;
    float rawValue_float = 0.0;
    float phyValue = 0.0;        

    //set the signal with updated raw value
    if(getValue(E_pubc_GW_GW_2BD_RRC_OBJ4_Location_SetVt)==0)
    {
        rawValue = getvalue(this);
        if(chgEv_GW_2BD_RRC_OBJ4_Location == 0)
        {
            //type conversion to float
            rawValue_float = rawValue;        
            // raw to physical conversion
            phyValue = ((rawValue_float *1)+(0));
            putValue(E_pubc_GW_GW_2BD_RRC_OBJ4_Location_Pv, phyValue);
            chgEv_GW_2BD_RRC_OBJ4_Location = 1;
        }
        else
        {
            chgEv_GW_2BD_RRC_OBJ4_Location = 0;
        }    
        //update the signal value
        Msg_GW_2BD.RRC_OBJ4_Location=rawValue;        
    }                                                                           
}
/*@@end*/

/*@@envVar:E_pubc_GW_GW_2BD_RRC_OBJ4_Location_Pv:*/
on envVar E_pubc_GW_GW_2BD_RRC_OBJ4_Location_Pv
{
    int64 rawValue = 0ll;
    float phyValue = 0.0;
    
    //update the raw value with physical value 
    if(getValue(E_pubc_GW_GW_2BD_RRC_OBJ4_Location_SetVt)==0)
    {
        if(chgEv_GW_2BD_RRC_OBJ4_Location == 0)
        {
            phyValue = getvalue(this);
            // physical to raw conversion
            rawValue = ((phyValue -(0))/1);
            putValue(E_pubc_GW_GW_2BD_RRC_OBJ4_Location_Rv, rawValue);
            chgEv_GW_2BD_RRC_OBJ4_Location = 1;  
        }
        else
        {
            chgEv_GW_2BD_RRC_OBJ4_Location = 0;
        }
    }
}
/*@@end*/

/*@@envVar:E_pubc_GW_GW_2BD_RRC_OBJ4_Location_Vt:*/
on envVar E_pubc_GW_GW_2BD_RRC_OBJ4_Location_Vt
{
    qword rawValue = 0ll;
    if(getValue(E_pubc_GW_GW_2BD_RRC_OBJ4_Location_SetVt))
    {
        //update the signal value
        Msg_GW_2BD.RRC_OBJ4_Location=getValue(this);
    }
}
/*@@end*/

/*@@envVar:E_pubc_GW_GW_2BD_RRC_OBJ4_Location_SetVt:*/
on envVar E_pubc_GW_GW_2BD_RRC_OBJ4_Location_SetVt
{
    if(getValue(E_pubc_GW_GW_2BD_RRC_OBJ4_Location_SetVt))
    {
        //update the signal value
        Msg_GW_2BD.RRC_OBJ4_Location=getvalue(E_pubc_GW_GW_2BD_RRC_OBJ4_Location_Vt);
    }
    else
    {
        Msg_GW_2BD.RRC_OBJ4_Location=getValue(E_pubc_GW_GW_2BD_RRC_OBJ4_Location_Rv);
    }
}
/*@@end*/
 
/*@@envVar:E_pubc_GW_GW_2BD_RRC_OBJ2_Length_Rv:*/
on envVar E_pubc_GW_GW_2BD_RRC_OBJ2_Length_Rv
{
    int64 rawValue = 0ll;
    float rawValue_float = 0.0;
    float phyValue = 0.0;        

    //set the signal with updated raw value
    {
        rawValue = getvalue(this);
        if(chgEv_GW_2BD_RRC_OBJ2_Length == 0)
        {
            //type conversion to float
            rawValue_float = rawValue;        
            // raw to physical conversion
            phyValue = ((rawValue_float *0.05)+(0));
            putValue(E_pubc_GW_GW_2BD_RRC_OBJ2_Length_Pv, phyValue);
            chgEv_GW_2BD_RRC_OBJ2_Length = 1;
        }
        else
        {
            chgEv_GW_2BD_RRC_OBJ2_Length = 0;
        }    
        //update the signal value
        Msg_GW_2BD.RRC_OBJ2_Length=rawValue;        
    }                                                                           
}
/*@@end*/

/*@@envVar:E_pubc_GW_GW_2BD_RRC_OBJ2_Length_Pv:*/
on envVar E_pubc_GW_GW_2BD_RRC_OBJ2_Length_Pv
{
    int64 rawValue = 0ll;
    float phyValue = 0.0;
    
    //update the raw value with physical value 
    {
        if(chgEv_GW_2BD_RRC_OBJ2_Length == 0)
        {
            phyValue = getvalue(this);
            // physical to raw conversion
            rawValue = ((phyValue -(0))/0.05);
            putValue(E_pubc_GW_GW_2BD_RRC_OBJ2_Length_Rv, rawValue);
            chgEv_GW_2BD_RRC_OBJ2_Length = 1;  
        }
        else
        {
            chgEv_GW_2BD_RRC_OBJ2_Length = 0;
        }
    }
}
/*@@end*/


 
/*@@envVar:E_pubc_GW_GW_2BD_RRC_OBJ1_Type_Rv:*/
on envVar E_pubc_GW_GW_2BD_RRC_OBJ1_Type_Rv
{
    int64 rawValue = 0ll;
    float rawValue_float = 0.0;
    float phyValue = 0.0;        

    //set the signal with updated raw value
    if(getValue(E_pubc_GW_GW_2BD_RRC_OBJ1_Type_SetVt)==0)
    {
        rawValue = getvalue(this);
        if(chgEv_GW_2BD_RRC_OBJ1_Type == 0)
        {
            //type conversion to float
            rawValue_float = rawValue;        
            // raw to physical conversion
            phyValue = ((rawValue_float *1)+(0));
            putValue(E_pubc_GW_GW_2BD_RRC_OBJ1_Type_Pv, phyValue);
            chgEv_GW_2BD_RRC_OBJ1_Type = 1;
        }
        else
        {
            chgEv_GW_2BD_RRC_OBJ1_Type = 0;
        }    
        //update the signal value
        Msg_GW_2BD.RRC_OBJ1_Type=rawValue;        
    }                                                                           
}
/*@@end*/

/*@@envVar:E_pubc_GW_GW_2BD_RRC_OBJ1_Type_Pv:*/
on envVar E_pubc_GW_GW_2BD_RRC_OBJ1_Type_Pv
{
    int64 rawValue = 0ll;
    float phyValue = 0.0;
    
    //update the raw value with physical value 
    if(getValue(E_pubc_GW_GW_2BD_RRC_OBJ1_Type_SetVt)==0)
    {
        if(chgEv_GW_2BD_RRC_OBJ1_Type == 0)
        {
            phyValue = getvalue(this);
            // physical to raw conversion
            rawValue = ((phyValue -(0))/1);
            putValue(E_pubc_GW_GW_2BD_RRC_OBJ1_Type_Rv, rawValue);
            chgEv_GW_2BD_RRC_OBJ1_Type = 1;  
        }
        else
        {
            chgEv_GW_2BD_RRC_OBJ1_Type = 0;
        }
    }
}
/*@@end*/

/*@@envVar:E_pubc_GW_GW_2BD_RRC_OBJ1_Type_Vt:*/
on envVar E_pubc_GW_GW_2BD_RRC_OBJ1_Type_Vt
{
    qword rawValue = 0ll;
    if(getValue(E_pubc_GW_GW_2BD_RRC_OBJ1_Type_SetVt))
    {
        //update the signal value
        Msg_GW_2BD.RRC_OBJ1_Type=getValue(this);
    }
}
/*@@end*/

/*@@envVar:E_pubc_GW_GW_2BD_RRC_OBJ1_Type_SetVt:*/
on envVar E_pubc_GW_GW_2BD_RRC_OBJ1_Type_SetVt
{
    if(getValue(E_pubc_GW_GW_2BD_RRC_OBJ1_Type_SetVt))
    {
        //update the signal value
        Msg_GW_2BD.RRC_OBJ1_Type=getvalue(E_pubc_GW_GW_2BD_RRC_OBJ1_Type_Vt);
    }
    else
    {
        Msg_GW_2BD.RRC_OBJ1_Type=getValue(E_pubc_GW_GW_2BD_RRC_OBJ1_Type_Rv);
    }
}
/*@@end*/
 
/*@@envVar:E_pubc_GW_GW_2BD_RRC_OBJ3_Ax_Rv:*/
on envVar E_pubc_GW_GW_2BD_RRC_OBJ3_Ax_Rv
{
    int64 rawValue = 0ll;
    float rawValue_float = 0.0;
    float phyValue = 0.0;        

    //set the signal with updated raw value
    {
        rawValue = getvalue(this);
        if(chgEv_GW_2BD_RRC_OBJ3_Ax == 0)
        {
            //type conversion to float
            rawValue_float = rawValue;        
            // raw to physical conversion
            phyValue = ((rawValue_float *0.0625)+(-16));
            putValue(E_pubc_GW_GW_2BD_RRC_OBJ3_Ax_Pv, phyValue);
            chgEv_GW_2BD_RRC_OBJ3_Ax = 1;
        }
        else
        {
            chgEv_GW_2BD_RRC_OBJ3_Ax = 0;
        }    
        //update the signal value
        Msg_GW_2BD.RRC_OBJ3_Ax=rawValue;        
    }                                                                           
}
/*@@end*/

/*@@envVar:E_pubc_GW_GW_2BD_RRC_OBJ3_Ax_Pv:*/
on envVar E_pubc_GW_GW_2BD_RRC_OBJ3_Ax_Pv
{
    int64 rawValue = 0ll;
    float phyValue = 0.0;
    
    //update the raw value with physical value 
    {
        if(chgEv_GW_2BD_RRC_OBJ3_Ax == 0)
        {
            phyValue = getvalue(this);
            // physical to raw conversion
            rawValue = ((phyValue -(-16))/0.0625);
            putValue(E_pubc_GW_GW_2BD_RRC_OBJ3_Ax_Rv, rawValue);
            chgEv_GW_2BD_RRC_OBJ3_Ax = 1;  
        }
        else
        {
            chgEv_GW_2BD_RRC_OBJ3_Ax = 0;
        }
    }
}
/*@@end*/


 
/*@@envVar:E_pubc_GW_GW_2BD_RRC_OBJ4_ExistProb_Rv:*/
on envVar E_pubc_GW_GW_2BD_RRC_OBJ4_ExistProb_Rv
{
    int64 rawValue = 0ll;
    float rawValue_float = 0.0;
    float phyValue = 0.0;        

    //set the signal with updated raw value
    {
        rawValue = getvalue(this);
        if(chgEv_GW_2BD_RRC_OBJ4_ExistProb == 0)
        {
            //type conversion to float
            rawValue_float = rawValue;        
            // raw to physical conversion
            phyValue = ((rawValue_float *2)+(0));
            putValue(E_pubc_GW_GW_2BD_RRC_OBJ4_ExistProb_Pv, phyValue);
            chgEv_GW_2BD_RRC_OBJ4_ExistProb = 1;
        }
        else
        {
            chgEv_GW_2BD_RRC_OBJ4_ExistProb = 0;
        }    
        //update the signal value
        Msg_GW_2BD.RRC_OBJ4_ExistProb=rawValue;        
    }                                                                           
}
/*@@end*/

/*@@envVar:E_pubc_GW_GW_2BD_RRC_OBJ4_ExistProb_Pv:*/
on envVar E_pubc_GW_GW_2BD_RRC_OBJ4_ExistProb_Pv
{
    int64 rawValue = 0ll;
    float phyValue = 0.0;
    
    //update the raw value with physical value 
    {
        if(chgEv_GW_2BD_RRC_OBJ4_ExistProb == 0)
        {
            phyValue = getvalue(this);
            // physical to raw conversion
            rawValue = ((phyValue -(0))/2);
            putValue(E_pubc_GW_GW_2BD_RRC_OBJ4_ExistProb_Rv, rawValue);
            chgEv_GW_2BD_RRC_OBJ4_ExistProb = 1;  
        }
        else
        {
            chgEv_GW_2BD_RRC_OBJ4_ExistProb = 0;
        }
    }
}
/*@@end*/


 
/*@@envVar:E_pubc_GW_GW_2BD_RRC_OBJ1_ExistProb_Rv:*/
on envVar E_pubc_GW_GW_2BD_RRC_OBJ1_ExistProb_Rv
{
    int64 rawValue = 0ll;
    float rawValue_float = 0.0;
    float phyValue = 0.0;        

    //set the signal with updated raw value
    {
        rawValue = getvalue(this);
        if(chgEv_GW_2BD_RRC_OBJ1_ExistProb == 0)
        {
            //type conversion to float
            rawValue_float = rawValue;        
            // raw to physical conversion
            phyValue = ((rawValue_float *2)+(0));
            putValue(E_pubc_GW_GW_2BD_RRC_OBJ1_ExistProb_Pv, phyValue);
            chgEv_GW_2BD_RRC_OBJ1_ExistProb = 1;
        }
        else
        {
            chgEv_GW_2BD_RRC_OBJ1_ExistProb = 0;
        }    
        //update the signal value
        Msg_GW_2BD.RRC_OBJ1_ExistProb=rawValue;        
    }                                                                           
}
/*@@end*/

/*@@envVar:E_pubc_GW_GW_2BD_RRC_OBJ1_ExistProb_Pv:*/
on envVar E_pubc_GW_GW_2BD_RRC_OBJ1_ExistProb_Pv
{
    int64 rawValue = 0ll;
    float phyValue = 0.0;
    
    //update the raw value with physical value 
    {
        if(chgEv_GW_2BD_RRC_OBJ1_ExistProb == 0)
        {
            phyValue = getvalue(this);
            // physical to raw conversion
            rawValue = ((phyValue -(0))/2);
            putValue(E_pubc_GW_GW_2BD_RRC_OBJ1_ExistProb_Rv, rawValue);
            chgEv_GW_2BD_RRC_OBJ1_ExistProb = 1;  
        }
        else
        {
            chgEv_GW_2BD_RRC_OBJ1_ExistProb = 0;
        }
    }
}
/*@@end*/


 
/*@@envVar:E_pubc_GW_GW_2BD_RRC_OBJ4_HeadingAngle_Rv:*/
on envVar E_pubc_GW_GW_2BD_RRC_OBJ4_HeadingAngle_Rv
{
    int64 rawValue = 0ll;
    float rawValue_float = 0.0;
    float phyValue = 0.0;        

    //set the signal with updated raw value
    {
        rawValue = getvalue(this);
        if(chgEv_GW_2BD_RRC_OBJ4_HeadingAngle == 0)
        {
            //type conversion to float
            rawValue_float = rawValue;        
            // raw to physical conversion
            phyValue = ((rawValue_float *0.01)+(-3.14));
            putValue(E_pubc_GW_GW_2BD_RRC_OBJ4_HeadingAngle_Pv, phyValue);
            chgEv_GW_2BD_RRC_OBJ4_HeadingAngle = 1;
        }
        else
        {
            chgEv_GW_2BD_RRC_OBJ4_HeadingAngle = 0;
        }    
        //update the signal value
        Msg_GW_2BD.RRC_OBJ4_HeadingAngle=rawValue;        
    }                                                                           
}
/*@@end*/

/*@@envVar:E_pubc_GW_GW_2BD_RRC_OBJ4_HeadingAngle_Pv:*/
on envVar E_pubc_GW_GW_2BD_RRC_OBJ4_HeadingAngle_Pv
{
    int64 rawValue = 0ll;
    float phyValue = 0.0;
    
    //update the raw value with physical value 
    {
        if(chgEv_GW_2BD_RRC_OBJ4_HeadingAngle == 0)
        {
            phyValue = getvalue(this);
            // physical to raw conversion
            rawValue = ((phyValue -(-3.14))/0.01);
            putValue(E_pubc_GW_GW_2BD_RRC_OBJ4_HeadingAngle_Rv, rawValue);
            chgEv_GW_2BD_RRC_OBJ4_HeadingAngle = 1;  
        }
        else
        {
            chgEv_GW_2BD_RRC_OBJ4_HeadingAngle = 0;
        }
    }
}
/*@@end*/


 
/*@@envVar:E_pubc_GW_GW_2BD_RRC_OBJ3_Type_Rv:*/
on envVar E_pubc_GW_GW_2BD_RRC_OBJ3_Type_Rv
{
    int64 rawValue = 0ll;
    float rawValue_float = 0.0;
    float phyValue = 0.0;        

    //set the signal with updated raw value
    if(getValue(E_pubc_GW_GW_2BD_RRC_OBJ3_Type_SetVt)==0)
    {
        rawValue = getvalue(this);
        if(chgEv_GW_2BD_RRC_OBJ3_Type == 0)
        {
            //type conversion to float
            rawValue_float = rawValue;        
            // raw to physical conversion
            phyValue = ((rawValue_float *1)+(0));
            putValue(E_pubc_GW_GW_2BD_RRC_OBJ3_Type_Pv, phyValue);
            chgEv_GW_2BD_RRC_OBJ3_Type = 1;
        }
        else
        {
            chgEv_GW_2BD_RRC_OBJ3_Type = 0;
        }    
        //update the signal value
        Msg_GW_2BD.RRC_OBJ3_Type=rawValue;        
    }                                                                           
}
/*@@end*/

/*@@envVar:E_pubc_GW_GW_2BD_RRC_OBJ3_Type_Pv:*/
on envVar E_pubc_GW_GW_2BD_RRC_OBJ3_Type_Pv
{
    int64 rawValue = 0ll;
    float phyValue = 0.0;
    
    //update the raw value with physical value 
    if(getValue(E_pubc_GW_GW_2BD_RRC_OBJ3_Type_SetVt)==0)
    {
        if(chgEv_GW_2BD_RRC_OBJ3_Type == 0)
        {
            phyValue = getvalue(this);
            // physical to raw conversion
            rawValue = ((phyValue -(0))/1);
            putValue(E_pubc_GW_GW_2BD_RRC_OBJ3_Type_Rv, rawValue);
            chgEv_GW_2BD_RRC_OBJ3_Type = 1;  
        }
        else
        {
            chgEv_GW_2BD_RRC_OBJ3_Type = 0;
        }
    }
}
/*@@end*/

/*@@envVar:E_pubc_GW_GW_2BD_RRC_OBJ3_Type_Vt:*/
on envVar E_pubc_GW_GW_2BD_RRC_OBJ3_Type_Vt
{
    qword rawValue = 0ll;
    if(getValue(E_pubc_GW_GW_2BD_RRC_OBJ3_Type_SetVt))
    {
        //update the signal value
        Msg_GW_2BD.RRC_OBJ3_Type=getValue(this);
    }
}
/*@@end*/

/*@@envVar:E_pubc_GW_GW_2BD_RRC_OBJ3_Type_SetVt:*/
on envVar E_pubc_GW_GW_2BD_RRC_OBJ3_Type_SetVt
{
    if(getValue(E_pubc_GW_GW_2BD_RRC_OBJ3_Type_SetVt))
    {
        //update the signal value
        Msg_GW_2BD.RRC_OBJ3_Type=getvalue(E_pubc_GW_GW_2BD_RRC_OBJ3_Type_Vt);
    }
    else
    {
        Msg_GW_2BD.RRC_OBJ3_Type=getValue(E_pubc_GW_GW_2BD_RRC_OBJ3_Type_Rv);
    }
}
/*@@end*/
 
/*@@envVar:E_pubc_GW_GW_2BD_RRC_OBJ1_Vx_Rv:*/
on envVar E_pubc_GW_GW_2BD_RRC_OBJ1_Vx_Rv
{
    int64 rawValue = 0ll;
    float rawValue_float = 0.0;
    float phyValue = 0.0;        

    //set the signal with updated raw value
    {
        rawValue = getvalue(this);
        if(chgEv_GW_2BD_RRC_OBJ1_Vx == 0)
        {
            //type conversion to float
            rawValue_float = rawValue;        
            // raw to physical conversion
            phyValue = ((rawValue_float *0.0625)+(-128));
            putValue(E_pubc_GW_GW_2BD_RRC_OBJ1_Vx_Pv, phyValue);
            chgEv_GW_2BD_RRC_OBJ1_Vx = 1;
        }
        else
        {
            chgEv_GW_2BD_RRC_OBJ1_Vx = 0;
        }    
        //update the signal value
        Msg_GW_2BD.RRC_OBJ1_Vx=rawValue;        
    }                                                                           
}
/*@@end*/

/*@@envVar:E_pubc_GW_GW_2BD_RRC_OBJ1_Vx_Pv:*/
on envVar E_pubc_GW_GW_2BD_RRC_OBJ1_Vx_Pv
{
    int64 rawValue = 0ll;
    float phyValue = 0.0;
    
    //update the raw value with physical value 
    {
        if(chgEv_GW_2BD_RRC_OBJ1_Vx == 0)
        {
            phyValue = getvalue(this);
            // physical to raw conversion
            rawValue = ((phyValue -(-128))/0.0625);
            putValue(E_pubc_GW_GW_2BD_RRC_OBJ1_Vx_Rv, rawValue);
            chgEv_GW_2BD_RRC_OBJ1_Vx = 1;  
        }
        else
        {
            chgEv_GW_2BD_RRC_OBJ1_Vx = 0;
        }
    }
}
/*@@end*/


 
/*@@envVar:E_pubc_GW_GW_2BD_RRC_OBJ3_HeadingAngle_Rv:*/
on envVar E_pubc_GW_GW_2BD_RRC_OBJ3_HeadingAngle_Rv
{
    int64 rawValue = 0ll;
    float rawValue_float = 0.0;
    float phyValue = 0.0;        

    //set the signal with updated raw value
    {
        rawValue = getvalue(this);
        if(chgEv_GW_2BD_RRC_OBJ3_HeadingAngle == 0)
        {
            //type conversion to float
            rawValue_float = rawValue;        
            // raw to physical conversion
            phyValue = ((rawValue_float *0.01)+(-3.14));
            putValue(E_pubc_GW_GW_2BD_RRC_OBJ3_HeadingAngle_Pv, phyValue);
            chgEv_GW_2BD_RRC_OBJ3_HeadingAngle = 1;
        }
        else
        {
            chgEv_GW_2BD_RRC_OBJ3_HeadingAngle = 0;
        }    
        //update the signal value
        Msg_GW_2BD.RRC_OBJ3_HeadingAngle=rawValue;        
    }                                                                           
}
/*@@end*/

/*@@envVar:E_pubc_GW_GW_2BD_RRC_OBJ3_HeadingAngle_Pv:*/
on envVar E_pubc_GW_GW_2BD_RRC_OBJ3_HeadingAngle_Pv
{
    int64 rawValue = 0ll;
    float phyValue = 0.0;
    
    //update the raw value with physical value 
    {
        if(chgEv_GW_2BD_RRC_OBJ3_HeadingAngle == 0)
        {
            phyValue = getvalue(this);
            // physical to raw conversion
            rawValue = ((phyValue -(-3.14))/0.01);
            putValue(E_pubc_GW_GW_2BD_RRC_OBJ3_HeadingAngle_Rv, rawValue);
            chgEv_GW_2BD_RRC_OBJ3_HeadingAngle = 1;  
        }
        else
        {
            chgEv_GW_2BD_RRC_OBJ3_HeadingAngle = 0;
        }
    }
}
/*@@end*/


 
/*@@envVar:E_pubc_GW_GW_2BD_RRC_OBJ4_Type_Rv:*/
on envVar E_pubc_GW_GW_2BD_RRC_OBJ4_Type_Rv
{
    int64 rawValue = 0ll;
    float rawValue_float = 0.0;
    float phyValue = 0.0;        

    //set the signal with updated raw value
    if(getValue(E_pubc_GW_GW_2BD_RRC_OBJ4_Type_SetVt)==0)
    {
        rawValue = getvalue(this);
        if(chgEv_GW_2BD_RRC_OBJ4_Type == 0)
        {
            //type conversion to float
            rawValue_float = rawValue;        
            // raw to physical conversion
            phyValue = ((rawValue_float *1)+(0));
            putValue(E_pubc_GW_GW_2BD_RRC_OBJ4_Type_Pv, phyValue);
            chgEv_GW_2BD_RRC_OBJ4_Type = 1;
        }
        else
        {
            chgEv_GW_2BD_RRC_OBJ4_Type = 0;
        }    
        //update the signal value
        Msg_GW_2BD.RRC_OBJ4_Type=rawValue;        
    }                                                                           
}
/*@@end*/

/*@@envVar:E_pubc_GW_GW_2BD_RRC_OBJ4_Type_Pv:*/
on envVar E_pubc_GW_GW_2BD_RRC_OBJ4_Type_Pv
{
    int64 rawValue = 0ll;
    float phyValue = 0.0;
    
    //update the raw value with physical value 
    if(getValue(E_pubc_GW_GW_2BD_RRC_OBJ4_Type_SetVt)==0)
    {
        if(chgEv_GW_2BD_RRC_OBJ4_Type == 0)
        {
            phyValue = getvalue(this);
            // physical to raw conversion
            rawValue = ((phyValue -(0))/1);
            putValue(E_pubc_GW_GW_2BD_RRC_OBJ4_Type_Rv, rawValue);
            chgEv_GW_2BD_RRC_OBJ4_Type = 1;  
        }
        else
        {
            chgEv_GW_2BD_RRC_OBJ4_Type = 0;
        }
    }
}
/*@@end*/

/*@@envVar:E_pubc_GW_GW_2BD_RRC_OBJ4_Type_Vt:*/
on envVar E_pubc_GW_GW_2BD_RRC_OBJ4_Type_Vt
{
    qword rawValue = 0ll;
    if(getValue(E_pubc_GW_GW_2BD_RRC_OBJ4_Type_SetVt))
    {
        //update the signal value
        Msg_GW_2BD.RRC_OBJ4_Type=getValue(this);
    }
}
/*@@end*/

/*@@envVar:E_pubc_GW_GW_2BD_RRC_OBJ4_Type_SetVt:*/
on envVar E_pubc_GW_GW_2BD_RRC_OBJ4_Type_SetVt
{
    if(getValue(E_pubc_GW_GW_2BD_RRC_OBJ4_Type_SetVt))
    {
        //update the signal value
        Msg_GW_2BD.RRC_OBJ4_Type=getvalue(E_pubc_GW_GW_2BD_RRC_OBJ4_Type_Vt);
    }
    else
    {
        Msg_GW_2BD.RRC_OBJ4_Type=getValue(E_pubc_GW_GW_2BD_RRC_OBJ4_Type_Rv);
    }
}
/*@@end*/
 
/*@@envVar:E_pubc_GW_GW_2BD_RRC_OBJ2_Track_ID_Rv:*/
on envVar E_pubc_GW_GW_2BD_RRC_OBJ2_Track_ID_Rv
{
    int64 rawValue = 0ll;
    float rawValue_float = 0.0;
    float phyValue = 0.0;        

    //set the signal with updated raw value
    {
        rawValue = getvalue(this);
        if(chgEv_GW_2BD_RRC_OBJ2_Track_ID == 0)
        {
            //type conversion to float
            rawValue_float = rawValue;        
            // raw to physical conversion
            phyValue = ((rawValue_float *1)+(0));
            putValue(E_pubc_GW_GW_2BD_RRC_OBJ2_Track_ID_Pv, phyValue);
            chgEv_GW_2BD_RRC_OBJ2_Track_ID = 1;
        }
        else
        {
            chgEv_GW_2BD_RRC_OBJ2_Track_ID = 0;
        }    
        //update the signal value
        Msg_GW_2BD.RRC_OBJ2_Track_ID=rawValue;        
    }                                                                           
}
/*@@end*/

/*@@envVar:E_pubc_GW_GW_2BD_RRC_OBJ2_Track_ID_Pv:*/
on envVar E_pubc_GW_GW_2BD_RRC_OBJ2_Track_ID_Pv
{
    int64 rawValue = 0ll;
    float phyValue = 0.0;
    
    //update the raw value with physical value 
    {
        if(chgEv_GW_2BD_RRC_OBJ2_Track_ID == 0)
        {
            phyValue = getvalue(this);
            // physical to raw conversion
            rawValue = ((phyValue -(0))/1);
            putValue(E_pubc_GW_GW_2BD_RRC_OBJ2_Track_ID_Rv, rawValue);
            chgEv_GW_2BD_RRC_OBJ2_Track_ID = 1;  
        }
        else
        {
            chgEv_GW_2BD_RRC_OBJ2_Track_ID = 0;
        }
    }
}
/*@@end*/


 
/*@@envVar:E_pubc_GW_GW_2BD_RRC_OBJ1_Ay_Rv:*/
on envVar E_pubc_GW_GW_2BD_RRC_OBJ1_Ay_Rv
{
    int64 rawValue = 0ll;
    float rawValue_float = 0.0;
    float phyValue = 0.0;        

    //set the signal with updated raw value
    {
        rawValue = getvalue(this);
        if(chgEv_GW_2BD_RRC_OBJ1_Ay == 0)
        {
            //type conversion to float
            rawValue_float = rawValue;        
            // raw to physical conversion
            phyValue = ((rawValue_float *0.03125)+(-16));
            putValue(E_pubc_GW_GW_2BD_RRC_OBJ1_Ay_Pv, phyValue);
            chgEv_GW_2BD_RRC_OBJ1_Ay = 1;
        }
        else
        {
            chgEv_GW_2BD_RRC_OBJ1_Ay = 0;
        }    
        //update the signal value
        Msg_GW_2BD.RRC_OBJ1_Ay=rawValue;        
    }                                                                           
}
/*@@end*/

/*@@envVar:E_pubc_GW_GW_2BD_RRC_OBJ1_Ay_Pv:*/
on envVar E_pubc_GW_GW_2BD_RRC_OBJ1_Ay_Pv
{
    int64 rawValue = 0ll;
    float phyValue = 0.0;
    
    //update the raw value with physical value 
    {
        if(chgEv_GW_2BD_RRC_OBJ1_Ay == 0)
        {
            phyValue = getvalue(this);
            // physical to raw conversion
            rawValue = ((phyValue -(-16))/0.03125);
            putValue(E_pubc_GW_GW_2BD_RRC_OBJ1_Ay_Rv, rawValue);
            chgEv_GW_2BD_RRC_OBJ1_Ay = 1;  
        }
        else
        {
            chgEv_GW_2BD_RRC_OBJ1_Ay = 0;
        }
    }
}
/*@@end*/


 
/*@@envVar:E_pubc_GW_GW_2BD_RRC_OBJ1_Ax_Rv:*/
on envVar E_pubc_GW_GW_2BD_RRC_OBJ1_Ax_Rv
{
    int64 rawValue = 0ll;
    float rawValue_float = 0.0;
    float phyValue = 0.0;        

    //set the signal with updated raw value
    {
        rawValue = getvalue(this);
        if(chgEv_GW_2BD_RRC_OBJ1_Ax == 0)
        {
            //type conversion to float
            rawValue_float = rawValue;        
            // raw to physical conversion
            phyValue = ((rawValue_float *0.0625)+(-16));
            putValue(E_pubc_GW_GW_2BD_RRC_OBJ1_Ax_Pv, phyValue);
            chgEv_GW_2BD_RRC_OBJ1_Ax = 1;
        }
        else
        {
            chgEv_GW_2BD_RRC_OBJ1_Ax = 0;
        }    
        //update the signal value
        Msg_GW_2BD.RRC_OBJ1_Ax=rawValue;        
    }                                                                           
}
/*@@end*/

/*@@envVar:E_pubc_GW_GW_2BD_RRC_OBJ1_Ax_Pv:*/
on envVar E_pubc_GW_GW_2BD_RRC_OBJ1_Ax_Pv
{
    int64 rawValue = 0ll;
    float phyValue = 0.0;
    
    //update the raw value with physical value 
    {
        if(chgEv_GW_2BD_RRC_OBJ1_Ax == 0)
        {
            phyValue = getvalue(this);
            // physical to raw conversion
            rawValue = ((phyValue -(-16))/0.0625);
            putValue(E_pubc_GW_GW_2BD_RRC_OBJ1_Ax_Rv, rawValue);
            chgEv_GW_2BD_RRC_OBJ1_Ax = 1;  
        }
        else
        {
            chgEv_GW_2BD_RRC_OBJ1_Ax = 0;
        }
    }
}
/*@@end*/


 
/*@@envVar:E_pubc_GW_GW_2BD_RRC_OBJ3_ExistProb_Rv:*/
on envVar E_pubc_GW_GW_2BD_RRC_OBJ3_ExistProb_Rv
{
    int64 rawValue = 0ll;
    float rawValue_float = 0.0;
    float phyValue = 0.0;        

    //set the signal with updated raw value
    {
        rawValue = getvalue(this);
        if(chgEv_GW_2BD_RRC_OBJ3_ExistProb == 0)
        {
            //type conversion to float
            rawValue_float = rawValue;        
            // raw to physical conversion
            phyValue = ((rawValue_float *2)+(0));
            putValue(E_pubc_GW_GW_2BD_RRC_OBJ3_ExistProb_Pv, phyValue);
            chgEv_GW_2BD_RRC_OBJ3_ExistProb = 1;
        }
        else
        {
            chgEv_GW_2BD_RRC_OBJ3_ExistProb = 0;
        }    
        //update the signal value
        Msg_GW_2BD.RRC_OBJ3_ExistProb=rawValue;        
    }                                                                           
}
/*@@end*/

/*@@envVar:E_pubc_GW_GW_2BD_RRC_OBJ3_ExistProb_Pv:*/
on envVar E_pubc_GW_GW_2BD_RRC_OBJ3_ExistProb_Pv
{
    int64 rawValue = 0ll;
    float phyValue = 0.0;
    
    //update the raw value with physical value 
    {
        if(chgEv_GW_2BD_RRC_OBJ3_ExistProb == 0)
        {
            phyValue = getvalue(this);
            // physical to raw conversion
            rawValue = ((phyValue -(0))/2);
            putValue(E_pubc_GW_GW_2BD_RRC_OBJ3_ExistProb_Rv, rawValue);
            chgEv_GW_2BD_RRC_OBJ3_ExistProb = 1;  
        }
        else
        {
            chgEv_GW_2BD_RRC_OBJ3_ExistProb = 0;
        }
    }
}
/*@@end*/


 
/*@@envVar:E_pubc_GW_GW_2BD_RRC_OBJ3_Length_Rv:*/
on envVar E_pubc_GW_GW_2BD_RRC_OBJ3_Length_Rv
{
    int64 rawValue = 0ll;
    float rawValue_float = 0.0;
    float phyValue = 0.0;        

    //set the signal with updated raw value
    {
        rawValue = getvalue(this);
        if(chgEv_GW_2BD_RRC_OBJ3_Length == 0)
        {
            //type conversion to float
            rawValue_float = rawValue;        
            // raw to physical conversion
            phyValue = ((rawValue_float *0.05)+(0));
            putValue(E_pubc_GW_GW_2BD_RRC_OBJ3_Length_Pv, phyValue);
            chgEv_GW_2BD_RRC_OBJ3_Length = 1;
        }
        else
        {
            chgEv_GW_2BD_RRC_OBJ3_Length = 0;
        }    
        //update the signal value
        Msg_GW_2BD.RRC_OBJ3_Length=rawValue;        
    }                                                                           
}
/*@@end*/

/*@@envVar:E_pubc_GW_GW_2BD_RRC_OBJ3_Length_Pv:*/
on envVar E_pubc_GW_GW_2BD_RRC_OBJ3_Length_Pv
{
    int64 rawValue = 0ll;
    float phyValue = 0.0;
    
    //update the raw value with physical value 
    {
        if(chgEv_GW_2BD_RRC_OBJ3_Length == 0)
        {
            phyValue = getvalue(this);
            // physical to raw conversion
            rawValue = ((phyValue -(0))/0.05);
            putValue(E_pubc_GW_GW_2BD_RRC_OBJ3_Length_Rv, rawValue);
            chgEv_GW_2BD_RRC_OBJ3_Length = 1;  
        }
        else
        {
            chgEv_GW_2BD_RRC_OBJ3_Length = 0;
        }
    }
}
/*@@end*/


 
/*@@envVar:E_pubc_GW_GW_2BD_RRC_OBJ1_Vy_Rv:*/
on envVar E_pubc_GW_GW_2BD_RRC_OBJ1_Vy_Rv
{
    int64 rawValue = 0ll;
    float rawValue_float = 0.0;
    float phyValue = 0.0;        

    //set the signal with updated raw value
    {
        rawValue = getvalue(this);
        if(chgEv_GW_2BD_RRC_OBJ1_Vy == 0)
        {
            //type conversion to float
            rawValue_float = rawValue;        
            // raw to physical conversion
            phyValue = ((rawValue_float *0.125)+(-64));
            putValue(E_pubc_GW_GW_2BD_RRC_OBJ1_Vy_Pv, phyValue);
            chgEv_GW_2BD_RRC_OBJ1_Vy = 1;
        }
        else
        {
            chgEv_GW_2BD_RRC_OBJ1_Vy = 0;
        }    
        //update the signal value
        Msg_GW_2BD.RRC_OBJ1_Vy=rawValue;        
    }                                                                           
}
/*@@end*/

/*@@envVar:E_pubc_GW_GW_2BD_RRC_OBJ1_Vy_Pv:*/
on envVar E_pubc_GW_GW_2BD_RRC_OBJ1_Vy_Pv
{
    int64 rawValue = 0ll;
    float phyValue = 0.0;
    
    //update the raw value with physical value 
    {
        if(chgEv_GW_2BD_RRC_OBJ1_Vy == 0)
        {
            phyValue = getvalue(this);
            // physical to raw conversion
            rawValue = ((phyValue -(-64))/0.125);
            putValue(E_pubc_GW_GW_2BD_RRC_OBJ1_Vy_Rv, rawValue);
            chgEv_GW_2BD_RRC_OBJ1_Vy = 1;  
        }
        else
        {
            chgEv_GW_2BD_RRC_OBJ1_Vy = 0;
        }
    }
}
/*@@end*/


 
/*@@envVar:E_pubc_GW_GW_2BD_RRC_OBJ3_Measured_Rv:*/
on envVar E_pubc_GW_GW_2BD_RRC_OBJ3_Measured_Rv
{
    int64 rawValue = 0ll;
    float rawValue_float = 0.0;
    float phyValue = 0.0;        

    //set the signal with updated raw value
    if(getValue(E_pubc_GW_GW_2BD_RRC_OBJ3_Measured_SetVt)==0)
    {
        rawValue = getvalue(this);
        if(chgEv_GW_2BD_RRC_OBJ3_Measured == 0)
        {
            //type conversion to float
            rawValue_float = rawValue;        
            // raw to physical conversion
            phyValue = ((rawValue_float *1)+(0));
            putValue(E_pubc_GW_GW_2BD_RRC_OBJ3_Measured_Pv, phyValue);
            chgEv_GW_2BD_RRC_OBJ3_Measured = 1;
        }
        else
        {
            chgEv_GW_2BD_RRC_OBJ3_Measured = 0;
        }    
        //update the signal value
        Msg_GW_2BD.RRC_OBJ3_Measured=rawValue;        
    }                                                                           
}
/*@@end*/

/*@@envVar:E_pubc_GW_GW_2BD_RRC_OBJ3_Measured_Pv:*/
on envVar E_pubc_GW_GW_2BD_RRC_OBJ3_Measured_Pv
{
    int64 rawValue = 0ll;
    float phyValue = 0.0;
    
    //update the raw value with physical value 
    if(getValue(E_pubc_GW_GW_2BD_RRC_OBJ3_Measured_SetVt)==0)
    {
        if(chgEv_GW_2BD_RRC_OBJ3_Measured == 0)
        {
            phyValue = getvalue(this);
            // physical to raw conversion
            rawValue = ((phyValue -(0))/1);
            putValue(E_pubc_GW_GW_2BD_RRC_OBJ3_Measured_Rv, rawValue);
            chgEv_GW_2BD_RRC_OBJ3_Measured = 1;  
        }
        else
        {
            chgEv_GW_2BD_RRC_OBJ3_Measured = 0;
        }
    }
}
/*@@end*/

/*@@envVar:E_pubc_GW_GW_2BD_RRC_OBJ3_Measured_Vt:*/
on envVar E_pubc_GW_GW_2BD_RRC_OBJ3_Measured_Vt
{
    qword rawValue = 0ll;
    if(getValue(E_pubc_GW_GW_2BD_RRC_OBJ3_Measured_SetVt))
    {
        //update the signal value
        Msg_GW_2BD.RRC_OBJ3_Measured=getValue(this);
    }
}
/*@@end*/

/*@@envVar:E_pubc_GW_GW_2BD_RRC_OBJ3_Measured_SetVt:*/
on envVar E_pubc_GW_GW_2BD_RRC_OBJ3_Measured_SetVt
{
    if(getValue(E_pubc_GW_GW_2BD_RRC_OBJ3_Measured_SetVt))
    {
        //update the signal value
        Msg_GW_2BD.RRC_OBJ3_Measured=getvalue(E_pubc_GW_GW_2BD_RRC_OBJ3_Measured_Vt);
    }
    else
    {
        Msg_GW_2BD.RRC_OBJ3_Measured=getValue(E_pubc_GW_GW_2BD_RRC_OBJ3_Measured_Rv);
    }
}
/*@@end*/
 
/*@@envVar:E_pubc_GW_GW_2BD_RRC_OBJ3_Width_Rv:*/
on envVar E_pubc_GW_GW_2BD_RRC_OBJ3_Width_Rv
{
    int64 rawValue = 0ll;
    float rawValue_float = 0.0;
    float phyValue = 0.0;        

    //set the signal with updated raw value
    {
        rawValue = getvalue(this);
        if(chgEv_GW_2BD_RRC_OBJ3_Width == 0)
        {
            //type conversion to float
            rawValue_float = rawValue;        
            // raw to physical conversion
            phyValue = ((rawValue_float *0.01)+(0));
            putValue(E_pubc_GW_GW_2BD_RRC_OBJ3_Width_Pv, phyValue);
            chgEv_GW_2BD_RRC_OBJ3_Width = 1;
        }
        else
        {
            chgEv_GW_2BD_RRC_OBJ3_Width = 0;
        }    
        //update the signal value
        Msg_GW_2BD.RRC_OBJ3_Width=rawValue;        
    }                                                                           
}
/*@@end*/

/*@@envVar:E_pubc_GW_GW_2BD_RRC_OBJ3_Width_Pv:*/
on envVar E_pubc_GW_GW_2BD_RRC_OBJ3_Width_Pv
{
    int64 rawValue = 0ll;
    float phyValue = 0.0;
    
    //update the raw value with physical value 
    {
        if(chgEv_GW_2BD_RRC_OBJ3_Width == 0)
        {
            phyValue = getvalue(this);
            // physical to raw conversion
            rawValue = ((phyValue -(0))/0.01);
            putValue(E_pubc_GW_GW_2BD_RRC_OBJ3_Width_Rv, rawValue);
            chgEv_GW_2BD_RRC_OBJ3_Width = 1;  
        }
        else
        {
            chgEv_GW_2BD_RRC_OBJ3_Width = 0;
        }
    }
}
/*@@end*/


 
/*@@envVar:E_pubc_GW_GW_2BD_RRC_OBJ2_Vy_Rv:*/
on envVar E_pubc_GW_GW_2BD_RRC_OBJ2_Vy_Rv
{
    int64 rawValue = 0ll;
    float rawValue_float = 0.0;
    float phyValue = 0.0;        

    //set the signal with updated raw value
    {
        rawValue = getvalue(this);
        if(chgEv_GW_2BD_RRC_OBJ2_Vy == 0)
        {
            //type conversion to float
            rawValue_float = rawValue;        
            // raw to physical conversion
            phyValue = ((rawValue_float *0.125)+(-64));
            putValue(E_pubc_GW_GW_2BD_RRC_OBJ2_Vy_Pv, phyValue);
            chgEv_GW_2BD_RRC_OBJ2_Vy = 1;
        }
        else
        {
            chgEv_GW_2BD_RRC_OBJ2_Vy = 0;
        }    
        //update the signal value
        Msg_GW_2BD.RRC_OBJ2_Vy=rawValue;        
    }                                                                           
}
/*@@end*/

/*@@envVar:E_pubc_GW_GW_2BD_RRC_OBJ2_Vy_Pv:*/
on envVar E_pubc_GW_GW_2BD_RRC_OBJ2_Vy_Pv
{
    int64 rawValue = 0ll;
    float phyValue = 0.0;
    
    //update the raw value with physical value 
    {
        if(chgEv_GW_2BD_RRC_OBJ2_Vy == 0)
        {
            phyValue = getvalue(this);
            // physical to raw conversion
            rawValue = ((phyValue -(-64))/0.125);
            putValue(E_pubc_GW_GW_2BD_RRC_OBJ2_Vy_Rv, rawValue);
            chgEv_GW_2BD_RRC_OBJ2_Vy = 1;  
        }
        else
        {
            chgEv_GW_2BD_RRC_OBJ2_Vy = 0;
        }
    }
}
/*@@end*/


 
/*@@envVar:E_pubc_GW_GW_2BD_RRC_OBJ2_Vx_Rv:*/
on envVar E_pubc_GW_GW_2BD_RRC_OBJ2_Vx_Rv
{
    int64 rawValue = 0ll;
    float rawValue_float = 0.0;
    float phyValue = 0.0;        

    //set the signal with updated raw value
    {
        rawValue = getvalue(this);
        if(chgEv_GW_2BD_RRC_OBJ2_Vx == 0)
        {
            //type conversion to float
            rawValue_float = rawValue;        
            // raw to physical conversion
            phyValue = ((rawValue_float *0.0625)+(-128));
            putValue(E_pubc_GW_GW_2BD_RRC_OBJ2_Vx_Pv, phyValue);
            chgEv_GW_2BD_RRC_OBJ2_Vx = 1;
        }
        else
        {
            chgEv_GW_2BD_RRC_OBJ2_Vx = 0;
        }    
        //update the signal value
        Msg_GW_2BD.RRC_OBJ2_Vx=rawValue;        
    }                                                                           
}
/*@@end*/

/*@@envVar:E_pubc_GW_GW_2BD_RRC_OBJ2_Vx_Pv:*/
on envVar E_pubc_GW_GW_2BD_RRC_OBJ2_Vx_Pv
{
    int64 rawValue = 0ll;
    float phyValue = 0.0;
    
    //update the raw value with physical value 
    {
        if(chgEv_GW_2BD_RRC_OBJ2_Vx == 0)
        {
            phyValue = getvalue(this);
            // physical to raw conversion
            rawValue = ((phyValue -(-128))/0.0625);
            putValue(E_pubc_GW_GW_2BD_RRC_OBJ2_Vx_Rv, rawValue);
            chgEv_GW_2BD_RRC_OBJ2_Vx = 1;  
        }
        else
        {
            chgEv_GW_2BD_RRC_OBJ2_Vx = 0;
        }
    }
}
/*@@end*/


 
/*@@envVar:E_pubc_GW_GW_2BD_RRC_OBJ1_ObstacleProb_Rv:*/
on envVar E_pubc_GW_GW_2BD_RRC_OBJ1_ObstacleProb_Rv
{
    int64 rawValue = 0ll;
    float rawValue_float = 0.0;
    float phyValue = 0.0;        

    //set the signal with updated raw value
    {
        rawValue = getvalue(this);
        if(chgEv_GW_2BD_RRC_OBJ1_ObstacleProb == 0)
        {
            //type conversion to float
            rawValue_float = rawValue;        
            // raw to physical conversion
            phyValue = ((rawValue_float *2)+(0));
            putValue(E_pubc_GW_GW_2BD_RRC_OBJ1_ObstacleProb_Pv, phyValue);
            chgEv_GW_2BD_RRC_OBJ1_ObstacleProb = 1;
        }
        else
        {
            chgEv_GW_2BD_RRC_OBJ1_ObstacleProb = 0;
        }    
        //update the signal value
        Msg_GW_2BD.RRC_OBJ1_ObstacleProb=rawValue;        
    }                                                                           
}
/*@@end*/

/*@@envVar:E_pubc_GW_GW_2BD_RRC_OBJ1_ObstacleProb_Pv:*/
on envVar E_pubc_GW_GW_2BD_RRC_OBJ1_ObstacleProb_Pv
{
    int64 rawValue = 0ll;
    float phyValue = 0.0;
    
    //update the raw value with physical value 
    {
        if(chgEv_GW_2BD_RRC_OBJ1_ObstacleProb == 0)
        {
            phyValue = getvalue(this);
            // physical to raw conversion
            rawValue = ((phyValue -(0))/2);
            putValue(E_pubc_GW_GW_2BD_RRC_OBJ1_ObstacleProb_Rv, rawValue);
            chgEv_GW_2BD_RRC_OBJ1_ObstacleProb = 1;  
        }
        else
        {
            chgEv_GW_2BD_RRC_OBJ1_ObstacleProb = 0;
        }
    }
}
/*@@end*/


 
/*@@envVar:E_pubc_GW_GW_2BD_RRC_OBJ1_HeadingAngle_Rv:*/
on envVar E_pubc_GW_GW_2BD_RRC_OBJ1_HeadingAngle_Rv
{
    int64 rawValue = 0ll;
    float rawValue_float = 0.0;
    float phyValue = 0.0;        

    //set the signal with updated raw value
    {
        rawValue = getvalue(this);
        if(chgEv_GW_2BD_RRC_OBJ1_HeadingAngle == 0)
        {
            //type conversion to float
            rawValue_float = rawValue;        
            // raw to physical conversion
            phyValue = ((rawValue_float *0.01)+(-3.14));
            putValue(E_pubc_GW_GW_2BD_RRC_OBJ1_HeadingAngle_Pv, phyValue);
            chgEv_GW_2BD_RRC_OBJ1_HeadingAngle = 1;
        }
        else
        {
            chgEv_GW_2BD_RRC_OBJ1_HeadingAngle = 0;
        }    
        //update the signal value
        Msg_GW_2BD.RRC_OBJ1_HeadingAngle=rawValue;        
    }                                                                           
}
/*@@end*/

/*@@envVar:E_pubc_GW_GW_2BD_RRC_OBJ1_HeadingAngle_Pv:*/
on envVar E_pubc_GW_GW_2BD_RRC_OBJ1_HeadingAngle_Pv
{
    int64 rawValue = 0ll;
    float phyValue = 0.0;
    
    //update the raw value with physical value 
    {
        if(chgEv_GW_2BD_RRC_OBJ1_HeadingAngle == 0)
        {
            phyValue = getvalue(this);
            // physical to raw conversion
            rawValue = ((phyValue -(-3.14))/0.01);
            putValue(E_pubc_GW_GW_2BD_RRC_OBJ1_HeadingAngle_Rv, rawValue);
            chgEv_GW_2BD_RRC_OBJ1_HeadingAngle = 1;  
        }
        else
        {
            chgEv_GW_2BD_RRC_OBJ1_HeadingAngle = 0;
        }
    }
}
/*@@end*/


 
/*@@envVar:E_pubc_GW_GW_2BD_RRC_OBJ3_Dx_Rv:*/
on envVar E_pubc_GW_GW_2BD_RRC_OBJ3_Dx_Rv
{
    int64 rawValue = 0ll;
    float rawValue_float = 0.0;
    float phyValue = 0.0;        

    //set the signal with updated raw value
    {
        rawValue = getvalue(this);
        if(chgEv_GW_2BD_RRC_OBJ3_Dx == 0)
        {
            //type conversion to float
            rawValue_float = rawValue;        
            // raw to physical conversion
            phyValue = ((rawValue_float *0.0625)+(-256));
            putValue(E_pubc_GW_GW_2BD_RRC_OBJ3_Dx_Pv, phyValue);
            chgEv_GW_2BD_RRC_OBJ3_Dx = 1;
        }
        else
        {
            chgEv_GW_2BD_RRC_OBJ3_Dx = 0;
        }    
        //update the signal value
        Msg_GW_2BD.RRC_OBJ3_Dx=rawValue;        
    }                                                                           
}
/*@@end*/

/*@@envVar:E_pubc_GW_GW_2BD_RRC_OBJ3_Dx_Pv:*/
on envVar E_pubc_GW_GW_2BD_RRC_OBJ3_Dx_Pv
{
    int64 rawValue = 0ll;
    float phyValue = 0.0;
    
    //update the raw value with physical value 
    {
        if(chgEv_GW_2BD_RRC_OBJ3_Dx == 0)
        {
            phyValue = getvalue(this);
            // physical to raw conversion
            rawValue = ((phyValue -(-256))/0.0625);
            putValue(E_pubc_GW_GW_2BD_RRC_OBJ3_Dx_Rv, rawValue);
            chgEv_GW_2BD_RRC_OBJ3_Dx = 1;  
        }
        else
        {
            chgEv_GW_2BD_RRC_OBJ3_Dx = 0;
        }
    }
}
/*@@end*/


 
/*@@envVar:E_pubc_GW_GW_2BD_RRC_OBJ3_Dy_Rv:*/
on envVar E_pubc_GW_GW_2BD_RRC_OBJ3_Dy_Rv
{
    int64 rawValue = 0ll;
    float rawValue_float = 0.0;
    float phyValue = 0.0;        

    //set the signal with updated raw value
    {
        rawValue = getvalue(this);
        if(chgEv_GW_2BD_RRC_OBJ3_Dy == 0)
        {
            //type conversion to float
            rawValue_float = rawValue;        
            // raw to physical conversion
            phyValue = ((rawValue_float *0.125)+(-128));
            putValue(E_pubc_GW_GW_2BD_RRC_OBJ3_Dy_Pv, phyValue);
            chgEv_GW_2BD_RRC_OBJ3_Dy = 1;
        }
        else
        {
            chgEv_GW_2BD_RRC_OBJ3_Dy = 0;
        }    
        //update the signal value
        Msg_GW_2BD.RRC_OBJ3_Dy=rawValue;        
    }                                                                           
}
/*@@end*/

/*@@envVar:E_pubc_GW_GW_2BD_RRC_OBJ3_Dy_Pv:*/
on envVar E_pubc_GW_GW_2BD_RRC_OBJ3_Dy_Pv
{
    int64 rawValue = 0ll;
    float phyValue = 0.0;
    
    //update the raw value with physical value 
    {
        if(chgEv_GW_2BD_RRC_OBJ3_Dy == 0)
        {
            phyValue = getvalue(this);
            // physical to raw conversion
            rawValue = ((phyValue -(-128))/0.125);
            putValue(E_pubc_GW_GW_2BD_RRC_OBJ3_Dy_Rv, rawValue);
            chgEv_GW_2BD_RRC_OBJ3_Dy = 1;  
        }
        else
        {
            chgEv_GW_2BD_RRC_OBJ3_Dy = 0;
        }
    }
}
/*@@end*/


 
/*@@envVar:E_pubc_GW_GW_2BD_RRC_OBJ3_Location_Rv:*/
on envVar E_pubc_GW_GW_2BD_RRC_OBJ3_Location_Rv
{
    int64 rawValue = 0ll;
    float rawValue_float = 0.0;
    float phyValue = 0.0;        

    //set the signal with updated raw value
    if(getValue(E_pubc_GW_GW_2BD_RRC_OBJ3_Location_SetVt)==0)
    {
        rawValue = getvalue(this);
        if(chgEv_GW_2BD_RRC_OBJ3_Location == 0)
        {
            //type conversion to float
            rawValue_float = rawValue;        
            // raw to physical conversion
            phyValue = ((rawValue_float *1)+(0));
            putValue(E_pubc_GW_GW_2BD_RRC_OBJ3_Location_Pv, phyValue);
            chgEv_GW_2BD_RRC_OBJ3_Location = 1;
        }
        else
        {
            chgEv_GW_2BD_RRC_OBJ3_Location = 0;
        }    
        //update the signal value
        Msg_GW_2BD.RRC_OBJ3_Location=rawValue;        
    }                                                                           
}
/*@@end*/

/*@@envVar:E_pubc_GW_GW_2BD_RRC_OBJ3_Location_Pv:*/
on envVar E_pubc_GW_GW_2BD_RRC_OBJ3_Location_Pv
{
    int64 rawValue = 0ll;
    float phyValue = 0.0;
    
    //update the raw value with physical value 
    if(getValue(E_pubc_GW_GW_2BD_RRC_OBJ3_Location_SetVt)==0)
    {
        if(chgEv_GW_2BD_RRC_OBJ3_Location == 0)
        {
            phyValue = getvalue(this);
            // physical to raw conversion
            rawValue = ((phyValue -(0))/1);
            putValue(E_pubc_GW_GW_2BD_RRC_OBJ3_Location_Rv, rawValue);
            chgEv_GW_2BD_RRC_OBJ3_Location = 1;  
        }
        else
        {
            chgEv_GW_2BD_RRC_OBJ3_Location = 0;
        }
    }
}
/*@@end*/

/*@@envVar:E_pubc_GW_GW_2BD_RRC_OBJ3_Location_Vt:*/
on envVar E_pubc_GW_GW_2BD_RRC_OBJ3_Location_Vt
{
    qword rawValue = 0ll;
    if(getValue(E_pubc_GW_GW_2BD_RRC_OBJ3_Location_SetVt))
    {
        //update the signal value
        Msg_GW_2BD.RRC_OBJ3_Location=getValue(this);
    }
}
/*@@end*/

/*@@envVar:E_pubc_GW_GW_2BD_RRC_OBJ3_Location_SetVt:*/
on envVar E_pubc_GW_GW_2BD_RRC_OBJ3_Location_SetVt
{
    if(getValue(E_pubc_GW_GW_2BD_RRC_OBJ3_Location_SetVt))
    {
        //update the signal value
        Msg_GW_2BD.RRC_OBJ3_Location=getvalue(E_pubc_GW_GW_2BD_RRC_OBJ3_Location_Vt);
    }
    else
    {
        Msg_GW_2BD.RRC_OBJ3_Location=getValue(E_pubc_GW_GW_2BD_RRC_OBJ3_Location_Rv);
    }
}
/*@@end*/
 
/*@@envVar:E_pubc_GW_GW_2BD_RRC_OBJ4_Dy_Rv:*/
on envVar E_pubc_GW_GW_2BD_RRC_OBJ4_Dy_Rv
{
    int64 rawValue = 0ll;
    float rawValue_float = 0.0;
    float phyValue = 0.0;        

    //set the signal with updated raw value
    {
        rawValue = getvalue(this);
        if(chgEv_GW_2BD_RRC_OBJ4_Dy == 0)
        {
            //type conversion to float
            rawValue_float = rawValue;        
            // raw to physical conversion
            phyValue = ((rawValue_float *0.125)+(-128));
            putValue(E_pubc_GW_GW_2BD_RRC_OBJ4_Dy_Pv, phyValue);
            chgEv_GW_2BD_RRC_OBJ4_Dy = 1;
        }
        else
        {
            chgEv_GW_2BD_RRC_OBJ4_Dy = 0;
        }    
        //update the signal value
        Msg_GW_2BD.RRC_OBJ4_Dy=rawValue;        
    }                                                                           
}
/*@@end*/

/*@@envVar:E_pubc_GW_GW_2BD_RRC_OBJ4_Dy_Pv:*/
on envVar E_pubc_GW_GW_2BD_RRC_OBJ4_Dy_Pv
{
    int64 rawValue = 0ll;
    float phyValue = 0.0;
    
    //update the raw value with physical value 
    {
        if(chgEv_GW_2BD_RRC_OBJ4_Dy == 0)
        {
            phyValue = getvalue(this);
            // physical to raw conversion
            rawValue = ((phyValue -(-128))/0.125);
            putValue(E_pubc_GW_GW_2BD_RRC_OBJ4_Dy_Rv, rawValue);
            chgEv_GW_2BD_RRC_OBJ4_Dy = 1;  
        }
        else
        {
            chgEv_GW_2BD_RRC_OBJ4_Dy = 0;
        }
    }
}
/*@@end*/


 
/*@@envVar:E_pubc_GW_GW_2BD_RRC_OBJ4_Dx_Rv:*/
on envVar E_pubc_GW_GW_2BD_RRC_OBJ4_Dx_Rv
{
    int64 rawValue = 0ll;
    float rawValue_float = 0.0;
    float phyValue = 0.0;        

    //set the signal with updated raw value
    {
        rawValue = getvalue(this);
        if(chgEv_GW_2BD_RRC_OBJ4_Dx == 0)
        {
            //type conversion to float
            rawValue_float = rawValue;        
            // raw to physical conversion
            phyValue = ((rawValue_float *0.0625)+(-256));
            putValue(E_pubc_GW_GW_2BD_RRC_OBJ4_Dx_Pv, phyValue);
            chgEv_GW_2BD_RRC_OBJ4_Dx = 1;
        }
        else
        {
            chgEv_GW_2BD_RRC_OBJ4_Dx = 0;
        }    
        //update the signal value
        Msg_GW_2BD.RRC_OBJ4_Dx=rawValue;        
    }                                                                           
}
/*@@end*/

/*@@envVar:E_pubc_GW_GW_2BD_RRC_OBJ4_Dx_Pv:*/
on envVar E_pubc_GW_GW_2BD_RRC_OBJ4_Dx_Pv
{
    int64 rawValue = 0ll;
    float phyValue = 0.0;
    
    //update the raw value with physical value 
    {
        if(chgEv_GW_2BD_RRC_OBJ4_Dx == 0)
        {
            phyValue = getvalue(this);
            // physical to raw conversion
            rawValue = ((phyValue -(-256))/0.0625);
            putValue(E_pubc_GW_GW_2BD_RRC_OBJ4_Dx_Rv, rawValue);
            chgEv_GW_2BD_RRC_OBJ4_Dx = 1;  
        }
        else
        {
            chgEv_GW_2BD_RRC_OBJ4_Dx = 0;
        }
    }
}
/*@@end*/


 
/*@@envVar:E_pubc_GW_GW_2BD_RRC_OBJ2_Location_Rv:*/
on envVar E_pubc_GW_GW_2BD_RRC_OBJ2_Location_Rv
{
    int64 rawValue = 0ll;
    float rawValue_float = 0.0;
    float phyValue = 0.0;        

    //set the signal with updated raw value
    if(getValue(E_pubc_GW_GW_2BD_RRC_OBJ2_Location_SetVt)==0)
    {
        rawValue = getvalue(this);
        if(chgEv_GW_2BD_RRC_OBJ2_Location == 0)
        {
            //type conversion to float
            rawValue_float = rawValue;        
            // raw to physical conversion
            phyValue = ((rawValue_float *1)+(0));
            putValue(E_pubc_GW_GW_2BD_RRC_OBJ2_Location_Pv, phyValue);
            chgEv_GW_2BD_RRC_OBJ2_Location = 1;
        }
        else
        {
            chgEv_GW_2BD_RRC_OBJ2_Location = 0;
        }    
        //update the signal value
        Msg_GW_2BD.RRC_OBJ2_Location=rawValue;        
    }                                                                           
}
/*@@end*/

/*@@envVar:E_pubc_GW_GW_2BD_RRC_OBJ2_Location_Pv:*/
on envVar E_pubc_GW_GW_2BD_RRC_OBJ2_Location_Pv
{
    int64 rawValue = 0ll;
    float phyValue = 0.0;
    
    //update the raw value with physical value 
    if(getValue(E_pubc_GW_GW_2BD_RRC_OBJ2_Location_SetVt)==0)
    {
        if(chgEv_GW_2BD_RRC_OBJ2_Location == 0)
        {
            phyValue = getvalue(this);
            // physical to raw conversion
            rawValue = ((phyValue -(0))/1);
            putValue(E_pubc_GW_GW_2BD_RRC_OBJ2_Location_Rv, rawValue);
            chgEv_GW_2BD_RRC_OBJ2_Location = 1;  
        }
        else
        {
            chgEv_GW_2BD_RRC_OBJ2_Location = 0;
        }
    }
}
/*@@end*/

/*@@envVar:E_pubc_GW_GW_2BD_RRC_OBJ2_Location_Vt:*/
on envVar E_pubc_GW_GW_2BD_RRC_OBJ2_Location_Vt
{
    qword rawValue = 0ll;
    if(getValue(E_pubc_GW_GW_2BD_RRC_OBJ2_Location_SetVt))
    {
        //update the signal value
        Msg_GW_2BD.RRC_OBJ2_Location=getValue(this);
    }
}
/*@@end*/

/*@@envVar:E_pubc_GW_GW_2BD_RRC_OBJ2_Location_SetVt:*/
on envVar E_pubc_GW_GW_2BD_RRC_OBJ2_Location_SetVt
{
    if(getValue(E_pubc_GW_GW_2BD_RRC_OBJ2_Location_SetVt))
    {
        //update the signal value
        Msg_GW_2BD.RRC_OBJ2_Location=getvalue(E_pubc_GW_GW_2BD_RRC_OBJ2_Location_Vt);
    }
    else
    {
        Msg_GW_2BD.RRC_OBJ2_Location=getValue(E_pubc_GW_GW_2BD_RRC_OBJ2_Location_Rv);
    }
}
/*@@end*/
 
/*@@envVar:E_pubc_GW_GW_2BD_RRC_OBJ1_Width_Rv:*/
on envVar E_pubc_GW_GW_2BD_RRC_OBJ1_Width_Rv
{
    int64 rawValue = 0ll;
    float rawValue_float = 0.0;
    float phyValue = 0.0;        

    //set the signal with updated raw value
    {
        rawValue = getvalue(this);
        if(chgEv_GW_2BD_RRC_OBJ1_Width == 0)
        {
            //type conversion to float
            rawValue_float = rawValue;        
            // raw to physical conversion
            phyValue = ((rawValue_float *0.01)+(0));
            putValue(E_pubc_GW_GW_2BD_RRC_OBJ1_Width_Pv, phyValue);
            chgEv_GW_2BD_RRC_OBJ1_Width = 1;
        }
        else
        {
            chgEv_GW_2BD_RRC_OBJ1_Width = 0;
        }    
        //update the signal value
        Msg_GW_2BD.RRC_OBJ1_Width=rawValue;        
    }                                                                           
}
/*@@end*/

/*@@envVar:E_pubc_GW_GW_2BD_RRC_OBJ1_Width_Pv:*/
on envVar E_pubc_GW_GW_2BD_RRC_OBJ1_Width_Pv
{
    int64 rawValue = 0ll;
    float phyValue = 0.0;
    
    //update the raw value with physical value 
    {
        if(chgEv_GW_2BD_RRC_OBJ1_Width == 0)
        {
            phyValue = getvalue(this);
            // physical to raw conversion
            rawValue = ((phyValue -(0))/0.01);
            putValue(E_pubc_GW_GW_2BD_RRC_OBJ1_Width_Rv, rawValue);
            chgEv_GW_2BD_RRC_OBJ1_Width = 1;  
        }
        else
        {
            chgEv_GW_2BD_RRC_OBJ1_Width = 0;
        }
    }
}
/*@@end*/


 
/*@@envVar:E_pubc_GW_GW_2BD_RRC_OBJ1_Location_Rv:*/
on envVar E_pubc_GW_GW_2BD_RRC_OBJ1_Location_Rv
{
    int64 rawValue = 0ll;
    float rawValue_float = 0.0;
    float phyValue = 0.0;        

    //set the signal with updated raw value
    if(getValue(E_pubc_GW_GW_2BD_RRC_OBJ1_Location_SetVt)==0)
    {
        rawValue = getvalue(this);
        if(chgEv_GW_2BD_RRC_OBJ1_Location == 0)
        {
            //type conversion to float
            rawValue_float = rawValue;        
            // raw to physical conversion
            phyValue = ((rawValue_float *1)+(0));
            putValue(E_pubc_GW_GW_2BD_RRC_OBJ1_Location_Pv, phyValue);
            chgEv_GW_2BD_RRC_OBJ1_Location = 1;
        }
        else
        {
            chgEv_GW_2BD_RRC_OBJ1_Location = 0;
        }    
        //update the signal value
        Msg_GW_2BD.RRC_OBJ1_Location=rawValue;        
    }                                                                           
}
/*@@end*/

/*@@envVar:E_pubc_GW_GW_2BD_RRC_OBJ1_Location_Pv:*/
on envVar E_pubc_GW_GW_2BD_RRC_OBJ1_Location_Pv
{
    int64 rawValue = 0ll;
    float phyValue = 0.0;
    
    //update the raw value with physical value 
    if(getValue(E_pubc_GW_GW_2BD_RRC_OBJ1_Location_SetVt)==0)
    {
        if(chgEv_GW_2BD_RRC_OBJ1_Location == 0)
        {
            phyValue = getvalue(this);
            // physical to raw conversion
            rawValue = ((phyValue -(0))/1);
            putValue(E_pubc_GW_GW_2BD_RRC_OBJ1_Location_Rv, rawValue);
            chgEv_GW_2BD_RRC_OBJ1_Location = 1;  
        }
        else
        {
            chgEv_GW_2BD_RRC_OBJ1_Location = 0;
        }
    }
}
/*@@end*/

/*@@envVar:E_pubc_GW_GW_2BD_RRC_OBJ1_Location_Vt:*/
on envVar E_pubc_GW_GW_2BD_RRC_OBJ1_Location_Vt
{
    qword rawValue = 0ll;
    if(getValue(E_pubc_GW_GW_2BD_RRC_OBJ1_Location_SetVt))
    {
        //update the signal value
        Msg_GW_2BD.RRC_OBJ1_Location=getValue(this);
    }
}
/*@@end*/

/*@@envVar:E_pubc_GW_GW_2BD_RRC_OBJ1_Location_SetVt:*/
on envVar E_pubc_GW_GW_2BD_RRC_OBJ1_Location_SetVt
{
    if(getValue(E_pubc_GW_GW_2BD_RRC_OBJ1_Location_SetVt))
    {
        //update the signal value
        Msg_GW_2BD.RRC_OBJ1_Location=getvalue(E_pubc_GW_GW_2BD_RRC_OBJ1_Location_Vt);
    }
    else
    {
        Msg_GW_2BD.RRC_OBJ1_Location=getValue(E_pubc_GW_GW_2BD_RRC_OBJ1_Location_Rv);
    }
}
/*@@end*/
 
/*@@envVar:E_pubc_GW_GW_2BD_RRC_OBJ4_Track_ID_Rv:*/
on envVar E_pubc_GW_GW_2BD_RRC_OBJ4_Track_ID_Rv
{
    int64 rawValue = 0ll;
    float rawValue_float = 0.0;
    float phyValue = 0.0;        

    //set the signal with updated raw value
    {
        rawValue = getvalue(this);
        if(chgEv_GW_2BD_RRC_OBJ4_Track_ID == 0)
        {
            //type conversion to float
            rawValue_float = rawValue;        
            // raw to physical conversion
            phyValue = ((rawValue_float *1)+(0));
            putValue(E_pubc_GW_GW_2BD_RRC_OBJ4_Track_ID_Pv, phyValue);
            chgEv_GW_2BD_RRC_OBJ4_Track_ID = 1;
        }
        else
        {
            chgEv_GW_2BD_RRC_OBJ4_Track_ID = 0;
        }    
        //update the signal value
        Msg_GW_2BD.RRC_OBJ4_Track_ID=rawValue;        
    }                                                                           
}
/*@@end*/

/*@@envVar:E_pubc_GW_GW_2BD_RRC_OBJ4_Track_ID_Pv:*/
on envVar E_pubc_GW_GW_2BD_RRC_OBJ4_Track_ID_Pv
{
    int64 rawValue = 0ll;
    float phyValue = 0.0;
    
    //update the raw value with physical value 
    {
        if(chgEv_GW_2BD_RRC_OBJ4_Track_ID == 0)
        {
            phyValue = getvalue(this);
            // physical to raw conversion
            rawValue = ((phyValue -(0))/1);
            putValue(E_pubc_GW_GW_2BD_RRC_OBJ4_Track_ID_Rv, rawValue);
            chgEv_GW_2BD_RRC_OBJ4_Track_ID = 1;  
        }
        else
        {
            chgEv_GW_2BD_RRC_OBJ4_Track_ID = 0;
        }
    }
}
/*@@end*/


 
/*@@envVar:E_pubc_GW_GW_2BD_RRC_OBJ1_Track_ID_Rv:*/
on envVar E_pubc_GW_GW_2BD_RRC_OBJ1_Track_ID_Rv
{
    int64 rawValue = 0ll;
    float rawValue_float = 0.0;
    float phyValue = 0.0;        

    //set the signal with updated raw value
    {
        rawValue = getvalue(this);
        if(chgEv_GW_2BD_RRC_OBJ1_Track_ID == 0)
        {
            //type conversion to float
            rawValue_float = rawValue;        
            // raw to physical conversion
            phyValue = ((rawValue_float *1)+(0));
            putValue(E_pubc_GW_GW_2BD_RRC_OBJ1_Track_ID_Pv, phyValue);
            chgEv_GW_2BD_RRC_OBJ1_Track_ID = 1;
        }
        else
        {
            chgEv_GW_2BD_RRC_OBJ1_Track_ID = 0;
        }    
        //update the signal value
        Msg_GW_2BD.RRC_OBJ1_Track_ID=rawValue;        
    }                                                                           
}
/*@@end*/

/*@@envVar:E_pubc_GW_GW_2BD_RRC_OBJ1_Track_ID_Pv:*/
on envVar E_pubc_GW_GW_2BD_RRC_OBJ1_Track_ID_Pv
{
    int64 rawValue = 0ll;
    float phyValue = 0.0;
    
    //update the raw value with physical value 
    {
        if(chgEv_GW_2BD_RRC_OBJ1_Track_ID == 0)
        {
            phyValue = getvalue(this);
            // physical to raw conversion
            rawValue = ((phyValue -(0))/1);
            putValue(E_pubc_GW_GW_2BD_RRC_OBJ1_Track_ID_Rv, rawValue);
            chgEv_GW_2BD_RRC_OBJ1_Track_ID = 1;  
        }
        else
        {
            chgEv_GW_2BD_RRC_OBJ1_Track_ID = 0;
        }
    }
}
/*@@end*/


 
/*@@envVar:E_pubc_GW_GW_2BD_RRC_OBJ2_Ax_Rv:*/
on envVar E_pubc_GW_GW_2BD_RRC_OBJ2_Ax_Rv
{
    int64 rawValue = 0ll;
    float rawValue_float = 0.0;
    float phyValue = 0.0;        

    //set the signal with updated raw value
    {
        rawValue = getvalue(this);
        if(chgEv_GW_2BD_RRC_OBJ2_Ax == 0)
        {
            //type conversion to float
            rawValue_float = rawValue;        
            // raw to physical conversion
            phyValue = ((rawValue_float *0.0625)+(-16));
            putValue(E_pubc_GW_GW_2BD_RRC_OBJ2_Ax_Pv, phyValue);
            chgEv_GW_2BD_RRC_OBJ2_Ax = 1;
        }
        else
        {
            chgEv_GW_2BD_RRC_OBJ2_Ax = 0;
        }    
        //update the signal value
        Msg_GW_2BD.RRC_OBJ2_Ax=rawValue;        
    }                                                                           
}
/*@@end*/

/*@@envVar:E_pubc_GW_GW_2BD_RRC_OBJ2_Ax_Pv:*/
on envVar E_pubc_GW_GW_2BD_RRC_OBJ2_Ax_Pv
{
    int64 rawValue = 0ll;
    float phyValue = 0.0;
    
    //update the raw value with physical value 
    {
        if(chgEv_GW_2BD_RRC_OBJ2_Ax == 0)
        {
            phyValue = getvalue(this);
            // physical to raw conversion
            rawValue = ((phyValue -(-16))/0.0625);
            putValue(E_pubc_GW_GW_2BD_RRC_OBJ2_Ax_Rv, rawValue);
            chgEv_GW_2BD_RRC_OBJ2_Ax = 1;  
        }
        else
        {
            chgEv_GW_2BD_RRC_OBJ2_Ax = 0;
        }
    }
}
/*@@end*/


 
/*@@envVar:E_pubc_GW_GW_2BD_RRC_OBJ2_Ay_Rv:*/
on envVar E_pubc_GW_GW_2BD_RRC_OBJ2_Ay_Rv
{
    int64 rawValue = 0ll;
    float rawValue_float = 0.0;
    float phyValue = 0.0;        

    //set the signal with updated raw value
    {
        rawValue = getvalue(this);
        if(chgEv_GW_2BD_RRC_OBJ2_Ay == 0)
        {
            //type conversion to float
            rawValue_float = rawValue;        
            // raw to physical conversion
            phyValue = ((rawValue_float *0.03125)+(-16));
            putValue(E_pubc_GW_GW_2BD_RRC_OBJ2_Ay_Pv, phyValue);
            chgEv_GW_2BD_RRC_OBJ2_Ay = 1;
        }
        else
        {
            chgEv_GW_2BD_RRC_OBJ2_Ay = 0;
        }    
        //update the signal value
        Msg_GW_2BD.RRC_OBJ2_Ay=rawValue;        
    }                                                                           
}
/*@@end*/

/*@@envVar:E_pubc_GW_GW_2BD_RRC_OBJ2_Ay_Pv:*/
on envVar E_pubc_GW_GW_2BD_RRC_OBJ2_Ay_Pv
{
    int64 rawValue = 0ll;
    float phyValue = 0.0;
    
    //update the raw value with physical value 
    {
        if(chgEv_GW_2BD_RRC_OBJ2_Ay == 0)
        {
            phyValue = getvalue(this);
            // physical to raw conversion
            rawValue = ((phyValue -(-16))/0.03125);
            putValue(E_pubc_GW_GW_2BD_RRC_OBJ2_Ay_Rv, rawValue);
            chgEv_GW_2BD_RRC_OBJ2_Ay = 1;  
        }
        else
        {
            chgEv_GW_2BD_RRC_OBJ2_Ay = 0;
        }
    }
}
/*@@end*/


 
/*@@envVar:E_pubc_GW_GW_2BD_RRC_OBJ1_Length_Rv:*/
on envVar E_pubc_GW_GW_2BD_RRC_OBJ1_Length_Rv
{
    int64 rawValue = 0ll;
    float rawValue_float = 0.0;
    float phyValue = 0.0;        

    //set the signal with updated raw value
    {
        rawValue = getvalue(this);
        if(chgEv_GW_2BD_RRC_OBJ1_Length == 0)
        {
            //type conversion to float
            rawValue_float = rawValue;        
            // raw to physical conversion
            phyValue = ((rawValue_float *0.05)+(0));
            putValue(E_pubc_GW_GW_2BD_RRC_OBJ1_Length_Pv, phyValue);
            chgEv_GW_2BD_RRC_OBJ1_Length = 1;
        }
        else
        {
            chgEv_GW_2BD_RRC_OBJ1_Length = 0;
        }    
        //update the signal value
        Msg_GW_2BD.RRC_OBJ1_Length=rawValue;        
    }                                                                           
}
/*@@end*/

/*@@envVar:E_pubc_GW_GW_2BD_RRC_OBJ1_Length_Pv:*/
on envVar E_pubc_GW_GW_2BD_RRC_OBJ1_Length_Pv
{
    int64 rawValue = 0ll;
    float phyValue = 0.0;
    
    //update the raw value with physical value 
    {
        if(chgEv_GW_2BD_RRC_OBJ1_Length == 0)
        {
            phyValue = getvalue(this);
            // physical to raw conversion
            rawValue = ((phyValue -(0))/0.05);
            putValue(E_pubc_GW_GW_2BD_RRC_OBJ1_Length_Rv, rawValue);
            chgEv_GW_2BD_RRC_OBJ1_Length = 1;  
        }
        else
        {
            chgEv_GW_2BD_RRC_OBJ1_Length = 0;
        }
    }
}
/*@@end*/


 
/*@@envVar:E_pubc_GW_GW_2BD_RRC_OBJ3_ObstacleProb_Rv:*/
on envVar E_pubc_GW_GW_2BD_RRC_OBJ3_ObstacleProb_Rv
{
    int64 rawValue = 0ll;
    float rawValue_float = 0.0;
    float phyValue = 0.0;        

    //set the signal with updated raw value
    {
        rawValue = getvalue(this);
        if(chgEv_GW_2BD_RRC_OBJ3_ObstacleProb == 0)
        {
            //type conversion to float
            rawValue_float = rawValue;        
            // raw to physical conversion
            phyValue = ((rawValue_float *2)+(0));
            putValue(E_pubc_GW_GW_2BD_RRC_OBJ3_ObstacleProb_Pv, phyValue);
            chgEv_GW_2BD_RRC_OBJ3_ObstacleProb = 1;
        }
        else
        {
            chgEv_GW_2BD_RRC_OBJ3_ObstacleProb = 0;
        }    
        //update the signal value
        Msg_GW_2BD.RRC_OBJ3_ObstacleProb=rawValue;        
    }                                                                           
}
/*@@end*/

/*@@envVar:E_pubc_GW_GW_2BD_RRC_OBJ3_ObstacleProb_Pv:*/
on envVar E_pubc_GW_GW_2BD_RRC_OBJ3_ObstacleProb_Pv
{
    int64 rawValue = 0ll;
    float phyValue = 0.0;
    
    //update the raw value with physical value 
    {
        if(chgEv_GW_2BD_RRC_OBJ3_ObstacleProb == 0)
        {
            phyValue = getvalue(this);
            // physical to raw conversion
            rawValue = ((phyValue -(0))/2);
            putValue(E_pubc_GW_GW_2BD_RRC_OBJ3_ObstacleProb_Rv, rawValue);
            chgEv_GW_2BD_RRC_OBJ3_ObstacleProb = 1;  
        }
        else
        {
            chgEv_GW_2BD_RRC_OBJ3_ObstacleProb = 0;
        }
    }
}
/*@@end*/


 
/*@@envVar:E_pubc_GW_GW_2BD_RRC_OBJ4_Length_Rv:*/
on envVar E_pubc_GW_GW_2BD_RRC_OBJ4_Length_Rv
{
    int64 rawValue = 0ll;
    float rawValue_float = 0.0;
    float phyValue = 0.0;        

    //set the signal with updated raw value
    {
        rawValue = getvalue(this);
        if(chgEv_GW_2BD_RRC_OBJ4_Length == 0)
        {
            //type conversion to float
            rawValue_float = rawValue;        
            // raw to physical conversion
            phyValue = ((rawValue_float *0.05)+(0));
            putValue(E_pubc_GW_GW_2BD_RRC_OBJ4_Length_Pv, phyValue);
            chgEv_GW_2BD_RRC_OBJ4_Length = 1;
        }
        else
        {
            chgEv_GW_2BD_RRC_OBJ4_Length = 0;
        }    
        //update the signal value
        Msg_GW_2BD.RRC_OBJ4_Length=rawValue;        
    }                                                                           
}
/*@@end*/

/*@@envVar:E_pubc_GW_GW_2BD_RRC_OBJ4_Length_Pv:*/
on envVar E_pubc_GW_GW_2BD_RRC_OBJ4_Length_Pv
{
    int64 rawValue = 0ll;
    float phyValue = 0.0;
    
    //update the raw value with physical value 
    {
        if(chgEv_GW_2BD_RRC_OBJ4_Length == 0)
        {
            phyValue = getvalue(this);
            // physical to raw conversion
            rawValue = ((phyValue -(0))/0.05);
            putValue(E_pubc_GW_GW_2BD_RRC_OBJ4_Length_Rv, rawValue);
            chgEv_GW_2BD_RRC_OBJ4_Length = 1;  
        }
        else
        {
            chgEv_GW_2BD_RRC_OBJ4_Length = 0;
        }
    }
}
/*@@end*/


 
/*@@envVar:E_pubc_GW_GW_2BD_RRC_OBJ3_Vx_Rv:*/
on envVar E_pubc_GW_GW_2BD_RRC_OBJ3_Vx_Rv
{
    int64 rawValue = 0ll;
    float rawValue_float = 0.0;
    float phyValue = 0.0;        

    //set the signal with updated raw value
    {
        rawValue = getvalue(this);
        if(chgEv_GW_2BD_RRC_OBJ3_Vx == 0)
        {
            //type conversion to float
            rawValue_float = rawValue;        
            // raw to physical conversion
            phyValue = ((rawValue_float *0.0625)+(-128));
            putValue(E_pubc_GW_GW_2BD_RRC_OBJ3_Vx_Pv, phyValue);
            chgEv_GW_2BD_RRC_OBJ3_Vx = 1;
        }
        else
        {
            chgEv_GW_2BD_RRC_OBJ3_Vx = 0;
        }    
        //update the signal value
        Msg_GW_2BD.RRC_OBJ3_Vx=rawValue;        
    }                                                                           
}
/*@@end*/

/*@@envVar:E_pubc_GW_GW_2BD_RRC_OBJ3_Vx_Pv:*/
on envVar E_pubc_GW_GW_2BD_RRC_OBJ3_Vx_Pv
{
    int64 rawValue = 0ll;
    float phyValue = 0.0;
    
    //update the raw value with physical value 
    {
        if(chgEv_GW_2BD_RRC_OBJ3_Vx == 0)
        {
            phyValue = getvalue(this);
            // physical to raw conversion
            rawValue = ((phyValue -(-128))/0.0625);
            putValue(E_pubc_GW_GW_2BD_RRC_OBJ3_Vx_Rv, rawValue);
            chgEv_GW_2BD_RRC_OBJ3_Vx = 1;  
        }
        else
        {
            chgEv_GW_2BD_RRC_OBJ3_Vx = 0;
        }
    }
}
/*@@end*/


 
/*@@envVar:E_pubc_GW_GW_2BD_RRC_OBJ3_Vy_Rv:*/
on envVar E_pubc_GW_GW_2BD_RRC_OBJ3_Vy_Rv
{
    int64 rawValue = 0ll;
    float rawValue_float = 0.0;
    float phyValue = 0.0;        

    //set the signal with updated raw value
    {
        rawValue = getvalue(this);
        if(chgEv_GW_2BD_RRC_OBJ3_Vy == 0)
        {
            //type conversion to float
            rawValue_float = rawValue;        
            // raw to physical conversion
            phyValue = ((rawValue_float *0.125)+(-64));
            putValue(E_pubc_GW_GW_2BD_RRC_OBJ3_Vy_Pv, phyValue);
            chgEv_GW_2BD_RRC_OBJ3_Vy = 1;
        }
        else
        {
            chgEv_GW_2BD_RRC_OBJ3_Vy = 0;
        }    
        //update the signal value
        Msg_GW_2BD.RRC_OBJ3_Vy=rawValue;        
    }                                                                           
}
/*@@end*/

/*@@envVar:E_pubc_GW_GW_2BD_RRC_OBJ3_Vy_Pv:*/
on envVar E_pubc_GW_GW_2BD_RRC_OBJ3_Vy_Pv
{
    int64 rawValue = 0ll;
    float phyValue = 0.0;
    
    //update the raw value with physical value 
    {
        if(chgEv_GW_2BD_RRC_OBJ3_Vy == 0)
        {
            phyValue = getvalue(this);
            // physical to raw conversion
            rawValue = ((phyValue -(-64))/0.125);
            putValue(E_pubc_GW_GW_2BD_RRC_OBJ3_Vy_Rv, rawValue);
            chgEv_GW_2BD_RRC_OBJ3_Vy = 1;  
        }
        else
        {
            chgEv_GW_2BD_RRC_OBJ3_Vy = 0;
        }
    }
}
/*@@end*/


 
/*@@envVar:E_pubc_GW_GW_2BD_RRC_OBJ2_HeadingAngle_Rv:*/
on envVar E_pubc_GW_GW_2BD_RRC_OBJ2_HeadingAngle_Rv
{
    int64 rawValue = 0ll;
    float rawValue_float = 0.0;
    float phyValue = 0.0;        

    //set the signal with updated raw value
    {
        rawValue = getvalue(this);
        if(chgEv_GW_2BD_RRC_OBJ2_HeadingAngle == 0)
        {
            //type conversion to float
            rawValue_float = rawValue;        
            // raw to physical conversion
            phyValue = ((rawValue_float *0.01)+(-3.14));
            putValue(E_pubc_GW_GW_2BD_RRC_OBJ2_HeadingAngle_Pv, phyValue);
            chgEv_GW_2BD_RRC_OBJ2_HeadingAngle = 1;
        }
        else
        {
            chgEv_GW_2BD_RRC_OBJ2_HeadingAngle = 0;
        }    
        //update the signal value
        Msg_GW_2BD.RRC_OBJ2_HeadingAngle=rawValue;        
    }                                                                           
}
/*@@end*/

/*@@envVar:E_pubc_GW_GW_2BD_RRC_OBJ2_HeadingAngle_Pv:*/
on envVar E_pubc_GW_GW_2BD_RRC_OBJ2_HeadingAngle_Pv
{
    int64 rawValue = 0ll;
    float phyValue = 0.0;
    
    //update the raw value with physical value 
    {
        if(chgEv_GW_2BD_RRC_OBJ2_HeadingAngle == 0)
        {
            phyValue = getvalue(this);
            // physical to raw conversion
            rawValue = ((phyValue -(-3.14))/0.01);
            putValue(E_pubc_GW_GW_2BD_RRC_OBJ2_HeadingAngle_Rv, rawValue);
            chgEv_GW_2BD_RRC_OBJ2_HeadingAngle = 1;  
        }
        else
        {
            chgEv_GW_2BD_RRC_OBJ2_HeadingAngle = 0;
        }
    }
}
/*@@end*/


 
/*@@envVar:E_pubc_GW_GW_2BD_RRC_OBJ3_Track_ID_Rv:*/
on envVar E_pubc_GW_GW_2BD_RRC_OBJ3_Track_ID_Rv
{
    int64 rawValue = 0ll;
    float rawValue_float = 0.0;
    float phyValue = 0.0;        

    //set the signal with updated raw value
    {
        rawValue = getvalue(this);
        if(chgEv_GW_2BD_RRC_OBJ3_Track_ID == 0)
        {
            //type conversion to float
            rawValue_float = rawValue;        
            // raw to physical conversion
            phyValue = ((rawValue_float *1)+(0));
            putValue(E_pubc_GW_GW_2BD_RRC_OBJ3_Track_ID_Pv, phyValue);
            chgEv_GW_2BD_RRC_OBJ3_Track_ID = 1;
        }
        else
        {
            chgEv_GW_2BD_RRC_OBJ3_Track_ID = 0;
        }    
        //update the signal value
        Msg_GW_2BD.RRC_OBJ3_Track_ID=rawValue;        
    }                                                                           
}
/*@@end*/

/*@@envVar:E_pubc_GW_GW_2BD_RRC_OBJ3_Track_ID_Pv:*/
on envVar E_pubc_GW_GW_2BD_RRC_OBJ3_Track_ID_Pv
{
    int64 rawValue = 0ll;
    float phyValue = 0.0;
    
    //update the raw value with physical value 
    {
        if(chgEv_GW_2BD_RRC_OBJ3_Track_ID == 0)
        {
            phyValue = getvalue(this);
            // physical to raw conversion
            rawValue = ((phyValue -(0))/1);
            putValue(E_pubc_GW_GW_2BD_RRC_OBJ3_Track_ID_Rv, rawValue);
            chgEv_GW_2BD_RRC_OBJ3_Track_ID = 1;  
        }
        else
        {
            chgEv_GW_2BD_RRC_OBJ3_Track_ID = 0;
        }
    }
}
/*@@end*/


 
/*@@envVar:E_pubc_GW_GW_2BD_RRC_OBJ1_Dx_Rv:*/
on envVar E_pubc_GW_GW_2BD_RRC_OBJ1_Dx_Rv
{
    int64 rawValue = 0ll;
    float rawValue_float = 0.0;
    float phyValue = 0.0;        

    //set the signal with updated raw value
    {
        rawValue = getvalue(this);
        if(chgEv_GW_2BD_RRC_OBJ1_Dx == 0)
        {
            //type conversion to float
            rawValue_float = rawValue;        
            // raw to physical conversion
            phyValue = ((rawValue_float *0.0625)+(-256));
            putValue(E_pubc_GW_GW_2BD_RRC_OBJ1_Dx_Pv, phyValue);
            chgEv_GW_2BD_RRC_OBJ1_Dx = 1;
        }
        else
        {
            chgEv_GW_2BD_RRC_OBJ1_Dx = 0;
        }    
        //update the signal value
        Msg_GW_2BD.RRC_OBJ1_Dx=rawValue;        
    }                                                                           
}
/*@@end*/

/*@@envVar:E_pubc_GW_GW_2BD_RRC_OBJ1_Dx_Pv:*/
on envVar E_pubc_GW_GW_2BD_RRC_OBJ1_Dx_Pv
{
    int64 rawValue = 0ll;
    float phyValue = 0.0;
    
    //update the raw value with physical value 
    {
        if(chgEv_GW_2BD_RRC_OBJ1_Dx == 0)
        {
            phyValue = getvalue(this);
            // physical to raw conversion
            rawValue = ((phyValue -(-256))/0.0625);
            putValue(E_pubc_GW_GW_2BD_RRC_OBJ1_Dx_Rv, rawValue);
            chgEv_GW_2BD_RRC_OBJ1_Dx = 1;  
        }
        else
        {
            chgEv_GW_2BD_RRC_OBJ1_Dx = 0;
        }
    }
}
/*@@end*/


 
/*@@envVar:E_pubc_GW_GW_2BD_RRC_OBJ1_Dy_Rv:*/
on envVar E_pubc_GW_GW_2BD_RRC_OBJ1_Dy_Rv
{
    int64 rawValue = 0ll;
    float rawValue_float = 0.0;
    float phyValue = 0.0;        

    //set the signal with updated raw value
    {
        rawValue = getvalue(this);
        if(chgEv_GW_2BD_RRC_OBJ1_Dy == 0)
        {
            //type conversion to float
            rawValue_float = rawValue;        
            // raw to physical conversion
            phyValue = ((rawValue_float *0.125)+(-128));
            putValue(E_pubc_GW_GW_2BD_RRC_OBJ1_Dy_Pv, phyValue);
            chgEv_GW_2BD_RRC_OBJ1_Dy = 1;
        }
        else
        {
            chgEv_GW_2BD_RRC_OBJ1_Dy = 0;
        }    
        //update the signal value
        Msg_GW_2BD.RRC_OBJ1_Dy=rawValue;        
    }                                                                           
}
/*@@end*/

/*@@envVar:E_pubc_GW_GW_2BD_RRC_OBJ1_Dy_Pv:*/
on envVar E_pubc_GW_GW_2BD_RRC_OBJ1_Dy_Pv
{
    int64 rawValue = 0ll;
    float phyValue = 0.0;
    
    //update the raw value with physical value 
    {
        if(chgEv_GW_2BD_RRC_OBJ1_Dy == 0)
        {
            phyValue = getvalue(this);
            // physical to raw conversion
            rawValue = ((phyValue -(-128))/0.125);
            putValue(E_pubc_GW_GW_2BD_RRC_OBJ1_Dy_Rv, rawValue);
            chgEv_GW_2BD_RRC_OBJ1_Dy = 1;  
        }
        else
        {
            chgEv_GW_2BD_RRC_OBJ1_Dy = 0;
        }
    }
}
/*@@end*/


 
/*@@envVar:E_pubc_GW_GW_2BF_tx:*/
on envVar E_pubc_GW_GW_2BF_tx
{
    if(getValue(this))
    {       
        
        //update the BZ Signal
        if(GW_2BF_RRC_RollingCounter_2BF_wrongvalctr == 0)
        {
            update_GW_2BF_RRC_RollingCounter_2BF_counter();
            Msg_GW_2BF.RRC_RollingCounter_2BF= GW_2BF_RRC_RollingCounter_2BF_counter;
        }
        else if(GW_2BF_RRC_RollingCounter_2BF_wrongvalctr > 0)
        {
			GW_2BF_RRC_RollingCounter_2BF_counter=GW_2BF_RRC_RollingCounter_2BF_counter + GW_2BF_RRC_RollingCounter_2BF_wrongvalctr;
			 Msg_GW_2BF.RRC_RollingCounter_2BF= GW_2BF_RRC_RollingCounter_2BF_counter;
            /* GW_2BF_RRC_RollingCounter_2BF_wrongvalctr--;
              // if counter becomes zero, update panel controller to zero
             if(GW_2BF_RRC_RollingCounter_2BF_wrongvalctr == 0)
             {
                 putValue(E_pubc_GW_GW_2BF_RRC_RollingCounter_2BF_wrongvalctr,0);
             } */
        }
        else
        { 
			// do nothing
        }    
        //calculate the CRC CheckSum
        update_GW_2BF_CRC_CheckSum();

        output(Msg_GW_2BF);        
    }
}
/*@@end*/

/*@@envVar:E_pubc_GW_GW_2BF_Range:*/
on envVar E_pubc_GW_GW_2BF_Range
{
    qword rawstatus = 0ll;
    qword rawValue = 0ll;    
    
    rawstatus = getvalue(this);    
    // set all the signals with min raw /max raw /init raw
    switch (rawstatus) 
    {
     case(0) :
        rawValue= 0;
        putValue(E_pubc_GW_GW_2BF_RRC_OBJ8_HeadingAngle_Rv, rawValue);
        rawValue= 0;
        putValue(E_pubc_GW_GW_2BF_RRC_OBJ9_Type_Rv, rawValue);
        rawValue= 0;
        putValue(E_pubc_GW_GW_2BF_RRC_OBJ8_Vy_Rv, rawValue);
        rawValue= 0;
        putValue(E_pubc_GW_GW_2BF_RRC_OBJ6_Dy_Rv, rawValue);
        rawValue= 0;
        putValue(E_pubc_GW_GW_2BF_RRC_OBJ6_Dx_Rv, rawValue);
        rawValue= 0;
        putValue(E_pubc_GW_GW_2BF_RRC_OBJ6_HeadingAngle_Rv, rawValue);
        rawValue= 0;
        putValue(E_pubc_GW_GW_2BF_RRC_OBJ9_Ay_Rv, rawValue);
        rawValue= 0;
        putValue(E_pubc_GW_GW_2BF_RRC_OBJ9_Ax_Rv, rawValue);
        rawValue= 0;
        putValue(E_pubc_GW_GW_2BF_RRC_OBJ8_Vx_Rv, rawValue);
        rawValue= 0;
        putValue(E_pubc_GW_GW_2BF_RRC_OBJ7_Length_Rv, rawValue);
        rawValue= 0;
        putValue(E_pubc_GW_GW_2BF_RRC_OBJ8_Length_Rv, rawValue);
        rawValue= 0;
        putValue(E_pubc_GW_GW_2BF_RRC_OBJ6_Vy_Rv, rawValue);
        rawValue= 0;
        putValue(E_pubc_GW_GW_2BF_RRC_OBJ6_Vx_Rv, rawValue);
        rawValue= 0;
        putValue(E_pubc_GW_GW_2BF_RRC_OBJ8_Ax_Rv, rawValue);
        rawValue= 0;
        putValue(E_pubc_GW_GW_2BF_RRC_OBJ8_Measured_Rv, rawValue);
        rawValue= 0;
        putValue(E_pubc_GW_GW_2BF_RRC_OBJ7_Dx_Rv, rawValue);
        rawValue= 0;
        putValue(E_pubc_GW_GW_2BF_RRC_OBJ7_Dy_Rv, rawValue);
        rawValue= 0;
        putValue(E_pubc_GW_GW_2BF_RRC_OBJ8_Ay_Rv, rawValue);
        rawValue= 0;
        putValue(E_pubc_GW_GW_2BF_RRC_OBJ7_Track_ID_Rv, rawValue);
        rawValue= 0;
        putValue(E_pubc_GW_GW_2BF_RRC_OBJ6_Width_Rv, rawValue);
        rawValue= 0;
        putValue(E_pubc_GW_GW_2BF_RRC_OBJ9_Vx_Rv, rawValue);
        rawValue= 0;
        putValue(E_pubc_GW_GW_2BF_RRC_OBJ9_Vy_Rv, rawValue);
        rawValue= 0;
        putValue(E_pubc_GW_GW_2BF_RRC_OBJ9_ObstacleProb_Rv, rawValue);
        rawValue= 0;
        putValue(E_pubc_GW_GW_2BF_RRC_OBJ7_HeadingAngle_Rv, rawValue);
        rawValue= 0;
        putValue(E_pubc_GW_GW_2BF_RRC_OBJ8_Type_Rv, rawValue);
        rawValue= 0;
        putValue(E_pubc_GW_GW_2BF_RRC_OBJ9_Length_Rv, rawValue);
        rawValue= 0;
        putValue(E_pubc_GW_GW_2BF_RRC_OBJ6_ExistProb_Rv, rawValue);
        rawValue= 0;
        putValue(E_pubc_GW_GW_2BF_RRC_OBJ9_Track_ID_Rv, rawValue);
        rawValue= 0;
        putValue(E_pubc_GW_GW_2BF_RRC_OBJ6_Location_Rv, rawValue);
        rawValue= 0;
        putValue(E_pubc_GW_GW_2BF_RRC_OBJ9_Location_Rv, rawValue);
        rawValue= 0;
        putValue(E_pubc_GW_GW_2BF_RRC_OBJ7_Width_Rv, rawValue);
        rawValue= 0;
        putValue(E_pubc_GW_GW_2BF_RRC_OBJ6_Ax_Rv, rawValue);
        rawValue= 0;
        putValue(E_pubc_GW_GW_2BF_RRC_OBJ6_Ay_Rv, rawValue);
        rawValue= 0;
        putValue(E_pubc_GW_GW_2BF_RRC_OBJ6_Track_ID_Rv, rawValue);
        rawValue= 0;
        putValue(E_pubc_GW_GW_2BF_RRC_OBJ9_Dy_Rv, rawValue);
        rawValue= 0;
        putValue(E_pubc_GW_GW_2BF_RRC_OBJ9_Dx_Rv, rawValue);
        rawValue= 0;
        putValue(E_pubc_GW_GW_2BF_RRC_OBJ7_ExistProb_Rv, rawValue);
        rawValue= 0;
        putValue(E_pubc_GW_GW_2BF_RRC_OBJ8_Track_ID_Rv, rawValue);
        rawValue= 0;
        putValue(E_pubc_GW_GW_2BF_RRC_OBJ7_Measured_Rv, rawValue);
        rawValue= 0;
        putValue(E_pubc_GW_GW_2BF_RRC_OBJ7_Type_Rv, rawValue);
        rawValue= 0;
        putValue(E_pubc_GW_GW_2BF_RRC_OBJ7_Location_Rv, rawValue);
        rawValue= 0;
        putValue(E_pubc_GW_GW_2BF_RRC_OBJ9_Measured_Rv, rawValue);
        rawValue= 0;
        putValue(E_pubc_GW_GW_2BF_RRC_OBJ7_Vx_Rv, rawValue);
        rawValue= 0;
        putValue(E_pubc_GW_GW_2BF_RRC_OBJ7_Vy_Rv, rawValue);
        rawValue= 0;
        putValue(E_pubc_GW_GW_2BF_RRC_OBJ8_Location_Rv, rawValue);
        rawValue= 0;
        putValue(E_pubc_GW_GW_2BF_RRC_OBJ8_Dy_Rv, rawValue);
        rawValue= 0;
        putValue(E_pubc_GW_GW_2BF_RRC_OBJ9_Width_Rv, rawValue);
        rawValue= 0;
        putValue(E_pubc_GW_GW_2BF_RRC_OBJ6_Length_Rv, rawValue);
        rawValue= 0;
        putValue(E_pubc_GW_GW_2BF_RRC_OBJ6_Type_Rv, rawValue);
        rawValue= 0;
        putValue(E_pubc_GW_GW_2BF_RRC_OBJ9_HeadingAngle_Rv, rawValue);
        rawValue= 0;
        putValue(E_pubc_GW_GW_2BF_RRC_OBJ8_ExistProb_Rv, rawValue);
        rawValue= 0;
        putValue(E_pubc_GW_GW_2BF_RRC_OBJ6_ObstacleProb_Rv, rawValue);
        rawValue= 0;
        putValue(E_pubc_GW_GW_2BF_RRC_OBJ7_ObstacleProb_Rv, rawValue);
        rawValue= 0;
        putValue(E_pubc_GW_GW_2BF_RRC_OBJ8_ObstacleProb_Rv, rawValue);
        rawValue= 0;
        putValue(E_pubc_GW_GW_2BF_RRC_OBJ8_Dx_Rv, rawValue);
        rawValue= 0;
        putValue(E_pubc_GW_GW_2BF_RRC_OBJ9_ExistProb_Rv, rawValue);
        rawValue= 0;
        putValue(E_pubc_GW_GW_2BF_RRC_OBJ7_Ay_Rv, rawValue);
        rawValue= 0;
        putValue(E_pubc_GW_GW_2BF_RRC_OBJ7_Ax_Rv, rawValue);
        rawValue= 0;
        putValue(E_pubc_GW_GW_2BF_RRC_OBJ8_Width_Rv, rawValue);
        rawValue= 0;
        putValue(E_pubc_GW_GW_2BF_RRC_OBJ6_Measured_Rv, rawValue);
        break;
     case(1) :
        rawValue= 628;
        putValue(E_pubc_GW_GW_2BF_RRC_OBJ8_HeadingAngle_Rv, rawValue);
        rawValue= 7;
        putValue(E_pubc_GW_GW_2BF_RRC_OBJ9_Type_Rv, rawValue);
        rawValue= 1023;
        putValue(E_pubc_GW_GW_2BF_RRC_OBJ8_Vy_Rv, rawValue);
        rawValue= 2047;
        putValue(E_pubc_GW_GW_2BF_RRC_OBJ6_Dy_Rv, rawValue);
        rawValue= 8191;
        putValue(E_pubc_GW_GW_2BF_RRC_OBJ6_Dx_Rv, rawValue);
        rawValue= 628;
        putValue(E_pubc_GW_GW_2BF_RRC_OBJ6_HeadingAngle_Rv, rawValue);
        rawValue= 1023;
        putValue(E_pubc_GW_GW_2BF_RRC_OBJ9_Ay_Rv, rawValue);
        rawValue= 511;
        putValue(E_pubc_GW_GW_2BF_RRC_OBJ9_Ax_Rv, rawValue);
        rawValue= 4095;
        putValue(E_pubc_GW_GW_2BF_RRC_OBJ8_Vx_Rv, rawValue);
        rawValue= 510;
        putValue(E_pubc_GW_GW_2BF_RRC_OBJ7_Length_Rv, rawValue);
        rawValue= 510;
        putValue(E_pubc_GW_GW_2BF_RRC_OBJ8_Length_Rv, rawValue);
        rawValue= 1023;
        putValue(E_pubc_GW_GW_2BF_RRC_OBJ6_Vy_Rv, rawValue);
        rawValue= 4095;
        putValue(E_pubc_GW_GW_2BF_RRC_OBJ6_Vx_Rv, rawValue);
        rawValue= 511;
        putValue(E_pubc_GW_GW_2BF_RRC_OBJ8_Ax_Rv, rawValue);
        rawValue= 3;
        putValue(E_pubc_GW_GW_2BF_RRC_OBJ8_Measured_Rv, rawValue);
        rawValue= 8191;
        putValue(E_pubc_GW_GW_2BF_RRC_OBJ7_Dx_Rv, rawValue);
        rawValue= 2047;
        putValue(E_pubc_GW_GW_2BF_RRC_OBJ7_Dy_Rv, rawValue);
        rawValue= 1023;
        putValue(E_pubc_GW_GW_2BF_RRC_OBJ8_Ay_Rv, rawValue);
        rawValue= 127;
        putValue(E_pubc_GW_GW_2BF_RRC_OBJ7_Track_ID_Rv, rawValue);
        rawValue= 1200;
        putValue(E_pubc_GW_GW_2BF_RRC_OBJ6_Width_Rv, rawValue);
        rawValue= 4095;
        putValue(E_pubc_GW_GW_2BF_RRC_OBJ9_Vx_Rv, rawValue);
        rawValue= 1023;
        putValue(E_pubc_GW_GW_2BF_RRC_OBJ9_Vy_Rv, rawValue);
        rawValue= 50;
        putValue(E_pubc_GW_GW_2BF_RRC_OBJ9_ObstacleProb_Rv, rawValue);
        rawValue= 628;
        putValue(E_pubc_GW_GW_2BF_RRC_OBJ7_HeadingAngle_Rv, rawValue);
        rawValue= 7;
        putValue(E_pubc_GW_GW_2BF_RRC_OBJ8_Type_Rv, rawValue);
        rawValue= 510;
        putValue(E_pubc_GW_GW_2BF_RRC_OBJ9_Length_Rv, rawValue);
        rawValue= 50;
        putValue(E_pubc_GW_GW_2BF_RRC_OBJ6_ExistProb_Rv, rawValue);
        rawValue= 127;
        putValue(E_pubc_GW_GW_2BF_RRC_OBJ9_Track_ID_Rv, rawValue);
        rawValue= 3;
        putValue(E_pubc_GW_GW_2BF_RRC_OBJ6_Location_Rv, rawValue);
        rawValue= 3;
        putValue(E_pubc_GW_GW_2BF_RRC_OBJ9_Location_Rv, rawValue);
        rawValue= 1200;
        putValue(E_pubc_GW_GW_2BF_RRC_OBJ7_Width_Rv, rawValue);
        rawValue= 511;
        putValue(E_pubc_GW_GW_2BF_RRC_OBJ6_Ax_Rv, rawValue);
        rawValue= 1023;
        putValue(E_pubc_GW_GW_2BF_RRC_OBJ6_Ay_Rv, rawValue);
        rawValue= 127;
        putValue(E_pubc_GW_GW_2BF_RRC_OBJ6_Track_ID_Rv, rawValue);
        rawValue= 2047;
        putValue(E_pubc_GW_GW_2BF_RRC_OBJ9_Dy_Rv, rawValue);
        rawValue= 8191;
        putValue(E_pubc_GW_GW_2BF_RRC_OBJ9_Dx_Rv, rawValue);
        rawValue= 50;
        putValue(E_pubc_GW_GW_2BF_RRC_OBJ7_ExistProb_Rv, rawValue);
        rawValue= 127;
        putValue(E_pubc_GW_GW_2BF_RRC_OBJ8_Track_ID_Rv, rawValue);
        rawValue= 3;
        putValue(E_pubc_GW_GW_2BF_RRC_OBJ7_Measured_Rv, rawValue);
        rawValue= 7;
        putValue(E_pubc_GW_GW_2BF_RRC_OBJ7_Type_Rv, rawValue);
        rawValue= 3;
        putValue(E_pubc_GW_GW_2BF_RRC_OBJ7_Location_Rv, rawValue);
        rawValue= 3;
        putValue(E_pubc_GW_GW_2BF_RRC_OBJ9_Measured_Rv, rawValue);
        rawValue= 4095;
        putValue(E_pubc_GW_GW_2BF_RRC_OBJ7_Vx_Rv, rawValue);
        rawValue= 1023;
        putValue(E_pubc_GW_GW_2BF_RRC_OBJ7_Vy_Rv, rawValue);
        rawValue= 3;
        putValue(E_pubc_GW_GW_2BF_RRC_OBJ8_Location_Rv, rawValue);
        rawValue= 2047;
        putValue(E_pubc_GW_GW_2BF_RRC_OBJ8_Dy_Rv, rawValue);
        rawValue= 1200;
        putValue(E_pubc_GW_GW_2BF_RRC_OBJ9_Width_Rv, rawValue);
        rawValue= 510;
        putValue(E_pubc_GW_GW_2BF_RRC_OBJ6_Length_Rv, rawValue);
        rawValue= 7;
        putValue(E_pubc_GW_GW_2BF_RRC_OBJ6_Type_Rv, rawValue);
        rawValue= 628;
        putValue(E_pubc_GW_GW_2BF_RRC_OBJ9_HeadingAngle_Rv, rawValue);
        rawValue= 50;
        putValue(E_pubc_GW_GW_2BF_RRC_OBJ8_ExistProb_Rv, rawValue);
        rawValue= 50;
        putValue(E_pubc_GW_GW_2BF_RRC_OBJ6_ObstacleProb_Rv, rawValue);
        rawValue= 50;
        putValue(E_pubc_GW_GW_2BF_RRC_OBJ7_ObstacleProb_Rv, rawValue);
        rawValue= 50;
        putValue(E_pubc_GW_GW_2BF_RRC_OBJ8_ObstacleProb_Rv, rawValue);
        rawValue= 8191;
        putValue(E_pubc_GW_GW_2BF_RRC_OBJ8_Dx_Rv, rawValue);
        rawValue= 50;
        putValue(E_pubc_GW_GW_2BF_RRC_OBJ9_ExistProb_Rv, rawValue);
        rawValue= 1023;
        putValue(E_pubc_GW_GW_2BF_RRC_OBJ7_Ay_Rv, rawValue);
        rawValue= 511;
        putValue(E_pubc_GW_GW_2BF_RRC_OBJ7_Ax_Rv, rawValue);
        rawValue= 1200;
        putValue(E_pubc_GW_GW_2BF_RRC_OBJ8_Width_Rv, rawValue);
        rawValue= 3;
        putValue(E_pubc_GW_GW_2BF_RRC_OBJ6_Measured_Rv, rawValue);
        break;
     default :
        rawValue= 0;
        putValue(E_pubc_GW_GW_2BF_RRC_OBJ8_HeadingAngle_Rv, rawValue);
        rawValue= 0;
        putValue(E_pubc_GW_GW_2BF_RRC_OBJ9_Type_Rv, rawValue);
        rawValue= 0;
        putValue(E_pubc_GW_GW_2BF_RRC_OBJ8_Vy_Rv, rawValue);
        rawValue= 0;
        putValue(E_pubc_GW_GW_2BF_RRC_OBJ6_Dy_Rv, rawValue);
        rawValue= 0;
        putValue(E_pubc_GW_GW_2BF_RRC_OBJ6_Dx_Rv, rawValue);
        rawValue= 0;
        putValue(E_pubc_GW_GW_2BF_RRC_OBJ6_HeadingAngle_Rv, rawValue);
        rawValue= 0;
        putValue(E_pubc_GW_GW_2BF_RRC_OBJ9_Ay_Rv, rawValue);
        rawValue= 0;
        putValue(E_pubc_GW_GW_2BF_RRC_OBJ9_Ax_Rv, rawValue);
        rawValue= 0;
        putValue(E_pubc_GW_GW_2BF_RRC_OBJ8_Vx_Rv, rawValue);
        rawValue= 0;
        putValue(E_pubc_GW_GW_2BF_RRC_OBJ7_Length_Rv, rawValue);
        rawValue= 0;
        putValue(E_pubc_GW_GW_2BF_RRC_OBJ8_Length_Rv, rawValue);
        rawValue= 0;
        putValue(E_pubc_GW_GW_2BF_RRC_OBJ6_Vy_Rv, rawValue);
        rawValue= 0;
        putValue(E_pubc_GW_GW_2BF_RRC_OBJ6_Vx_Rv, rawValue);
        rawValue= 0;
        putValue(E_pubc_GW_GW_2BF_RRC_OBJ8_Ax_Rv, rawValue);
        rawValue= 0;
        putValue(E_pubc_GW_GW_2BF_RRC_OBJ8_Measured_Rv, rawValue);
        rawValue= 0;
        putValue(E_pubc_GW_GW_2BF_RRC_OBJ7_Dx_Rv, rawValue);
        rawValue= 0;
        putValue(E_pubc_GW_GW_2BF_RRC_OBJ7_Dy_Rv, rawValue);
        rawValue= 0;
        putValue(E_pubc_GW_GW_2BF_RRC_OBJ8_Ay_Rv, rawValue);
        rawValue= 0;
        putValue(E_pubc_GW_GW_2BF_RRC_OBJ7_Track_ID_Rv, rawValue);
        rawValue= 0;
        putValue(E_pubc_GW_GW_2BF_RRC_OBJ6_Width_Rv, rawValue);
        rawValue= 0;
        putValue(E_pubc_GW_GW_2BF_RRC_OBJ9_Vx_Rv, rawValue);
        rawValue= 0;
        putValue(E_pubc_GW_GW_2BF_RRC_OBJ9_Vy_Rv, rawValue);
        rawValue= 0;
        putValue(E_pubc_GW_GW_2BF_RRC_OBJ9_ObstacleProb_Rv, rawValue);
        rawValue= 0;
        putValue(E_pubc_GW_GW_2BF_RRC_OBJ7_HeadingAngle_Rv, rawValue);
        rawValue= 0;
        putValue(E_pubc_GW_GW_2BF_RRC_OBJ8_Type_Rv, rawValue);
        rawValue= 0;
        putValue(E_pubc_GW_GW_2BF_RRC_OBJ9_Length_Rv, rawValue);
        rawValue= 0;
        putValue(E_pubc_GW_GW_2BF_RRC_OBJ6_ExistProb_Rv, rawValue);
        rawValue= 0;
        putValue(E_pubc_GW_GW_2BF_RRC_OBJ9_Track_ID_Rv, rawValue);
        rawValue= 0;
        putValue(E_pubc_GW_GW_2BF_RRC_OBJ6_Location_Rv, rawValue);
        rawValue= 0;
        putValue(E_pubc_GW_GW_2BF_RRC_OBJ9_Location_Rv, rawValue);
        rawValue= 0;
        putValue(E_pubc_GW_GW_2BF_RRC_OBJ7_Width_Rv, rawValue);
        rawValue= 0;
        putValue(E_pubc_GW_GW_2BF_RRC_OBJ6_Ax_Rv, rawValue);
        rawValue= 0;
        putValue(E_pubc_GW_GW_2BF_RRC_OBJ6_Ay_Rv, rawValue);
        rawValue= 0;
        putValue(E_pubc_GW_GW_2BF_RRC_OBJ6_Track_ID_Rv, rawValue);
        rawValue= 0;
        putValue(E_pubc_GW_GW_2BF_RRC_OBJ9_Dy_Rv, rawValue);
        rawValue= 0;
        putValue(E_pubc_GW_GW_2BF_RRC_OBJ9_Dx_Rv, rawValue);
        rawValue= 0;
        putValue(E_pubc_GW_GW_2BF_RRC_OBJ7_ExistProb_Rv, rawValue);
        rawValue= 0;
        putValue(E_pubc_GW_GW_2BF_RRC_OBJ8_Track_ID_Rv, rawValue);
        rawValue= 0;
        putValue(E_pubc_GW_GW_2BF_RRC_OBJ7_Measured_Rv, rawValue);
        rawValue= 0;
        putValue(E_pubc_GW_GW_2BF_RRC_OBJ7_Type_Rv, rawValue);
        rawValue= 0;
        putValue(E_pubc_GW_GW_2BF_RRC_OBJ7_Location_Rv, rawValue);
        rawValue= 0;
        putValue(E_pubc_GW_GW_2BF_RRC_OBJ9_Measured_Rv, rawValue);
        rawValue= 0;
        putValue(E_pubc_GW_GW_2BF_RRC_OBJ7_Vx_Rv, rawValue);
        rawValue= 0;
        putValue(E_pubc_GW_GW_2BF_RRC_OBJ7_Vy_Rv, rawValue);
        rawValue= 0;
        putValue(E_pubc_GW_GW_2BF_RRC_OBJ8_Location_Rv, rawValue);
        rawValue= 0;
        putValue(E_pubc_GW_GW_2BF_RRC_OBJ8_Dy_Rv, rawValue);
        rawValue= 0;
        putValue(E_pubc_GW_GW_2BF_RRC_OBJ9_Width_Rv, rawValue);
        rawValue= 0;
        putValue(E_pubc_GW_GW_2BF_RRC_OBJ6_Length_Rv, rawValue);
        rawValue= 0;
        putValue(E_pubc_GW_GW_2BF_RRC_OBJ6_Type_Rv, rawValue);
        rawValue= 0;
        putValue(E_pubc_GW_GW_2BF_RRC_OBJ9_HeadingAngle_Rv, rawValue);
        rawValue= 0;
        putValue(E_pubc_GW_GW_2BF_RRC_OBJ8_ExistProb_Rv, rawValue);
        rawValue= 0;
        putValue(E_pubc_GW_GW_2BF_RRC_OBJ6_ObstacleProb_Rv, rawValue);
        rawValue= 0;
        putValue(E_pubc_GW_GW_2BF_RRC_OBJ7_ObstacleProb_Rv, rawValue);
        rawValue= 0;
        putValue(E_pubc_GW_GW_2BF_RRC_OBJ8_ObstacleProb_Rv, rawValue);
        rawValue= 0;
        putValue(E_pubc_GW_GW_2BF_RRC_OBJ8_Dx_Rv, rawValue);
        rawValue= 0;
        putValue(E_pubc_GW_GW_2BF_RRC_OBJ9_ExistProb_Rv, rawValue);
        rawValue= 0;
        putValue(E_pubc_GW_GW_2BF_RRC_OBJ7_Ay_Rv, rawValue);
        rawValue= 0;
        putValue(E_pubc_GW_GW_2BF_RRC_OBJ7_Ax_Rv, rawValue);
        rawValue= 0;
        putValue(E_pubc_GW_GW_2BF_RRC_OBJ8_Width_Rv, rawValue);
        rawValue= 0;
        putValue(E_pubc_GW_GW_2BF_RRC_OBJ6_Measured_Rv, rawValue);
      break;
   }
}
/*@@end*/

/*@@envVar:E_pubc_GW_GW_2BF_Dlc:*/
on envVar E_pubc_GW_GW_2BF_Dlc
{
    if(getValue(E_pubc_GW_GW_2BF_enDlc))
    {
        Msg_GW_2BF.dlc =getValue(this);
    }
    else
    {
       Dbc_dlc = 64;
	   Msg_GW_2BF.dlc = Calc_Canfd_dlc(Dbc_dlc);
	   // Msg_GW_2BF.dlc = 64;
	   	
  }
}
/*@@end*/

/*@@envVar:E_pubc_GW_GW_2BF_enDlc:*/
on envVar E_pubc_GW_GW_2BF_enDlc
{
    //For Messages with DLC = 8, set wrong DLC to smaller than defined DLC
    //For Messages with DLC < 8 set wrong DLC to smaller/longer than defined DLC
    if(getValue(this))
    {
        Msg_GW_2BF.dlc =getValue(E_pubc_GW_GW_2BF_Dlc);
    }
    else
    {
       Dbc_dlc = 64;
	   Msg_GW_2BF.dlc = Calc_Canfd_dlc(Dbc_dlc);
	   // Msg_GW_2BF.dlc = 64;
    }
}
/*@@end*/

/*@@envVar:E_pubc_GW_GW_2BF_RRC_CRCCheck_2BF_wrongvalctr:*/
on envVar E_pubc_GW_GW_2BF_RRC_CRCCheck_2BF_wrongvalctr
{
    //update disturb count
    //disturb value range:(-1 = always send wrong value),( X>0 ,x is the number of Messages with wrong CHK sent)
    GW_2BF_RRC_CRCCheck_2BF_wrongvalctr =getValue(this);    
}
/*@@end*/
/*@@envVar:E_pubc_GW_GW_2BF_RRC_RollingCounter_2BF_wrongvalctr:*/
on envVar E_pubc_GW_GW_2BF_RRC_RollingCounter_2BF_wrongvalctr
{
    //update disturb count
    //disturb value range:(-1 = always send wrong value),( X>0 ,x is the number of Messages with wrong CHK sent)
    GW_2BF_RRC_RollingCounter_2BF_wrongvalctr =getValue(this);    
}
/*@@end*/

/*@@envVar:E_pubc_GW_GW_2BF_RRC_OBJ8_HeadingAngle_Rv:*/
on envVar E_pubc_GW_GW_2BF_RRC_OBJ8_HeadingAngle_Rv
{
    int64 rawValue = 0ll;
    float rawValue_float = 0.0;
    float phyValue = 0.0;        

    //set the signal with updated raw value
    {
        rawValue = getvalue(this);
        if(chgEv_GW_2BF_RRC_OBJ8_HeadingAngle == 0)
        {
            //type conversion to float
            rawValue_float = rawValue;        
            // raw to physical conversion
            phyValue = ((rawValue_float *0.01)+(-3.14));
            putValue(E_pubc_GW_GW_2BF_RRC_OBJ8_HeadingAngle_Pv, phyValue);
            chgEv_GW_2BF_RRC_OBJ8_HeadingAngle = 1;
        }
        else
        {
            chgEv_GW_2BF_RRC_OBJ8_HeadingAngle = 0;
        }    
        //update the signal value
        Msg_GW_2BF.RRC_OBJ8_HeadingAngle=rawValue;        
    }                                                                           
}
/*@@end*/

/*@@envVar:E_pubc_GW_GW_2BF_RRC_OBJ8_HeadingAngle_Pv:*/
on envVar E_pubc_GW_GW_2BF_RRC_OBJ8_HeadingAngle_Pv
{
    int64 rawValue = 0ll;
    float phyValue = 0.0;
    
    //update the raw value with physical value 
    {
        if(chgEv_GW_2BF_RRC_OBJ8_HeadingAngle == 0)
        {
            phyValue = getvalue(this);
            // physical to raw conversion
            rawValue = ((phyValue -(-3.14))/0.01);
            putValue(E_pubc_GW_GW_2BF_RRC_OBJ8_HeadingAngle_Rv, rawValue);
            chgEv_GW_2BF_RRC_OBJ8_HeadingAngle = 1;  
        }
        else
        {
            chgEv_GW_2BF_RRC_OBJ8_HeadingAngle = 0;
        }
    }
}
/*@@end*/


 
/*@@envVar:E_pubc_GW_GW_2BF_RRC_OBJ9_Type_Rv:*/
on envVar E_pubc_GW_GW_2BF_RRC_OBJ9_Type_Rv
{
    int64 rawValue = 0ll;
    float rawValue_float = 0.0;
    float phyValue = 0.0;        

    //set the signal with updated raw value
    if(getValue(E_pubc_GW_GW_2BF_RRC_OBJ9_Type_SetVt)==0)
    {
        rawValue = getvalue(this);
        if(chgEv_GW_2BF_RRC_OBJ9_Type == 0)
        {
            //type conversion to float
            rawValue_float = rawValue;        
            // raw to physical conversion
            phyValue = ((rawValue_float *1)+(0));
            putValue(E_pubc_GW_GW_2BF_RRC_OBJ9_Type_Pv, phyValue);
            chgEv_GW_2BF_RRC_OBJ9_Type = 1;
        }
        else
        {
            chgEv_GW_2BF_RRC_OBJ9_Type = 0;
        }    
        //update the signal value
        Msg_GW_2BF.RRC_OBJ9_Type=rawValue;        
    }                                                                           
}
/*@@end*/

/*@@envVar:E_pubc_GW_GW_2BF_RRC_OBJ9_Type_Pv:*/
on envVar E_pubc_GW_GW_2BF_RRC_OBJ9_Type_Pv
{
    int64 rawValue = 0ll;
    float phyValue = 0.0;
    
    //update the raw value with physical value 
    if(getValue(E_pubc_GW_GW_2BF_RRC_OBJ9_Type_SetVt)==0)
    {
        if(chgEv_GW_2BF_RRC_OBJ9_Type == 0)
        {
            phyValue = getvalue(this);
            // physical to raw conversion
            rawValue = ((phyValue -(0))/1);
            putValue(E_pubc_GW_GW_2BF_RRC_OBJ9_Type_Rv, rawValue);
            chgEv_GW_2BF_RRC_OBJ9_Type = 1;  
        }
        else
        {
            chgEv_GW_2BF_RRC_OBJ9_Type = 0;
        }
    }
}
/*@@end*/

/*@@envVar:E_pubc_GW_GW_2BF_RRC_OBJ9_Type_Vt:*/
on envVar E_pubc_GW_GW_2BF_RRC_OBJ9_Type_Vt
{
    qword rawValue = 0ll;
    if(getValue(E_pubc_GW_GW_2BF_RRC_OBJ9_Type_SetVt))
    {
        //update the signal value
        Msg_GW_2BF.RRC_OBJ9_Type=getValue(this);
    }
}
/*@@end*/

/*@@envVar:E_pubc_GW_GW_2BF_RRC_OBJ9_Type_SetVt:*/
on envVar E_pubc_GW_GW_2BF_RRC_OBJ9_Type_SetVt
{
    if(getValue(E_pubc_GW_GW_2BF_RRC_OBJ9_Type_SetVt))
    {
        //update the signal value
        Msg_GW_2BF.RRC_OBJ9_Type=getvalue(E_pubc_GW_GW_2BF_RRC_OBJ9_Type_Vt);
    }
    else
    {
        Msg_GW_2BF.RRC_OBJ9_Type=getValue(E_pubc_GW_GW_2BF_RRC_OBJ9_Type_Rv);
    }
}
/*@@end*/
 
/*@@envVar:E_pubc_GW_GW_2BF_RRC_OBJ8_Vy_Rv:*/
on envVar E_pubc_GW_GW_2BF_RRC_OBJ8_Vy_Rv
{
    int64 rawValue = 0ll;
    float rawValue_float = 0.0;
    float phyValue = 0.0;        

    //set the signal with updated raw value
    {
        rawValue = getvalue(this);
        if(chgEv_GW_2BF_RRC_OBJ8_Vy == 0)
        {
            //type conversion to float
            rawValue_float = rawValue;        
            // raw to physical conversion
            phyValue = ((rawValue_float *0.125)+(-64));
            putValue(E_pubc_GW_GW_2BF_RRC_OBJ8_Vy_Pv, phyValue);
            chgEv_GW_2BF_RRC_OBJ8_Vy = 1;
        }
        else
        {
            chgEv_GW_2BF_RRC_OBJ8_Vy = 0;
        }    
        //update the signal value
        Msg_GW_2BF.RRC_OBJ8_Vy=rawValue;        
    }                                                                           
}
/*@@end*/

/*@@envVar:E_pubc_GW_GW_2BF_RRC_OBJ8_Vy_Pv:*/
on envVar E_pubc_GW_GW_2BF_RRC_OBJ8_Vy_Pv
{
    int64 rawValue = 0ll;
    float phyValue = 0.0;
    
    //update the raw value with physical value 
    {
        if(chgEv_GW_2BF_RRC_OBJ8_Vy == 0)
        {
            phyValue = getvalue(this);
            // physical to raw conversion
            rawValue = ((phyValue -(-64))/0.125);
            putValue(E_pubc_GW_GW_2BF_RRC_OBJ8_Vy_Rv, rawValue);
            chgEv_GW_2BF_RRC_OBJ8_Vy = 1;  
        }
        else
        {
            chgEv_GW_2BF_RRC_OBJ8_Vy = 0;
        }
    }
}
/*@@end*/


 
/*@@envVar:E_pubc_GW_GW_2BF_RRC_OBJ6_Dy_Rv:*/
on envVar E_pubc_GW_GW_2BF_RRC_OBJ6_Dy_Rv
{
    int64 rawValue = 0ll;
    float rawValue_float = 0.0;
    float phyValue = 0.0;        

    //set the signal with updated raw value
    {
        rawValue = getvalue(this);
        if(chgEv_GW_2BF_RRC_OBJ6_Dy == 0)
        {
            //type conversion to float
            rawValue_float = rawValue;        
            // raw to physical conversion
            phyValue = ((rawValue_float *0.125)+(-128));
            putValue(E_pubc_GW_GW_2BF_RRC_OBJ6_Dy_Pv, phyValue);
            chgEv_GW_2BF_RRC_OBJ6_Dy = 1;
        }
        else
        {
            chgEv_GW_2BF_RRC_OBJ6_Dy = 0;
        }    
        //update the signal value
        Msg_GW_2BF.RRC_OBJ6_Dy=rawValue;        
    }                                                                           
}
/*@@end*/

/*@@envVar:E_pubc_GW_GW_2BF_RRC_OBJ6_Dy_Pv:*/
on envVar E_pubc_GW_GW_2BF_RRC_OBJ6_Dy_Pv
{
    int64 rawValue = 0ll;
    float phyValue = 0.0;
    
    //update the raw value with physical value 
    {
        if(chgEv_GW_2BF_RRC_OBJ6_Dy == 0)
        {
            phyValue = getvalue(this);
            // physical to raw conversion
            rawValue = ((phyValue -(-128))/0.125);
            putValue(E_pubc_GW_GW_2BF_RRC_OBJ6_Dy_Rv, rawValue);
            chgEv_GW_2BF_RRC_OBJ6_Dy = 1;  
        }
        else
        {
            chgEv_GW_2BF_RRC_OBJ6_Dy = 0;
        }
    }
}
/*@@end*/


 
/*@@envVar:E_pubc_GW_GW_2BF_RRC_OBJ6_Dx_Rv:*/
on envVar E_pubc_GW_GW_2BF_RRC_OBJ6_Dx_Rv
{
    int64 rawValue = 0ll;
    float rawValue_float = 0.0;
    float phyValue = 0.0;        

    //set the signal with updated raw value
    {
        rawValue = getvalue(this);
        if(chgEv_GW_2BF_RRC_OBJ6_Dx == 0)
        {
            //type conversion to float
            rawValue_float = rawValue;        
            // raw to physical conversion
            phyValue = ((rawValue_float *0.0625)+(-256));
            putValue(E_pubc_GW_GW_2BF_RRC_OBJ6_Dx_Pv, phyValue);
            chgEv_GW_2BF_RRC_OBJ6_Dx = 1;
        }
        else
        {
            chgEv_GW_2BF_RRC_OBJ6_Dx = 0;
        }    
        //update the signal value
        Msg_GW_2BF.RRC_OBJ6_Dx=rawValue;        
    }                                                                           
}
/*@@end*/

/*@@envVar:E_pubc_GW_GW_2BF_RRC_OBJ6_Dx_Pv:*/
on envVar E_pubc_GW_GW_2BF_RRC_OBJ6_Dx_Pv
{
    int64 rawValue = 0ll;
    float phyValue = 0.0;
    
    //update the raw value with physical value 
    {
        if(chgEv_GW_2BF_RRC_OBJ6_Dx == 0)
        {
            phyValue = getvalue(this);
            // physical to raw conversion
            rawValue = ((phyValue -(-256))/0.0625);
            putValue(E_pubc_GW_GW_2BF_RRC_OBJ6_Dx_Rv, rawValue);
            chgEv_GW_2BF_RRC_OBJ6_Dx = 1;  
        }
        else
        {
            chgEv_GW_2BF_RRC_OBJ6_Dx = 0;
        }
    }
}
/*@@end*/


 
/*@@envVar:E_pubc_GW_GW_2BF_RRC_OBJ6_HeadingAngle_Rv:*/
on envVar E_pubc_GW_GW_2BF_RRC_OBJ6_HeadingAngle_Rv
{
    int64 rawValue = 0ll;
    float rawValue_float = 0.0;
    float phyValue = 0.0;        

    //set the signal with updated raw value
    {
        rawValue = getvalue(this);
        if(chgEv_GW_2BF_RRC_OBJ6_HeadingAngle == 0)
        {
            //type conversion to float
            rawValue_float = rawValue;        
            // raw to physical conversion
            phyValue = ((rawValue_float *0.01)+(-3.14));
            putValue(E_pubc_GW_GW_2BF_RRC_OBJ6_HeadingAngle_Pv, phyValue);
            chgEv_GW_2BF_RRC_OBJ6_HeadingAngle = 1;
        }
        else
        {
            chgEv_GW_2BF_RRC_OBJ6_HeadingAngle = 0;
        }    
        //update the signal value
        Msg_GW_2BF.RRC_OBJ6_HeadingAngle=rawValue;        
    }                                                                           
}
/*@@end*/

/*@@envVar:E_pubc_GW_GW_2BF_RRC_OBJ6_HeadingAngle_Pv:*/
on envVar E_pubc_GW_GW_2BF_RRC_OBJ6_HeadingAngle_Pv
{
    int64 rawValue = 0ll;
    float phyValue = 0.0;
    
    //update the raw value with physical value 
    {
        if(chgEv_GW_2BF_RRC_OBJ6_HeadingAngle == 0)
        {
            phyValue = getvalue(this);
            // physical to raw conversion
            rawValue = ((phyValue -(-3.14))/0.01);
            putValue(E_pubc_GW_GW_2BF_RRC_OBJ6_HeadingAngle_Rv, rawValue);
            chgEv_GW_2BF_RRC_OBJ6_HeadingAngle = 1;  
        }
        else
        {
            chgEv_GW_2BF_RRC_OBJ6_HeadingAngle = 0;
        }
    }
}
/*@@end*/


 
/*@@envVar:E_pubc_GW_GW_2BF_RRC_OBJ9_Ay_Rv:*/
on envVar E_pubc_GW_GW_2BF_RRC_OBJ9_Ay_Rv
{
    int64 rawValue = 0ll;
    float rawValue_float = 0.0;
    float phyValue = 0.0;        

    //set the signal with updated raw value
    {
        rawValue = getvalue(this);
        if(chgEv_GW_2BF_RRC_OBJ9_Ay == 0)
        {
            //type conversion to float
            rawValue_float = rawValue;        
            // raw to physical conversion
            phyValue = ((rawValue_float *0.03125)+(-16));
            putValue(E_pubc_GW_GW_2BF_RRC_OBJ9_Ay_Pv, phyValue);
            chgEv_GW_2BF_RRC_OBJ9_Ay = 1;
        }
        else
        {
            chgEv_GW_2BF_RRC_OBJ9_Ay = 0;
        }    
        //update the signal value
        Msg_GW_2BF.RRC_OBJ9_Ay=rawValue;        
    }                                                                           
}
/*@@end*/

/*@@envVar:E_pubc_GW_GW_2BF_RRC_OBJ9_Ay_Pv:*/
on envVar E_pubc_GW_GW_2BF_RRC_OBJ9_Ay_Pv
{
    int64 rawValue = 0ll;
    float phyValue = 0.0;
    
    //update the raw value with physical value 
    {
        if(chgEv_GW_2BF_RRC_OBJ9_Ay == 0)
        {
            phyValue = getvalue(this);
            // physical to raw conversion
            rawValue = ((phyValue -(-16))/0.03125);
            putValue(E_pubc_GW_GW_2BF_RRC_OBJ9_Ay_Rv, rawValue);
            chgEv_GW_2BF_RRC_OBJ9_Ay = 1;  
        }
        else
        {
            chgEv_GW_2BF_RRC_OBJ9_Ay = 0;
        }
    }
}
/*@@end*/


 
/*@@envVar:E_pubc_GW_GW_2BF_RRC_OBJ9_Ax_Rv:*/
on envVar E_pubc_GW_GW_2BF_RRC_OBJ9_Ax_Rv
{
    int64 rawValue = 0ll;
    float rawValue_float = 0.0;
    float phyValue = 0.0;        

    //set the signal with updated raw value
    {
        rawValue = getvalue(this);
        if(chgEv_GW_2BF_RRC_OBJ9_Ax == 0)
        {
            //type conversion to float
            rawValue_float = rawValue;        
            // raw to physical conversion
            phyValue = ((rawValue_float *0.0625)+(-16));
            putValue(E_pubc_GW_GW_2BF_RRC_OBJ9_Ax_Pv, phyValue);
            chgEv_GW_2BF_RRC_OBJ9_Ax = 1;
        }
        else
        {
            chgEv_GW_2BF_RRC_OBJ9_Ax = 0;
        }    
        //update the signal value
        Msg_GW_2BF.RRC_OBJ9_Ax=rawValue;        
    }                                                                           
}
/*@@end*/

/*@@envVar:E_pubc_GW_GW_2BF_RRC_OBJ9_Ax_Pv:*/
on envVar E_pubc_GW_GW_2BF_RRC_OBJ9_Ax_Pv
{
    int64 rawValue = 0ll;
    float phyValue = 0.0;
    
    //update the raw value with physical value 
    {
        if(chgEv_GW_2BF_RRC_OBJ9_Ax == 0)
        {
            phyValue = getvalue(this);
            // physical to raw conversion
            rawValue = ((phyValue -(-16))/0.0625);
            putValue(E_pubc_GW_GW_2BF_RRC_OBJ9_Ax_Rv, rawValue);
            chgEv_GW_2BF_RRC_OBJ9_Ax = 1;  
        }
        else
        {
            chgEv_GW_2BF_RRC_OBJ9_Ax = 0;
        }
    }
}
/*@@end*/


 
/*@@envVar:E_pubc_GW_GW_2BF_RRC_OBJ8_Vx_Rv:*/
on envVar E_pubc_GW_GW_2BF_RRC_OBJ8_Vx_Rv
{
    int64 rawValue = 0ll;
    float rawValue_float = 0.0;
    float phyValue = 0.0;        

    //set the signal with updated raw value
    {
        rawValue = getvalue(this);
        if(chgEv_GW_2BF_RRC_OBJ8_Vx == 0)
        {
            //type conversion to float
            rawValue_float = rawValue;        
            // raw to physical conversion
            phyValue = ((rawValue_float *0.0625)+(-128));
            putValue(E_pubc_GW_GW_2BF_RRC_OBJ8_Vx_Pv, phyValue);
            chgEv_GW_2BF_RRC_OBJ8_Vx = 1;
        }
        else
        {
            chgEv_GW_2BF_RRC_OBJ8_Vx = 0;
        }    
        //update the signal value
        Msg_GW_2BF.RRC_OBJ8_Vx=rawValue;        
    }                                                                           
}
/*@@end*/

/*@@envVar:E_pubc_GW_GW_2BF_RRC_OBJ8_Vx_Pv:*/
on envVar E_pubc_GW_GW_2BF_RRC_OBJ8_Vx_Pv
{
    int64 rawValue = 0ll;
    float phyValue = 0.0;
    
    //update the raw value with physical value 
    {
        if(chgEv_GW_2BF_RRC_OBJ8_Vx == 0)
        {
            phyValue = getvalue(this);
            // physical to raw conversion
            rawValue = ((phyValue -(-128))/0.0625);
            putValue(E_pubc_GW_GW_2BF_RRC_OBJ8_Vx_Rv, rawValue);
            chgEv_GW_2BF_RRC_OBJ8_Vx = 1;  
        }
        else
        {
            chgEv_GW_2BF_RRC_OBJ8_Vx = 0;
        }
    }
}
/*@@end*/


 
/*@@envVar:E_pubc_GW_GW_2BF_RRC_OBJ7_Length_Rv:*/
on envVar E_pubc_GW_GW_2BF_RRC_OBJ7_Length_Rv
{
    int64 rawValue = 0ll;
    float rawValue_float = 0.0;
    float phyValue = 0.0;        

    //set the signal with updated raw value
    {
        rawValue = getvalue(this);
        if(chgEv_GW_2BF_RRC_OBJ7_Length == 0)
        {
            //type conversion to float
            rawValue_float = rawValue;        
            // raw to physical conversion
            phyValue = ((rawValue_float *0.05)+(0));
            putValue(E_pubc_GW_GW_2BF_RRC_OBJ7_Length_Pv, phyValue);
            chgEv_GW_2BF_RRC_OBJ7_Length = 1;
        }
        else
        {
            chgEv_GW_2BF_RRC_OBJ7_Length = 0;
        }    
        //update the signal value
        Msg_GW_2BF.RRC_OBJ7_Length=rawValue;        
    }                                                                           
}
/*@@end*/

/*@@envVar:E_pubc_GW_GW_2BF_RRC_OBJ7_Length_Pv:*/
on envVar E_pubc_GW_GW_2BF_RRC_OBJ7_Length_Pv
{
    int64 rawValue = 0ll;
    float phyValue = 0.0;
    
    //update the raw value with physical value 
    {
        if(chgEv_GW_2BF_RRC_OBJ7_Length == 0)
        {
            phyValue = getvalue(this);
            // physical to raw conversion
            rawValue = ((phyValue -(0))/0.05);
            putValue(E_pubc_GW_GW_2BF_RRC_OBJ7_Length_Rv, rawValue);
            chgEv_GW_2BF_RRC_OBJ7_Length = 1;  
        }
        else
        {
            chgEv_GW_2BF_RRC_OBJ7_Length = 0;
        }
    }
}
/*@@end*/


 
/*@@envVar:E_pubc_GW_GW_2BF_RRC_OBJ8_Length_Rv:*/
on envVar E_pubc_GW_GW_2BF_RRC_OBJ8_Length_Rv
{
    int64 rawValue = 0ll;
    float rawValue_float = 0.0;
    float phyValue = 0.0;        

    //set the signal with updated raw value
    {
        rawValue = getvalue(this);
        if(chgEv_GW_2BF_RRC_OBJ8_Length == 0)
        {
            //type conversion to float
            rawValue_float = rawValue;        
            // raw to physical conversion
            phyValue = ((rawValue_float *0.05)+(0));
            putValue(E_pubc_GW_GW_2BF_RRC_OBJ8_Length_Pv, phyValue);
            chgEv_GW_2BF_RRC_OBJ8_Length = 1;
        }
        else
        {
            chgEv_GW_2BF_RRC_OBJ8_Length = 0;
        }    
        //update the signal value
        Msg_GW_2BF.RRC_OBJ8_Length=rawValue;        
    }                                                                           
}
/*@@end*/

/*@@envVar:E_pubc_GW_GW_2BF_RRC_OBJ8_Length_Pv:*/
on envVar E_pubc_GW_GW_2BF_RRC_OBJ8_Length_Pv
{
    int64 rawValue = 0ll;
    float phyValue = 0.0;
    
    //update the raw value with physical value 
    {
        if(chgEv_GW_2BF_RRC_OBJ8_Length == 0)
        {
            phyValue = getvalue(this);
            // physical to raw conversion
            rawValue = ((phyValue -(0))/0.05);
            putValue(E_pubc_GW_GW_2BF_RRC_OBJ8_Length_Rv, rawValue);
            chgEv_GW_2BF_RRC_OBJ8_Length = 1;  
        }
        else
        {
            chgEv_GW_2BF_RRC_OBJ8_Length = 0;
        }
    }
}
/*@@end*/


 
/*@@envVar:E_pubc_GW_GW_2BF_RRC_OBJ6_Vy_Rv:*/
on envVar E_pubc_GW_GW_2BF_RRC_OBJ6_Vy_Rv
{
    int64 rawValue = 0ll;
    float rawValue_float = 0.0;
    float phyValue = 0.0;        

    //set the signal with updated raw value
    {
        rawValue = getvalue(this);
        if(chgEv_GW_2BF_RRC_OBJ6_Vy == 0)
        {
            //type conversion to float
            rawValue_float = rawValue;        
            // raw to physical conversion
            phyValue = ((rawValue_float *0.125)+(-64));
            putValue(E_pubc_GW_GW_2BF_RRC_OBJ6_Vy_Pv, phyValue);
            chgEv_GW_2BF_RRC_OBJ6_Vy = 1;
        }
        else
        {
            chgEv_GW_2BF_RRC_OBJ6_Vy = 0;
        }    
        //update the signal value
        Msg_GW_2BF.RRC_OBJ6_Vy=rawValue;        
    }                                                                           
}
/*@@end*/

/*@@envVar:E_pubc_GW_GW_2BF_RRC_OBJ6_Vy_Pv:*/
on envVar E_pubc_GW_GW_2BF_RRC_OBJ6_Vy_Pv
{
    int64 rawValue = 0ll;
    float phyValue = 0.0;
    
    //update the raw value with physical value 
    {
        if(chgEv_GW_2BF_RRC_OBJ6_Vy == 0)
        {
            phyValue = getvalue(this);
            // physical to raw conversion
            rawValue = ((phyValue -(-64))/0.125);
            putValue(E_pubc_GW_GW_2BF_RRC_OBJ6_Vy_Rv, rawValue);
            chgEv_GW_2BF_RRC_OBJ6_Vy = 1;  
        }
        else
        {
            chgEv_GW_2BF_RRC_OBJ6_Vy = 0;
        }
    }
}
/*@@end*/


 
/*@@envVar:E_pubc_GW_GW_2BF_RRC_OBJ6_Vx_Rv:*/
on envVar E_pubc_GW_GW_2BF_RRC_OBJ6_Vx_Rv
{
    int64 rawValue = 0ll;
    float rawValue_float = 0.0;
    float phyValue = 0.0;        

    //set the signal with updated raw value
    {
        rawValue = getvalue(this);
        if(chgEv_GW_2BF_RRC_OBJ6_Vx == 0)
        {
            //type conversion to float
            rawValue_float = rawValue;        
            // raw to physical conversion
            phyValue = ((rawValue_float *0.0625)+(-128));
            putValue(E_pubc_GW_GW_2BF_RRC_OBJ6_Vx_Pv, phyValue);
            chgEv_GW_2BF_RRC_OBJ6_Vx = 1;
        }
        else
        {
            chgEv_GW_2BF_RRC_OBJ6_Vx = 0;
        }    
        //update the signal value
        Msg_GW_2BF.RRC_OBJ6_Vx=rawValue;        
    }                                                                           
}
/*@@end*/

/*@@envVar:E_pubc_GW_GW_2BF_RRC_OBJ6_Vx_Pv:*/
on envVar E_pubc_GW_GW_2BF_RRC_OBJ6_Vx_Pv
{
    int64 rawValue = 0ll;
    float phyValue = 0.0;
    
    //update the raw value with physical value 
    {
        if(chgEv_GW_2BF_RRC_OBJ6_Vx == 0)
        {
            phyValue = getvalue(this);
            // physical to raw conversion
            rawValue = ((phyValue -(-128))/0.0625);
            putValue(E_pubc_GW_GW_2BF_RRC_OBJ6_Vx_Rv, rawValue);
            chgEv_GW_2BF_RRC_OBJ6_Vx = 1;  
        }
        else
        {
            chgEv_GW_2BF_RRC_OBJ6_Vx = 0;
        }
    }
}
/*@@end*/


 
/*@@envVar:E_pubc_GW_GW_2BF_RRC_OBJ8_Ax_Rv:*/
on envVar E_pubc_GW_GW_2BF_RRC_OBJ8_Ax_Rv
{
    int64 rawValue = 0ll;
    float rawValue_float = 0.0;
    float phyValue = 0.0;        

    //set the signal with updated raw value
    {
        rawValue = getvalue(this);
        if(chgEv_GW_2BF_RRC_OBJ8_Ax == 0)
        {
            //type conversion to float
            rawValue_float = rawValue;        
            // raw to physical conversion
            phyValue = ((rawValue_float *0.0625)+(-16));
            putValue(E_pubc_GW_GW_2BF_RRC_OBJ8_Ax_Pv, phyValue);
            chgEv_GW_2BF_RRC_OBJ8_Ax = 1;
        }
        else
        {
            chgEv_GW_2BF_RRC_OBJ8_Ax = 0;
        }    
        //update the signal value
        Msg_GW_2BF.RRC_OBJ8_Ax=rawValue;        
    }                                                                           
}
/*@@end*/

/*@@envVar:E_pubc_GW_GW_2BF_RRC_OBJ8_Ax_Pv:*/
on envVar E_pubc_GW_GW_2BF_RRC_OBJ8_Ax_Pv
{
    int64 rawValue = 0ll;
    float phyValue = 0.0;
    
    //update the raw value with physical value 
    {
        if(chgEv_GW_2BF_RRC_OBJ8_Ax == 0)
        {
            phyValue = getvalue(this);
            // physical to raw conversion
            rawValue = ((phyValue -(-16))/0.0625);
            putValue(E_pubc_GW_GW_2BF_RRC_OBJ8_Ax_Rv, rawValue);
            chgEv_GW_2BF_RRC_OBJ8_Ax = 1;  
        }
        else
        {
            chgEv_GW_2BF_RRC_OBJ8_Ax = 0;
        }
    }
}
/*@@end*/


 
/*@@envVar:E_pubc_GW_GW_2BF_RRC_OBJ8_Measured_Rv:*/
on envVar E_pubc_GW_GW_2BF_RRC_OBJ8_Measured_Rv
{
    int64 rawValue = 0ll;
    float rawValue_float = 0.0;
    float phyValue = 0.0;        

    //set the signal with updated raw value
    if(getValue(E_pubc_GW_GW_2BF_RRC_OBJ8_Measured_SetVt)==0)
    {
        rawValue = getvalue(this);
        if(chgEv_GW_2BF_RRC_OBJ8_Measured == 0)
        {
            //type conversion to float
            rawValue_float = rawValue;        
            // raw to physical conversion
            phyValue = ((rawValue_float *1)+(0));
            putValue(E_pubc_GW_GW_2BF_RRC_OBJ8_Measured_Pv, phyValue);
            chgEv_GW_2BF_RRC_OBJ8_Measured = 1;
        }
        else
        {
            chgEv_GW_2BF_RRC_OBJ8_Measured = 0;
        }    
        //update the signal value
        Msg_GW_2BF.RRC_OBJ8_Measured=rawValue;        
    }                                                                           
}
/*@@end*/

/*@@envVar:E_pubc_GW_GW_2BF_RRC_OBJ8_Measured_Pv:*/
on envVar E_pubc_GW_GW_2BF_RRC_OBJ8_Measured_Pv
{
    int64 rawValue = 0ll;
    float phyValue = 0.0;
    
    //update the raw value with physical value 
    if(getValue(E_pubc_GW_GW_2BF_RRC_OBJ8_Measured_SetVt)==0)
    {
        if(chgEv_GW_2BF_RRC_OBJ8_Measured == 0)
        {
            phyValue = getvalue(this);
            // physical to raw conversion
            rawValue = ((phyValue -(0))/1);
            putValue(E_pubc_GW_GW_2BF_RRC_OBJ8_Measured_Rv, rawValue);
            chgEv_GW_2BF_RRC_OBJ8_Measured = 1;  
        }
        else
        {
            chgEv_GW_2BF_RRC_OBJ8_Measured = 0;
        }
    }
}
/*@@end*/

/*@@envVar:E_pubc_GW_GW_2BF_RRC_OBJ8_Measured_Vt:*/
on envVar E_pubc_GW_GW_2BF_RRC_OBJ8_Measured_Vt
{
    qword rawValue = 0ll;
    if(getValue(E_pubc_GW_GW_2BF_RRC_OBJ8_Measured_SetVt))
    {
        //update the signal value
        Msg_GW_2BF.RRC_OBJ8_Measured=getValue(this);
    }
}
/*@@end*/

/*@@envVar:E_pubc_GW_GW_2BF_RRC_OBJ8_Measured_SetVt:*/
on envVar E_pubc_GW_GW_2BF_RRC_OBJ8_Measured_SetVt
{
    if(getValue(E_pubc_GW_GW_2BF_RRC_OBJ8_Measured_SetVt))
    {
        //update the signal value
        Msg_GW_2BF.RRC_OBJ8_Measured=getvalue(E_pubc_GW_GW_2BF_RRC_OBJ8_Measured_Vt);
    }
    else
    {
        Msg_GW_2BF.RRC_OBJ8_Measured=getValue(E_pubc_GW_GW_2BF_RRC_OBJ8_Measured_Rv);
    }
}
/*@@end*/
 
/*@@envVar:E_pubc_GW_GW_2BF_RRC_OBJ7_Dx_Rv:*/
on envVar E_pubc_GW_GW_2BF_RRC_OBJ7_Dx_Rv
{
    int64 rawValue = 0ll;
    float rawValue_float = 0.0;
    float phyValue = 0.0;        

    //set the signal with updated raw value
    {
        rawValue = getvalue(this);
        if(chgEv_GW_2BF_RRC_OBJ7_Dx == 0)
        {
            //type conversion to float
            rawValue_float = rawValue;        
            // raw to physical conversion
            phyValue = ((rawValue_float *0.0625)+(-256));
            putValue(E_pubc_GW_GW_2BF_RRC_OBJ7_Dx_Pv, phyValue);
            chgEv_GW_2BF_RRC_OBJ7_Dx = 1;
        }
        else
        {
            chgEv_GW_2BF_RRC_OBJ7_Dx = 0;
        }    
        //update the signal value
        Msg_GW_2BF.RRC_OBJ7_Dx=rawValue;        
    }                                                                           
}
/*@@end*/

/*@@envVar:E_pubc_GW_GW_2BF_RRC_OBJ7_Dx_Pv:*/
on envVar E_pubc_GW_GW_2BF_RRC_OBJ7_Dx_Pv
{
    int64 rawValue = 0ll;
    float phyValue = 0.0;
    
    //update the raw value with physical value 
    {
        if(chgEv_GW_2BF_RRC_OBJ7_Dx == 0)
        {
            phyValue = getvalue(this);
            // physical to raw conversion
            rawValue = ((phyValue -(-256))/0.0625);
            putValue(E_pubc_GW_GW_2BF_RRC_OBJ7_Dx_Rv, rawValue);
            chgEv_GW_2BF_RRC_OBJ7_Dx = 1;  
        }
        else
        {
            chgEv_GW_2BF_RRC_OBJ7_Dx = 0;
        }
    }
}
/*@@end*/


 
/*@@envVar:E_pubc_GW_GW_2BF_RRC_OBJ7_Dy_Rv:*/
on envVar E_pubc_GW_GW_2BF_RRC_OBJ7_Dy_Rv
{
    int64 rawValue = 0ll;
    float rawValue_float = 0.0;
    float phyValue = 0.0;        

    //set the signal with updated raw value
    {
        rawValue = getvalue(this);
        if(chgEv_GW_2BF_RRC_OBJ7_Dy == 0)
        {
            //type conversion to float
            rawValue_float = rawValue;        
            // raw to physical conversion
            phyValue = ((rawValue_float *0.125)+(-128));
            putValue(E_pubc_GW_GW_2BF_RRC_OBJ7_Dy_Pv, phyValue);
            chgEv_GW_2BF_RRC_OBJ7_Dy = 1;
        }
        else
        {
            chgEv_GW_2BF_RRC_OBJ7_Dy = 0;
        }    
        //update the signal value
        Msg_GW_2BF.RRC_OBJ7_Dy=rawValue;        
    }                                                                           
}
/*@@end*/

/*@@envVar:E_pubc_GW_GW_2BF_RRC_OBJ7_Dy_Pv:*/
on envVar E_pubc_GW_GW_2BF_RRC_OBJ7_Dy_Pv
{
    int64 rawValue = 0ll;
    float phyValue = 0.0;
    
    //update the raw value with physical value 
    {
        if(chgEv_GW_2BF_RRC_OBJ7_Dy == 0)
        {
            phyValue = getvalue(this);
            // physical to raw conversion
            rawValue = ((phyValue -(-128))/0.125);
            putValue(E_pubc_GW_GW_2BF_RRC_OBJ7_Dy_Rv, rawValue);
            chgEv_GW_2BF_RRC_OBJ7_Dy = 1;  
        }
        else
        {
            chgEv_GW_2BF_RRC_OBJ7_Dy = 0;
        }
    }
}
/*@@end*/


 
/*@@envVar:E_pubc_GW_GW_2BF_RRC_OBJ8_Ay_Rv:*/
on envVar E_pubc_GW_GW_2BF_RRC_OBJ8_Ay_Rv
{
    int64 rawValue = 0ll;
    float rawValue_float = 0.0;
    float phyValue = 0.0;        

    //set the signal with updated raw value
    {
        rawValue = getvalue(this);
        if(chgEv_GW_2BF_RRC_OBJ8_Ay == 0)
        {
            //type conversion to float
            rawValue_float = rawValue;        
            // raw to physical conversion
            phyValue = ((rawValue_float *0.03125)+(-16));
            putValue(E_pubc_GW_GW_2BF_RRC_OBJ8_Ay_Pv, phyValue);
            chgEv_GW_2BF_RRC_OBJ8_Ay = 1;
        }
        else
        {
            chgEv_GW_2BF_RRC_OBJ8_Ay = 0;
        }    
        //update the signal value
        Msg_GW_2BF.RRC_OBJ8_Ay=rawValue;        
    }                                                                           
}
/*@@end*/

/*@@envVar:E_pubc_GW_GW_2BF_RRC_OBJ8_Ay_Pv:*/
on envVar E_pubc_GW_GW_2BF_RRC_OBJ8_Ay_Pv
{
    int64 rawValue = 0ll;
    float phyValue = 0.0;
    
    //update the raw value with physical value 
    {
        if(chgEv_GW_2BF_RRC_OBJ8_Ay == 0)
        {
            phyValue = getvalue(this);
            // physical to raw conversion
            rawValue = ((phyValue -(-16))/0.03125);
            putValue(E_pubc_GW_GW_2BF_RRC_OBJ8_Ay_Rv, rawValue);
            chgEv_GW_2BF_RRC_OBJ8_Ay = 1;  
        }
        else
        {
            chgEv_GW_2BF_RRC_OBJ8_Ay = 0;
        }
    }
}
/*@@end*/


 
/*@@envVar:E_pubc_GW_GW_2BF_RRC_OBJ7_Track_ID_Rv:*/
on envVar E_pubc_GW_GW_2BF_RRC_OBJ7_Track_ID_Rv
{
    int64 rawValue = 0ll;
    float rawValue_float = 0.0;
    float phyValue = 0.0;        

    //set the signal with updated raw value
    {
        rawValue = getvalue(this);
        if(chgEv_GW_2BF_RRC_OBJ7_Track_ID == 0)
        {
            //type conversion to float
            rawValue_float = rawValue;        
            // raw to physical conversion
            phyValue = ((rawValue_float *1)+(0));
            putValue(E_pubc_GW_GW_2BF_RRC_OBJ7_Track_ID_Pv, phyValue);
            chgEv_GW_2BF_RRC_OBJ7_Track_ID = 1;
        }
        else
        {
            chgEv_GW_2BF_RRC_OBJ7_Track_ID = 0;
        }    
        //update the signal value
        Msg_GW_2BF.RRC_OBJ7_Track_ID=rawValue;        
    }                                                                           
}
/*@@end*/

/*@@envVar:E_pubc_GW_GW_2BF_RRC_OBJ7_Track_ID_Pv:*/
on envVar E_pubc_GW_GW_2BF_RRC_OBJ7_Track_ID_Pv
{
    int64 rawValue = 0ll;
    float phyValue = 0.0;
    
    //update the raw value with physical value 
    {
        if(chgEv_GW_2BF_RRC_OBJ7_Track_ID == 0)
        {
            phyValue = getvalue(this);
            // physical to raw conversion
            rawValue = ((phyValue -(0))/1);
            putValue(E_pubc_GW_GW_2BF_RRC_OBJ7_Track_ID_Rv, rawValue);
            chgEv_GW_2BF_RRC_OBJ7_Track_ID = 1;  
        }
        else
        {
            chgEv_GW_2BF_RRC_OBJ7_Track_ID = 0;
        }
    }
}
/*@@end*/


 
/*@@envVar:E_pubc_GW_GW_2BF_RRC_OBJ6_Width_Rv:*/
on envVar E_pubc_GW_GW_2BF_RRC_OBJ6_Width_Rv
{
    int64 rawValue = 0ll;
    float rawValue_float = 0.0;
    float phyValue = 0.0;        

    //set the signal with updated raw value
    {
        rawValue = getvalue(this);
        if(chgEv_GW_2BF_RRC_OBJ6_Width == 0)
        {
            //type conversion to float
            rawValue_float = rawValue;        
            // raw to physical conversion
            phyValue = ((rawValue_float *0.01)+(0));
            putValue(E_pubc_GW_GW_2BF_RRC_OBJ6_Width_Pv, phyValue);
            chgEv_GW_2BF_RRC_OBJ6_Width = 1;
        }
        else
        {
            chgEv_GW_2BF_RRC_OBJ6_Width = 0;
        }    
        //update the signal value
        Msg_GW_2BF.RRC_OBJ6_Width=rawValue;        
    }                                                                           
}
/*@@end*/

/*@@envVar:E_pubc_GW_GW_2BF_RRC_OBJ6_Width_Pv:*/
on envVar E_pubc_GW_GW_2BF_RRC_OBJ6_Width_Pv
{
    int64 rawValue = 0ll;
    float phyValue = 0.0;
    
    //update the raw value with physical value 
    {
        if(chgEv_GW_2BF_RRC_OBJ6_Width == 0)
        {
            phyValue = getvalue(this);
            // physical to raw conversion
            rawValue = ((phyValue -(0))/0.01);
            putValue(E_pubc_GW_GW_2BF_RRC_OBJ6_Width_Rv, rawValue);
            chgEv_GW_2BF_RRC_OBJ6_Width = 1;  
        }
        else
        {
            chgEv_GW_2BF_RRC_OBJ6_Width = 0;
        }
    }
}
/*@@end*/


 
/*@@envVar:E_pubc_GW_GW_2BF_RRC_OBJ9_Vx_Rv:*/
on envVar E_pubc_GW_GW_2BF_RRC_OBJ9_Vx_Rv
{
    int64 rawValue = 0ll;
    float rawValue_float = 0.0;
    float phyValue = 0.0;        

    //set the signal with updated raw value
    {
        rawValue = getvalue(this);
        if(chgEv_GW_2BF_RRC_OBJ9_Vx == 0)
        {
            //type conversion to float
            rawValue_float = rawValue;        
            // raw to physical conversion
            phyValue = ((rawValue_float *0.0625)+(-128));
            putValue(E_pubc_GW_GW_2BF_RRC_OBJ9_Vx_Pv, phyValue);
            chgEv_GW_2BF_RRC_OBJ9_Vx = 1;
        }
        else
        {
            chgEv_GW_2BF_RRC_OBJ9_Vx = 0;
        }    
        //update the signal value
        Msg_GW_2BF.RRC_OBJ9_Vx=rawValue;        
    }                                                                           
}
/*@@end*/

/*@@envVar:E_pubc_GW_GW_2BF_RRC_OBJ9_Vx_Pv:*/
on envVar E_pubc_GW_GW_2BF_RRC_OBJ9_Vx_Pv
{
    int64 rawValue = 0ll;
    float phyValue = 0.0;
    
    //update the raw value with physical value 
    {
        if(chgEv_GW_2BF_RRC_OBJ9_Vx == 0)
        {
            phyValue = getvalue(this);
            // physical to raw conversion
            rawValue = ((phyValue -(-128))/0.0625);
            putValue(E_pubc_GW_GW_2BF_RRC_OBJ9_Vx_Rv, rawValue);
            chgEv_GW_2BF_RRC_OBJ9_Vx = 1;  
        }
        else
        {
            chgEv_GW_2BF_RRC_OBJ9_Vx = 0;
        }
    }
}
/*@@end*/


 
/*@@envVar:E_pubc_GW_GW_2BF_RRC_OBJ9_Vy_Rv:*/
on envVar E_pubc_GW_GW_2BF_RRC_OBJ9_Vy_Rv
{
    int64 rawValue = 0ll;
    float rawValue_float = 0.0;
    float phyValue = 0.0;        

    //set the signal with updated raw value
    {
        rawValue = getvalue(this);
        if(chgEv_GW_2BF_RRC_OBJ9_Vy == 0)
        {
            //type conversion to float
            rawValue_float = rawValue;        
            // raw to physical conversion
            phyValue = ((rawValue_float *0.125)+(-64));
            putValue(E_pubc_GW_GW_2BF_RRC_OBJ9_Vy_Pv, phyValue);
            chgEv_GW_2BF_RRC_OBJ9_Vy = 1;
        }
        else
        {
            chgEv_GW_2BF_RRC_OBJ9_Vy = 0;
        }    
        //update the signal value
        Msg_GW_2BF.RRC_OBJ9_Vy=rawValue;        
    }                                                                           
}
/*@@end*/

/*@@envVar:E_pubc_GW_GW_2BF_RRC_OBJ9_Vy_Pv:*/
on envVar E_pubc_GW_GW_2BF_RRC_OBJ9_Vy_Pv
{
    int64 rawValue = 0ll;
    float phyValue = 0.0;
    
    //update the raw value with physical value 
    {
        if(chgEv_GW_2BF_RRC_OBJ9_Vy == 0)
        {
            phyValue = getvalue(this);
            // physical to raw conversion
            rawValue = ((phyValue -(-64))/0.125);
            putValue(E_pubc_GW_GW_2BF_RRC_OBJ9_Vy_Rv, rawValue);
            chgEv_GW_2BF_RRC_OBJ9_Vy = 1;  
        }
        else
        {
            chgEv_GW_2BF_RRC_OBJ9_Vy = 0;
        }
    }
}
/*@@end*/


 
/*@@envVar:E_pubc_GW_GW_2BF_RRC_OBJ9_ObstacleProb_Rv:*/
on envVar E_pubc_GW_GW_2BF_RRC_OBJ9_ObstacleProb_Rv
{
    int64 rawValue = 0ll;
    float rawValue_float = 0.0;
    float phyValue = 0.0;        

    //set the signal with updated raw value
    {
        rawValue = getvalue(this);
        if(chgEv_GW_2BF_RRC_OBJ9_ObstacleProb == 0)
        {
            //type conversion to float
            rawValue_float = rawValue;        
            // raw to physical conversion
            phyValue = ((rawValue_float *2)+(0));
            putValue(E_pubc_GW_GW_2BF_RRC_OBJ9_ObstacleProb_Pv, phyValue);
            chgEv_GW_2BF_RRC_OBJ9_ObstacleProb = 1;
        }
        else
        {
            chgEv_GW_2BF_RRC_OBJ9_ObstacleProb = 0;
        }    
        //update the signal value
        Msg_GW_2BF.RRC_OBJ9_ObstacleProb=rawValue;        
    }                                                                           
}
/*@@end*/

/*@@envVar:E_pubc_GW_GW_2BF_RRC_OBJ9_ObstacleProb_Pv:*/
on envVar E_pubc_GW_GW_2BF_RRC_OBJ9_ObstacleProb_Pv
{
    int64 rawValue = 0ll;
    float phyValue = 0.0;
    
    //update the raw value with physical value 
    {
        if(chgEv_GW_2BF_RRC_OBJ9_ObstacleProb == 0)
        {
            phyValue = getvalue(this);
            // physical to raw conversion
            rawValue = ((phyValue -(0))/2);
            putValue(E_pubc_GW_GW_2BF_RRC_OBJ9_ObstacleProb_Rv, rawValue);
            chgEv_GW_2BF_RRC_OBJ9_ObstacleProb = 1;  
        }
        else
        {
            chgEv_GW_2BF_RRC_OBJ9_ObstacleProb = 0;
        }
    }
}
/*@@end*/


 
/*@@envVar:E_pubc_GW_GW_2BF_RRC_OBJ7_HeadingAngle_Rv:*/
on envVar E_pubc_GW_GW_2BF_RRC_OBJ7_HeadingAngle_Rv
{
    int64 rawValue = 0ll;
    float rawValue_float = 0.0;
    float phyValue = 0.0;        

    //set the signal with updated raw value
    {
        rawValue = getvalue(this);
        if(chgEv_GW_2BF_RRC_OBJ7_HeadingAngle == 0)
        {
            //type conversion to float
            rawValue_float = rawValue;        
            // raw to physical conversion
            phyValue = ((rawValue_float *0.01)+(-3.14));
            putValue(E_pubc_GW_GW_2BF_RRC_OBJ7_HeadingAngle_Pv, phyValue);
            chgEv_GW_2BF_RRC_OBJ7_HeadingAngle = 1;
        }
        else
        {
            chgEv_GW_2BF_RRC_OBJ7_HeadingAngle = 0;
        }    
        //update the signal value
        Msg_GW_2BF.RRC_OBJ7_HeadingAngle=rawValue;        
    }                                                                           
}
/*@@end*/

/*@@envVar:E_pubc_GW_GW_2BF_RRC_OBJ7_HeadingAngle_Pv:*/
on envVar E_pubc_GW_GW_2BF_RRC_OBJ7_HeadingAngle_Pv
{
    int64 rawValue = 0ll;
    float phyValue = 0.0;
    
    //update the raw value with physical value 
    {
        if(chgEv_GW_2BF_RRC_OBJ7_HeadingAngle == 0)
        {
            phyValue = getvalue(this);
            // physical to raw conversion
            rawValue = ((phyValue -(-3.14))/0.01);
            putValue(E_pubc_GW_GW_2BF_RRC_OBJ7_HeadingAngle_Rv, rawValue);
            chgEv_GW_2BF_RRC_OBJ7_HeadingAngle = 1;  
        }
        else
        {
            chgEv_GW_2BF_RRC_OBJ7_HeadingAngle = 0;
        }
    }
}
/*@@end*/


 
/*@@envVar:E_pubc_GW_GW_2BF_RRC_OBJ8_Type_Rv:*/
on envVar E_pubc_GW_GW_2BF_RRC_OBJ8_Type_Rv
{
    int64 rawValue = 0ll;
    float rawValue_float = 0.0;
    float phyValue = 0.0;        

    //set the signal with updated raw value
    if(getValue(E_pubc_GW_GW_2BF_RRC_OBJ8_Type_SetVt)==0)
    {
        rawValue = getvalue(this);
        if(chgEv_GW_2BF_RRC_OBJ8_Type == 0)
        {
            //type conversion to float
            rawValue_float = rawValue;        
            // raw to physical conversion
            phyValue = ((rawValue_float *1)+(0));
            putValue(E_pubc_GW_GW_2BF_RRC_OBJ8_Type_Pv, phyValue);
            chgEv_GW_2BF_RRC_OBJ8_Type = 1;
        }
        else
        {
            chgEv_GW_2BF_RRC_OBJ8_Type = 0;
        }    
        //update the signal value
        Msg_GW_2BF.RRC_OBJ8_Type=rawValue;        
    }                                                                           
}
/*@@end*/

/*@@envVar:E_pubc_GW_GW_2BF_RRC_OBJ8_Type_Pv:*/
on envVar E_pubc_GW_GW_2BF_RRC_OBJ8_Type_Pv
{
    int64 rawValue = 0ll;
    float phyValue = 0.0;
    
    //update the raw value with physical value 
    if(getValue(E_pubc_GW_GW_2BF_RRC_OBJ8_Type_SetVt)==0)
    {
        if(chgEv_GW_2BF_RRC_OBJ8_Type == 0)
        {
            phyValue = getvalue(this);
            // physical to raw conversion
            rawValue = ((phyValue -(0))/1);
            putValue(E_pubc_GW_GW_2BF_RRC_OBJ8_Type_Rv, rawValue);
            chgEv_GW_2BF_RRC_OBJ8_Type = 1;  
        }
        else
        {
            chgEv_GW_2BF_RRC_OBJ8_Type = 0;
        }
    }
}
/*@@end*/

/*@@envVar:E_pubc_GW_GW_2BF_RRC_OBJ8_Type_Vt:*/
on envVar E_pubc_GW_GW_2BF_RRC_OBJ8_Type_Vt
{
    qword rawValue = 0ll;
    if(getValue(E_pubc_GW_GW_2BF_RRC_OBJ8_Type_SetVt))
    {
        //update the signal value
        Msg_GW_2BF.RRC_OBJ8_Type=getValue(this);
    }
}
/*@@end*/

/*@@envVar:E_pubc_GW_GW_2BF_RRC_OBJ8_Type_SetVt:*/
on envVar E_pubc_GW_GW_2BF_RRC_OBJ8_Type_SetVt
{
    if(getValue(E_pubc_GW_GW_2BF_RRC_OBJ8_Type_SetVt))
    {
        //update the signal value
        Msg_GW_2BF.RRC_OBJ8_Type=getvalue(E_pubc_GW_GW_2BF_RRC_OBJ8_Type_Vt);
    }
    else
    {
        Msg_GW_2BF.RRC_OBJ8_Type=getValue(E_pubc_GW_GW_2BF_RRC_OBJ8_Type_Rv);
    }
}
/*@@end*/
 
/*@@envVar:E_pubc_GW_GW_2BF_RRC_OBJ9_Length_Rv:*/
on envVar E_pubc_GW_GW_2BF_RRC_OBJ9_Length_Rv
{
    int64 rawValue = 0ll;
    float rawValue_float = 0.0;
    float phyValue = 0.0;        

    //set the signal with updated raw value
    {
        rawValue = getvalue(this);
        if(chgEv_GW_2BF_RRC_OBJ9_Length == 0)
        {
            //type conversion to float
            rawValue_float = rawValue;        
            // raw to physical conversion
            phyValue = ((rawValue_float *0.05)+(0));
            putValue(E_pubc_GW_GW_2BF_RRC_OBJ9_Length_Pv, phyValue);
            chgEv_GW_2BF_RRC_OBJ9_Length = 1;
        }
        else
        {
            chgEv_GW_2BF_RRC_OBJ9_Length = 0;
        }    
        //update the signal value
        Msg_GW_2BF.RRC_OBJ9_Length=rawValue;        
    }                                                                           
}
/*@@end*/

/*@@envVar:E_pubc_GW_GW_2BF_RRC_OBJ9_Length_Pv:*/
on envVar E_pubc_GW_GW_2BF_RRC_OBJ9_Length_Pv
{
    int64 rawValue = 0ll;
    float phyValue = 0.0;
    
    //update the raw value with physical value 
    {
        if(chgEv_GW_2BF_RRC_OBJ9_Length == 0)
        {
            phyValue = getvalue(this);
            // physical to raw conversion
            rawValue = ((phyValue -(0))/0.05);
            putValue(E_pubc_GW_GW_2BF_RRC_OBJ9_Length_Rv, rawValue);
            chgEv_GW_2BF_RRC_OBJ9_Length = 1;  
        }
        else
        {
            chgEv_GW_2BF_RRC_OBJ9_Length = 0;
        }
    }
}
/*@@end*/


 
/*@@envVar:E_pubc_GW_GW_2BF_RRC_OBJ6_ExistProb_Rv:*/
on envVar E_pubc_GW_GW_2BF_RRC_OBJ6_ExistProb_Rv
{
    int64 rawValue = 0ll;
    float rawValue_float = 0.0;
    float phyValue = 0.0;        

    //set the signal with updated raw value
    {
        rawValue = getvalue(this);
        if(chgEv_GW_2BF_RRC_OBJ6_ExistProb == 0)
        {
            //type conversion to float
            rawValue_float = rawValue;        
            // raw to physical conversion
            phyValue = ((rawValue_float *2)+(0));
            putValue(E_pubc_GW_GW_2BF_RRC_OBJ6_ExistProb_Pv, phyValue);
            chgEv_GW_2BF_RRC_OBJ6_ExistProb = 1;
        }
        else
        {
            chgEv_GW_2BF_RRC_OBJ6_ExistProb = 0;
        }    
        //update the signal value
        Msg_GW_2BF.RRC_OBJ6_ExistProb=rawValue;        
    }                                                                           
}
/*@@end*/

/*@@envVar:E_pubc_GW_GW_2BF_RRC_OBJ6_ExistProb_Pv:*/
on envVar E_pubc_GW_GW_2BF_RRC_OBJ6_ExistProb_Pv
{
    int64 rawValue = 0ll;
    float phyValue = 0.0;
    
    //update the raw value with physical value 
    {
        if(chgEv_GW_2BF_RRC_OBJ6_ExistProb == 0)
        {
            phyValue = getvalue(this);
            // physical to raw conversion
            rawValue = ((phyValue -(0))/2);
            putValue(E_pubc_GW_GW_2BF_RRC_OBJ6_ExistProb_Rv, rawValue);
            chgEv_GW_2BF_RRC_OBJ6_ExistProb = 1;  
        }
        else
        {
            chgEv_GW_2BF_RRC_OBJ6_ExistProb = 0;
        }
    }
}
/*@@end*/


 
/*@@envVar:E_pubc_GW_GW_2BF_RRC_OBJ9_Track_ID_Rv:*/
on envVar E_pubc_GW_GW_2BF_RRC_OBJ9_Track_ID_Rv
{
    int64 rawValue = 0ll;
    float rawValue_float = 0.0;
    float phyValue = 0.0;        

    //set the signal with updated raw value
    {
        rawValue = getvalue(this);
        if(chgEv_GW_2BF_RRC_OBJ9_Track_ID == 0)
        {
            //type conversion to float
            rawValue_float = rawValue;        
            // raw to physical conversion
            phyValue = ((rawValue_float *1)+(0));
            putValue(E_pubc_GW_GW_2BF_RRC_OBJ9_Track_ID_Pv, phyValue);
            chgEv_GW_2BF_RRC_OBJ9_Track_ID = 1;
        }
        else
        {
            chgEv_GW_2BF_RRC_OBJ9_Track_ID = 0;
        }    
        //update the signal value
        Msg_GW_2BF.RRC_OBJ9_Track_ID=rawValue;        
    }                                                                           
}
/*@@end*/

/*@@envVar:E_pubc_GW_GW_2BF_RRC_OBJ9_Track_ID_Pv:*/
on envVar E_pubc_GW_GW_2BF_RRC_OBJ9_Track_ID_Pv
{
    int64 rawValue = 0ll;
    float phyValue = 0.0;
    
    //update the raw value with physical value 
    {
        if(chgEv_GW_2BF_RRC_OBJ9_Track_ID == 0)
        {
            phyValue = getvalue(this);
            // physical to raw conversion
            rawValue = ((phyValue -(0))/1);
            putValue(E_pubc_GW_GW_2BF_RRC_OBJ9_Track_ID_Rv, rawValue);
            chgEv_GW_2BF_RRC_OBJ9_Track_ID = 1;  
        }
        else
        {
            chgEv_GW_2BF_RRC_OBJ9_Track_ID = 0;
        }
    }
}
/*@@end*/


 
/*@@envVar:E_pubc_GW_GW_2BF_RRC_OBJ6_Location_Rv:*/
on envVar E_pubc_GW_GW_2BF_RRC_OBJ6_Location_Rv
{
    int64 rawValue = 0ll;
    float rawValue_float = 0.0;
    float phyValue = 0.0;        

    //set the signal with updated raw value
    if(getValue(E_pubc_GW_GW_2BF_RRC_OBJ6_Location_SetVt)==0)
    {
        rawValue = getvalue(this);
        if(chgEv_GW_2BF_RRC_OBJ6_Location == 0)
        {
            //type conversion to float
            rawValue_float = rawValue;        
            // raw to physical conversion
            phyValue = ((rawValue_float *1)+(0));
            putValue(E_pubc_GW_GW_2BF_RRC_OBJ6_Location_Pv, phyValue);
            chgEv_GW_2BF_RRC_OBJ6_Location = 1;
        }
        else
        {
            chgEv_GW_2BF_RRC_OBJ6_Location = 0;
        }    
        //update the signal value
        Msg_GW_2BF.RRC_OBJ6_Location=rawValue;        
    }                                                                           
}
/*@@end*/

/*@@envVar:E_pubc_GW_GW_2BF_RRC_OBJ6_Location_Pv:*/
on envVar E_pubc_GW_GW_2BF_RRC_OBJ6_Location_Pv
{
    int64 rawValue = 0ll;
    float phyValue = 0.0;
    
    //update the raw value with physical value 
    if(getValue(E_pubc_GW_GW_2BF_RRC_OBJ6_Location_SetVt)==0)
    {
        if(chgEv_GW_2BF_RRC_OBJ6_Location == 0)
        {
            phyValue = getvalue(this);
            // physical to raw conversion
            rawValue = ((phyValue -(0))/1);
            putValue(E_pubc_GW_GW_2BF_RRC_OBJ6_Location_Rv, rawValue);
            chgEv_GW_2BF_RRC_OBJ6_Location = 1;  
        }
        else
        {
            chgEv_GW_2BF_RRC_OBJ6_Location = 0;
        }
    }
}
/*@@end*/

/*@@envVar:E_pubc_GW_GW_2BF_RRC_OBJ6_Location_Vt:*/
on envVar E_pubc_GW_GW_2BF_RRC_OBJ6_Location_Vt
{
    qword rawValue = 0ll;
    if(getValue(E_pubc_GW_GW_2BF_RRC_OBJ6_Location_SetVt))
    {
        //update the signal value
        Msg_GW_2BF.RRC_OBJ6_Location=getValue(this);
    }
}
/*@@end*/

/*@@envVar:E_pubc_GW_GW_2BF_RRC_OBJ6_Location_SetVt:*/
on envVar E_pubc_GW_GW_2BF_RRC_OBJ6_Location_SetVt
{
    if(getValue(E_pubc_GW_GW_2BF_RRC_OBJ6_Location_SetVt))
    {
        //update the signal value
        Msg_GW_2BF.RRC_OBJ6_Location=getvalue(E_pubc_GW_GW_2BF_RRC_OBJ6_Location_Vt);
    }
    else
    {
        Msg_GW_2BF.RRC_OBJ6_Location=getValue(E_pubc_GW_GW_2BF_RRC_OBJ6_Location_Rv);
    }
}
/*@@end*/
 
/*@@envVar:E_pubc_GW_GW_2BF_RRC_OBJ9_Location_Rv:*/
on envVar E_pubc_GW_GW_2BF_RRC_OBJ9_Location_Rv
{
    int64 rawValue = 0ll;
    float rawValue_float = 0.0;
    float phyValue = 0.0;        

    //set the signal with updated raw value
    if(getValue(E_pubc_GW_GW_2BF_RRC_OBJ9_Location_SetVt)==0)
    {
        rawValue = getvalue(this);
        if(chgEv_GW_2BF_RRC_OBJ9_Location == 0)
        {
            //type conversion to float
            rawValue_float = rawValue;        
            // raw to physical conversion
            phyValue = ((rawValue_float *1)+(0));
            putValue(E_pubc_GW_GW_2BF_RRC_OBJ9_Location_Pv, phyValue);
            chgEv_GW_2BF_RRC_OBJ9_Location = 1;
        }
        else
        {
            chgEv_GW_2BF_RRC_OBJ9_Location = 0;
        }    
        //update the signal value
        Msg_GW_2BF.RRC_OBJ9_Location=rawValue;        
    }                                                                           
}
/*@@end*/

/*@@envVar:E_pubc_GW_GW_2BF_RRC_OBJ9_Location_Pv:*/
on envVar E_pubc_GW_GW_2BF_RRC_OBJ9_Location_Pv
{
    int64 rawValue = 0ll;
    float phyValue = 0.0;
    
    //update the raw value with physical value 
    if(getValue(E_pubc_GW_GW_2BF_RRC_OBJ9_Location_SetVt)==0)
    {
        if(chgEv_GW_2BF_RRC_OBJ9_Location == 0)
        {
            phyValue = getvalue(this);
            // physical to raw conversion
            rawValue = ((phyValue -(0))/1);
            putValue(E_pubc_GW_GW_2BF_RRC_OBJ9_Location_Rv, rawValue);
            chgEv_GW_2BF_RRC_OBJ9_Location = 1;  
        }
        else
        {
            chgEv_GW_2BF_RRC_OBJ9_Location = 0;
        }
    }
}
/*@@end*/

/*@@envVar:E_pubc_GW_GW_2BF_RRC_OBJ9_Location_Vt:*/
on envVar E_pubc_GW_GW_2BF_RRC_OBJ9_Location_Vt
{
    qword rawValue = 0ll;
    if(getValue(E_pubc_GW_GW_2BF_RRC_OBJ9_Location_SetVt))
    {
        //update the signal value
        Msg_GW_2BF.RRC_OBJ9_Location=getValue(this);
    }
}
/*@@end*/

/*@@envVar:E_pubc_GW_GW_2BF_RRC_OBJ9_Location_SetVt:*/
on envVar E_pubc_GW_GW_2BF_RRC_OBJ9_Location_SetVt
{
    if(getValue(E_pubc_GW_GW_2BF_RRC_OBJ9_Location_SetVt))
    {
        //update the signal value
        Msg_GW_2BF.RRC_OBJ9_Location=getvalue(E_pubc_GW_GW_2BF_RRC_OBJ9_Location_Vt);
    }
    else
    {
        Msg_GW_2BF.RRC_OBJ9_Location=getValue(E_pubc_GW_GW_2BF_RRC_OBJ9_Location_Rv);
    }
}
/*@@end*/
 
/*@@envVar:E_pubc_GW_GW_2BF_RRC_OBJ7_Width_Rv:*/
on envVar E_pubc_GW_GW_2BF_RRC_OBJ7_Width_Rv
{
    int64 rawValue = 0ll;
    float rawValue_float = 0.0;
    float phyValue = 0.0;        

    //set the signal with updated raw value
    {
        rawValue = getvalue(this);
        if(chgEv_GW_2BF_RRC_OBJ7_Width == 0)
        {
            //type conversion to float
            rawValue_float = rawValue;        
            // raw to physical conversion
            phyValue = ((rawValue_float *0.01)+(0));
            putValue(E_pubc_GW_GW_2BF_RRC_OBJ7_Width_Pv, phyValue);
            chgEv_GW_2BF_RRC_OBJ7_Width = 1;
        }
        else
        {
            chgEv_GW_2BF_RRC_OBJ7_Width = 0;
        }    
        //update the signal value
        Msg_GW_2BF.RRC_OBJ7_Width=rawValue;        
    }                                                                           
}
/*@@end*/

/*@@envVar:E_pubc_GW_GW_2BF_RRC_OBJ7_Width_Pv:*/
on envVar E_pubc_GW_GW_2BF_RRC_OBJ7_Width_Pv
{
    int64 rawValue = 0ll;
    float phyValue = 0.0;
    
    //update the raw value with physical value 
    {
        if(chgEv_GW_2BF_RRC_OBJ7_Width == 0)
        {
            phyValue = getvalue(this);
            // physical to raw conversion
            rawValue = ((phyValue -(0))/0.01);
            putValue(E_pubc_GW_GW_2BF_RRC_OBJ7_Width_Rv, rawValue);
            chgEv_GW_2BF_RRC_OBJ7_Width = 1;  
        }
        else
        {
            chgEv_GW_2BF_RRC_OBJ7_Width = 0;
        }
    }
}
/*@@end*/


 
/*@@envVar:E_pubc_GW_GW_2BF_RRC_OBJ6_Ax_Rv:*/
on envVar E_pubc_GW_GW_2BF_RRC_OBJ6_Ax_Rv
{
    int64 rawValue = 0ll;
    float rawValue_float = 0.0;
    float phyValue = 0.0;        

    //set the signal with updated raw value
    {
        rawValue = getvalue(this);
        if(chgEv_GW_2BF_RRC_OBJ6_Ax == 0)
        {
            //type conversion to float
            rawValue_float = rawValue;        
            // raw to physical conversion
            phyValue = ((rawValue_float *0.0625)+(-16));
            putValue(E_pubc_GW_GW_2BF_RRC_OBJ6_Ax_Pv, phyValue);
            chgEv_GW_2BF_RRC_OBJ6_Ax = 1;
        }
        else
        {
            chgEv_GW_2BF_RRC_OBJ6_Ax = 0;
        }    
        //update the signal value
        Msg_GW_2BF.RRC_OBJ6_Ax=rawValue;        
    }                                                                           
}
/*@@end*/

/*@@envVar:E_pubc_GW_GW_2BF_RRC_OBJ6_Ax_Pv:*/
on envVar E_pubc_GW_GW_2BF_RRC_OBJ6_Ax_Pv
{
    int64 rawValue = 0ll;
    float phyValue = 0.0;
    
    //update the raw value with physical value 
    {
        if(chgEv_GW_2BF_RRC_OBJ6_Ax == 0)
        {
            phyValue = getvalue(this);
            // physical to raw conversion
            rawValue = ((phyValue -(-16))/0.0625);
            putValue(E_pubc_GW_GW_2BF_RRC_OBJ6_Ax_Rv, rawValue);
            chgEv_GW_2BF_RRC_OBJ6_Ax = 1;  
        }
        else
        {
            chgEv_GW_2BF_RRC_OBJ6_Ax = 0;
        }
    }
}
/*@@end*/


 
/*@@envVar:E_pubc_GW_GW_2BF_RRC_OBJ6_Ay_Rv:*/
on envVar E_pubc_GW_GW_2BF_RRC_OBJ6_Ay_Rv
{
    int64 rawValue = 0ll;
    float rawValue_float = 0.0;
    float phyValue = 0.0;        

    //set the signal with updated raw value
    {
        rawValue = getvalue(this);
        if(chgEv_GW_2BF_RRC_OBJ6_Ay == 0)
        {
            //type conversion to float
            rawValue_float = rawValue;        
            // raw to physical conversion
            phyValue = ((rawValue_float *0.03125)+(-16));
            putValue(E_pubc_GW_GW_2BF_RRC_OBJ6_Ay_Pv, phyValue);
            chgEv_GW_2BF_RRC_OBJ6_Ay = 1;
        }
        else
        {
            chgEv_GW_2BF_RRC_OBJ6_Ay = 0;
        }    
        //update the signal value
        Msg_GW_2BF.RRC_OBJ6_Ay=rawValue;        
    }                                                                           
}
/*@@end*/

/*@@envVar:E_pubc_GW_GW_2BF_RRC_OBJ6_Ay_Pv:*/
on envVar E_pubc_GW_GW_2BF_RRC_OBJ6_Ay_Pv
{
    int64 rawValue = 0ll;
    float phyValue = 0.0;
    
    //update the raw value with physical value 
    {
        if(chgEv_GW_2BF_RRC_OBJ6_Ay == 0)
        {
            phyValue = getvalue(this);
            // physical to raw conversion
            rawValue = ((phyValue -(-16))/0.03125);
            putValue(E_pubc_GW_GW_2BF_RRC_OBJ6_Ay_Rv, rawValue);
            chgEv_GW_2BF_RRC_OBJ6_Ay = 1;  
        }
        else
        {
            chgEv_GW_2BF_RRC_OBJ6_Ay = 0;
        }
    }
}
/*@@end*/


 
/*@@envVar:E_pubc_GW_GW_2BF_RRC_OBJ6_Track_ID_Rv:*/
on envVar E_pubc_GW_GW_2BF_RRC_OBJ6_Track_ID_Rv
{
    int64 rawValue = 0ll;
    float rawValue_float = 0.0;
    float phyValue = 0.0;        

    //set the signal with updated raw value
    {
        rawValue = getvalue(this);
        if(chgEv_GW_2BF_RRC_OBJ6_Track_ID == 0)
        {
            //type conversion to float
            rawValue_float = rawValue;        
            // raw to physical conversion
            phyValue = ((rawValue_float *1)+(0));
            putValue(E_pubc_GW_GW_2BF_RRC_OBJ6_Track_ID_Pv, phyValue);
            chgEv_GW_2BF_RRC_OBJ6_Track_ID = 1;
        }
        else
        {
            chgEv_GW_2BF_RRC_OBJ6_Track_ID = 0;
        }    
        //update the signal value
        Msg_GW_2BF.RRC_OBJ6_Track_ID=rawValue;        
    }                                                                           
}
/*@@end*/

/*@@envVar:E_pubc_GW_GW_2BF_RRC_OBJ6_Track_ID_Pv:*/
on envVar E_pubc_GW_GW_2BF_RRC_OBJ6_Track_ID_Pv
{
    int64 rawValue = 0ll;
    float phyValue = 0.0;
    
    //update the raw value with physical value 
    {
        if(chgEv_GW_2BF_RRC_OBJ6_Track_ID == 0)
        {
            phyValue = getvalue(this);
            // physical to raw conversion
            rawValue = ((phyValue -(0))/1);
            putValue(E_pubc_GW_GW_2BF_RRC_OBJ6_Track_ID_Rv, rawValue);
            chgEv_GW_2BF_RRC_OBJ6_Track_ID = 1;  
        }
        else
        {
            chgEv_GW_2BF_RRC_OBJ6_Track_ID = 0;
        }
    }
}
/*@@end*/


 
/*@@envVar:E_pubc_GW_GW_2BF_RRC_OBJ9_Dy_Rv:*/
on envVar E_pubc_GW_GW_2BF_RRC_OBJ9_Dy_Rv
{
    int64 rawValue = 0ll;
    float rawValue_float = 0.0;
    float phyValue = 0.0;        

    //set the signal with updated raw value
    {
        rawValue = getvalue(this);
        if(chgEv_GW_2BF_RRC_OBJ9_Dy == 0)
        {
            //type conversion to float
            rawValue_float = rawValue;        
            // raw to physical conversion
            phyValue = ((rawValue_float *0.125)+(-128));
            putValue(E_pubc_GW_GW_2BF_RRC_OBJ9_Dy_Pv, phyValue);
            chgEv_GW_2BF_RRC_OBJ9_Dy = 1;
        }
        else
        {
            chgEv_GW_2BF_RRC_OBJ9_Dy = 0;
        }    
        //update the signal value
        Msg_GW_2BF.RRC_OBJ9_Dy=rawValue;        
    }                                                                           
}
/*@@end*/

/*@@envVar:E_pubc_GW_GW_2BF_RRC_OBJ9_Dy_Pv:*/
on envVar E_pubc_GW_GW_2BF_RRC_OBJ9_Dy_Pv
{
    int64 rawValue = 0ll;
    float phyValue = 0.0;
    
    //update the raw value with physical value 
    {
        if(chgEv_GW_2BF_RRC_OBJ9_Dy == 0)
        {
            phyValue = getvalue(this);
            // physical to raw conversion
            rawValue = ((phyValue -(-128))/0.125);
            putValue(E_pubc_GW_GW_2BF_RRC_OBJ9_Dy_Rv, rawValue);
            chgEv_GW_2BF_RRC_OBJ9_Dy = 1;  
        }
        else
        {
            chgEv_GW_2BF_RRC_OBJ9_Dy = 0;
        }
    }
}
/*@@end*/


 
/*@@envVar:E_pubc_GW_GW_2BF_RRC_OBJ9_Dx_Rv:*/
on envVar E_pubc_GW_GW_2BF_RRC_OBJ9_Dx_Rv
{
    int64 rawValue = 0ll;
    float rawValue_float = 0.0;
    float phyValue = 0.0;        

    //set the signal with updated raw value
    {
        rawValue = getvalue(this);
        if(chgEv_GW_2BF_RRC_OBJ9_Dx == 0)
        {
            //type conversion to float
            rawValue_float = rawValue;        
            // raw to physical conversion
            phyValue = ((rawValue_float *0.0625)+(-256));
            putValue(E_pubc_GW_GW_2BF_RRC_OBJ9_Dx_Pv, phyValue);
            chgEv_GW_2BF_RRC_OBJ9_Dx = 1;
        }
        else
        {
            chgEv_GW_2BF_RRC_OBJ9_Dx = 0;
        }    
        //update the signal value
        Msg_GW_2BF.RRC_OBJ9_Dx=rawValue;        
    }                                                                           
}
/*@@end*/

/*@@envVar:E_pubc_GW_GW_2BF_RRC_OBJ9_Dx_Pv:*/
on envVar E_pubc_GW_GW_2BF_RRC_OBJ9_Dx_Pv
{
    int64 rawValue = 0ll;
    float phyValue = 0.0;
    
    //update the raw value with physical value 
    {
        if(chgEv_GW_2BF_RRC_OBJ9_Dx == 0)
        {
            phyValue = getvalue(this);
            // physical to raw conversion
            rawValue = ((phyValue -(-256))/0.0625);
            putValue(E_pubc_GW_GW_2BF_RRC_OBJ9_Dx_Rv, rawValue);
            chgEv_GW_2BF_RRC_OBJ9_Dx = 1;  
        }
        else
        {
            chgEv_GW_2BF_RRC_OBJ9_Dx = 0;
        }
    }
}
/*@@end*/


 
/*@@envVar:E_pubc_GW_GW_2BF_RRC_OBJ7_ExistProb_Rv:*/
on envVar E_pubc_GW_GW_2BF_RRC_OBJ7_ExistProb_Rv
{
    int64 rawValue = 0ll;
    float rawValue_float = 0.0;
    float phyValue = 0.0;        

    //set the signal with updated raw value
    {
        rawValue = getvalue(this);
        if(chgEv_GW_2BF_RRC_OBJ7_ExistProb == 0)
        {
            //type conversion to float
            rawValue_float = rawValue;        
            // raw to physical conversion
            phyValue = ((rawValue_float *2)+(0));
            putValue(E_pubc_GW_GW_2BF_RRC_OBJ7_ExistProb_Pv, phyValue);
            chgEv_GW_2BF_RRC_OBJ7_ExistProb = 1;
        }
        else
        {
            chgEv_GW_2BF_RRC_OBJ7_ExistProb = 0;
        }    
        //update the signal value
        Msg_GW_2BF.RRC_OBJ7_ExistProb=rawValue;        
    }                                                                           
}
/*@@end*/

/*@@envVar:E_pubc_GW_GW_2BF_RRC_OBJ7_ExistProb_Pv:*/
on envVar E_pubc_GW_GW_2BF_RRC_OBJ7_ExistProb_Pv
{
    int64 rawValue = 0ll;
    float phyValue = 0.0;
    
    //update the raw value with physical value 
    {
        if(chgEv_GW_2BF_RRC_OBJ7_ExistProb == 0)
        {
            phyValue = getvalue(this);
            // physical to raw conversion
            rawValue = ((phyValue -(0))/2);
            putValue(E_pubc_GW_GW_2BF_RRC_OBJ7_ExistProb_Rv, rawValue);
            chgEv_GW_2BF_RRC_OBJ7_ExistProb = 1;  
        }
        else
        {
            chgEv_GW_2BF_RRC_OBJ7_ExistProb = 0;
        }
    }
}
/*@@end*/


 
/*@@envVar:E_pubc_GW_GW_2BF_RRC_OBJ8_Track_ID_Rv:*/
on envVar E_pubc_GW_GW_2BF_RRC_OBJ8_Track_ID_Rv
{
    int64 rawValue = 0ll;
    float rawValue_float = 0.0;
    float phyValue = 0.0;        

    //set the signal with updated raw value
    {
        rawValue = getvalue(this);
        if(chgEv_GW_2BF_RRC_OBJ8_Track_ID == 0)
        {
            //type conversion to float
            rawValue_float = rawValue;        
            // raw to physical conversion
            phyValue = ((rawValue_float *1)+(0));
            putValue(E_pubc_GW_GW_2BF_RRC_OBJ8_Track_ID_Pv, phyValue);
            chgEv_GW_2BF_RRC_OBJ8_Track_ID = 1;
        }
        else
        {
            chgEv_GW_2BF_RRC_OBJ8_Track_ID = 0;
        }    
        //update the signal value
        Msg_GW_2BF.RRC_OBJ8_Track_ID=rawValue;        
    }                                                                           
}
/*@@end*/

/*@@envVar:E_pubc_GW_GW_2BF_RRC_OBJ8_Track_ID_Pv:*/
on envVar E_pubc_GW_GW_2BF_RRC_OBJ8_Track_ID_Pv
{
    int64 rawValue = 0ll;
    float phyValue = 0.0;
    
    //update the raw value with physical value 
    {
        if(chgEv_GW_2BF_RRC_OBJ8_Track_ID == 0)
        {
            phyValue = getvalue(this);
            // physical to raw conversion
            rawValue = ((phyValue -(0))/1);
            putValue(E_pubc_GW_GW_2BF_RRC_OBJ8_Track_ID_Rv, rawValue);
            chgEv_GW_2BF_RRC_OBJ8_Track_ID = 1;  
        }
        else
        {
            chgEv_GW_2BF_RRC_OBJ8_Track_ID = 0;
        }
    }
}
/*@@end*/


 
/*@@envVar:E_pubc_GW_GW_2BF_RRC_OBJ7_Measured_Rv:*/
on envVar E_pubc_GW_GW_2BF_RRC_OBJ7_Measured_Rv
{
    int64 rawValue = 0ll;
    float rawValue_float = 0.0;
    float phyValue = 0.0;        

    //set the signal with updated raw value
    if(getValue(E_pubc_GW_GW_2BF_RRC_OBJ7_Measured_SetVt)==0)
    {
        rawValue = getvalue(this);
        if(chgEv_GW_2BF_RRC_OBJ7_Measured == 0)
        {
            //type conversion to float
            rawValue_float = rawValue;        
            // raw to physical conversion
            phyValue = ((rawValue_float *1)+(0));
            putValue(E_pubc_GW_GW_2BF_RRC_OBJ7_Measured_Pv, phyValue);
            chgEv_GW_2BF_RRC_OBJ7_Measured = 1;
        }
        else
        {
            chgEv_GW_2BF_RRC_OBJ7_Measured = 0;
        }    
        //update the signal value
        Msg_GW_2BF.RRC_OBJ7_Measured=rawValue;        
    }                                                                           
}
/*@@end*/

/*@@envVar:E_pubc_GW_GW_2BF_RRC_OBJ7_Measured_Pv:*/
on envVar E_pubc_GW_GW_2BF_RRC_OBJ7_Measured_Pv
{
    int64 rawValue = 0ll;
    float phyValue = 0.0;
    
    //update the raw value with physical value 
    if(getValue(E_pubc_GW_GW_2BF_RRC_OBJ7_Measured_SetVt)==0)
    {
        if(chgEv_GW_2BF_RRC_OBJ7_Measured == 0)
        {
            phyValue = getvalue(this);
            // physical to raw conversion
            rawValue = ((phyValue -(0))/1);
            putValue(E_pubc_GW_GW_2BF_RRC_OBJ7_Measured_Rv, rawValue);
            chgEv_GW_2BF_RRC_OBJ7_Measured = 1;  
        }
        else
        {
            chgEv_GW_2BF_RRC_OBJ7_Measured = 0;
        }
    }
}
/*@@end*/

/*@@envVar:E_pubc_GW_GW_2BF_RRC_OBJ7_Measured_Vt:*/
on envVar E_pubc_GW_GW_2BF_RRC_OBJ7_Measured_Vt
{
    qword rawValue = 0ll;
    if(getValue(E_pubc_GW_GW_2BF_RRC_OBJ7_Measured_SetVt))
    {
        //update the signal value
        Msg_GW_2BF.RRC_OBJ7_Measured=getValue(this);
    }
}
/*@@end*/

/*@@envVar:E_pubc_GW_GW_2BF_RRC_OBJ7_Measured_SetVt:*/
on envVar E_pubc_GW_GW_2BF_RRC_OBJ7_Measured_SetVt
{
    if(getValue(E_pubc_GW_GW_2BF_RRC_OBJ7_Measured_SetVt))
    {
        //update the signal value
        Msg_GW_2BF.RRC_OBJ7_Measured=getvalue(E_pubc_GW_GW_2BF_RRC_OBJ7_Measured_Vt);
    }
    else
    {
        Msg_GW_2BF.RRC_OBJ7_Measured=getValue(E_pubc_GW_GW_2BF_RRC_OBJ7_Measured_Rv);
    }
}
/*@@end*/
 
/*@@envVar:E_pubc_GW_GW_2BF_RRC_OBJ7_Type_Rv:*/
on envVar E_pubc_GW_GW_2BF_RRC_OBJ7_Type_Rv
{
    int64 rawValue = 0ll;
    float rawValue_float = 0.0;
    float phyValue = 0.0;        

    //set the signal with updated raw value
    if(getValue(E_pubc_GW_GW_2BF_RRC_OBJ7_Type_SetVt)==0)
    {
        rawValue = getvalue(this);
        if(chgEv_GW_2BF_RRC_OBJ7_Type == 0)
        {
            //type conversion to float
            rawValue_float = rawValue;        
            // raw to physical conversion
            phyValue = ((rawValue_float *1)+(0));
            putValue(E_pubc_GW_GW_2BF_RRC_OBJ7_Type_Pv, phyValue);
            chgEv_GW_2BF_RRC_OBJ7_Type = 1;
        }
        else
        {
            chgEv_GW_2BF_RRC_OBJ7_Type = 0;
        }    
        //update the signal value
        Msg_GW_2BF.RRC_OBJ7_Type=rawValue;        
    }                                                                           
}
/*@@end*/

/*@@envVar:E_pubc_GW_GW_2BF_RRC_OBJ7_Type_Pv:*/
on envVar E_pubc_GW_GW_2BF_RRC_OBJ7_Type_Pv
{
    int64 rawValue = 0ll;
    float phyValue = 0.0;
    
    //update the raw value with physical value 
    if(getValue(E_pubc_GW_GW_2BF_RRC_OBJ7_Type_SetVt)==0)
    {
        if(chgEv_GW_2BF_RRC_OBJ7_Type == 0)
        {
            phyValue = getvalue(this);
            // physical to raw conversion
            rawValue = ((phyValue -(0))/1);
            putValue(E_pubc_GW_GW_2BF_RRC_OBJ7_Type_Rv, rawValue);
            chgEv_GW_2BF_RRC_OBJ7_Type = 1;  
        }
        else
        {
            chgEv_GW_2BF_RRC_OBJ7_Type = 0;
        }
    }
}
/*@@end*/

/*@@envVar:E_pubc_GW_GW_2BF_RRC_OBJ7_Type_Vt:*/
on envVar E_pubc_GW_GW_2BF_RRC_OBJ7_Type_Vt
{
    qword rawValue = 0ll;
    if(getValue(E_pubc_GW_GW_2BF_RRC_OBJ7_Type_SetVt))
    {
        //update the signal value
        Msg_GW_2BF.RRC_OBJ7_Type=getValue(this);
    }
}
/*@@end*/

/*@@envVar:E_pubc_GW_GW_2BF_RRC_OBJ7_Type_SetVt:*/
on envVar E_pubc_GW_GW_2BF_RRC_OBJ7_Type_SetVt
{
    if(getValue(E_pubc_GW_GW_2BF_RRC_OBJ7_Type_SetVt))
    {
        //update the signal value
        Msg_GW_2BF.RRC_OBJ7_Type=getvalue(E_pubc_GW_GW_2BF_RRC_OBJ7_Type_Vt);
    }
    else
    {
        Msg_GW_2BF.RRC_OBJ7_Type=getValue(E_pubc_GW_GW_2BF_RRC_OBJ7_Type_Rv);
    }
}
/*@@end*/
 
/*@@envVar:E_pubc_GW_GW_2BF_RRC_OBJ7_Location_Rv:*/
on envVar E_pubc_GW_GW_2BF_RRC_OBJ7_Location_Rv
{
    int64 rawValue = 0ll;
    float rawValue_float = 0.0;
    float phyValue = 0.0;        

    //set the signal with updated raw value
    if(getValue(E_pubc_GW_GW_2BF_RRC_OBJ7_Location_SetVt)==0)
    {
        rawValue = getvalue(this);
        if(chgEv_GW_2BF_RRC_OBJ7_Location == 0)
        {
            //type conversion to float
            rawValue_float = rawValue;        
            // raw to physical conversion
            phyValue = ((rawValue_float *1)+(0));
            putValue(E_pubc_GW_GW_2BF_RRC_OBJ7_Location_Pv, phyValue);
            chgEv_GW_2BF_RRC_OBJ7_Location = 1;
        }
        else
        {
            chgEv_GW_2BF_RRC_OBJ7_Location = 0;
        }    
        //update the signal value
        Msg_GW_2BF.RRC_OBJ7_Location=rawValue;        
    }                                                                           
}
/*@@end*/

/*@@envVar:E_pubc_GW_GW_2BF_RRC_OBJ7_Location_Pv:*/
on envVar E_pubc_GW_GW_2BF_RRC_OBJ7_Location_Pv
{
    int64 rawValue = 0ll;
    float phyValue = 0.0;
    
    //update the raw value with physical value 
    if(getValue(E_pubc_GW_GW_2BF_RRC_OBJ7_Location_SetVt)==0)
    {
        if(chgEv_GW_2BF_RRC_OBJ7_Location == 0)
        {
            phyValue = getvalue(this);
            // physical to raw conversion
            rawValue = ((phyValue -(0))/1);
            putValue(E_pubc_GW_GW_2BF_RRC_OBJ7_Location_Rv, rawValue);
            chgEv_GW_2BF_RRC_OBJ7_Location = 1;  
        }
        else
        {
            chgEv_GW_2BF_RRC_OBJ7_Location = 0;
        }
    }
}
/*@@end*/

/*@@envVar:E_pubc_GW_GW_2BF_RRC_OBJ7_Location_Vt:*/
on envVar E_pubc_GW_GW_2BF_RRC_OBJ7_Location_Vt
{
    qword rawValue = 0ll;
    if(getValue(E_pubc_GW_GW_2BF_RRC_OBJ7_Location_SetVt))
    {
        //update the signal value
        Msg_GW_2BF.RRC_OBJ7_Location=getValue(this);
    }
}
/*@@end*/

/*@@envVar:E_pubc_GW_GW_2BF_RRC_OBJ7_Location_SetVt:*/
on envVar E_pubc_GW_GW_2BF_RRC_OBJ7_Location_SetVt
{
    if(getValue(E_pubc_GW_GW_2BF_RRC_OBJ7_Location_SetVt))
    {
        //update the signal value
        Msg_GW_2BF.RRC_OBJ7_Location=getvalue(E_pubc_GW_GW_2BF_RRC_OBJ7_Location_Vt);
    }
    else
    {
        Msg_GW_2BF.RRC_OBJ7_Location=getValue(E_pubc_GW_GW_2BF_RRC_OBJ7_Location_Rv);
    }
}
/*@@end*/
 
/*@@envVar:E_pubc_GW_GW_2BF_RRC_OBJ9_Measured_Rv:*/
on envVar E_pubc_GW_GW_2BF_RRC_OBJ9_Measured_Rv
{
    int64 rawValue = 0ll;
    float rawValue_float = 0.0;
    float phyValue = 0.0;        

    //set the signal with updated raw value
    if(getValue(E_pubc_GW_GW_2BF_RRC_OBJ9_Measured_SetVt)==0)
    {
        rawValue = getvalue(this);
        if(chgEv_GW_2BF_RRC_OBJ9_Measured == 0)
        {
            //type conversion to float
            rawValue_float = rawValue;        
            // raw to physical conversion
            phyValue = ((rawValue_float *1)+(0));
            putValue(E_pubc_GW_GW_2BF_RRC_OBJ9_Measured_Pv, phyValue);
            chgEv_GW_2BF_RRC_OBJ9_Measured = 1;
        }
        else
        {
            chgEv_GW_2BF_RRC_OBJ9_Measured = 0;
        }    
        //update the signal value
        Msg_GW_2BF.RRC_OBJ9_Measured=rawValue;        
    }                                                                           
}
/*@@end*/

/*@@envVar:E_pubc_GW_GW_2BF_RRC_OBJ9_Measured_Pv:*/
on envVar E_pubc_GW_GW_2BF_RRC_OBJ9_Measured_Pv
{
    int64 rawValue = 0ll;
    float phyValue = 0.0;
    
    //update the raw value with physical value 
    if(getValue(E_pubc_GW_GW_2BF_RRC_OBJ9_Measured_SetVt)==0)
    {
        if(chgEv_GW_2BF_RRC_OBJ9_Measured == 0)
        {
            phyValue = getvalue(this);
            // physical to raw conversion
            rawValue = ((phyValue -(0))/1);
            putValue(E_pubc_GW_GW_2BF_RRC_OBJ9_Measured_Rv, rawValue);
            chgEv_GW_2BF_RRC_OBJ9_Measured = 1;  
        }
        else
        {
            chgEv_GW_2BF_RRC_OBJ9_Measured = 0;
        }
    }
}
/*@@end*/

/*@@envVar:E_pubc_GW_GW_2BF_RRC_OBJ9_Measured_Vt:*/
on envVar E_pubc_GW_GW_2BF_RRC_OBJ9_Measured_Vt
{
    qword rawValue = 0ll;
    if(getValue(E_pubc_GW_GW_2BF_RRC_OBJ9_Measured_SetVt))
    {
        //update the signal value
        Msg_GW_2BF.RRC_OBJ9_Measured=getValue(this);
    }
}
/*@@end*/

/*@@envVar:E_pubc_GW_GW_2BF_RRC_OBJ9_Measured_SetVt:*/
on envVar E_pubc_GW_GW_2BF_RRC_OBJ9_Measured_SetVt
{
    if(getValue(E_pubc_GW_GW_2BF_RRC_OBJ9_Measured_SetVt))
    {
        //update the signal value
        Msg_GW_2BF.RRC_OBJ9_Measured=getvalue(E_pubc_GW_GW_2BF_RRC_OBJ9_Measured_Vt);
    }
    else
    {
        Msg_GW_2BF.RRC_OBJ9_Measured=getValue(E_pubc_GW_GW_2BF_RRC_OBJ9_Measured_Rv);
    }
}
/*@@end*/
 
/*@@envVar:E_pubc_GW_GW_2BF_RRC_OBJ7_Vx_Rv:*/
on envVar E_pubc_GW_GW_2BF_RRC_OBJ7_Vx_Rv
{
    int64 rawValue = 0ll;
    float rawValue_float = 0.0;
    float phyValue = 0.0;        

    //set the signal with updated raw value
    {
        rawValue = getvalue(this);
        if(chgEv_GW_2BF_RRC_OBJ7_Vx == 0)
        {
            //type conversion to float
            rawValue_float = rawValue;        
            // raw to physical conversion
            phyValue = ((rawValue_float *0.0625)+(-128));
            putValue(E_pubc_GW_GW_2BF_RRC_OBJ7_Vx_Pv, phyValue);
            chgEv_GW_2BF_RRC_OBJ7_Vx = 1;
        }
        else
        {
            chgEv_GW_2BF_RRC_OBJ7_Vx = 0;
        }    
        //update the signal value
        Msg_GW_2BF.RRC_OBJ7_Vx=rawValue;        
    }                                                                           
}
/*@@end*/

/*@@envVar:E_pubc_GW_GW_2BF_RRC_OBJ7_Vx_Pv:*/
on envVar E_pubc_GW_GW_2BF_RRC_OBJ7_Vx_Pv
{
    int64 rawValue = 0ll;
    float phyValue = 0.0;
    
    //update the raw value with physical value 
    {
        if(chgEv_GW_2BF_RRC_OBJ7_Vx == 0)
        {
            phyValue = getvalue(this);
            // physical to raw conversion
            rawValue = ((phyValue -(-128))/0.0625);
            putValue(E_pubc_GW_GW_2BF_RRC_OBJ7_Vx_Rv, rawValue);
            chgEv_GW_2BF_RRC_OBJ7_Vx = 1;  
        }
        else
        {
            chgEv_GW_2BF_RRC_OBJ7_Vx = 0;
        }
    }
}
/*@@end*/


 
/*@@envVar:E_pubc_GW_GW_2BF_RRC_OBJ7_Vy_Rv:*/
on envVar E_pubc_GW_GW_2BF_RRC_OBJ7_Vy_Rv
{
    int64 rawValue = 0ll;
    float rawValue_float = 0.0;
    float phyValue = 0.0;        

    //set the signal with updated raw value
    {
        rawValue = getvalue(this);
        if(chgEv_GW_2BF_RRC_OBJ7_Vy == 0)
        {
            //type conversion to float
            rawValue_float = rawValue;        
            // raw to physical conversion
            phyValue = ((rawValue_float *0.125)+(-64));
            putValue(E_pubc_GW_GW_2BF_RRC_OBJ7_Vy_Pv, phyValue);
            chgEv_GW_2BF_RRC_OBJ7_Vy = 1;
        }
        else
        {
            chgEv_GW_2BF_RRC_OBJ7_Vy = 0;
        }    
        //update the signal value
        Msg_GW_2BF.RRC_OBJ7_Vy=rawValue;        
    }                                                                           
}
/*@@end*/

/*@@envVar:E_pubc_GW_GW_2BF_RRC_OBJ7_Vy_Pv:*/
on envVar E_pubc_GW_GW_2BF_RRC_OBJ7_Vy_Pv
{
    int64 rawValue = 0ll;
    float phyValue = 0.0;
    
    //update the raw value with physical value 
    {
        if(chgEv_GW_2BF_RRC_OBJ7_Vy == 0)
        {
            phyValue = getvalue(this);
            // physical to raw conversion
            rawValue = ((phyValue -(-64))/0.125);
            putValue(E_pubc_GW_GW_2BF_RRC_OBJ7_Vy_Rv, rawValue);
            chgEv_GW_2BF_RRC_OBJ7_Vy = 1;  
        }
        else
        {
            chgEv_GW_2BF_RRC_OBJ7_Vy = 0;
        }
    }
}
/*@@end*/


 
/*@@envVar:E_pubc_GW_GW_2BF_RRC_OBJ8_Location_Rv:*/
on envVar E_pubc_GW_GW_2BF_RRC_OBJ8_Location_Rv
{
    int64 rawValue = 0ll;
    float rawValue_float = 0.0;
    float phyValue = 0.0;        

    //set the signal with updated raw value
    if(getValue(E_pubc_GW_GW_2BF_RRC_OBJ8_Location_SetVt)==0)
    {
        rawValue = getvalue(this);
        if(chgEv_GW_2BF_RRC_OBJ8_Location == 0)
        {
            //type conversion to float
            rawValue_float = rawValue;        
            // raw to physical conversion
            phyValue = ((rawValue_float *1)+(0));
            putValue(E_pubc_GW_GW_2BF_RRC_OBJ8_Location_Pv, phyValue);
            chgEv_GW_2BF_RRC_OBJ8_Location = 1;
        }
        else
        {
            chgEv_GW_2BF_RRC_OBJ8_Location = 0;
        }    
        //update the signal value
        Msg_GW_2BF.RRC_OBJ8_Location=rawValue;        
    }                                                                           
}
/*@@end*/

/*@@envVar:E_pubc_GW_GW_2BF_RRC_OBJ8_Location_Pv:*/
on envVar E_pubc_GW_GW_2BF_RRC_OBJ8_Location_Pv
{
    int64 rawValue = 0ll;
    float phyValue = 0.0;
    
    //update the raw value with physical value 
    if(getValue(E_pubc_GW_GW_2BF_RRC_OBJ8_Location_SetVt)==0)
    {
        if(chgEv_GW_2BF_RRC_OBJ8_Location == 0)
        {
            phyValue = getvalue(this);
            // physical to raw conversion
            rawValue = ((phyValue -(0))/1);
            putValue(E_pubc_GW_GW_2BF_RRC_OBJ8_Location_Rv, rawValue);
            chgEv_GW_2BF_RRC_OBJ8_Location = 1;  
        }
        else
        {
            chgEv_GW_2BF_RRC_OBJ8_Location = 0;
        }
    }
}
/*@@end*/

/*@@envVar:E_pubc_GW_GW_2BF_RRC_OBJ8_Location_Vt:*/
on envVar E_pubc_GW_GW_2BF_RRC_OBJ8_Location_Vt
{
    qword rawValue = 0ll;
    if(getValue(E_pubc_GW_GW_2BF_RRC_OBJ8_Location_SetVt))
    {
        //update the signal value
        Msg_GW_2BF.RRC_OBJ8_Location=getValue(this);
    }
}
/*@@end*/

/*@@envVar:E_pubc_GW_GW_2BF_RRC_OBJ8_Location_SetVt:*/
on envVar E_pubc_GW_GW_2BF_RRC_OBJ8_Location_SetVt
{
    if(getValue(E_pubc_GW_GW_2BF_RRC_OBJ8_Location_SetVt))
    {
        //update the signal value
        Msg_GW_2BF.RRC_OBJ8_Location=getvalue(E_pubc_GW_GW_2BF_RRC_OBJ8_Location_Vt);
    }
    else
    {
        Msg_GW_2BF.RRC_OBJ8_Location=getValue(E_pubc_GW_GW_2BF_RRC_OBJ8_Location_Rv);
    }
}
/*@@end*/
 
/*@@envVar:E_pubc_GW_GW_2BF_RRC_OBJ8_Dy_Rv:*/
on envVar E_pubc_GW_GW_2BF_RRC_OBJ8_Dy_Rv
{
    int64 rawValue = 0ll;
    float rawValue_float = 0.0;
    float phyValue = 0.0;        

    //set the signal with updated raw value
    {
        rawValue = getvalue(this);
        if(chgEv_GW_2BF_RRC_OBJ8_Dy == 0)
        {
            //type conversion to float
            rawValue_float = rawValue;        
            // raw to physical conversion
            phyValue = ((rawValue_float *0.125)+(-128));
            putValue(E_pubc_GW_GW_2BF_RRC_OBJ8_Dy_Pv, phyValue);
            chgEv_GW_2BF_RRC_OBJ8_Dy = 1;
        }
        else
        {
            chgEv_GW_2BF_RRC_OBJ8_Dy = 0;
        }    
        //update the signal value
        Msg_GW_2BF.RRC_OBJ8_Dy=rawValue;        
    }                                                                           
}
/*@@end*/

/*@@envVar:E_pubc_GW_GW_2BF_RRC_OBJ8_Dy_Pv:*/
on envVar E_pubc_GW_GW_2BF_RRC_OBJ8_Dy_Pv
{
    int64 rawValue = 0ll;
    float phyValue = 0.0;
    
    //update the raw value with physical value 
    {
        if(chgEv_GW_2BF_RRC_OBJ8_Dy == 0)
        {
            phyValue = getvalue(this);
            // physical to raw conversion
            rawValue = ((phyValue -(-128))/0.125);
            putValue(E_pubc_GW_GW_2BF_RRC_OBJ8_Dy_Rv, rawValue);
            chgEv_GW_2BF_RRC_OBJ8_Dy = 1;  
        }
        else
        {
            chgEv_GW_2BF_RRC_OBJ8_Dy = 0;
        }
    }
}
/*@@end*/


 
/*@@envVar:E_pubc_GW_GW_2BF_RRC_OBJ9_Width_Rv:*/
on envVar E_pubc_GW_GW_2BF_RRC_OBJ9_Width_Rv
{
    int64 rawValue = 0ll;
    float rawValue_float = 0.0;
    float phyValue = 0.0;        

    //set the signal with updated raw value
    {
        rawValue = getvalue(this);
        if(chgEv_GW_2BF_RRC_OBJ9_Width == 0)
        {
            //type conversion to float
            rawValue_float = rawValue;        
            // raw to physical conversion
            phyValue = ((rawValue_float *0.01)+(0));
            putValue(E_pubc_GW_GW_2BF_RRC_OBJ9_Width_Pv, phyValue);
            chgEv_GW_2BF_RRC_OBJ9_Width = 1;
        }
        else
        {
            chgEv_GW_2BF_RRC_OBJ9_Width = 0;
        }    
        //update the signal value
        Msg_GW_2BF.RRC_OBJ9_Width=rawValue;        
    }                                                                           
}
/*@@end*/

/*@@envVar:E_pubc_GW_GW_2BF_RRC_OBJ9_Width_Pv:*/
on envVar E_pubc_GW_GW_2BF_RRC_OBJ9_Width_Pv
{
    int64 rawValue = 0ll;
    float phyValue = 0.0;
    
    //update the raw value with physical value 
    {
        if(chgEv_GW_2BF_RRC_OBJ9_Width == 0)
        {
            phyValue = getvalue(this);
            // physical to raw conversion
            rawValue = ((phyValue -(0))/0.01);
            putValue(E_pubc_GW_GW_2BF_RRC_OBJ9_Width_Rv, rawValue);
            chgEv_GW_2BF_RRC_OBJ9_Width = 1;  
        }
        else
        {
            chgEv_GW_2BF_RRC_OBJ9_Width = 0;
        }
    }
}
/*@@end*/


 
/*@@envVar:E_pubc_GW_GW_2BF_RRC_OBJ6_Length_Rv:*/
on envVar E_pubc_GW_GW_2BF_RRC_OBJ6_Length_Rv
{
    int64 rawValue = 0ll;
    float rawValue_float = 0.0;
    float phyValue = 0.0;        

    //set the signal with updated raw value
    {
        rawValue = getvalue(this);
        if(chgEv_GW_2BF_RRC_OBJ6_Length == 0)
        {
            //type conversion to float
            rawValue_float = rawValue;        
            // raw to physical conversion
            phyValue = ((rawValue_float *0.05)+(0));
            putValue(E_pubc_GW_GW_2BF_RRC_OBJ6_Length_Pv, phyValue);
            chgEv_GW_2BF_RRC_OBJ6_Length = 1;
        }
        else
        {
            chgEv_GW_2BF_RRC_OBJ6_Length = 0;
        }    
        //update the signal value
        Msg_GW_2BF.RRC_OBJ6_Length=rawValue;        
    }                                                                           
}
/*@@end*/

/*@@envVar:E_pubc_GW_GW_2BF_RRC_OBJ6_Length_Pv:*/
on envVar E_pubc_GW_GW_2BF_RRC_OBJ6_Length_Pv
{
    int64 rawValue = 0ll;
    float phyValue = 0.0;
    
    //update the raw value with physical value 
    {
        if(chgEv_GW_2BF_RRC_OBJ6_Length == 0)
        {
            phyValue = getvalue(this);
            // physical to raw conversion
            rawValue = ((phyValue -(0))/0.05);
            putValue(E_pubc_GW_GW_2BF_RRC_OBJ6_Length_Rv, rawValue);
            chgEv_GW_2BF_RRC_OBJ6_Length = 1;  
        }
        else
        {
            chgEv_GW_2BF_RRC_OBJ6_Length = 0;
        }
    }
}
/*@@end*/


 
/*@@envVar:E_pubc_GW_GW_2BF_RRC_OBJ6_Type_Rv:*/
on envVar E_pubc_GW_GW_2BF_RRC_OBJ6_Type_Rv
{
    int64 rawValue = 0ll;
    float rawValue_float = 0.0;
    float phyValue = 0.0;        

    //set the signal with updated raw value
    if(getValue(E_pubc_GW_GW_2BF_RRC_OBJ6_Type_SetVt)==0)
    {
        rawValue = getvalue(this);
        if(chgEv_GW_2BF_RRC_OBJ6_Type == 0)
        {
            //type conversion to float
            rawValue_float = rawValue;        
            // raw to physical conversion
            phyValue = ((rawValue_float *1)+(0));
            putValue(E_pubc_GW_GW_2BF_RRC_OBJ6_Type_Pv, phyValue);
            chgEv_GW_2BF_RRC_OBJ6_Type = 1;
        }
        else
        {
            chgEv_GW_2BF_RRC_OBJ6_Type = 0;
        }    
        //update the signal value
        Msg_GW_2BF.RRC_OBJ6_Type=rawValue;        
    }                                                                           
}
/*@@end*/

/*@@envVar:E_pubc_GW_GW_2BF_RRC_OBJ6_Type_Pv:*/
on envVar E_pubc_GW_GW_2BF_RRC_OBJ6_Type_Pv
{
    int64 rawValue = 0ll;
    float phyValue = 0.0;
    
    //update the raw value with physical value 
    if(getValue(E_pubc_GW_GW_2BF_RRC_OBJ6_Type_SetVt)==0)
    {
        if(chgEv_GW_2BF_RRC_OBJ6_Type == 0)
        {
            phyValue = getvalue(this);
            // physical to raw conversion
            rawValue = ((phyValue -(0))/1);
            putValue(E_pubc_GW_GW_2BF_RRC_OBJ6_Type_Rv, rawValue);
            chgEv_GW_2BF_RRC_OBJ6_Type = 1;  
        }
        else
        {
            chgEv_GW_2BF_RRC_OBJ6_Type = 0;
        }
    }
}
/*@@end*/

/*@@envVar:E_pubc_GW_GW_2BF_RRC_OBJ6_Type_Vt:*/
on envVar E_pubc_GW_GW_2BF_RRC_OBJ6_Type_Vt
{
    qword rawValue = 0ll;
    if(getValue(E_pubc_GW_GW_2BF_RRC_OBJ6_Type_SetVt))
    {
        //update the signal value
        Msg_GW_2BF.RRC_OBJ6_Type=getValue(this);
    }
}
/*@@end*/

/*@@envVar:E_pubc_GW_GW_2BF_RRC_OBJ6_Type_SetVt:*/
on envVar E_pubc_GW_GW_2BF_RRC_OBJ6_Type_SetVt
{
    if(getValue(E_pubc_GW_GW_2BF_RRC_OBJ6_Type_SetVt))
    {
        //update the signal value
        Msg_GW_2BF.RRC_OBJ6_Type=getvalue(E_pubc_GW_GW_2BF_RRC_OBJ6_Type_Vt);
    }
    else
    {
        Msg_GW_2BF.RRC_OBJ6_Type=getValue(E_pubc_GW_GW_2BF_RRC_OBJ6_Type_Rv);
    }
}
/*@@end*/
 
/*@@envVar:E_pubc_GW_GW_2BF_RRC_OBJ9_HeadingAngle_Rv:*/
on envVar E_pubc_GW_GW_2BF_RRC_OBJ9_HeadingAngle_Rv
{
    int64 rawValue = 0ll;
    float rawValue_float = 0.0;
    float phyValue = 0.0;        

    //set the signal with updated raw value
    {
        rawValue = getvalue(this);
        if(chgEv_GW_2BF_RRC_OBJ9_HeadingAngle == 0)
        {
            //type conversion to float
            rawValue_float = rawValue;        
            // raw to physical conversion
            phyValue = ((rawValue_float *0.01)+(-3.14));
            putValue(E_pubc_GW_GW_2BF_RRC_OBJ9_HeadingAngle_Pv, phyValue);
            chgEv_GW_2BF_RRC_OBJ9_HeadingAngle = 1;
        }
        else
        {
            chgEv_GW_2BF_RRC_OBJ9_HeadingAngle = 0;
        }    
        //update the signal value
        Msg_GW_2BF.RRC_OBJ9_HeadingAngle=rawValue;        
    }                                                                           
}
/*@@end*/

/*@@envVar:E_pubc_GW_GW_2BF_RRC_OBJ9_HeadingAngle_Pv:*/
on envVar E_pubc_GW_GW_2BF_RRC_OBJ9_HeadingAngle_Pv
{
    int64 rawValue = 0ll;
    float phyValue = 0.0;
    
    //update the raw value with physical value 
    {
        if(chgEv_GW_2BF_RRC_OBJ9_HeadingAngle == 0)
        {
            phyValue = getvalue(this);
            // physical to raw conversion
            rawValue = ((phyValue -(-3.14))/0.01);
            putValue(E_pubc_GW_GW_2BF_RRC_OBJ9_HeadingAngle_Rv, rawValue);
            chgEv_GW_2BF_RRC_OBJ9_HeadingAngle = 1;  
        }
        else
        {
            chgEv_GW_2BF_RRC_OBJ9_HeadingAngle = 0;
        }
    }
}
/*@@end*/


 
/*@@envVar:E_pubc_GW_GW_2BF_RRC_OBJ8_ExistProb_Rv:*/
on envVar E_pubc_GW_GW_2BF_RRC_OBJ8_ExistProb_Rv
{
    int64 rawValue = 0ll;
    float rawValue_float = 0.0;
    float phyValue = 0.0;        

    //set the signal with updated raw value
    {
        rawValue = getvalue(this);
        if(chgEv_GW_2BF_RRC_OBJ8_ExistProb == 0)
        {
            //type conversion to float
            rawValue_float = rawValue;        
            // raw to physical conversion
            phyValue = ((rawValue_float *2)+(0));
            putValue(E_pubc_GW_GW_2BF_RRC_OBJ8_ExistProb_Pv, phyValue);
            chgEv_GW_2BF_RRC_OBJ8_ExistProb = 1;
        }
        else
        {
            chgEv_GW_2BF_RRC_OBJ8_ExistProb = 0;
        }    
        //update the signal value
        Msg_GW_2BF.RRC_OBJ8_ExistProb=rawValue;        
    }                                                                           
}
/*@@end*/

/*@@envVar:E_pubc_GW_GW_2BF_RRC_OBJ8_ExistProb_Pv:*/
on envVar E_pubc_GW_GW_2BF_RRC_OBJ8_ExistProb_Pv
{
    int64 rawValue = 0ll;
    float phyValue = 0.0;
    
    //update the raw value with physical value 
    {
        if(chgEv_GW_2BF_RRC_OBJ8_ExistProb == 0)
        {
            phyValue = getvalue(this);
            // physical to raw conversion
            rawValue = ((phyValue -(0))/2);
            putValue(E_pubc_GW_GW_2BF_RRC_OBJ8_ExistProb_Rv, rawValue);
            chgEv_GW_2BF_RRC_OBJ8_ExistProb = 1;  
        }
        else
        {
            chgEv_GW_2BF_RRC_OBJ8_ExistProb = 0;
        }
    }
}
/*@@end*/


 
/*@@envVar:E_pubc_GW_GW_2BF_RRC_OBJ6_ObstacleProb_Rv:*/
on envVar E_pubc_GW_GW_2BF_RRC_OBJ6_ObstacleProb_Rv
{
    int64 rawValue = 0ll;
    float rawValue_float = 0.0;
    float phyValue = 0.0;        

    //set the signal with updated raw value
    {
        rawValue = getvalue(this);
        if(chgEv_GW_2BF_RRC_OBJ6_ObstacleProb == 0)
        {
            //type conversion to float
            rawValue_float = rawValue;        
            // raw to physical conversion
            phyValue = ((rawValue_float *2)+(0));
            putValue(E_pubc_GW_GW_2BF_RRC_OBJ6_ObstacleProb_Pv, phyValue);
            chgEv_GW_2BF_RRC_OBJ6_ObstacleProb = 1;
        }
        else
        {
            chgEv_GW_2BF_RRC_OBJ6_ObstacleProb = 0;
        }    
        //update the signal value
        Msg_GW_2BF.RRC_OBJ6_ObstacleProb=rawValue;        
    }                                                                           
}
/*@@end*/

/*@@envVar:E_pubc_GW_GW_2BF_RRC_OBJ6_ObstacleProb_Pv:*/
on envVar E_pubc_GW_GW_2BF_RRC_OBJ6_ObstacleProb_Pv
{
    int64 rawValue = 0ll;
    float phyValue = 0.0;
    
    //update the raw value with physical value 
    {
        if(chgEv_GW_2BF_RRC_OBJ6_ObstacleProb == 0)
        {
            phyValue = getvalue(this);
            // physical to raw conversion
            rawValue = ((phyValue -(0))/2);
            putValue(E_pubc_GW_GW_2BF_RRC_OBJ6_ObstacleProb_Rv, rawValue);
            chgEv_GW_2BF_RRC_OBJ6_ObstacleProb = 1;  
        }
        else
        {
            chgEv_GW_2BF_RRC_OBJ6_ObstacleProb = 0;
        }
    }
}
/*@@end*/


 
/*@@envVar:E_pubc_GW_GW_2BF_RRC_OBJ7_ObstacleProb_Rv:*/
on envVar E_pubc_GW_GW_2BF_RRC_OBJ7_ObstacleProb_Rv
{
    int64 rawValue = 0ll;
    float rawValue_float = 0.0;
    float phyValue = 0.0;        

    //set the signal with updated raw value
    {
        rawValue = getvalue(this);
        if(chgEv_GW_2BF_RRC_OBJ7_ObstacleProb == 0)
        {
            //type conversion to float
            rawValue_float = rawValue;        
            // raw to physical conversion
            phyValue = ((rawValue_float *2)+(0));
            putValue(E_pubc_GW_GW_2BF_RRC_OBJ7_ObstacleProb_Pv, phyValue);
            chgEv_GW_2BF_RRC_OBJ7_ObstacleProb = 1;
        }
        else
        {
            chgEv_GW_2BF_RRC_OBJ7_ObstacleProb = 0;
        }    
        //update the signal value
        Msg_GW_2BF.RRC_OBJ7_ObstacleProb=rawValue;        
    }                                                                           
}
/*@@end*/

/*@@envVar:E_pubc_GW_GW_2BF_RRC_OBJ7_ObstacleProb_Pv:*/
on envVar E_pubc_GW_GW_2BF_RRC_OBJ7_ObstacleProb_Pv
{
    int64 rawValue = 0ll;
    float phyValue = 0.0;
    
    //update the raw value with physical value 
    {
        if(chgEv_GW_2BF_RRC_OBJ7_ObstacleProb == 0)
        {
            phyValue = getvalue(this);
            // physical to raw conversion
            rawValue = ((phyValue -(0))/2);
            putValue(E_pubc_GW_GW_2BF_RRC_OBJ7_ObstacleProb_Rv, rawValue);
            chgEv_GW_2BF_RRC_OBJ7_ObstacleProb = 1;  
        }
        else
        {
            chgEv_GW_2BF_RRC_OBJ7_ObstacleProb = 0;
        }
    }
}
/*@@end*/


 
/*@@envVar:E_pubc_GW_GW_2BF_RRC_OBJ8_ObstacleProb_Rv:*/
on envVar E_pubc_GW_GW_2BF_RRC_OBJ8_ObstacleProb_Rv
{
    int64 rawValue = 0ll;
    float rawValue_float = 0.0;
    float phyValue = 0.0;        

    //set the signal with updated raw value
    {
        rawValue = getvalue(this);
        if(chgEv_GW_2BF_RRC_OBJ8_ObstacleProb == 0)
        {
            //type conversion to float
            rawValue_float = rawValue;        
            // raw to physical conversion
            phyValue = ((rawValue_float *2)+(0));
            putValue(E_pubc_GW_GW_2BF_RRC_OBJ8_ObstacleProb_Pv, phyValue);
            chgEv_GW_2BF_RRC_OBJ8_ObstacleProb = 1;
        }
        else
        {
            chgEv_GW_2BF_RRC_OBJ8_ObstacleProb = 0;
        }    
        //update the signal value
        Msg_GW_2BF.RRC_OBJ8_ObstacleProb=rawValue;        
    }                                                                           
}
/*@@end*/

/*@@envVar:E_pubc_GW_GW_2BF_RRC_OBJ8_ObstacleProb_Pv:*/
on envVar E_pubc_GW_GW_2BF_RRC_OBJ8_ObstacleProb_Pv
{
    int64 rawValue = 0ll;
    float phyValue = 0.0;
    
    //update the raw value with physical value 
    {
        if(chgEv_GW_2BF_RRC_OBJ8_ObstacleProb == 0)
        {
            phyValue = getvalue(this);
            // physical to raw conversion
            rawValue = ((phyValue -(0))/2);
            putValue(E_pubc_GW_GW_2BF_RRC_OBJ8_ObstacleProb_Rv, rawValue);
            chgEv_GW_2BF_RRC_OBJ8_ObstacleProb = 1;  
        }
        else
        {
            chgEv_GW_2BF_RRC_OBJ8_ObstacleProb = 0;
        }
    }
}
/*@@end*/


 
/*@@envVar:E_pubc_GW_GW_2BF_RRC_OBJ8_Dx_Rv:*/
on envVar E_pubc_GW_GW_2BF_RRC_OBJ8_Dx_Rv
{
    int64 rawValue = 0ll;
    float rawValue_float = 0.0;
    float phyValue = 0.0;        

    //set the signal with updated raw value
    {
        rawValue = getvalue(this);
        if(chgEv_GW_2BF_RRC_OBJ8_Dx == 0)
        {
            //type conversion to float
            rawValue_float = rawValue;        
            // raw to physical conversion
            phyValue = ((rawValue_float *0.0625)+(-256));
            putValue(E_pubc_GW_GW_2BF_RRC_OBJ8_Dx_Pv, phyValue);
            chgEv_GW_2BF_RRC_OBJ8_Dx = 1;
        }
        else
        {
            chgEv_GW_2BF_RRC_OBJ8_Dx = 0;
        }    
        //update the signal value
        Msg_GW_2BF.RRC_OBJ8_Dx=rawValue;        
    }                                                                           
}
/*@@end*/

/*@@envVar:E_pubc_GW_GW_2BF_RRC_OBJ8_Dx_Pv:*/
on envVar E_pubc_GW_GW_2BF_RRC_OBJ8_Dx_Pv
{
    int64 rawValue = 0ll;
    float phyValue = 0.0;
    
    //update the raw value with physical value 
    {
        if(chgEv_GW_2BF_RRC_OBJ8_Dx == 0)
        {
            phyValue = getvalue(this);
            // physical to raw conversion
            rawValue = ((phyValue -(-256))/0.0625);
            putValue(E_pubc_GW_GW_2BF_RRC_OBJ8_Dx_Rv, rawValue);
            chgEv_GW_2BF_RRC_OBJ8_Dx = 1;  
        }
        else
        {
            chgEv_GW_2BF_RRC_OBJ8_Dx = 0;
        }
    }
}
/*@@end*/


 
/*@@envVar:E_pubc_GW_GW_2BF_RRC_OBJ9_ExistProb_Rv:*/
on envVar E_pubc_GW_GW_2BF_RRC_OBJ9_ExistProb_Rv
{
    int64 rawValue = 0ll;
    float rawValue_float = 0.0;
    float phyValue = 0.0;        

    //set the signal with updated raw value
    {
        rawValue = getvalue(this);
        if(chgEv_GW_2BF_RRC_OBJ9_ExistProb == 0)
        {
            //type conversion to float
            rawValue_float = rawValue;        
            // raw to physical conversion
            phyValue = ((rawValue_float *2)+(0));
            putValue(E_pubc_GW_GW_2BF_RRC_OBJ9_ExistProb_Pv, phyValue);
            chgEv_GW_2BF_RRC_OBJ9_ExistProb = 1;
        }
        else
        {
            chgEv_GW_2BF_RRC_OBJ9_ExistProb = 0;
        }    
        //update the signal value
        Msg_GW_2BF.RRC_OBJ9_ExistProb=rawValue;        
    }                                                                           
}
/*@@end*/

/*@@envVar:E_pubc_GW_GW_2BF_RRC_OBJ9_ExistProb_Pv:*/
on envVar E_pubc_GW_GW_2BF_RRC_OBJ9_ExistProb_Pv
{
    int64 rawValue = 0ll;
    float phyValue = 0.0;
    
    //update the raw value with physical value 
    {
        if(chgEv_GW_2BF_RRC_OBJ9_ExistProb == 0)
        {
            phyValue = getvalue(this);
            // physical to raw conversion
            rawValue = ((phyValue -(0))/2);
            putValue(E_pubc_GW_GW_2BF_RRC_OBJ9_ExistProb_Rv, rawValue);
            chgEv_GW_2BF_RRC_OBJ9_ExistProb = 1;  
        }
        else
        {
            chgEv_GW_2BF_RRC_OBJ9_ExistProb = 0;
        }
    }
}
/*@@end*/


 
/*@@envVar:E_pubc_GW_GW_2BF_RRC_OBJ7_Ay_Rv:*/
on envVar E_pubc_GW_GW_2BF_RRC_OBJ7_Ay_Rv
{
    int64 rawValue = 0ll;
    float rawValue_float = 0.0;
    float phyValue = 0.0;        

    //set the signal with updated raw value
    {
        rawValue = getvalue(this);
        if(chgEv_GW_2BF_RRC_OBJ7_Ay == 0)
        {
            //type conversion to float
            rawValue_float = rawValue;        
            // raw to physical conversion
            phyValue = ((rawValue_float *0.03125)+(-16));
            putValue(E_pubc_GW_GW_2BF_RRC_OBJ7_Ay_Pv, phyValue);
            chgEv_GW_2BF_RRC_OBJ7_Ay = 1;
        }
        else
        {
            chgEv_GW_2BF_RRC_OBJ7_Ay = 0;
        }    
        //update the signal value
        Msg_GW_2BF.RRC_OBJ7_Ay=rawValue;        
    }                                                                           
}
/*@@end*/

/*@@envVar:E_pubc_GW_GW_2BF_RRC_OBJ7_Ay_Pv:*/
on envVar E_pubc_GW_GW_2BF_RRC_OBJ7_Ay_Pv
{
    int64 rawValue = 0ll;
    float phyValue = 0.0;
    
    //update the raw value with physical value 
    {
        if(chgEv_GW_2BF_RRC_OBJ7_Ay == 0)
        {
            phyValue = getvalue(this);
            // physical to raw conversion
            rawValue = ((phyValue -(-16))/0.03125);
            putValue(E_pubc_GW_GW_2BF_RRC_OBJ7_Ay_Rv, rawValue);
            chgEv_GW_2BF_RRC_OBJ7_Ay = 1;  
        }
        else
        {
            chgEv_GW_2BF_RRC_OBJ7_Ay = 0;
        }
    }
}
/*@@end*/


 
/*@@envVar:E_pubc_GW_GW_2BF_RRC_OBJ7_Ax_Rv:*/
on envVar E_pubc_GW_GW_2BF_RRC_OBJ7_Ax_Rv
{
    int64 rawValue = 0ll;
    float rawValue_float = 0.0;
    float phyValue = 0.0;        

    //set the signal with updated raw value
    {
        rawValue = getvalue(this);
        if(chgEv_GW_2BF_RRC_OBJ7_Ax == 0)
        {
            //type conversion to float
            rawValue_float = rawValue;        
            // raw to physical conversion
            phyValue = ((rawValue_float *0.0625)+(-16));
            putValue(E_pubc_GW_GW_2BF_RRC_OBJ7_Ax_Pv, phyValue);
            chgEv_GW_2BF_RRC_OBJ7_Ax = 1;
        }
        else
        {
            chgEv_GW_2BF_RRC_OBJ7_Ax = 0;
        }    
        //update the signal value
        Msg_GW_2BF.RRC_OBJ7_Ax=rawValue;        
    }                                                                           
}
/*@@end*/

/*@@envVar:E_pubc_GW_GW_2BF_RRC_OBJ7_Ax_Pv:*/
on envVar E_pubc_GW_GW_2BF_RRC_OBJ7_Ax_Pv
{
    int64 rawValue = 0ll;
    float phyValue = 0.0;
    
    //update the raw value with physical value 
    {
        if(chgEv_GW_2BF_RRC_OBJ7_Ax == 0)
        {
            phyValue = getvalue(this);
            // physical to raw conversion
            rawValue = ((phyValue -(-16))/0.0625);
            putValue(E_pubc_GW_GW_2BF_RRC_OBJ7_Ax_Rv, rawValue);
            chgEv_GW_2BF_RRC_OBJ7_Ax = 1;  
        }
        else
        {
            chgEv_GW_2BF_RRC_OBJ7_Ax = 0;
        }
    }
}
/*@@end*/


 
/*@@envVar:E_pubc_GW_GW_2BF_RRC_OBJ8_Width_Rv:*/
on envVar E_pubc_GW_GW_2BF_RRC_OBJ8_Width_Rv
{
    int64 rawValue = 0ll;
    float rawValue_float = 0.0;
    float phyValue = 0.0;        

    //set the signal with updated raw value
    {
        rawValue = getvalue(this);
        if(chgEv_GW_2BF_RRC_OBJ8_Width == 0)
        {
            //type conversion to float
            rawValue_float = rawValue;        
            // raw to physical conversion
            phyValue = ((rawValue_float *0.01)+(0));
            putValue(E_pubc_GW_GW_2BF_RRC_OBJ8_Width_Pv, phyValue);
            chgEv_GW_2BF_RRC_OBJ8_Width = 1;
        }
        else
        {
            chgEv_GW_2BF_RRC_OBJ8_Width = 0;
        }    
        //update the signal value
        Msg_GW_2BF.RRC_OBJ8_Width=rawValue;        
    }                                                                           
}
/*@@end*/

/*@@envVar:E_pubc_GW_GW_2BF_RRC_OBJ8_Width_Pv:*/
on envVar E_pubc_GW_GW_2BF_RRC_OBJ8_Width_Pv
{
    int64 rawValue = 0ll;
    float phyValue = 0.0;
    
    //update the raw value with physical value 
    {
        if(chgEv_GW_2BF_RRC_OBJ8_Width == 0)
        {
            phyValue = getvalue(this);
            // physical to raw conversion
            rawValue = ((phyValue -(0))/0.01);
            putValue(E_pubc_GW_GW_2BF_RRC_OBJ8_Width_Rv, rawValue);
            chgEv_GW_2BF_RRC_OBJ8_Width = 1;  
        }
        else
        {
            chgEv_GW_2BF_RRC_OBJ8_Width = 0;
        }
    }
}
/*@@end*/


 
/*@@envVar:E_pubc_GW_GW_2BF_RRC_OBJ6_Measured_Rv:*/
on envVar E_pubc_GW_GW_2BF_RRC_OBJ6_Measured_Rv
{
    int64 rawValue = 0ll;
    float rawValue_float = 0.0;
    float phyValue = 0.0;        

    //set the signal with updated raw value
    if(getValue(E_pubc_GW_GW_2BF_RRC_OBJ6_Measured_SetVt)==0)
    {
        rawValue = getvalue(this);
        if(chgEv_GW_2BF_RRC_OBJ6_Measured == 0)
        {
            //type conversion to float
            rawValue_float = rawValue;        
            // raw to physical conversion
            phyValue = ((rawValue_float *1)+(0));
            putValue(E_pubc_GW_GW_2BF_RRC_OBJ6_Measured_Pv, phyValue);
            chgEv_GW_2BF_RRC_OBJ6_Measured = 1;
        }
        else
        {
            chgEv_GW_2BF_RRC_OBJ6_Measured = 0;
        }    
        //update the signal value
        Msg_GW_2BF.RRC_OBJ6_Measured=rawValue;        
    }                                                                           
}
/*@@end*/

/*@@envVar:E_pubc_GW_GW_2BF_RRC_OBJ6_Measured_Pv:*/
on envVar E_pubc_GW_GW_2BF_RRC_OBJ6_Measured_Pv
{
    int64 rawValue = 0ll;
    float phyValue = 0.0;
    
    //update the raw value with physical value 
    if(getValue(E_pubc_GW_GW_2BF_RRC_OBJ6_Measured_SetVt)==0)
    {
        if(chgEv_GW_2BF_RRC_OBJ6_Measured == 0)
        {
            phyValue = getvalue(this);
            // physical to raw conversion
            rawValue = ((phyValue -(0))/1);
            putValue(E_pubc_GW_GW_2BF_RRC_OBJ6_Measured_Rv, rawValue);
            chgEv_GW_2BF_RRC_OBJ6_Measured = 1;  
        }
        else
        {
            chgEv_GW_2BF_RRC_OBJ6_Measured = 0;
        }
    }
}
/*@@end*/

/*@@envVar:E_pubc_GW_GW_2BF_RRC_OBJ6_Measured_Vt:*/
on envVar E_pubc_GW_GW_2BF_RRC_OBJ6_Measured_Vt
{
    qword rawValue = 0ll;
    if(getValue(E_pubc_GW_GW_2BF_RRC_OBJ6_Measured_SetVt))
    {
        //update the signal value
        Msg_GW_2BF.RRC_OBJ6_Measured=getValue(this);
    }
}
/*@@end*/

/*@@envVar:E_pubc_GW_GW_2BF_RRC_OBJ6_Measured_SetVt:*/
on envVar E_pubc_GW_GW_2BF_RRC_OBJ6_Measured_SetVt
{
    if(getValue(E_pubc_GW_GW_2BF_RRC_OBJ6_Measured_SetVt))
    {
        //update the signal value
        Msg_GW_2BF.RRC_OBJ6_Measured=getvalue(E_pubc_GW_GW_2BF_RRC_OBJ6_Measured_Vt);
    }
    else
    {
        Msg_GW_2BF.RRC_OBJ6_Measured=getValue(E_pubc_GW_GW_2BF_RRC_OBJ6_Measured_Rv);
    }
}
/*@@end*/
 
/*@@envVar:E_pubc_GW_GW_3BD_tx:*/
on envVar E_pubc_GW_GW_3BD_tx
{
    if(getValue(this))
    {       
        

        output(Msg_GW_3BD);        
    }
}
/*@@end*/

/*@@envVar:E_pubc_GW_GW_3BD_Range:*/
on envVar E_pubc_GW_GW_3BD_Range
{
    qword rawstatus = 0ll;
    qword rawValue = 0ll;    
    
    rawstatus = getvalue(this);    
    // set all the signals with min raw /max raw /init raw
    switch (rawstatus) 
    {
     case(0) :
        rawValue= 0;
        putValue(E_pubc_GW_GW_3BD_HU_TLAEnable_Rv, rawValue);
        rawValue= 0;
        putValue(E_pubc_GW_GW_3BD_HU_ELKEnable_Rv, rawValue);
        rawValue= 0;
        putValue(E_pubc_GW_GW_3BD_HU_CSLAEnable_Rv, rawValue);
        break;
     case(1) :
        rawValue= 3;
        putValue(E_pubc_GW_GW_3BD_HU_TLAEnable_Rv, rawValue);
        rawValue= 3;
        putValue(E_pubc_GW_GW_3BD_HU_ELKEnable_Rv, rawValue);
        rawValue= 3;
        putValue(E_pubc_GW_GW_3BD_HU_CSLAEnable_Rv, rawValue);
        break;
     default :
        rawValue= 0;
        putValue(E_pubc_GW_GW_3BD_HU_TLAEnable_Rv, rawValue);
        rawValue= 0;
        putValue(E_pubc_GW_GW_3BD_HU_ELKEnable_Rv, rawValue);
        rawValue= 0;
        putValue(E_pubc_GW_GW_3BD_HU_CSLAEnable_Rv, rawValue);
      break;
   }
}
/*@@end*/

/*@@envVar:E_pubc_GW_GW_3BD_Dlc:*/
on envVar E_pubc_GW_GW_3BD_Dlc
{
    if(getValue(E_pubc_GW_GW_3BD_enDlc))
    {
        Msg_GW_3BD.dlc =getValue(this);
    }
    else
    {
       Dbc_dlc = 64;
	   Msg_GW_3BD.dlc = Calc_Canfd_dlc(Dbc_dlc);
	   // Msg_GW_3BD.dlc = 64;
	   	
  }
}
/*@@end*/

/*@@envVar:E_pubc_GW_GW_3BD_enDlc:*/
on envVar E_pubc_GW_GW_3BD_enDlc
{
    //For Messages with DLC = 8, set wrong DLC to smaller than defined DLC
    //For Messages with DLC < 8 set wrong DLC to smaller/longer than defined DLC
    if(getValue(this))
    {
        Msg_GW_3BD.dlc =getValue(E_pubc_GW_GW_3BD_Dlc);
    }
    else
    {
       Dbc_dlc = 64;
	   Msg_GW_3BD.dlc = Calc_Canfd_dlc(Dbc_dlc);
	   // Msg_GW_3BD.dlc = 64;
    }
}
/*@@end*/


/*@@envVar:E_pubc_GW_GW_3BD_HU_TLAEnable_Rv:*/
on envVar E_pubc_GW_GW_3BD_HU_TLAEnable_Rv
{
    int64 rawValue = 0ll;
    float rawValue_float = 0.0;
    float phyValue = 0.0;        

    //set the signal with updated raw value
    if(getValue(E_pubc_GW_GW_3BD_HU_TLAEnable_SetVt)==0)
    {
        rawValue = getvalue(this);
        if(chgEv_GW_3BD_HU_TLAEnable == 0)
        {
            //type conversion to float
            rawValue_float = rawValue;        
            // raw to physical conversion
            phyValue = ((rawValue_float *1)+(0));
            putValue(E_pubc_GW_GW_3BD_HU_TLAEnable_Pv, phyValue);
            chgEv_GW_3BD_HU_TLAEnable = 1;
        }
        else
        {
            chgEv_GW_3BD_HU_TLAEnable = 0;
        }    
        //update the signal value
        Msg_GW_3BD.HU_TLAEnable=rawValue;        
    }                                                                           
}
/*@@end*/

/*@@envVar:E_pubc_GW_GW_3BD_HU_TLAEnable_Pv:*/
on envVar E_pubc_GW_GW_3BD_HU_TLAEnable_Pv
{
    int64 rawValue = 0ll;
    float phyValue = 0.0;
    
    //update the raw value with physical value 
    if(getValue(E_pubc_GW_GW_3BD_HU_TLAEnable_SetVt)==0)
    {
        if(chgEv_GW_3BD_HU_TLAEnable == 0)
        {
            phyValue = getvalue(this);
            // physical to raw conversion
            rawValue = ((phyValue -(0))/1);
            putValue(E_pubc_GW_GW_3BD_HU_TLAEnable_Rv, rawValue);
            chgEv_GW_3BD_HU_TLAEnable = 1;  
        }
        else
        {
            chgEv_GW_3BD_HU_TLAEnable = 0;
        }
    }
}
/*@@end*/

/*@@envVar:E_pubc_GW_GW_3BD_HU_TLAEnable_Vt:*/
on envVar E_pubc_GW_GW_3BD_HU_TLAEnable_Vt
{
    qword rawValue = 0ll;
    if(getValue(E_pubc_GW_GW_3BD_HU_TLAEnable_SetVt))
    {
        //update the signal value
        Msg_GW_3BD.HU_TLAEnable=getValue(this);
    }
}
/*@@end*/

/*@@envVar:E_pubc_GW_GW_3BD_HU_TLAEnable_SetVt:*/
on envVar E_pubc_GW_GW_3BD_HU_TLAEnable_SetVt
{
    if(getValue(E_pubc_GW_GW_3BD_HU_TLAEnable_SetVt))
    {
        //update the signal value
        Msg_GW_3BD.HU_TLAEnable=getvalue(E_pubc_GW_GW_3BD_HU_TLAEnable_Vt);
    }
    else
    {
        Msg_GW_3BD.HU_TLAEnable=getValue(E_pubc_GW_GW_3BD_HU_TLAEnable_Rv);
    }
}
/*@@end*/
 
/*@@envVar:E_pubc_GW_GW_3BD_HU_ELKEnable_Rv:*/
on envVar E_pubc_GW_GW_3BD_HU_ELKEnable_Rv
{
    int64 rawValue = 0ll;
    float rawValue_float = 0.0;
    float phyValue = 0.0;        

    //set the signal with updated raw value
    if(getValue(E_pubc_GW_GW_3BD_HU_ELKEnable_SetVt)==0)
    {
        rawValue = getvalue(this);
        if(chgEv_GW_3BD_HU_ELKEnable == 0)
        {
            //type conversion to float
            rawValue_float = rawValue;        
            // raw to physical conversion
            phyValue = ((rawValue_float *1)+(0));
            putValue(E_pubc_GW_GW_3BD_HU_ELKEnable_Pv, phyValue);
            chgEv_GW_3BD_HU_ELKEnable = 1;
        }
        else
        {
            chgEv_GW_3BD_HU_ELKEnable = 0;
        }    
        //update the signal value
        Msg_GW_3BD.HU_ELKEnable=rawValue;        
    }                                                                           
}
/*@@end*/

/*@@envVar:E_pubc_GW_GW_3BD_HU_ELKEnable_Pv:*/
on envVar E_pubc_GW_GW_3BD_HU_ELKEnable_Pv
{
    int64 rawValue = 0ll;
    float phyValue = 0.0;
    
    //update the raw value with physical value 
    if(getValue(E_pubc_GW_GW_3BD_HU_ELKEnable_SetVt)==0)
    {
        if(chgEv_GW_3BD_HU_ELKEnable == 0)
        {
            phyValue = getvalue(this);
            // physical to raw conversion
            rawValue = ((phyValue -(0))/1);
            putValue(E_pubc_GW_GW_3BD_HU_ELKEnable_Rv, rawValue);
            chgEv_GW_3BD_HU_ELKEnable = 1;  
        }
        else
        {
            chgEv_GW_3BD_HU_ELKEnable = 0;
        }
    }
}
/*@@end*/

/*@@envVar:E_pubc_GW_GW_3BD_HU_ELKEnable_Vt:*/
on envVar E_pubc_GW_GW_3BD_HU_ELKEnable_Vt
{
    qword rawValue = 0ll;
    if(getValue(E_pubc_GW_GW_3BD_HU_ELKEnable_SetVt))
    {
        //update the signal value
        Msg_GW_3BD.HU_ELKEnable=getValue(this);
    }
}
/*@@end*/

/*@@envVar:E_pubc_GW_GW_3BD_HU_ELKEnable_SetVt:*/
on envVar E_pubc_GW_GW_3BD_HU_ELKEnable_SetVt
{
    if(getValue(E_pubc_GW_GW_3BD_HU_ELKEnable_SetVt))
    {
        //update the signal value
        Msg_GW_3BD.HU_ELKEnable=getvalue(E_pubc_GW_GW_3BD_HU_ELKEnable_Vt);
    }
    else
    {
        Msg_GW_3BD.HU_ELKEnable=getValue(E_pubc_GW_GW_3BD_HU_ELKEnable_Rv);
    }
}
/*@@end*/
 
/*@@envVar:E_pubc_GW_GW_3BD_HU_CSLAEnable_Rv:*/
on envVar E_pubc_GW_GW_3BD_HU_CSLAEnable_Rv
{
    int64 rawValue = 0ll;
    float rawValue_float = 0.0;
    float phyValue = 0.0;        

    //set the signal with updated raw value
    if(getValue(E_pubc_GW_GW_3BD_HU_CSLAEnable_SetVt)==0)
    {
        rawValue = getvalue(this);
        if(chgEv_GW_3BD_HU_CSLAEnable == 0)
        {
            //type conversion to float
            rawValue_float = rawValue;        
            // raw to physical conversion
            phyValue = ((rawValue_float *1)+(0));
            putValue(E_pubc_GW_GW_3BD_HU_CSLAEnable_Pv, phyValue);
            chgEv_GW_3BD_HU_CSLAEnable = 1;
        }
        else
        {
            chgEv_GW_3BD_HU_CSLAEnable = 0;
        }    
        //update the signal value
        Msg_GW_3BD.HU_CSLAEnable=rawValue;        
    }                                                                           
}
/*@@end*/

/*@@envVar:E_pubc_GW_GW_3BD_HU_CSLAEnable_Pv:*/
on envVar E_pubc_GW_GW_3BD_HU_CSLAEnable_Pv
{
    int64 rawValue = 0ll;
    float phyValue = 0.0;
    
    //update the raw value with physical value 
    if(getValue(E_pubc_GW_GW_3BD_HU_CSLAEnable_SetVt)==0)
    {
        if(chgEv_GW_3BD_HU_CSLAEnable == 0)
        {
            phyValue = getvalue(this);
            // physical to raw conversion
            rawValue = ((phyValue -(0))/1);
            putValue(E_pubc_GW_GW_3BD_HU_CSLAEnable_Rv, rawValue);
            chgEv_GW_3BD_HU_CSLAEnable = 1;  
        }
        else
        {
            chgEv_GW_3BD_HU_CSLAEnable = 0;
        }
    }
}
/*@@end*/

/*@@envVar:E_pubc_GW_GW_3BD_HU_CSLAEnable_Vt:*/
on envVar E_pubc_GW_GW_3BD_HU_CSLAEnable_Vt
{
    qword rawValue = 0ll;
    if(getValue(E_pubc_GW_GW_3BD_HU_CSLAEnable_SetVt))
    {
        //update the signal value
        Msg_GW_3BD.HU_CSLAEnable=getValue(this);
    }
}
/*@@end*/

/*@@envVar:E_pubc_GW_GW_3BD_HU_CSLAEnable_SetVt:*/
on envVar E_pubc_GW_GW_3BD_HU_CSLAEnable_SetVt
{
    if(getValue(E_pubc_GW_GW_3BD_HU_CSLAEnable_SetVt))
    {
        //update the signal value
        Msg_GW_3BD.HU_CSLAEnable=getvalue(E_pubc_GW_GW_3BD_HU_CSLAEnable_Vt);
    }
    else
    {
        Msg_GW_3BD.HU_CSLAEnable=getValue(E_pubc_GW_GW_3BD_HU_CSLAEnable_Rv);
    }
}
/*@@end*/
 
/*@@envVar:E_pubc_GW_GW_28B_tx:*/
on envVar E_pubc_GW_GW_28B_tx
{
    if(getValue(this))
    {       
        
        //update the BZ Signal
        if(GW_28B_BCM_RollingCounter_28B_wrongvalctr == 0)
        {
            update_GW_28B_BCM_RollingCounter_28B_counter();
            Msg_GW_28B.BCM_RollingCounter_28B= GW_28B_BCM_RollingCounter_28B_counter;
        }
        else if(GW_28B_BCM_RollingCounter_28B_wrongvalctr > 0)
        {
			GW_28B_BCM_RollingCounter_28B_counter=GW_28B_BCM_RollingCounter_28B_counter + GW_28B_BCM_RollingCounter_28B_wrongvalctr;
			 Msg_GW_28B.BCM_RollingCounter_28B= GW_28B_BCM_RollingCounter_28B_counter;
            /* GW_28B_BCM_RollingCounter_28B_wrongvalctr--;
              // if counter becomes zero, update panel controller to zero
             if(GW_28B_BCM_RollingCounter_28B_wrongvalctr == 0)
             {
                 putValue(E_pubc_GW_GW_28B_BCM_RollingCounter_28B_wrongvalctr,0);
             } */
        }
        else
        { 
			// do nothing
        }    
        //calculate the CRC CheckSum
        update_GW_28B_CRC_CheckSum();

        output(Msg_GW_28B);        
    }
}
/*@@end*/

/*@@envVar:E_pubc_GW_GW_28B_Range:*/
on envVar E_pubc_GW_GW_28B_Range
{
    qword rawstatus = 0ll;
    qword rawValue = 0ll;    
    
    rawstatus = getvalue(this);    
    // set all the signals with min raw /max raw /init raw
    switch (rawstatus) 
    {
     case(0) :
        rawValue= 0;
        putValue(E_pubc_GW_GW_28B_BCM_TurnLightSwitchSts_Rv, rawValue);
        break;
     case(1) :
        rawValue= 3;
        putValue(E_pubc_GW_GW_28B_BCM_TurnLightSwitchSts_Rv, rawValue);
        break;
     default :
        rawValue= 0;
        putValue(E_pubc_GW_GW_28B_BCM_TurnLightSwitchSts_Rv, rawValue);
      break;
   }
}
/*@@end*/

/*@@envVar:E_pubc_GW_GW_28B_Dlc:*/
on envVar E_pubc_GW_GW_28B_Dlc
{
    if(getValue(E_pubc_GW_GW_28B_enDlc))
    {
        Msg_GW_28B.dlc =getValue(this);
    }
    else
    {
       Dbc_dlc = 8;
	   Msg_GW_28B.dlc = Calc_Canfd_dlc(Dbc_dlc);
	   // Msg_GW_28B.dlc = 8;
	   	
  }
}
/*@@end*/

/*@@envVar:E_pubc_GW_GW_28B_enDlc:*/
on envVar E_pubc_GW_GW_28B_enDlc
{
    //For Messages with DLC = 8, set wrong DLC to smaller than defined DLC
    //For Messages with DLC < 8 set wrong DLC to smaller/longer than defined DLC
    if(getValue(this))
    {
        Msg_GW_28B.dlc =getValue(E_pubc_GW_GW_28B_Dlc);
    }
    else
    {
       Dbc_dlc = 8;
	   Msg_GW_28B.dlc = Calc_Canfd_dlc(Dbc_dlc);
	   // Msg_GW_28B.dlc = 8;
    }
}
/*@@end*/

/*@@envVar:E_pubc_GW_GW_28B_BCM_CRCCheck_28B_wrongvalctr:*/
on envVar E_pubc_GW_GW_28B_BCM_CRCCheck_28B_wrongvalctr
{
    //update disturb count
    //disturb value range:(-1 = always send wrong value),( X>0 ,x is the number of Messages with wrong CHK sent)
    GW_28B_BCM_CRCCheck_28B_wrongvalctr =getValue(this);    
}
/*@@end*/
/*@@envVar:E_pubc_GW_GW_28B_BCM_RollingCounter_28B_wrongvalctr:*/
on envVar E_pubc_GW_GW_28B_BCM_RollingCounter_28B_wrongvalctr
{
    //update disturb count
    //disturb value range:(-1 = always send wrong value),( X>0 ,x is the number of Messages with wrong CHK sent)
    GW_28B_BCM_RollingCounter_28B_wrongvalctr =getValue(this);    
}
/*@@end*/

/*@@envVar:E_pubc_GW_GW_28B_BCM_TurnLightSwitchSts_Rv:*/
on envVar E_pubc_GW_GW_28B_BCM_TurnLightSwitchSts_Rv
{
    int64 rawValue = 0ll;
    float rawValue_float = 0.0;
    float phyValue = 0.0;        

    //set the signal with updated raw value
    if(getValue(E_pubc_GW_GW_28B_BCM_TurnLightSwitchSts_SetVt)==0)
    {
        rawValue = getvalue(this);
        if(chgEv_GW_28B_BCM_TurnLightSwitchSts == 0)
        {
            //type conversion to float
            rawValue_float = rawValue;        
            // raw to physical conversion
            phyValue = ((rawValue_float *1)+(0));
            putValue(E_pubc_GW_GW_28B_BCM_TurnLightSwitchSts_Pv, phyValue);
            chgEv_GW_28B_BCM_TurnLightSwitchSts = 1;
        }
        else
        {
            chgEv_GW_28B_BCM_TurnLightSwitchSts = 0;
        }    
        //update the signal value
        Msg_GW_28B.BCM_TurnLightSwitchSts=rawValue;        
    }                                                                           
}
/*@@end*/

/*@@envVar:E_pubc_GW_GW_28B_BCM_TurnLightSwitchSts_Pv:*/
on envVar E_pubc_GW_GW_28B_BCM_TurnLightSwitchSts_Pv
{
    int64 rawValue = 0ll;
    float phyValue = 0.0;
    
    //update the raw value with physical value 
    if(getValue(E_pubc_GW_GW_28B_BCM_TurnLightSwitchSts_SetVt)==0)
    {
        if(chgEv_GW_28B_BCM_TurnLightSwitchSts == 0)
        {
            phyValue = getvalue(this);
            // physical to raw conversion
            rawValue = ((phyValue -(0))/1);
            putValue(E_pubc_GW_GW_28B_BCM_TurnLightSwitchSts_Rv, rawValue);
            chgEv_GW_28B_BCM_TurnLightSwitchSts = 1;  
        }
        else
        {
            chgEv_GW_28B_BCM_TurnLightSwitchSts = 0;
        }
    }
}
/*@@end*/

/*@@envVar:E_pubc_GW_GW_28B_BCM_TurnLightSwitchSts_Vt:*/
on envVar E_pubc_GW_GW_28B_BCM_TurnLightSwitchSts_Vt
{
    qword rawValue = 0ll;
    if(getValue(E_pubc_GW_GW_28B_BCM_TurnLightSwitchSts_SetVt))
    {
        //update the signal value
        Msg_GW_28B.BCM_TurnLightSwitchSts=getValue(this);
    }
}
/*@@end*/

/*@@envVar:E_pubc_GW_GW_28B_BCM_TurnLightSwitchSts_SetVt:*/
on envVar E_pubc_GW_GW_28B_BCM_TurnLightSwitchSts_SetVt
{
    if(getValue(E_pubc_GW_GW_28B_BCM_TurnLightSwitchSts_SetVt))
    {
        //update the signal value
        Msg_GW_28B.BCM_TurnLightSwitchSts=getvalue(E_pubc_GW_GW_28B_BCM_TurnLightSwitchSts_Vt);
    }
    else
    {
        Msg_GW_28B.BCM_TurnLightSwitchSts=getValue(E_pubc_GW_GW_28B_BCM_TurnLightSwitchSts_Rv);
    }
}
/*@@end*/
 

/*@@caplFunc:update_GW_387_BCM_RollingCounter_387_counter():*///function
update_GW_387_BCM_RollingCounter_387_counter()
{
    //update the signal value
    Msg_GW_387.BCM_RollingCounter_387=GW_387_BCM_RollingCounter_387_counter;
    
    if(GW_387_BCM_RollingCounter_387_counter == 15)
    {
        GW_387_BCM_RollingCounter_387_counter =0;
    }
    else
    {
        GW_387_BCM_RollingCounter_387_counter =GW_387_BCM_RollingCounter_387_counter+1;
    }    
    
}
/*@@end*/
/*@@caplFunc:update_GW_288_BcmCycCntr288_counter():*///function
update_GW_288_BcmCycCntr288_counter()
{
    //update the signal value
    Msg_GW_288.BcmCycCntr288=GW_288_BcmCycCntr288_counter;
    
    if(GW_288_BcmCycCntr288_counter == 15)
    {
        GW_288_BcmCycCntr288_counter =0;
    }
    else
    {
        GW_288_BcmCycCntr288_counter =GW_288_BcmCycCntr288_counter+1;
    }    
    
}
/*@@end*/
/*@@caplFunc:update_GW_1D2_EspCycCntr1D2_counter():*///function
update_GW_1D2_EspCycCntr1D2_counter()
{
    //update the signal value
    Msg_GW_1D2.EspCycCntr1D2=GW_1D2_EspCycCntr1D2_counter;
    
    if(GW_1D2_EspCycCntr1D2_counter == 15)
    {
        GW_1D2_EspCycCntr1D2_counter =0;
    }
    else
    {
        GW_1D2_EspCycCntr1D2_counter =GW_1D2_EspCycCntr1D2_counter+1;
    }    
    
}
/*@@end*/
/*@@caplFunc:update_GW_2DE_IP_RollingCounter_2DE_counter():*///function
update_GW_2DE_IP_RollingCounter_2DE_counter()
{
    //update the signal value
    Msg_GW_2DE.IP_RollingCounter_2DE=GW_2DE_IP_RollingCounter_2DE_counter;
    
    if(GW_2DE_IP_RollingCounter_2DE_counter == 15)
    {
        GW_2DE_IP_RollingCounter_2DE_counter =0;
    }
    else
    {
        GW_2DE_IP_RollingCounter_2DE_counter =GW_2DE_IP_RollingCounter_2DE_counter+1;
    }    
    
}
/*@@end*/
/*@@caplFunc:update_GW_50_SrsCycCntr050_counter():*///function
update_GW_50_SrsCycCntr050_counter()
{
    //update the signal value
    Msg_GW_50.SrsCycCntr050=GW_50_SrsCycCntr050_counter;
    
    if(GW_50_SrsCycCntr050_counter == 15)
    {
        GW_50_SrsCycCntr050_counter =0;
    }
    else
    {
        GW_50_SrsCycCntr050_counter =GW_50_SrsCycCntr050_counter+1;
    }    
    
}
/*@@end*/
/*@@caplFunc:update_GW_20B_EspCycCntr20B_counter():*///function
update_GW_20B_EspCycCntr20B_counter()
{
    //update the signal value
    Msg_GW_20B.EspCycCntr20B=GW_20B_EspCycCntr20B_counter;
    
    if(GW_20B_EspCycCntr20B_counter == 15)
    {
        GW_20B_EspCycCntr20B_counter =0;
    }
    else
    {
        GW_20B_EspCycCntr20B_counter =GW_20B_EspCycCntr20B_counter+1;
    }    
    
}
/*@@end*/
/*@@caplFunc:update_GW_1C2_EspCycCntr1C2_counter():*///function
update_GW_1C2_EspCycCntr1C2_counter()
{
    //update the signal value
    Msg_GW_1C2.EspCycCntr1C2=GW_1C2_EspCycCntr1C2_counter;
    
    if(GW_1C2_EspCycCntr1C2_counter == 15)
    {
        GW_1C2_EspCycCntr1C2_counter =0;
    }
    else
    {
        GW_1C2_EspCycCntr1C2_counter =GW_1C2_EspCycCntr1C2_counter+1;
    }    
    
}
/*@@end*/
/*@@caplFunc:update_GW_24F_EPS_RollingCounter_24F_counter():*///function
update_GW_24F_EPS_RollingCounter_24F_counter()
{
    //update the signal value
    Msg_GW_24F.EPS_RollingCounter_24F=GW_24F_EPS_RollingCounter_24F_counter;
    
    if(GW_24F_EPS_RollingCounter_24F_counter == 15)
    {
        GW_24F_EPS_RollingCounter_24F_counter =0;
    }
    else
    {
        GW_24F_EPS_RollingCounter_24F_counter =GW_24F_EPS_RollingCounter_24F_counter+1;
    }    
    
}
/*@@end*/
/*@@caplFunc:update_GW_356_IMS_RollingCounter_356_counter():*///function
update_GW_356_IMS_RollingCounter_356_counter()
{
    //update the signal value
    Msg_GW_356.IMS_RollingCounter_356=GW_356_IMS_RollingCounter_356_counter;
    
    if(GW_356_IMS_RollingCounter_356_counter == 15)
    {
        GW_356_IMS_RollingCounter_356_counter =0;
    }
    else
    {
        GW_356_IMS_RollingCounter_356_counter =GW_356_IMS_RollingCounter_356_counter+1;
    }    
    
}
/*@@end*/
/*@@caplFunc:update_GW_356_IMS_RollingCounter_360_counter():*///function
update_GW_356_IMS_RollingCounter_360_counter()
{
    //update the signal value
    Msg_GW_356.IMS_RollingCounter_360=GW_356_IMS_RollingCounter_360_counter;
    
    if(GW_356_IMS_RollingCounter_360_counter == 15)
    {
        GW_356_IMS_RollingCounter_360_counter =0;
    }
    else
    {
        GW_356_IMS_RollingCounter_360_counter =GW_356_IMS_RollingCounter_360_counter+1;
    }    
    
}
/*@@end*/
/*@@caplFunc:update_GW_3C4_HU_RollingCounter_3B8_counter():*///function
update_GW_3C4_HU_RollingCounter_3B8_counter()
{
    //update the signal value
    Msg_GW_3C4.HU_RollingCounter_3B8=GW_3C4_HU_RollingCounter_3B8_counter;
    
    if(GW_3C4_HU_RollingCounter_3B8_counter == 15)
    {
        GW_3C4_HU_RollingCounter_3B8_counter =0;
    }
    else
    {
        GW_3C4_HU_RollingCounter_3B8_counter =GW_3C4_HU_RollingCounter_3B8_counter+1;
    }    
    
}
/*@@end*/
/*@@caplFunc:update_GW_3C4_HU_RollingCounter_3C4_counter():*///function
update_GW_3C4_HU_RollingCounter_3C4_counter()
{
    //update the signal value
    Msg_GW_3C4.HU_RollingCounter_3C4=GW_3C4_HU_RollingCounter_3C4_counter;
    
    if(GW_3C4_HU_RollingCounter_3C4_counter == 15)
    {
        GW_3C4_HU_RollingCounter_3C4_counter =0;
    }
    else
    {
        GW_3C4_HU_RollingCounter_3C4_counter =GW_3C4_HU_RollingCounter_3C4_counter+1;
    }    
    
}
/*@@end*/
/*@@caplFunc:update_GW_3C4_HU_RollingCounter_3C2_counter():*///function
update_GW_3C4_HU_RollingCounter_3C2_counter()
{
    //update the signal value
    Msg_GW_3C4.HU_RollingCounter_3C2=GW_3C4_HU_RollingCounter_3C2_counter;
    
    if(GW_3C4_HU_RollingCounter_3C2_counter == 15)
    {
        GW_3C4_HU_RollingCounter_3C2_counter =0;
    }
    else
    {
        GW_3C4_HU_RollingCounter_3C2_counter =GW_3C4_HU_RollingCounter_3C2_counter+1;
    }    
    
}
/*@@end*/
/*@@caplFunc:update_GW_3C4_HU_RollingCounter_3C6_counter():*///function
update_GW_3C4_HU_RollingCounter_3C6_counter()
{
    //update the signal value
    Msg_GW_3C4.HU_RollingCounter_3C6=GW_3C4_HU_RollingCounter_3C6_counter;
    
    if(GW_3C4_HU_RollingCounter_3C6_counter == 15)
    {
        GW_3C4_HU_RollingCounter_3C6_counter =0;
    }
    else
    {
        GW_3C4_HU_RollingCounter_3C6_counter =GW_3C4_HU_RollingCounter_3C6_counter+1;
    }    
    
}
/*@@end*/
/*@@caplFunc:update_GW_3C4_HU_RollingCounter_3C7_counter():*///function
update_GW_3C4_HU_RollingCounter_3C7_counter()
{
    //update the signal value
    Msg_GW_3C4.HU_RollingCounter_3C7=GW_3C4_HU_RollingCounter_3C7_counter;
    
    if(GW_3C4_HU_RollingCounter_3C7_counter == 15)
    {
        GW_3C4_HU_RollingCounter_3C7_counter =0;
    }
    else
    {
        GW_3C4_HU_RollingCounter_3C7_counter =GW_3C4_HU_RollingCounter_3C7_counter+1;
    }    
    
}
/*@@end*/
/*@@caplFunc:update_GW_3C2_EspCycCntr3C2_counter():*///function
update_GW_3C2_EspCycCntr3C2_counter()
{
    //update the signal value
    Msg_GW_3C2.EspCycCntr3C2=GW_3C2_EspCycCntr3C2_counter;
    
    if(GW_3C2_EspCycCntr3C2_counter == 15)
    {
        GW_3C2_EspCycCntr3C2_counter =0;
    }
    else
    {
        GW_3C2_EspCycCntr3C2_counter =GW_3C2_EspCycCntr3C2_counter+1;
    }    
    
}
/*@@end*/
/*@@caplFunc:update_GW_3AF_HU_RollingCounter_3BB_counter():*///function
update_GW_3AF_HU_RollingCounter_3BB_counter()
{
    //update the signal value
    Msg_GW_3AF.HU_RollingCounter_3BB=GW_3AF_HU_RollingCounter_3BB_counter;
    
    if(GW_3AF_HU_RollingCounter_3BB_counter == 15)
    {
        GW_3AF_HU_RollingCounter_3BB_counter =0;
    }
    else
    {
        GW_3AF_HU_RollingCounter_3BB_counter =GW_3AF_HU_RollingCounter_3BB_counter+1;
    }    
    
}
/*@@end*/
/*@@caplFunc:update_GW_3AF_HU_RollingCounter_3AF_counter():*///function
update_GW_3AF_HU_RollingCounter_3AF_counter()
{
    //update the signal value
    Msg_GW_3AF.HU_RollingCounter_3AF=GW_3AF_HU_RollingCounter_3AF_counter;
    
    if(GW_3AF_HU_RollingCounter_3AF_counter == 15)
    {
        GW_3AF_HU_RollingCounter_3AF_counter =0;
    }
    else
    {
        GW_3AF_HU_RollingCounter_3AF_counter =GW_3AF_HU_RollingCounter_3AF_counter+1;
    }    
    
}
/*@@end*/
/*@@caplFunc:update_GW_170_EPS_RollingCounter_170_counter():*///function
update_GW_170_EPS_RollingCounter_170_counter()
{
    //update the signal value
    Msg_GW_170.EPS_RollingCounter_170=GW_170_EPS_RollingCounter_170_counter;
    
    if(GW_170_EPS_RollingCounter_170_counter == 15)
    {
        GW_170_EPS_RollingCounter_170_counter =0;
    }
    else
    {
        GW_170_EPS_RollingCounter_170_counter =GW_170_EPS_RollingCounter_170_counter+1;
    }    
    
}
/*@@end*/
/*@@caplFunc:update_GW_2C8_RRC_RollingCounter_2C8_counter():*///function
update_GW_2C8_RRC_RollingCounter_2C8_counter()
{
    //update the signal value
    Msg_GW_2C8.RRC_RollingCounter_2C8=GW_2C8_RRC_RollingCounter_2C8_counter;
    
    if(GW_2C8_RRC_RollingCounter_2C8_counter == 15)
    {
        GW_2C8_RRC_RollingCounter_2C8_counter =0;
    }
    else
    {
        GW_2C8_RRC_RollingCounter_2C8_counter =GW_2C8_RRC_RollingCounter_2C8_counter+1;
    }    
    
}
/*@@end*/
/*@@caplFunc:update_GW_17E_EPS_RollingCounter_17E_counter():*///function
update_GW_17E_EPS_RollingCounter_17E_counter()
{
    //update the signal value
    Msg_GW_17E.EPS_RollingCounter_17E=GW_17E_EPS_RollingCounter_17E_counter;
    
    if(GW_17E_EPS_RollingCounter_17E_counter == 15)
    {
        GW_17E_EPS_RollingCounter_17E_counter =0;
    }
    else
    {
        GW_17E_EPS_RollingCounter_17E_counter =GW_17E_EPS_RollingCounter_17E_counter+1;
    }    
    
}
/*@@end*/
/*@@caplFunc:update_GW_2C2_IbCycCntr2C2_counter():*///function
update_GW_2C2_IbCycCntr2C2_counter()
{
    //update the signal value
    Msg_GW_2C2.IbCycCntr2C2=GW_2C2_IbCycCntr2C2_counter;
    
    if(GW_2C2_IbCycCntr2C2_counter == 15)
    {
        GW_2C2_IbCycCntr2C2_counter =0;
    }
    else
    {
        GW_2C2_IbCycCntr2C2_counter =GW_2C2_IbCycCntr2C2_counter+1;
    }    
    
}
/*@@end*/
/*@@caplFunc:update_GW_2A4_LCDAR_RollingCounter_2AF_counter():*///function
update_GW_2A4_LCDAR_RollingCounter_2AF_counter()
{
    //update the signal value
    Msg_GW_2A4.LCDAR_RollingCounter_2AF=GW_2A4_LCDAR_RollingCounter_2AF_counter;
    
    if(GW_2A4_LCDAR_RollingCounter_2AF_counter == 15)
    {
        GW_2A4_LCDAR_RollingCounter_2AF_counter =0;
    }
    else
    {
        GW_2A4_LCDAR_RollingCounter_2AF_counter =GW_2A4_LCDAR_RollingCounter_2AF_counter+1;
    }    
    
}
/*@@end*/
/*@@caplFunc:update_GW_2A4_RRC_RollingCounter_2A4_counter():*///function
update_GW_2A4_RRC_RollingCounter_2A4_counter()
{
    //update the signal value
    Msg_GW_2A4.RRC_RollingCounter_2A4=GW_2A4_RRC_RollingCounter_2A4_counter;
    
    if(GW_2A4_RRC_RollingCounter_2A4_counter == 15)
    {
        GW_2A4_RRC_RollingCounter_2A4_counter =0;
    }
    else
    {
        GW_2A4_RRC_RollingCounter_2A4_counter =GW_2A4_RRC_RollingCounter_2A4_counter+1;
    }    
    
}
/*@@end*/
/*@@caplFunc:update_GW_2D2_CdcCycCntr2D2_counter():*///function
update_GW_2D2_CdcCycCntr2D2_counter()
{
    //update the signal value
    Msg_GW_2D2.CdcCycCntr2D2=GW_2D2_CdcCycCntr2D2_counter;
    
    if(GW_2D2_CdcCycCntr2D2_counter == 15)
    {
        GW_2D2_CdcCycCntr2D2_counter =0;
    }
    else
    {
        GW_2D2_CdcCycCntr2D2_counter =GW_2D2_CdcCycCntr2D2_counter+1;
    }    
    
}
/*@@end*/
/*@@caplFunc:update_GW_3D2_EspCycCntr3D2_counter():*///function
update_GW_3D2_EspCycCntr3D2_counter()
{
    //update the signal value
    Msg_GW_3D2.EspCycCntr3D2=GW_3D2_EspCycCntr3D2_counter;
    
    if(GW_3D2_EspCycCntr3D2_counter == 15)
    {
        GW_3D2_EspCycCntr3D2_counter =0;
    }
    else
    {
        GW_3D2_EspCycCntr3D2_counter =GW_3D2_EspCycCntr3D2_counter+1;
    }    
    
}
/*@@end*/
/*@@caplFunc:update_GW_180_EpsCycCntr180_counter():*///function
update_GW_180_EpsCycCntr180_counter()
{
    //update the signal value
    Msg_GW_180.EpsCycCntr180=GW_180_EpsCycCntr180_counter;
    
    if(GW_180_EpsCycCntr180_counter == 15)
    {
        GW_180_EpsCycCntr180_counter =0;
    }
    else
    {
        GW_180_EpsCycCntr180_counter =GW_180_EpsCycCntr180_counter+1;
    }    
    
}
/*@@end*/
/*@@caplFunc:update_GW_2BD_RRC_RollingCounter_2BD_counter():*///function
update_GW_2BD_RRC_RollingCounter_2BD_counter()
{
    //update the signal value
    Msg_GW_2BD.RRC_RollingCounter_2BD=GW_2BD_RRC_RollingCounter_2BD_counter;
    
    if(GW_2BD_RRC_RollingCounter_2BD_counter == 15)
    {
        GW_2BD_RRC_RollingCounter_2BD_counter =0;
    }
    else
    {
        GW_2BD_RRC_RollingCounter_2BD_counter =GW_2BD_RRC_RollingCounter_2BD_counter+1;
    }    
    
}
/*@@end*/
/*@@caplFunc:update_GW_2BF_RRC_RollingCounter_2BF_counter():*///function
update_GW_2BF_RRC_RollingCounter_2BF_counter()
{
    //update the signal value
    Msg_GW_2BF.RRC_RollingCounter_2BF=GW_2BF_RRC_RollingCounter_2BF_counter;
    
    if(GW_2BF_RRC_RollingCounter_2BF_counter == 15)
    {
        GW_2BF_RRC_RollingCounter_2BF_counter =0;
    }
    else
    {
        GW_2BF_RRC_RollingCounter_2BF_counter =GW_2BF_RRC_RollingCounter_2BF_counter+1;
    }    
    
}
/*@@end*/
/*@@caplFunc:update_GW_28B_BCM_RollingCounter_28B_counter():*///function
update_GW_28B_BCM_RollingCounter_28B_counter()
{
    //update the signal value
    Msg_GW_28B.BCM_RollingCounter_28B=GW_28B_BCM_RollingCounter_28B_counter;
    
    if(GW_28B_BCM_RollingCounter_28B_counter == 15)
    {
        GW_28B_BCM_RollingCounter_28B_counter =0;
    }
    else
    {
        GW_28B_BCM_RollingCounter_28B_counter =GW_28B_BCM_RollingCounter_28B_counter+1;
    }    
    
}
/*@@end*/


update_GW_387_CRC_CheckSum()
{
  int l_Crc_Len=0,l_count=0;
  int l_data[8];
 
  l_Crc_Len = 8-1;
  for (l_count=0;l_count<l_Crc_Len;l_count++)
    {
      l_data[l_count] = Msg_GW_387.BYTE(l_count);    
    }
       
	Msg_GW_387.BYTE(l_Crc_Len) = calc_SAE_J1850(l_data,l_Crc_Len); 

	
	if(GW_387_BCM_CRCCheck_387_wrongvalctr != 0)
    {
		Msg_GW_387.BCM_CRCCheck_387+=1; 
        //update signal with wrong CRC value
		if(GW_387_BCM_CRCCheck_387_wrongvalctr > 0)
        {
             GW_387_BCM_CRCCheck_387_wrongvalctr--;
              // if counter becomes zero, update panel controller to zero
             if(GW_387_BCM_CRCCheck_387_wrongvalctr == 0)
             {
                 putValue(E_pubc_GW_GW_387_BCM_CRCCheck_387_wrongvalctr,0);
             }
        }
	}
}
update_GW_288_CRC_CheckSum()
{
  int l_Crc_Len=0,l_count=0;
  int l_data[8];
 
  l_Crc_Len = 8-1;
  for (l_count=0;l_count<l_Crc_Len;l_count++)
    {
      l_data[l_count] = Msg_GW_288.BYTE(l_count);    
    }
       
	Msg_GW_288.BYTE(l_Crc_Len) = calc_SAE_J1850(l_data,l_Crc_Len); 

	
	if(GW_288_BcmCrcChk288_wrongvalctr != 0)
    {
		Msg_GW_288.BcmCrcChk288+=1; 
        //update signal with wrong CRC value
		if(GW_288_BcmCrcChk288_wrongvalctr > 0)
        {
             GW_288_BcmCrcChk288_wrongvalctr--;
              // if counter becomes zero, update panel controller to zero
             if(GW_288_BcmCrcChk288_wrongvalctr == 0)
             {
                 putValue(E_pubc_GW_GW_288_BcmCrcChk288_wrongvalctr,0);
             }
        }
	}
}
update_GW_1D2_CRC_CheckSum()
{
  int l_Crc_Len=0,l_count=0;
  int l_data[64];
 
  l_Crc_Len = 64-2;
  for (l_count=0;l_count<l_Crc_Len;l_count++)
    {
      l_data[l_count] = Msg_GW_1D2.BYTE(l_count);    
	  
    }
     
	Msg_GW_1D2.EspCrcChk1D2 = calc_CRC16_CCITT_FALSE_H1021(l_data,62);
	
	if(GW_1D2_EspCrcChk1D2_wrongvalctr != 0)
    {
		Msg_GW_1D2.EspCrcChk1D2+=1; 
        //update signal with wrong CRC value
		if(GW_1D2_EspCrcChk1D2_wrongvalctr > 0)
        {
             GW_1D2_EspCrcChk1D2_wrongvalctr--;
              // if counter becomes zero, update panel controller to zero
             if(GW_1D2_EspCrcChk1D2_wrongvalctr == 0)
             {
                 putValue(E_pubc_GW_GW_1D2_EspCrcChk1D2_wrongvalctr,0);
             }
        }
	}
}
update_GW_2DE_CRC_CheckSum()
{
  int l_Crc_Len=0,l_count=0;
  int l_data[8];
 
  l_Crc_Len = 8-1;
  for (l_count=0;l_count<l_Crc_Len;l_count++)
    {
      l_data[l_count] = Msg_GW_2DE.BYTE(l_count);    
    }
       
	Msg_GW_2DE.BYTE(l_Crc_Len) = calc_SAE_J1850(l_data,l_Crc_Len); 

	
	if(GW_2DE_IP_CRCCheck_2DE_wrongvalctr != 0)
    {
		Msg_GW_2DE.IP_CRCCheck_2DE+=1; 
        //update signal with wrong CRC value
		if(GW_2DE_IP_CRCCheck_2DE_wrongvalctr > 0)
        {
             GW_2DE_IP_CRCCheck_2DE_wrongvalctr--;
              // if counter becomes zero, update panel controller to zero
             if(GW_2DE_IP_CRCCheck_2DE_wrongvalctr == 0)
             {
                 putValue(E_pubc_GW_GW_2DE_IP_CRCCheck_2DE_wrongvalctr,0);
             }
        }
	}
}

update_GW_50_CRC_CheckSum()
{
  int l_Crc_Len=0,l_count=0;
  int l_data[8];
 
  l_Crc_Len = 8-1;
  for (l_count=0;l_count<l_Crc_Len;l_count++)
    {
      l_data[l_count] = Msg_GW_50.BYTE(l_count);    
    }
       
	Msg_GW_50.BYTE(l_Crc_Len) = calc_SAE_J1850(l_data,l_Crc_Len); 

	
	if(GW_50_SrsCrcChk050_wrongvalctr != 0)
    {
		Msg_GW_50.SrsCrcChk050+=1; 
        //update signal with wrong CRC value
		if(GW_50_SrsCrcChk050_wrongvalctr > 0)
        {
             GW_50_SrsCrcChk050_wrongvalctr--;
              // if counter becomes zero, update panel controller to zero
             if(GW_50_SrsCrcChk050_wrongvalctr == 0)
             {
                 putValue(E_pubc_GW_GW_50_SrsCrcChk050_wrongvalctr,0);
             }
        }
	}
}
update_GW_20B_CRC_CheckSum()
{
  int l_Crc_Len=0,l_count=0;
  int l_data[48];
 
  l_Crc_Len = 48-2;
  for (l_count=0;l_count<l_Crc_Len;l_count++)
    {
      l_data[l_count] = Msg_GW_20B.BYTE(l_count);    
	  
    }

	Msg_GW_20B.EspCrcChk20B = calc_CRC16_CCITT_FALSE_H1021(l_data,46);

	if(GW_20B_EspCrcChk20B_wrongvalctr != 0)
    {
		Msg_GW_20B.EspCrcChk20B+=1; 
        //update signal with wrong CRC value
		if(GW_20B_EspCrcChk20B_wrongvalctr > 0)
        {
             GW_20B_EspCrcChk20B_wrongvalctr--;
              // if counter becomes zero, update panel controller to zero
             if(GW_20B_EspCrcChk20B_wrongvalctr == 0)
             {
                 putValue(E_pubc_GW_GW_20B_EspCrcChk20B_wrongvalctr,0);
             }
        }
	}
}
update_GW_1C2_CRC_CheckSum()
{
  int l_Crc_Len=0,l_count=0;
  int l_data[64];
 
  l_Crc_Len = 64-2;
  for (l_count=0;l_count<l_Crc_Len;l_count++)
    {
      l_data[l_count] = Msg_GW_1C2.BYTE(l_count);    
	  
    }
       
	Msg_GW_1C2.EspCrcChk1C2 = calc_CRC16_CCITT_FALSE_H1021(l_data,62);
	
	if(GW_1C2_EspCrcChk1C2_wrongvalctr != 0)
    {
		Msg_GW_1C2.EspCrcChk1C2+=1; 
        //update signal with wrong CRC value
		if(GW_1C2_EspCrcChk1C2_wrongvalctr > 0)
        {
             GW_1C2_EspCrcChk1C2_wrongvalctr--;
              // if counter becomes zero, update panel controller to zero
             if(GW_1C2_EspCrcChk1C2_wrongvalctr == 0)
             {
                 putValue(E_pubc_GW_GW_1C2_EspCrcChk1C2_wrongvalctr,0);
             }
        }
	}
}
update_GW_24F_CRC_CheckSum()
{
  int l_Crc_Len=0,l_count=0;
  int l_data[8];
 
  l_Crc_Len = 8-1;
  for (l_count=0;l_count<l_Crc_Len;l_count++)
    {
      l_data[l_count] = Msg_GW_24F.BYTE(l_count);    
    }
       
	Msg_GW_24F.BYTE(l_Crc_Len) = calc_SAE_J1850(l_data,l_Crc_Len); 

	
	if(GW_24F_EPS_CRCCheck_24F_wrongvalctr != 0)
    {
		Msg_GW_24F.EPS_CRCCheck_24F+=1; 
        //update signal with wrong CRC value
		if(GW_24F_EPS_CRCCheck_24F_wrongvalctr > 0)
        {
             GW_24F_EPS_CRCCheck_24F_wrongvalctr--;
              // if counter becomes zero, update panel controller to zero
             if(GW_24F_EPS_CRCCheck_24F_wrongvalctr == 0)
             {
                 putValue(E_pubc_GW_GW_24F_EPS_CRCCheck_24F_wrongvalctr,0);
             }
        }
	}
}

update_GW_356_CRC_CheckSum()
{
  int l_Crc_Len1=0,l_Crc_Len2=0,l_count=0;
  int l_count_356=0,l_count_360 =0;
  int l_data_356[8];
  int l_data_360[8];

 
  l_Crc_Len1 = 7;
  l_Crc_Len2 = 15;

  //IMS_CRCCheck_356
  for (l_count=0;l_count<l_Crc_Len1;l_count++)
    {
      l_data_356[l_count_356] = Msg_GW_356.BYTE(l_count);
      l_count_356++ ;
    }
    l_count_356 =0;
       
	Msg_GW_356.BYTE(l_Crc_Len1) = calc_SAE_J1850(l_data_356,7); 

	
	if(GW_356_IMS_CRCCheck_356_wrongvalctr != 0)
    {
		Msg_GW_356.IMS_CRCCheck_356+=1; 
        //update signal with wrong CRC value
		if(GW_356_IMS_CRCCheck_356_wrongvalctr > 0)
        {
             GW_356_IMS_CRCCheck_356_wrongvalctr--;
              // if counter becomes zero, update panel controller to zero
             if(GW_356_IMS_CRCCheck_356_wrongvalctr == 0)
             {
                 putValue(E_pubc_GW_GW_356_IMS_CRCCheck_356_wrongvalctr,0);
             }
        }
	}
	
	// IMS_CRCCheck_360
	for (l_count=8;l_count<l_Crc_Len2;l_count++)
    {
      l_data_360[l_count_360] = Msg_GW_356.BYTE(l_count);
      l_count_360++;  
    }
     l_count_360 = 0;  
	Msg_GW_356.BYTE(l_Crc_Len2) = calc_SAE_J1850(l_data_360,7); 

	
	if(GW_356_IMS_CRCCheck_360_wrongvalctr != 0)
    {
		Msg_GW_356.IMS_CRCCheck_360+=1; 
        //update signal with wrong CRC value
		if(GW_356_IMS_CRCCheck_360_wrongvalctr > 0)
        {
             GW_356_IMS_CRCCheck_360_wrongvalctr--;
              // if counter becomes zero, update panel controller to zero
             if(GW_356_IMS_CRCCheck_360_wrongvalctr == 0)
             {
                 putValue(E_pubc_GW_GW_356_IMS_CRCCheck_360_wrongvalctr,0);
             }
        }
	}
}

update_GW_3C4_CRC_CheckSum()
{
  int l_Crc_Len1=0,l_Crc_Len2=0,l_Crc_Len3=0,l_Crc_Len4=0,l_Crc_Len5=0,l_count=0;
  int l_count_3B8=0,l_count_3C2 =0,l_count_3C4=0,l_count_3C6 =0,l_count_3C7 =0;
  int l_data_3B8[8];
  int l_data_3C2[8];
  int l_data_3C4[8];
  int l_data_3C6[8];
  int l_data_3C7[8];
 
  l_Crc_Len1 = 7;
  l_Crc_Len2 = 15;
  l_Crc_Len3 = 23;
  l_Crc_Len4 = 31;
  l_Crc_Len5 = 39;
  //HU_CRCCheck_3B8
  for (l_count=0;l_count<l_Crc_Len1;l_count++)
    {
      l_data_3B8[l_count_3B8] = Msg_GW_3C4.BYTE(l_count);
      l_count_3B8++ ;
    }
    l_count_3B8 =0;
       
	Msg_GW_3C4.BYTE(l_Crc_Len1) = calc_SAE_J1850(l_data_3B8,7); 

	
	if(GW_3C4_HU_CRCCheck_3B8_wrongvalctr != 0)
    {
		Msg_GW_3C4.HU_CRCCheck_3B8+=1; 
        //update signal with wrong CRC value
		if(GW_3C4_HU_CRCCheck_3B8_wrongvalctr > 0)
        {
             GW_3C4_HU_CRCCheck_3B8_wrongvalctr--;
              // if counter becomes zero, update panel controller to zero
             if(GW_3C4_HU_CRCCheck_3B8_wrongvalctr == 0)
             {
                 putValue(E_pubc_GW_GW_3C4_HU_CRCCheck_3B8_wrongvalctr,0);
             }
        }
	}
	
	// HU_CRCCheck_3C2
	for (l_count=8;l_count<l_Crc_Len2;l_count++)
    {
      l_data_3C2[l_count_3C2] = Msg_GW_3C4.BYTE(l_count);
      l_count_3C2++;  
    }
     l_count_3C2 = 0;  
	Msg_GW_3C4.BYTE(l_Crc_Len2) = calc_SAE_J1850(l_data_3C2,7); 

	
	if(GW_3C4_HU_CRCCheck_3C2_wrongvalctr != 0)
    {
		Msg_GW_3C4.HU_CRCCheck_3C2+=1; 
        //update signal with wrong CRC value
		if(GW_3C4_HU_CRCCheck_3C2_wrongvalctr > 0)
        {
             GW_3C4_HU_CRCCheck_3C2_wrongvalctr--;
              // if counter becomes zero, update panel controller to zero
             if(GW_3C4_HU_CRCCheck_3C2_wrongvalctr == 0)
             {
                 putValue(E_pubc_GW_GW_3C4_HU_CRCCheck_3C2_wrongvalctr,0);
             }
        }
	}
	
	// HU_CRCCheck_3C4
	for (l_count=16;l_count<l_Crc_Len3;l_count++)
    {
      l_data_3C4[l_count_3C4] = Msg_GW_3C4.BYTE(l_count); 
    l_count_3C4++;  
    }
       l_count_3C4 =0;
	Msg_GW_3C4.BYTE(l_Crc_Len3) = calc_SAE_J1850(l_data_3C4,7); 

	
	if(GW_3C4_HU_CRCCheck_3C4_wrongvalctr != 0)
    {
		Msg_GW_3C4.HU_CRCCheck_3C4+=1; 
        //update signal with wrong CRC value
		if(GW_3C4_HU_CRCCheck_3C4_wrongvalctr > 0)
        {
             GW_3C4_HU_CRCCheck_3C4_wrongvalctr--;
              // if counter becomes zero, update panel controller to zero
             if(GW_3C4_HU_CRCCheck_3C4_wrongvalctr == 0)
             {
                 putValue(E_pubc_GW_GW_3C4_HU_CRCCheck_3C4_wrongvalctr,0);
             }
        }
	}
	
	// HU_CRCCheck_3C6
	for (l_count=24;l_count<l_Crc_Len4;l_count++)
    {
      l_data_3C6[l_count_3C6] = Msg_GW_3C4.BYTE(l_count);
      l_count_3C6++;  
    }
       l_count_3C6 = 0;
	Msg_GW_3C4.BYTE(l_Crc_Len4) = calc_SAE_J1850(l_data_3C6,7); 

	
	if(GW_3C4_HU_CRCCheck_3C6_wrongvalctr != 0)
    {
		Msg_GW_3C4.HU_CRCCheck_3C6+=1; 
        //update signal with wrong CRC value
		if(GW_3C4_HU_CRCCheck_3C6_wrongvalctr > 0)
        {
             GW_3C4_HU_CRCCheck_3C6_wrongvalctr--;
              // if counter becomes zero, update panel controller to zero
             if(GW_3C4_HU_CRCCheck_3C6_wrongvalctr == 0)
             {
                 putValue(E_pubc_GW_GW_3C4_HU_CRCCheck_3C6_wrongvalctr,0);
             }
        }
	}
	
	// HU_CRCCheck_3C7
	for (l_count=32;l_count<l_Crc_Len5;l_count++)
    {
      l_data_3C7[l_count_3C7] = Msg_GW_3C4.BYTE(l_count);
      l_count_3C7++;  
    }
       l_count_3C7 = 0;
	Msg_GW_3C4.BYTE(l_Crc_Len5) = calc_SAE_J1850(l_data_3C7,7); 

	
	if(GW_3C4_HU_CRCCheck_3C7_wrongvalctr != 0)
    {
		Msg_GW_3C4.HU_CRCCheck_3C7+=1; 
        //update signal with wrong CRC value
		if(GW_3C4_HU_CRCCheck_3C7_wrongvalctr > 0)
        {
             GW_3C4_HU_CRCCheck_3C7_wrongvalctr--;
              // if counter becomes zero, update panel controller to zero
             if(GW_3C4_HU_CRCCheck_3C7_wrongvalctr == 0)
             {
                 putValue(E_pubc_GW_GW_3C4_HU_CRCCheck_3C7_wrongvalctr,0);
             }
        }
	}
}

update_GW_3C2_CRC_CheckSum()
{
  int l_Crc_Len=0,l_count=0;
  int l_data[64];
 
  l_Crc_Len = 64-2;
  for (l_count=0;l_count<l_Crc_Len;l_count++)
    {
      l_data[l_count] = Msg_GW_3C2.BYTE(l_count);    
	  
    }
    
	Msg_GW_3C2.EspCrcChk3C2 = calc_CRC16_CCITT_FALSE_H1021(l_data,62);
	
	if(GW_3C2_EspCrcChk3C2_wrongvalctr != 0)
    {
		Msg_GW_3C2.EspCrcChk3C2+=1; 
        //update signal with wrong CRC value
		if(GW_3C2_EspCrcChk3C2_wrongvalctr > 0)
        {
             GW_3C2_EspCrcChk3C2_wrongvalctr--;
              // if counter becomes zero, update panel controller to zero
             if(GW_3C2_EspCrcChk3C2_wrongvalctr == 0)
             {
                 putValue(E_pubc_GW_GW_3C2_EspCrcChk3C2_wrongvalctr,0);
             }
        }
	}
}

update_GW_3AF_CRC_CheckSum()
{
  int l_Crc_Len1=0,l_Crc_Len2=0,l_count=0;
  int l_count_3AF=0,l_count_3BB =0;
  int l_data_3AF[8];
  int l_data_3BB[8];

 
  l_Crc_Len1 = 31;
  l_Crc_Len2 = 39;

  //HU_CRCCheck_3AF
  for (l_count=24;l_count<l_Crc_Len1;l_count++)
    {
      l_data_3AF[l_count_3AF] = Msg_GW_3AF.BYTE(l_count);
      l_count_3AF++ ;
    }
    l_count_3AF =0;
       
	Msg_GW_3AF.BYTE(l_Crc_Len1) = calc_SAE_J1850(l_data_3AF,7); 

	
	if(GW_3AF_HU_CRCCheck_3AF_wrongvalctr != 0)
    {
		Msg_GW_3AF.HU_CRCCheck_3AF+=1; 
        //update signal with wrong CRC value
		if(GW_3AF_HU_CRCCheck_3AF_wrongvalctr > 0)
        {
             GW_3AF_HU_CRCCheck_3AF_wrongvalctr--;
              // if counter becomes zero, update panel controller to zero
             if(GW_3AF_HU_CRCCheck_3AF_wrongvalctr == 0)
             {
                 putValue(E_pubc_GW_GW_3AF_HU_CRCCheck_3AF_wrongvalctr,0);
             }
        }
	}
	
	// HU_CRCCheck_3BB
	for (l_count=32;l_count<l_Crc_Len2;l_count++)
    {
      l_data_3BB[l_count_3BB] = Msg_GW_3AF.BYTE(l_count);
      l_count_3BB++;  
    }
     l_count_3BB = 0;  
	Msg_GW_3AF.BYTE(l_Crc_Len2) = calc_SAE_J1850(l_data_3BB,7); 

	
	if(GW_3AF_HU_CRCCheck_3BB_wrongvalctr != 0)
    {
		Msg_GW_3AF.HU_CRCCheck_3BB+=1; 
        //update signal with wrong CRC value
		if(GW_3AF_HU_CRCCheck_3BB_wrongvalctr > 0)
        {
             GW_3AF_HU_CRCCheck_3BB_wrongvalctr--;
              // if counter becomes zero, update panel controller to zero
             if(GW_3AF_HU_CRCCheck_3BB_wrongvalctr == 0)
             {
                 putValue(E_pubc_GW_GW_3AF_HU_CRCCheck_3BB_wrongvalctr,0);
             }
        }
	}
}

update_GW_170_CRC_CheckSum()
{
  int l_Crc_Len=0,l_count=0;
  int l_data[8];
 
  l_Crc_Len = 8-1;
  for (l_count=0;l_count<l_Crc_Len;l_count++)
    {
      l_data[l_count] = Msg_GW_170.BYTE(l_count);    
    }
       
	Msg_GW_170.BYTE(l_Crc_Len) = calc_SAE_J1850(l_data,l_Crc_Len); 

	
	if(GW_170_EPS_CRCCheck_170_wrongvalctr != 0)
    {
		Msg_GW_170.EPS_CRCCheck_170+=1; 
        //update signal with wrong CRC value
		if(GW_170_EPS_CRCCheck_170_wrongvalctr > 0)
        {
             GW_170_EPS_CRCCheck_170_wrongvalctr--;
              // if counter becomes zero, update panel controller to zero
             if(GW_170_EPS_CRCCheck_170_wrongvalctr == 0)
             {
                 putValue(E_pubc_GW_GW_170_EPS_CRCCheck_170_wrongvalctr,0);
             }
        }
	}
}
update_GW_2C8_CRC_CheckSum()
{
  int l_Crc_Len=0,l_count=0;
  int l_data[64];
 
  l_Crc_Len = 64-2;
  for (l_count=0;l_count<l_Crc_Len;l_count++)
    {
      l_data[l_count] = Msg_GW_2C8.BYTE(l_count);    
	  
    }
    
	Msg_GW_2C8.RRC_CRCCheck_2C8 = calc_CRC16_CCITT_FALSE_H1021(l_data,62);
	
	if(GW_2C8_RRC_CRCCheck_2C8_wrongvalctr != 0)
    {
		Msg_GW_2C8.RRC_CRCCheck_2C8+=1; 
        //update signal with wrong CRC value
		if(GW_2C8_RRC_CRCCheck_2C8_wrongvalctr > 0)
        {
             GW_2C8_RRC_CRCCheck_2C8_wrongvalctr--;
              // if counter becomes zero, update panel controller to zero
             if(GW_2C8_RRC_CRCCheck_2C8_wrongvalctr == 0)
             {
                 putValue(E_pubc_GW_GW_2C8_RRC_CRCCheck_2C8_wrongvalctr,0);
             }
        }
	}
}
update_GW_17E_CRC_CheckSum()
{
  int l_Crc_Len=0,l_count=0;
  int l_data[8];
 
  l_Crc_Len = 8-1;
  for (l_count=0;l_count<l_Crc_Len;l_count++)
    {
      l_data[l_count] = Msg_GW_17E.BYTE(l_count);    
    }
       
	Msg_GW_17E.BYTE(l_Crc_Len) = calc_SAE_J1850(l_data,l_Crc_Len); 

	
	if(GW_17E_EPS_CRCCheck_17E_wrongvalctr != 0)
    {
		Msg_GW_17E.EPS_CRCCheck_17E+=1; 
        //update signal with wrong CRC value
		if(GW_17E_EPS_CRCCheck_17E_wrongvalctr > 0)
        {
             GW_17E_EPS_CRCCheck_17E_wrongvalctr--;
              // if counter becomes zero, update panel controller to zero
             if(GW_17E_EPS_CRCCheck_17E_wrongvalctr == 0)
             {
                 putValue(E_pubc_GW_GW_17E_EPS_CRCCheck_17E_wrongvalctr,0);
             }
        }
	}
}
update_GW_2C2_CRC_CheckSum()
{
  int l_Crc_Len=0,l_count=0;
  int l_data[64];
 
  l_Crc_Len = 64-2;
  for (l_count=0;l_count<l_Crc_Len;l_count++)
    {
      l_data[l_count] = Msg_GW_2C2.BYTE(l_count);    
	  
    }
    
	Msg_GW_2C2.IbCrcChk2C2 = calc_CRC16_CCITT_FALSE_H1021(l_data,62);
	
	if(GW_2C2_IbCrcChk2C2_wrongvalctr != 0)
    {
		Msg_GW_2C2.IbCrcChk2C2+=1; 
        //update signal with wrong CRC value
		if(GW_2C2_IbCrcChk2C2_wrongvalctr > 0)
        {
             GW_2C2_IbCrcChk2C2_wrongvalctr--;
              // if counter becomes zero, update panel controller to zero
             if(GW_2C2_IbCrcChk2C2_wrongvalctr == 0)
             {
                 putValue(E_pubc_GW_GW_2C2_IbCrcChk2C2_wrongvalctr,0);
             }
        }
	}
}
update_GW_2A4_CRC_CheckSum()
{
  int l_Crc_Len1=0,l_Crc_Len2=0,l_count=0;
  int l_count_2AF=0,l_count_2A4=0;
  int l_data_2AF[8];
  int l_data_2A4[64];

 
  l_Crc_Len1 = 7;
  l_Crc_Len2 = 64-2;

  //LCDAR_CRCCheck_2AF
  for (l_count=0;l_count<l_Crc_Len1;l_count++)
    {
      l_data_2AF[l_count_2AF] = Msg_GW_2A4.BYTE(l_count);
      l_count_2AF++ ;
    }
    l_count_2AF =0;
       
	Msg_GW_2A4.BYTE(l_Crc_Len1) = calc_SAE_J1850(l_data_2AF,7); 

	
	if(GW_2A4_LCDAR_CRCCheck_2AF_wrongvalctr != 0)
    {
		Msg_GW_2A4.LCDAR_CRCCheck_2AF+=1; 
        //update signal with wrong CRC value
		if(GW_2A4_LCDAR_CRCCheck_2AF_wrongvalctr > 0)
        {
             GW_2A4_LCDAR_CRCCheck_2AF_wrongvalctr--;
              // if counter becomes zero, update panel controller to zero
             if(GW_2A4_LCDAR_CRCCheck_2AF_wrongvalctr == 0)
             {
                 putValue(E_pubc_GW_GW_2A4_LCDAR_CRCCheck_2AF_wrongvalctr,0);
             }
        }
	}
	
	// RRC_CRCCheck_2A4 (16)
  for (l_count=0;l_count<l_Crc_Len2;l_count++)
    {
      l_data_2A4[l_count_2A4] = Msg_GW_2A4.BYTE(l_count);
      l_count_2A4++ ; 
    }
    l_count_2A4 =0;
       
	Msg_GW_2A4.RRC_CRCCheck_2A4 = calc_CRC16_CCITT_FALSE_H1021(l_data_2A4,62);
	
	if(GW_2A4_RRC_CRCCheck_2A4_wrongvalctr != 0)
    {
		Msg_GW_2A4.RRC_CRCCheck_2A4+=1; 
        //update signal with wrong CRC value
		if(GW_2A4_RRC_CRCCheck_2A4_wrongvalctr > 0)
        {
             GW_2A4_RRC_CRCCheck_2A4_wrongvalctr--;
              // if counter becomes zero, update panel controller to zero
             if(GW_2A4_RRC_CRCCheck_2A4_wrongvalctr == 0)
             {
                 putValue(E_pubc_GW_GW_2A4_RRC_CRCCheck_2A4_wrongvalctr,0);
             }
        }
	}
}
update_GW_3D2_CRC_CheckSum()
{
  int l_Crc_Len=0,l_count=0;
  int l_data[64];
 
  l_Crc_Len = 64-2;
  for (l_count=0;l_count<l_Crc_Len;l_count++)
    {
      l_data[l_count] = Msg_GW_3D2.BYTE(l_count);    
	  
    }
    
	Msg_GW_3D2.EspCrcChk3D2 = calc_CRC16_CCITT_FALSE_H1021(l_data,62);
	
	if(GW_3D2_EspCrcChk3D2_wrongvalctr != 0)
    {
		Msg_GW_3D2.EspCrcChk3D2+=1; 
        //update signal with wrong CRC value
		if(GW_3D2_EspCrcChk3D2_wrongvalctr > 0)
        {
             GW_3D2_EspCrcChk3D2_wrongvalctr--;
              // if counter becomes zero, update panel controller to zero
             if(GW_3D2_EspCrcChk3D2_wrongvalctr == 0)
             {
                 putValue(E_pubc_GW_GW_3D2_EspCrcChk3D2_wrongvalctr,0);
             }
        }
	}
}
update_GW_180_CRC_CheckSum()
{
  int l_Crc_Len=0,l_count=0;
  int l_data[8];
 
  l_Crc_Len = 8-1;
  for (l_count=0;l_count<l_Crc_Len;l_count++)
    {
      l_data[l_count] = Msg_GW_180.BYTE(l_count);    
    }
       
	Msg_GW_180.BYTE(l_Crc_Len) = calc_SAE_J1850(l_data,l_Crc_Len); 

	
	if(GW_180_EpsCrcChk180_wrongvalctr != 0)
    {
		Msg_GW_180.EpsCrcChk180+=1; 
        //update signal with wrong CRC value
		if(GW_180_EpsCrcChk180_wrongvalctr > 0)
        {
             GW_180_EpsCrcChk180_wrongvalctr--;
              // if counter becomes zero, update panel controller to zero
             if(GW_180_EpsCrcChk180_wrongvalctr == 0)
             {
                 putValue(E_pubc_GW_GW_180_EpsCrcChk180_wrongvalctr,0);
             }
        }
	}
}
update_GW_2BD_CRC_CheckSum()
{
  int l_Crc_Len=0,l_count=0;
  int l_data[64];
 
  l_Crc_Len = 64-2;
  for (l_count=0;l_count<l_Crc_Len;l_count++)
    {
      l_data[l_count] = Msg_GW_2BD.BYTE(l_count);    
	  
    }
    
	Msg_GW_2BD.RRC_CRCCheck_2BD = calc_CRC16_CCITT_FALSE_H1021(l_data,62); 

	if(GW_2BD_RRC_CRCCheck_2BD_wrongvalctr != 0)
    {
		Msg_GW_2BD.RRC_CRCCheck_2BD+=1; 
        //update signal with wrong CRC value
		if(GW_2BD_RRC_CRCCheck_2BD_wrongvalctr > 0)
        {
             GW_2BD_RRC_CRCCheck_2BD_wrongvalctr--;
              // if counter becomes zero, update panel controller to zero
             if(GW_2BD_RRC_CRCCheck_2BD_wrongvalctr == 0)
             {
                 putValue(E_pubc_GW_GW_2BD_RRC_CRCCheck_2BD_wrongvalctr,0);
             }
        }
	}
}
update_GW_2BF_CRC_CheckSum()
{
  int l_Crc_Len=0,l_count=0;
  int l_data[64];
 
  l_Crc_Len = 64-2;
  for (l_count=0;l_count<l_Crc_Len;l_count++)
    {
      l_data[l_count] = Msg_GW_2BF.BYTE(l_count);    
	  
    }
    
	Msg_GW_2BF.RRC_CRCCheck_2BF = calc_CRC16_CCITT_FALSE_H1021(l_data,62); 
	
	if(GW_2BF_RRC_CRCCheck_2BF_wrongvalctr != 0)
    {
		Msg_GW_2BF.RRC_CRCCheck_2BF+=1; 
        //update signal with wrong CRC value
		if(GW_2BF_RRC_CRCCheck_2BF_wrongvalctr > 0)
        {
             GW_2BF_RRC_CRCCheck_2BF_wrongvalctr--;
              // if counter becomes zero, update panel controller to zero
             if(GW_2BF_RRC_CRCCheck_2BF_wrongvalctr == 0)
             {
                 putValue(E_pubc_GW_GW_2BF_RRC_CRCCheck_2BF_wrongvalctr,0);
             }
        }
	}
}
update_GW_28B_CRC_CheckSum()
{
  int l_Crc_Len=0,l_count=0;
  int l_data[8];
 
  l_Crc_Len = 8-1;
  for (l_count=0;l_count<l_Crc_Len;l_count++)
    {
      l_data[l_count] = Msg_GW_28B.BYTE(l_count);    
    }
       
	Msg_GW_28B.BYTE(l_Crc_Len) = calc_SAE_J1850(l_data,l_Crc_Len); 

	
	if(GW_28B_BCM_CRCCheck_28B_wrongvalctr != 0)
    {
		Msg_GW_28B.BCM_CRCCheck_28B+=1; 
        //update signal with wrong CRC value
		if(GW_28B_BCM_CRCCheck_28B_wrongvalctr > 0)
        {
             GW_28B_BCM_CRCCheck_28B_wrongvalctr--;
              // if counter becomes zero, update panel controller to zero
             if(GW_28B_BCM_CRCCheck_28B_wrongvalctr == 0)
             {
                 putValue(E_pubc_GW_GW_28B_BCM_CRCCheck_28B_wrongvalctr,0);
             }
        }
	}
}

update_GW_2D2_CRC_CheckSum()
{
  int l_Crc_Len=0,l_count=0;
  int l_data[64];
 
  l_Crc_Len = 64-2;
  for (l_count=0;l_count<l_Crc_Len;l_count++)
    {
      l_data[l_count] = Msg_GW_2D2.BYTE(l_count);    
	  
    }
    
	Msg_GW_2D2.CdcCycChk2D2 = calc_CRC16_CCITT_FALSE_H1021(l_data,62); 
	
	if(GW_2D2_CdcCycChk2D2_wrongvalctr != 0)
    {
		Msg_GW_2D2.CdcCycChk2D2+=1; 
        //update signal with wrong CRC value
		if(GW_2D2_CdcCycChk2D2_wrongvalctr > 0)
        {
             GW_2D2_CdcCycChk2D2_wrongvalctr--;
              // if counter becomes zero, update panel controller to zero
             if(GW_2D2_CdcCycChk2D2_wrongvalctr == 0)
             {
                 putValue(E_pubc_GW_GW_2D2_CdcCycChk2D2_wrongvalctr,0);
             }
        }
	}
}



int calc_SAE_J1850(int data[], int Crc_len)
	{
		int idx,crc,temp,temp1;
		crc = 0xFF;
        idx = 0;
        temp = 0;
        temp1 = 0;
	
        for(idx=0;idx < Crc_len;idx++)
        {
			temp1 = data[idx];
			temp = (crc^temp1);
			crc = CRC_J1850_Table[temp];
        }
		crc ^= 0xFF;
		return crc;
	}


/*	int calc_SAE_J1851(int data[], int Crc_len)
	{
		int crc;
		
        crc = (data[0]+data[1]+data[2]+data[3]+data[4]+data[5]+data[6]) ;
          
		crc ^= 255;
		return crc;
	}*/

	

/* 	int calc_SAE_J1850(int data[], int Crc_len)
	{
		int idx,crc,temp,temp1,temp2,idy;
		crc = 0xFF;
        idx = 0;
        idy = 0;
        temp = 0;
        temp1 = 0;
        temp2 = 0;
	
        for(idx=0;idx < Crc_len;idx++)
        {
         temp1 = data[idx];
         crc = (crc^temp1);
          for (idy=8; idy>0; idy--)
          {
              // Save the value before the top bit is shifted out.
              temp2 = crc;
              crc <<= 1;
              if (0 != (temp2 & 128))
              {
                  crc ^= 0x2f;
              }
          } 
          
         //crc = CRC_J1850_Table[temp];
        }
		crc ^= 0xFF;
		return crc;
	} */

int Calc_Canfd_dlc(byte Dbc_dlc1)
	{
		if(Dbc_dlc > 8)
		    {
			 while (i<=7)
			  {
				if (CANFD_DLC[i]==Dbc_dlc)
				{
				return CAN_DLC[i];
				 break;
				}
				i++ ;
			}
		}
    else
	
	return Dbc_dlc1 ;
	
		
	}
	
int calc_CRC16_CCITT_FALSE_H1021(int data[], int Crc_len)
{
	int idx, crc;

	crc = 0xFFFF;
	
    for (idx=0; idx<Crc_len; idx++)
    {
        /* Impact of temporary rest on next crc rest */
        /* MISRA RULE 12.8 VIOLATION: Shift is performed in the context of a data stream */
        crc ^= data[idx] << 8;

        /* Next temporary crc rest */
        /* MISRA RULE 12.8 VIOLATION: Shift is performed in the context of a data stream */
        crc = (crc << (8)) ^ CRC16_CCITT_FALSE_H1021_Table[(crc >> (8)) & (0xFF)];
    }
	return crc;
}
	
	//For Messages with DLC = 8, CAN FD data length =8
	//For Messages with DLC = 9, CAN FD data length =12
	//For Messages with DLC = 10, CAN FD data length =16
	//For Messages with DLC = 11, CAN FD data length =20
	//For Messages with DLC = 12, CAN FD data length =24
	//For Messages with DLC = 13, CAN FD data length =32
	//For Messages with DLC = 14, CAN FD data length =48
	//For Messages with DLC = 15, CAN FD data length =64
	

