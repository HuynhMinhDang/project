/*@!Encoding:1252*/
//!************************************************************************************************************************************
//! Copyright(c) - This program/software is the exclusive property of Robert Bosch
//! Gmbh. Without their consent it may not be reproduced or given to third parties.
//!************************************************************************************************************************************

//!************************************************************************************************************************************
//! Testscript for Set/Unset the ECAN and SFCAN bus load to desired value 
//! Store the default bud load
//!************************************************************************************************************************************

//!***********************************************
//! Files >> BusLoad.can,BusLoad.dbc,BusLoad.xvp
//!
//! Author Sathisha Ninge Gowda (RBEI/ESD-CN3)
//!***********************************************

variables
{  
//***********************
//! Variables for ECAN 
//***********************  
  
  int   j; 
  int64 i;
 
  //define messages
  message can1.125 msg1 =  {dlc = 8,byte(0) = 00, byte(1) = 00, byte(2) =  45, byte(3) = 00, byte(4) = 00, byte(5) = 34, byte(6) = 00, byte(7) = 39}; 
  message can1.128 msg2 =  {dlc = 8,byte(0) = 76, byte(1) = 01, byte(2) =  80, byte(3) = 00, byte(4) = 54, byte(5) = 83, byte(6) = 00, byte(7) = 00}; 
  message can1.131 msg3 =  {dlc = 8,byte(0) = 40, byte(1) = 80, byte(2) =  00, byte(3) = 16, byte(4) = 00, byte(5) = 00, byte(6) = 03, byte(7) = 96}; 
  message can1.132 msg4 =  {dlc = 8,byte(0) = 00, byte(1) = 34, byte(2) =  68, byte(3) = 00, byte(4) = 34, byte(5) = 38, byte(6) = 80, byte(7) = 00};    
  message can1.134 msg5 =  {dlc = 8,byte(0) = 00, byte(1) = 00, byte(2) =  69, byte(3) = 00, byte(4) = 68, byte(5) = 00, byte(6) = 03, byte(7) = 49}; 
  message can1.136 msg6 =  {dlc = 8,byte(0) = 10, byte(1) = 96, byte(2) =  09, byte(3) = 99, byte(4) = 00, byte(5) = 25, byte(6) = 00, byte(7) = 00}; 
  message can1.138 msg7 =  {dlc = 8,byte(0) = 00, byte(1) = 08, byte(2) =  27, byte(3) = 00, byte(4) = 18, byte(5) = 00, byte(6) = 80, byte(7) = 00}; 
  message can1.140 msg8 =  {dlc = 8,byte(0) = 18, byte(1) = 60, byte(2) =  30, byte(3) = 85, byte(4) = 85, byte(5) = 00, byte(6) = 00, byte(7) = 92}; 
  message can1.85 msg9  =  {dlc = 8,byte(0) = 08, byte(1) = 78, byte(2) =  00, byte(3) = 71, byte(4) = 00, byte(5) = 07, byte(6) = 00, byte(7) = 75}; 
  message can1.87 msg10 =  {dlc = 8,byte(0) = 04, byte(1) = 00, byte(2) =  75, byte(3) = 00, byte(4) = 00, byte(5) = 74, byte(6) = 00, byte(7) = 00}; 
  message can1.89 msg11 =  {dlc = 8,byte(0) = 75, byte(1) = 00, byte(2) =  86, byte(3) = 14, byte(4) = 00, byte(5) = 58, byte(6) = 03, byte(7) = 68}; 
  message can1.91 msg12 =  {dlc = 8,byte(0) = 02, byte(1) = 10, byte(2) =  84, byte(3) = 10, byte(4) = 40, byte(5) = 22, byte(6) = 00, byte(7) = 00}; 
  message can1.93 msg13 =  {dlc = 8,byte(0) = 00, byte(1) = 22, byte(2) =  00, byte(3) = 22, byte(4) = 08, byte(5) = 00, byte(6) = 75, byte(7) = 00}; 
  message can1.95 msg14 =  {dlc = 8,byte(0) = 00, byte(1) = 00, byte(2) =  07, byte(3) = 00, byte(4) = 20, byte(5) = 00, byte(6) = 06, byte(7) = 79};   
  message can1.97 msg15 =  {dlc = 8,byte(0) = 00, byte(1) = 71, byte(2) =  00, byte(3) = 40, byte(4) = 00, byte(5) = 00, byte(6) = 93, byte(7) = 96}; 
  message can1.99 msg16 =  {dlc = 8,byte(0) = 00, byte(1) = 85, byte(2) =  75, byte(3) = 00, byte(4) = 00, byte(5) = 17, byte(6) = 00, byte(7) = 88}; 
  message can1.145 msg17 = {dlc = 8,byte(0) = 30, byte(1) = 00, byte(2) =  00, byte(3) = 70, byte(4) = 00, byte(5) = 00, byte(6) = 03, byte(7) = 97}; 
  message can1.147 msg18 = {dlc = 8,byte(0) = 00, byte(1) = 88, byte(2) =  00, byte(3) = 08, byte(4) = 08, byte(5) = 00, byte(6) = 03, byte(7) = 84}; 
  message can1.149 msg19 = {dlc = 8,byte(0) = 90, byte(1) = 00, byte(2) =  00, byte(3) = 96, byte(4) = 00, byte(5) = 00, byte(6) = 85, byte(7) = 00}; 
  message can1.151 msg20 = {dlc = 8,byte(0) = 31, byte(1) = 33, byte(2) =  18, byte(3) = 31, byte(4) = 33, byte(5) = 17, byte(6) = 33, byte(7) = 29};
  message can1.75 msg21 =  {dlc = 8,byte(0) = 00, byte(1) = 85, byte(2) =  75, byte(3) = 00, byte(4) = 00, byte(5) = 17, byte(6) = 00, byte(7) = 88}; 
  message can1.72 msg22 =  {dlc = 8,byte(0) = 30, byte(1) = 00, byte(2) =  00, byte(3) = 70, byte(4) = 00, byte(5) = 00, byte(6) = 03, byte(7) = 97}; 
  message can1.79 msg23 =  {dlc = 8,byte(0) = 00, byte(1) = 88, byte(2) =  00, byte(3) = 08, byte(4) = 08, byte(5) = 00, byte(6) = 03, byte(7) = 84}; 
  message can1.76 msg24 =  {dlc = 8,byte(0) = 90, byte(1) = 00, byte(2) =  00, byte(3) = 96, byte(4) = 00, byte(5) = 00, byte(6) = 85, byte(7) = 00}; 
  message can1.55 msg25 =  {dlc = 8,byte(0) = 31, byte(1) = 33, byte(2) =  18, byte(3) = 31, byte(4) = 33, byte(5) = 17, byte(6) = 33, byte(7) = 29};
  message can1.51 msg26 =  {dlc = 8,byte(0) = 00, byte(1) = 85, byte(2) =  75, byte(3) = 00, byte(4) = 00, byte(5) = 17, byte(6) = 00, byte(7) = 88}; 
  message can1.53 msg27 =  {dlc = 8,byte(0) = 30, byte(1) = 00, byte(2) =  00, byte(3) = 70, byte(4) = 00, byte(5) = 00, byte(6) = 03, byte(7) = 97}; 
  message can1.50 msg28 =  {dlc = 8,byte(0) = 00, byte(1) = 88, byte(2) =  00, byte(3) = 08, byte(4) = 08, byte(5) = 00, byte(6) = 03, byte(7) = 84}; 
  message can1.44 msg29 =  {dlc = 8,byte(0) = 90, byte(1) = 00, byte(2) =  00, byte(3) = 96, byte(4) = 00, byte(5) = 00, byte(6) = 85, byte(7) = 00}; 
  message can1.41 msg30 =  {dlc = 8,byte(0) = 31, byte(1) = 33, byte(2) =  18, byte(3) = 31, byte(4) = 33, byte(5) = 17, byte(6) = 33, byte(7) = 29};

  // Variables for timers
  msTimer StartMsgECAN;
  msTimer StartMsgECAN1;
  msTimer ECANTimer1;
  mstimer StoreECANDefBusLod;
  
  // panel
  msTimer UpdateECANBusLoad;
  int ECANCurrBusload;
  int ExpBusload;
  int ECANSwitchStatus; 
  
//***********************
//! Variables for SFCAN 
//*********************** 
  int   y;
  int64 x;
  
  // de4ine 31N message
  message can2.10 msg51 =  {dlc = 15, byte(0) = 58, byte(1) = 67, byte(2) = 81, byte(3) = 01, byte(4) = 00, byte(5) = 00, byte(6) = 00, byte(7) = 00, byte(8) = 00, byte(9) = 33, byte(10) = 00, byte(11) = 60, byte(12) = 66, byte(13) = 00, byte(14) = 48, byte(15) = 74}; 
  message can2.12 msg52 =  {dlc = 15, byte(0) = 99, byte(1) = 54, byte(2) = 81, byte(3) = 01, byte(4) = 00, byte(5) = 00, byte(6) = 00, byte(7) = 00, byte(8) = 00, byte(9) = 67, byte(10) = 00, byte(11) = 60, byte(12) = 66, byte(13) = 00, byte(14) = 48, byte(15) = 74}; 
  message can2.15 msg53 =  {dlc = 15, byte(0) = 29, byte(1) = 22, byte(2) = 81, byte(3) = 01, byte(4) = 00, byte(5) = 00, byte(6) = 00, byte(7) = 00, byte(8) = 00, byte(9) = 94, byte(10) = 00, byte(11) = 60, byte(12) = 66, byte(13) = 00, byte(14) = 48, byte(15) = 74}; 
  message can2.16 msg54 =  {dlc = 15, byte(0) = 28, byte(1) = 41, byte(2) = 81, byte(3) = 01, byte(4) = 00, byte(5) = 50, byte(6) = 04, byte(7) = 06, byte(8) = 00, byte(9) = 40, byte(10) = 14, byte(11) = 27, byte(12) = 78, byte(13) = 00, byte(14) = 00, byte(15) = 00}; 
  message can2.18 msg55 =  {dlc = 15, byte(0) = 91, byte(1) = 41, byte(2) = 81, byte(3) = 01, byte(4) = 00, byte(5) = 00, byte(6) = 00, byte(7) = 00, byte(8) = 10, byte(9) = 04, byte(10) = 00, byte(11) = 44, byte(12) = 01, byte(13) = 73, byte(14) = 03, byte(15) = 00};
  message can2.19 msg56 =  {dlc = 15, byte(0) = 96, byte(1) = 33, byte(2) = 89, byte(3) = 09, byte(4) = 00, byte(5) = 50, byte(6) = 04, byte(7) = 06, byte(8) = 00, byte(9) = 40, byte(10) = 14, byte(11) = 76, byte(12) = 78, byte(13) = 00, byte(14) = 00, byte(15) = 00}; 
  message can2.21 msg57 =  {dlc = 15, byte(0) = 98, byte(1) = 22, byte(2) = 89, byte(3) = 09, byte(4) = 00, byte(5) = 00, byte(6) = 00, byte(7) = 00, byte(8) = 10, byte(9) = 04, byte(10) = 00, byte(11) = 44, byte(12) = 01, byte(13) = 72, byte(14) = 03, byte(15) = 00};
  message can2.23 msg58 =  {dlc = 15, byte(0) = 11, byte(1) = 32, byte(2) = 81, byte(3) = 01, byte(4) = 00, byte(5) = 50, byte(6) = 04, byte(7) = 06, byte(8) = 00, byte(9) = 40, byte(10) = 14, byte(11) = 22, byte(12) = 78, byte(13) = 00, byte(14) = 00, byte(15) = 00}; 
  message can2.28 msg59 =  {dlc = 15, byte(0) = 55, byte(1) = 83, byte(2) = 88, byte(3) = 01, byte(4) = 00, byte(5) = 00, byte(6) = 00, byte(7) = 00, byte(8) = 10, byte(9) = 04, byte(10) = 00, byte(11) = 44, byte(12) = 01, byte(13) = 68, byte(14) = 03, byte(15) = 00};
  message can2.30 msg60 = {dlc = 15, byte(0) = 55, byte(1) = 13, byte(2) = 89, byte(3) = 09, byte(4) = 00, byte(5) = 50, byte(6) = 04, byte(7) = 06, byte(8) = 00, byte(9) = 40, byte(10) = 14, byte(11) = 76, byte(12) = 78, byte(13) = 00, byte(14) = 00, byte(15) = 00}; 
  message can2.33 msg61 = {dlc = 15, byte(0) = 59, byte(1) = 76, byte(2) = 89, byte(3) = 09, byte(4) = 00, byte(5) = 00, byte(6) = 00, byte(7) = 00, byte(8) = 10, byte(9) = 04, byte(10) = 00, byte(11) = 44, byte(12) = 01, byte(13) = 67, byte(14) = 03, byte(15) = 00};
  message can2.49 msg62 = {dlc = 15, byte(0) = 83, byte(1) = 78, byte(2) = 81, byte(3) = 01, byte(4) = 00, byte(5) = 50, byte(6) = 04, byte(7) = 06, byte(8) = 00, byte(9) = 40, byte(10) = 14, byte(11) = 66, byte(12) = 78, byte(13) = 00, byte(14) = 00, byte(15) = 00}; 
  message can2.43 msg63 = {dlc = 15, byte(0) = 38, byte(1) = 36, byte(2) = 89, byte(3) = 01, byte(4) = 00, byte(5) = 00, byte(6) = 00, byte(7) = 00, byte(8) = 10, byte(9) = 04, byte(10) = 00, byte(11) = 44, byte(12) = 01, byte(13) = 22, byte(14) = 03, byte(15) = 00};
  message can2.45 msg64 = {dlc = 15, byte(0) = 75, byte(1) = 22, byte(2) = 89, byte(3) = 09, byte(4) = 00, byte(5) = 00, byte(6) = 00, byte(7) = 00, byte(8) = 10, byte(9) = 04, byte(10) = 00, byte(11) = 44, byte(12) = 01, byte(13) = 28, byte(14) = 03, byte(15) = 00};
  message can2.46 msg65 = {dlc = 15, byte(0) = 28, byte(1) = 78, byte(2) = 81, byte(3) = 01, byte(4) = 69, byte(5) = 00, byte(6) = 00, byte(7) = 00, byte(8) = 84, byte(9) = 01, byte(10) = 00, byte(11) = 00, byte(12) = 84, byte(13) = 01, byte(14) = 00, byte(15) = 00}; 
  message can2.48 msg66 = {dlc = 12, byte(0) = 42, byte(1) = 32, byte(2) = 63, byte(3) = 00, byte(4) = 07, byte(5) = 00, byte(6) = 00, byte(7) = 00, byte(8) = 00, byte(9) = 00, byte(10) = 00, byte(11) = 00};
  message can2.52 msg67 = {dlc = 08, byte(0) = 89, byte(1) = 07, byte(2) = 31, byte(3) = 20, byte(4) = 00, byte(5) = 00, byte(6) = 00, byte(7) = 00};
  message can2.54 msg68 = {dlc = 08, byte(0) = 42, byte(1) = 29, byte(2) = 47, byte(3) = 00, byte(4) = 20, byte(5) = 00, byte(6) = 00, byte(7) = 00};
  message can2.56 msg69 = {dlc = 15, byte(0) = 46, byte(1) = 32, byte(2) = 81, byte(3) = 01, byte(4) = 00, byte(5) = 00, byte(6) = 00, byte(7) = 00, byte(8) = 00, byte(9) = 72, byte(10) = 00, byte(11) = 60, byte(12) = 66, byte(13) = 00, byte(14) = 48, byte(15) = 74}; 
  message can2.58 msg70 = {dlc = 12, byte(0) = 42, byte(1) = 32, byte(2) = 63, byte(3) = 00, byte(4) = 07, byte(5) = 00, byte(6) = 00, byte(7) = 00, byte(8) = 00, byte(9) = 00, byte(10) = 00, byte(11) = 00};  
  message can2.13 msg71 = {dlc = 15, byte(0) = 59, byte(1) = 76, byte(2) = 89, byte(3) = 09, byte(4) = 00, byte(5) = 00, byte(6) = 00, byte(7) = 00, byte(8) = 10, byte(9) = 04, byte(10) = 00, byte(11) = 44, byte(12) = 01, byte(13) = 67, byte(14) = 03, byte(15) = 00};
  message can2.22 msg72 = {dlc = 15, byte(0) = 83, byte(1) = 78, byte(2) = 81, byte(3) = 01, byte(4) = 00, byte(5) = 50, byte(6) = 04, byte(7) = 06, byte(8) = 00, byte(9) = 40, byte(10) = 14, byte(11) = 66, byte(12) = 78, byte(13) = 00, byte(14) = 00, byte(15) = 00}; 
  message can2.24 msg73 = {dlc = 15, byte(0) = 38, byte(1) = 36, byte(2) = 89, byte(3) = 01, byte(4) = 00, byte(5) = 00, byte(6) = 00, byte(7) = 00, byte(8) = 10, byte(9) = 04, byte(10) = 00, byte(11) = 44, byte(12) = 01, byte(13) = 22, byte(14) = 03, byte(15) = 00};
  message can2.27 msg74 = {dlc = 15, byte(0) = 75, byte(1) = 22, byte(2) = 89, byte(3) = 09, byte(4) = 00, byte(5) = 00, byte(6) = 00, byte(7) = 00, byte(8) = 10, byte(9) = 04, byte(10) = 00, byte(11) = 44, byte(12) = 01, byte(13) = 28, byte(14) = 03, byte(15) = 00};
  message can2.29 msg75 = {dlc = 15, byte(0) = 28, byte(1) = 78, byte(2) = 81, byte(3) = 01, byte(4) = 69, byte(5) = 00, byte(6) = 00, byte(7) = 00, byte(8) = 84, byte(9) = 01, byte(10) = 00, byte(11) = 00, byte(12) = 84, byte(13) = 01, byte(14) = 00, byte(15) = 00}; 
  message can2.42 msg76 = {dlc = 12, byte(0) = 42, byte(1) = 32, byte(2) = 63, byte(3) = 00, byte(4) = 07, byte(5) = 00, byte(6) = 00, byte(7) = 00, byte(8) = 00, byte(9) = 00, byte(10) = 00, byte(11) = 00};
  message can2.38 msg77 = {dlc = 08, byte(0) = 89, byte(1) = 07, byte(2) = 31, byte(3) = 20, byte(4) = 00, byte(5) = 00, byte(6) = 00, byte(7) = 00};
  message can2.36 msg78 = {dlc = 08, byte(0) = 42, byte(1) = 29, byte(2) = 47, byte(3) = 00, byte(4) = 20, byte(5) = 00, byte(6) = 00, byte(7) = 00};
  message can2.39 msg79 = {dlc = 15, byte(0) = 46, byte(1) = 32, byte(2) = 81, byte(3) = 01, byte(4) = 00, byte(5) = 00, byte(6) = 00, byte(7) = 00, byte(8) = 00, byte(9) = 72, byte(10) = 00, byte(11) = 60, byte(12) = 66, byte(13) = 00, byte(14) = 48, byte(15) = 74}; 
  message can2.57 msg80 = {dlc = 12, byte(0) = 42, byte(1) = 32, byte(2) = 63, byte(3) = 00, byte(4) = 07, byte(5) = 00, byte(6) = 00, byte(7) = 00, byte(8) = 00, byte(9) = 00, byte(10) = 00, byte(11) = 00}; 
 
  // timers
  msTimer StartMsgSFCAN;
  msTimer StartMsgSFCAN1;
  msTimer SFCANTimer1;
  mstimer StoreSFCANDefBusLod;
  
  // panel
  msTimer UpdateSFCANBusLoad;
  int SFCANCurrBusload;
  int SFCANExpBusload;
  int SFCANSwitchStatus;
}

// Set timers for update the current bus load staus to "BusLoad Control Panel" dislpay
on start
{
  //ECAN
  setTimer (UpdateECANBusLoad,1);
  setTimer(StoreECANDefBusLod,3000);
  
  //SFCAN
  setTimer (UpdateSFCANBusLoad,1);
  setTimer(StoreSFCANDefBusLod,3000);
}

// update the default bus load to panel when "Upadte Default BusLoad" is pressed
on envVar Env_UpdateDefaultBusLoad
{
  if(@Env_UpdateDefaultBusLoad==1)
  {
    setTimer(StoreECANDefBusLod,2);
    setTimer(StoreSFCANDefBusLod,2);
  }
  else
  {
    // Do nothing
  }
  
}

//*******************************************
//! Functions related to ECAN BusLoad setting
//*******************************************

// store default ECAN bus load to Env variavle Env_ECANDefaulatBusLoad after a delay of 3sec
On timer StoreECANDefBusLod 
{
  putValue(Env_ECANDefaulatBusLoad,CAN1.busload);
}

// Update ECAN BusLoad continuously to Panel display with an interval of 10ms
on timer UpdateECANBusLoad
{
    putValue(Env_ECANCurrentBusLoad,CAN1.busload);
    ECANCurrBusload = CAN1.busload;
    setTimer (UpdateECANBusLoad,10);
}

// Monitor the ECAN Switch Env Variable 
on envVar Env_BusLoadECANSwitch
{

  ECANSwitchStatus = getValue(Env_BusLoadECANSwitch);
    
  if (ECANSwitchStatus==1)
  {
    SetBusLoadECAN();
  }   
  else
  {
    stopBusLoadECAN();
  }
}

// Monitor bus load percenatage set on the panel
on envVar Env_BusLoadpercentageECAN
{
  putValue(Env_BusLoadECANSwitch,1);
  ECANSwitchStatus = getValue(Env_BusLoadECANSwitch);
  
  i=0;
  j=0;
  cancelTimer(StartMsgECAN);
  cancelTimer(StartMsgECAN1);
  putValue(Env_BusLoadECANSwitch,1);
  setTimer(ECANTimer1,2000);

  }

On timer ECANTimer1
{
  SetBusLoadECAN();
}

SetBusLoadECAN()
{       
  if ((getvalue(Env_BusLoadpercentageECAN )> getValue(Env_ECANDefaulatBusLoad)) && (getValue(Env_BusLoadECANSwitch)==1))
    {
        setTimer(StartMsgECAN,5);
        j=0;
    }

  else if ((getvalue(Env_BusLoadpercentageECAN) <= getValue(Env_ECANDefaulatBusLoad)) && (getValue(Env_BusLoadECANSwitch)==1))
    {
      write("ECAN Bus load cannot be set less than the default busload %d%%",getValue(Env_ECANDefaulatBusLoad));
    }	
  else if ((getvalue(Env_BusLoadpercentageECAN) > 100) && (getValue(Env_BusLoadECANSwitch)==1))
    {
      write("ECAN Bus load cannot be set to more than than 100%%");
    }	       
}

void stopBusLoadECAN()
{
        cancelTimer(StartMsgECAN);
        cancelTimer(StartMsgECAN1);
        j=0;//reset number msg
        i=0;// reset wait counter
}

// calculate the number of messages required to set the desired ECAN BusLoad
 on timer StartMsgECAN
{
    if (((CAN1.BusLoad <= getValue(Env_BusLoadpercentageECAN)) && i>1))
    {
              output(msg1);  
              j=1;
  
     if ((CAN1.BusLoad <= getValue(Env_BusLoadpercentageECAN)) && i>300)
          {
             output(msg2);
             j=2;
            
            
     if ((CAN1.BusLoad <= getValue(Env_BusLoadpercentageECAN)) && i>600)
          {
             output(msg3);
             j=3;
                        
         
     if ((CAN1.BusLoad <= getValue(Env_BusLoadpercentageECAN)) && i>900)
         {                
            output(msg4);
            j=4;
                                    
                     
     if ((CAN1.BusLoad <= getValue(Env_BusLoadpercentageECAN)) && i>1200)
        {                
          output(msg5);
          j=5;

          
     if ((CAN1.BusLoad <= getValue(Env_BusLoadpercentageECAN)) && i>1500)
        {                
          output(msg6);
          j=6;
                   

     if ((CAN1.BusLoad <= getValue(Env_BusLoadpercentageECAN)) && i>1800)
        {
          output(msg7);
          j=7;

          
     if ((CAN1.BusLoad <= getValue(Env_BusLoadpercentageECAN)) && i>2100)
        {                                
          output(msg8);
          j=8;

                                   
     if ((CAN1.BusLoad <= getValue(Env_BusLoadpercentageECAN)) && i>2400)
        {                                   
          output(msg9);
          j=9;
                                                                                                   
                                                        
     if ((CAN1.BusLoad <= getValue(Env_BusLoadpercentageECAN)) && i>2700)
        {                                  
          output(msg10);
          j=10;
                                                                        
                                                                                                                          
    if ((CAN1.BusLoad <= getValue(Env_BusLoadpercentageECAN)) && i>3000)
       {                
         output(msg11);
         j=11;
                                                                                  
                                                       
     if ((CAN1.BusLoad <= getValue(Env_BusLoadpercentageECAN)) && i>3300)
        {
          output(msg12);
          j=12;
                                                      
     if ((CAN1.BusLoad <= getValue(Env_BusLoadpercentageECAN)) && i>3600)
        {                                 
          output(msg13);
          j=13;
                                                                                                                            
      if ((CAN1.BusLoad <= getValue(Env_BusLoadpercentageECAN)) && i>3900)
         {                                     
           output(msg14);
           j=14;
                                                                                                                      
                                                                                                          
      if ((CAN1.BusLoad <= getValue(Env_BusLoadpercentageECAN)) && i>4200)
         {                                 
           output(msg15);
           j=15;                                                                                                               
           
      if ((CAN1.BusLoad <= getValue(Env_BusLoadpercentageECAN)) && i>4500)
         {                                  
           output(msg16);
           j=16;           
          
      if ((CAN1.BusLoad <= getValue(Env_BusLoadpercentageECAN)) && i>4800)
         {                                   
           output(msg17);
           j=17;           
          
      if ((CAN1.BusLoad <= getValue(Env_BusLoadpercentageECAN)) && i>5100)
         {                                  
           output(msg18);
           j=18;           
          
      if ((CAN1.BusLoad <= getValue(Env_BusLoadpercentageECAN)) && i>5400)
         {                                
           output(msg19);
           j=19;           
          
      if ((CAN1.BusLoad <= getValue(Env_BusLoadpercentageECAN)) && i>5700)
         {                                   
           output(msg20);
           j=20;           
          
      if ((CAN1.BusLoad <= getValue(Env_BusLoadpercentageECAN)) && i>6000)
         {                                   
           output(msg21);
           j=21; 
        
      if ((CAN1.BusLoad <= getValue(Env_BusLoadpercentageECAN)) && i>6300)
         {                                   
           output(msg22);
           j=22;
          
      if ((CAN1.BusLoad <= getValue(Env_BusLoadpercentageECAN)) && i>6600)
         {                                   
           output(msg23);
           j=23; 
          
      if ((CAN1.BusLoad <= getValue(Env_BusLoadpercentageECAN)) && i>6900)
         {                                   
           output(msg24);
           j=24; 
          
      if ((CAN1.BusLoad <= getValue(Env_BusLoadpercentageECAN)) && i>7200)
         {                                   
           output(msg25);
           j=25; 
          
      if ((CAN1.BusLoad <= getValue(Env_BusLoadpercentageECAN)) && i>7500)
         {                                   
           output(msg26);
           j=26; 
          
      if ((CAN1.BusLoad <= getValue(Env_BusLoadpercentageECAN)) && i>7800)
         {                                   
           output(msg27);
           j=27; 
          
      if ((CAN1.BusLoad <= getValue(Env_BusLoadpercentageECAN)) && i>8100)
         {                                   
           output(msg28);
           j=28; 
          
      if ((CAN1.BusLoad <= getValue(Env_BusLoadpercentageECAN)) && i>8400)
         {                                   
           output(msg29);
           j=29; 
          
      if ((CAN1.BusLoad <= getValue(Env_BusLoadpercentageECAN)) && i>8700)
         {                                   
           output(msg30);
           j=30; 
         } 
         }
         }
         } 
         }
         } 
         }  
         }
         }
         }
         }
         }
         }
         }
         } 
         }
         } 
         }
         } 
         }
         }
         }
         }
         }
         }
         }                       
         }                              
         }  
         }
         }                       

   
          
// write("i=%d",i);         
 if (i<19000)
{
    i++;
}


setTimer(StartMsgECAN,8);


if (CAN1.BusLoad > getValue(Env_BusLoadpercentageECAN))
{
  cancelTimer(StartMsgECAN);
  setTimer(StartMsgECAN1,8);
}

}

// out put the required number of messages to ECAN 
on timer StartMsgECAN1
{  
  if(j>=1)
  {
    output(msg1);
   } 
  if(j>=2)
  { 
    output(msg2);
  }
  
  if(j>=3)
  { 
    output(msg3);    
  }
  
  if(j>=4)
  {  
    output(msg4);
  }
  
  if(j>=5)
  { 
    output(msg5);
  }
  
  if(j>=6)
  { 
    output(msg6);
  }
  
  if(j>=7)
  { 
    output(msg7);
  }
  
  if(j>=8)
  { 
    output(msg8);
  }
  
  if(j>=9)
  { 
    output(msg9);
  }
  
  if(j>=10)
  { 
    output(msg10);
  }
  if(j>=11)
  { 
    output(msg11);
  }
  if(j>=12)
  { 
    output(msg12);
  }
  if(j>=13)
  { 
    output(msg13);
  }
  
  if(j>=14)
  { 
    output(msg14);
  }
  
  if(j>=15)
  {  
    output(msg15);
  }
  if(j>=16)
  {  
    output(msg16);
  }  

  if(j>=17)
  {  
    output(msg17);
  }

  if(j>=18)
  {  
    output(msg18);
  }  

   if(j>=19)
  {  
    output(msg19);
  }
  
  if(j>=20)
  {  
    output(msg20);
  }  
  
  if(j>=21)
  { 
    output(msg21);
  }
  if(j>=22)
  { 
    output(msg22);
  }
  if(j>=23)
  { 
    output(msg23);
  }
  
  if(j>=24)
  { 
    output(msg24);
  }
  
  if(j>=25)
  {  
    output(msg25);
  }
  if(j>=26)
  {  
    output(msg26);
  }  

  if(j>=27)
  {  
    output(msg27);
  }

  if(j>=28)
  {  
    output(msg28);
  }  

   if(j>=29)
  {  
    output(msg29);
  }
  
  if(j>=30)
  {  
    output(msg30);
  } 
  
 setTimer(StartMsgECAN1,8); 
  
}


//********************************************
//! Functions related to SFCAN BusLoad setting
//********************************************

// store default SFCAN bus load to Env variavle Env_ECANDefaulatBusLoad after a delay of 3sec
on timer StoreSFCANDefBusLod
{
    putValue(Env_SFCANDefaulatBusLoad,CAN2.busload); 
}

// Update SFCAN BusLoad continuously to Panel display with an interval of 10ms
on timer UpdateSFCANBusLoad
{
    putValue(Env_SFCANCurrentBuslLoad,CAN2.busload);
	  SFCANCurrBusload=CAN2.busload;
    setTimer (UpdateSFCANBusLoad,10);
}

// Monitor the SFCAN Switch Env Variable 
on envVar Env_BusLoadSFCANSwitch
{
	SFCANSwitchStatus = getValue(Env_BusLoadSFCANSwitch);
	
    if (SFCANSwitchStatus==1)
    {
        SetBusLoadSFCAN();
    }  
      
    else
    {
     stopBusLoadSFCAN();
    } 
    
}

// monitor bus load percenatage

on envVar Env_BusLoadpercentageSFCAN
{
    putValue(Env_BusLoadSFCANSwitch,1);
    SFCANSwitchStatus = getValue(Env_BusLoadSFCANSwitch);	
    x=0;
    y=0;
    cancelTimer(StartMsgSFCAN);
    cancelTimer(StartMsgSFCAN1);
    putValue(Env_BusLoadSFCANSwitch,1);
    setTimer(SFCANTimer1,2000);
}

On timer SFCANTimer1
{
    SetBusLoadSFCAN();
}

SetBusLoadSFCAN()
{

    if ((getvalue(Env_BusLoadpercentageSFCAN )> getValue(Env_SFCANDefaulatBusLoad)) && (getValue(Env_BusLoadSFCANSwitch)==1))
    {
        setTimer(StartMsgSFCAN,5);
        y=0;
    }

    else if ((getvalue(Env_BusLoadpercentageSFCAN) <= getValue(Env_SFCANDefaulatBusLoad)) && (getValue(Env_BusLoadSFCANSwitch)==1))
    {
        write("Bus load cannot be set less than the default busload %d%%",getValue(Env_SFCANDefaulatBusLoad));
    }	
    else if ((getvalue(Env_BusLoadpercentageSFCAN) > 100) && (getValue(Env_BusLoadSFCANSwitch)==1))
    {
        write("Bus load cannot be set to more than than 100%%");
    }	
}


void stopBusLoadSFCAN()
{
    cancelTimer(StartMsgSFCAN);
    cancelTimer(StartMsgSFCAN1);
    x=0;//reset number msg
    y=0;// reset wait counter
}


// calculate the number of messages required to set the desired SFCAN BusLoad
on timer StartMsgSFCAN
{
  
if (((CAN2.BusLoad <= getValue(Env_BusLoadpercentageSFCAN)) && x>1))
    {
        output(msg51);  
        y=1;
  
    if ((CAN2.BusLoad <= getValue(Env_BusLoadpercentageSFCAN)) && x>300)
        {
			output(msg52);
			y=2;     
            
    if ((CAN2.BusLoad <= getValue(Env_BusLoadpercentageSFCAN)) && x>600)
        {
			output(msg53);
			y=3;

    if ((CAN2.BusLoad <= getValue(Env_BusLoadpercentageSFCAN)) && x>900)
        {                
			output(msg54);
			y=4;
   
    if ((CAN2.BusLoad <= getValue(Env_BusLoadpercentageSFCAN)) && x>1200)
        {                
			output(msg55);
			y=5;

    if ((CAN2.BusLoad <= getValue(Env_BusLoadpercentageSFCAN)) && x>1500)
        {                
			output(msg56);
			y=6; 

    if ((CAN2.BusLoad <= getValue(Env_BusLoadpercentageSFCAN)) && x>1800)
        {
			output(msg57);
			y=7;

    if ((CAN2.BusLoad <= getValue(Env_BusLoadpercentageSFCAN)) && x>2100)
        {                                
			output(msg58);
			y=8;

    if ((CAN2.BusLoad <= getValue(Env_BusLoadpercentageSFCAN)) && x>2400)
        {                                   
			output(msg59);
			y=9;
 
    if ((CAN2.BusLoad <= getValue(Env_BusLoadpercentageSFCAN)) && x>2700)
        {                                  
			output(msg60);
			y=10;
 
    if ((CAN2.BusLoad <= getValue(Env_BusLoadpercentageSFCAN)) && x>3000)
        {                
			output(msg61);
			y=11;
 
    if ((CAN2.BusLoad <= getValue(Env_BusLoadpercentageSFCAN)) && x>3300)
        {
			output(msg62);
			y=12;

    if ((CAN2.BusLoad <= getValue(Env_BusLoadpercentageSFCAN)) && x>3600)
        {                                 
			output(msg63);
			y=13;
   
    if ((CAN2.BusLoad <= getValue(Env_BusLoadpercentageSFCAN)) && x>3900)
        {                                     
			output(msg64);
			y=14; 

    if ((CAN2.BusLoad <= getValue(Env_BusLoadpercentageSFCAN)) && x>4200)
        {                                 
			output(msg65);
			y=15;                                                                                                               
           
    if ((CAN2.BusLoad <= getValue(Env_BusLoadpercentageSFCAN)) && x>4500)
        {                                  
			output(msg66);
			y=16;           
          
    if ((CAN2.BusLoad <= getValue(Env_BusLoadpercentageSFCAN)) && x>4800)
        {                                   
			output(msg67);
			y=17;           
          
    if ((CAN2.BusLoad <= getValue(Env_BusLoadpercentageSFCAN)) && x>5100)
        {                                  
			output(msg68);
			y=18;           
          
    if ((CAN2.BusLoad <= getValue(Env_BusLoadpercentageSFCAN)) && x>5400)
        {                                
			output(msg69);
			y=19;           
          
    if ((CAN2.BusLoad <= getValue(Env_BusLoadpercentageSFCAN)) && x>5700)
        {                                   
			output(msg70);
			y=20;           
          
    if ((CAN2.BusLoad <= getValue(Env_BusLoadpercentageSFCAN)) && x>6000)
        {                                   
			output(msg71);
			y=21; 
        
    if ((CAN2.BusLoad <= getValue(Env_BusLoadpercentageSFCAN)) && x>6300)
        {                                   
			output(msg72);
			y=22;
          
    if ((CAN2.BusLoad <= getValue(Env_BusLoadpercentageSFCAN)) && x>6600)
        {                                   
			output(msg73);
			y=23; 
          
    if ((CAN2.BusLoad <= getValue(Env_BusLoadpercentageSFCAN)) && x>6900)
        {                                   
			output(msg74);
			y=24; 
          
    if ((CAN2.BusLoad <= getValue(Env_BusLoadpercentageSFCAN)) && x>7200)
        {                                   
			output(msg75);
			y=25; 
          
    if ((CAN2.BusLoad <= getValue(Env_BusLoadpercentageSFCAN)) && x>7500)
        {                                   
			output(msg76);
			y=26; 
          
    if ((CAN2.BusLoad <= getValue(Env_BusLoadpercentageSFCAN)) && x>7800)
        {                                   
			output(msg77);
			y=27; 
          
    if ((CAN2.BusLoad <= getValue(Env_BusLoadpercentageSFCAN)) && x>8100)
        {                                   
			output(msg78);
			y=28; 
          
    if ((CAN2.BusLoad <= getValue(Env_BusLoadpercentageSFCAN)) && x>8400)
        {                                   
			output(msg79);
			y=29; 
          
    if ((CAN2.BusLoad <= getValue(Env_BusLoadpercentageSFCAN)) && x>8700)
        {                                   
			output(msg80);
			y=30;        
          
        }
        }
        }
        }
        }
        }
        }
        }
        }
        }
        }
        }
        }
        }
        }
        }
        }
        }
        }
        }
        }                       
        }                              
        }  
        }
        }                       
        }                                      
        }                     
        }   
        }
        } 
          
 if (x<350000)
	{
		x++;
	}
	setTimer(StartMsgSFCAN,9);


if (CAN2.BusLoad > getValue(Env_BusLoadpercentageSFCAN))
	{
		cancelTimer(StartMsgSFCAN);
		setTimer(StartMsgSFCAN1,9);
	}
}


// out put the required number of messages to SFCAN 
on timer StartMsgSFCAN1
{
  if(y>=1)
  {  
    output(msg51);  
  }
  if(y>=2)
  {  
    output(msg52);
  }
  
  if(y>=3)
  {  
    output(msg53);    
  }
  
  if(y>=4)
  {  
    output(msg54);
  }
  
  if(y>=5)
  { 

    output(msg55);
  }
  
  if(y>=6)
  { 
    output(msg56);
  }
  
  if(y>=7)
  {  
    output(msg57);
  }
  
  if(y>=8)
  { 
    output(msg58);
  }
  
  if(y>=9)
  { 
    output(msg59);
  }
  
  if(y>=10)
  { 
    output(msg60);
  }
  if(y>=11)
  { 
    output(msg61);    
  }
  if(y>=12)
  {  
    output(msg62);
  }
  if(y>=13)
  { 
    output(msg63);
  }
  
  if(y>=14)
  { 
    output(msg64);
  }
  
  if(y>=15)
  { 
    output(msg65);
  }
  
   if(y>=16)
  { 
    output(msg66);
  } 
  
   if(y>=17)
  { 
    output(msg67);
  } 
  
   if(y>=18)
  { 
    output(msg68);
  } 
  
   if(y>=19)
  { 
    output(msg69);
  } 
  
  if(y>=20)
  { 
    output(msg70);
  }  
  
  if(y>=21)
  { 
    output(msg71);
  }
  if(y>=22)
  { 
    output(msg72);
  }
  if(y>=23)
  { 
    output(msg73);
  }
  
  if(y>=24)
  { 
    output(msg74);
  }
  
  if(y>=25)
  {  
    output(msg75);
  }
  if(y>=26)
  {  
    output(msg76);
  }  

  if(y>=27)
  {  
    output(msg77);
  }

  if(y>=28)
  {  
    output(msg78);
  }  

   if(y>=29)
  {  
    output(msg79);
  }
  
  if(y>=30)
  {  
    output(msg80);
  }
  
 setTimer(StartMsgSFCAN1,9); 
}