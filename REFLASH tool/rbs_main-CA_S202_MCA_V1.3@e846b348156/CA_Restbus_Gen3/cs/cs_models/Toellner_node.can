/*@!Encoding:1250*/
// includes
// {
	// #include "Toellner_fns.can"
// }

variables
{
    // GPIB variables
    long GPIBid;
    int GPIB_boardIdx = 0;
  	int GPIB_primAddr = 20;
  	int GPIB_secAddr = 0;
  	int GPIB_timeout = 11;
  	int GPIB_eot = 1;
  	int GPIB_eos = 0;
    long GPIB_Error=0 ;
    char GPIB_resultString[50]; 
    long GPIB_DevStatus;
    int GPIB_DeviceOnline=0;
    int GPIB_OutputState = 0;
	long errorcode;
	char errorText[200];
	long statusword;
	char answer[20];
	float value;
}


on preStart
{
  GBIP_Init();
}

on stopMeasurement
{
  GPIB_Stop();
}


void GPIB_Stop()
{
  GPIBDevOnline(GPIBid, 0);
  GPIBDevClear(GPIBid);
  GPIB_DeviceOnline = 0;
}

void GBIP_Init()
{
	int i;
	write("Init phase started\n");
    
    //                   	 0        		 8        	 	0         	  11     		1    	  0
    GPIBid = GPIBDevOpen (GPIB_boardIdx, GPIB_primAddr, GPIB_secAddr, GPIB_timeout, GPIB_eot, GPIB_eos);
  putvalue(Env_GPIBid,GPIBid);
	if(GPIBid == -1) write("Error %d: %s",errorcode,errorText);
	else
	{
		i=GPIBDevOnline(GPIBid, 1);
		if(i == -1) write("Error %d: %s",errorcode,errorText);
		//read Device information
		/*write("Identification\n");
		GPIBQuery (GPIBid, "*IDN?");*/
		
			
		else
		{
			write("Reset\n");
			GPIBQuery (GPIBid, "*RST");
			
			//write("Default values\n");
			GPIBQuery (GPIBid, "FAE 0;*OPC?");   
			GPIBWriteStr  (GPIBid, "ESE 0");      
			GPIBWriteStr  (GPIBid, "SRE 0");  
			GPIBWriteStr  (GPIBid, "*CLS");  

			/*GPIBQuery (GPIBid, "*TST?");
			GPIBQuery (GPIBid, "*IST?");*/

		  // Read Device Config
		   GPIBQuery (GPIBid, "*LRN?");
		   GPIBQuery (GPIBid, "EX?");
		   GPIBQuery (GPIBid, "K?");
		   GPIBQuery (GPIBid, "S?");
		   
			//Set current
		   GPIBQuery (GPIBid,"C 3.00");  
		   
		   //set device in state "active" == 0
			write("Function mode - Power supply\n");
			GPIBWriteStr (GPIBid, "F 0");
		   GPIB_SetDeviceOnline();
		  
		   write("Init phase ended\n");
		}
	}
	write ("GPIBid: %d", GPIBid);
}

void GPIB_SetDeviceOnline()
{
  write("Set device online\n");
  GPIBQuery(GPIBid,"EX 1;*OPC?");
  GPIB_DeviceOnline =1;
  GPIB_OutputState = 1;
}

//______________________Callback functions__________________________________

//Function automatically called on a GPIBQuery function
GPIBResponse (long deviceDescriptor, char queryString[], char resultString[])
{
	if (deviceDescriptor == GPIBid)
	{
		if(strncmp(queryString,"MV?",3) == 0 || strncmp(queryString,"MC?",3) == 0) value=GPIBGetFloatResult(resultString);
		else 
		{
			snprintf(answer,elcount(answer),"");
			strncpy(answer,resultString,elcount(resultString));
		}
	}
	else write("The device isn't correct.");
}

//Function automatically called if a GPIBQuery or write function raised an error operation
GPIBOnError (long deviceDescriptor, char query[], char response[], long status, long error)
{
	if (deviceDescriptor == GPIBid)
	{
		strncpy(errorText,response,elcount(response));
		errorcode=error;
		statusword=status;
	}
	else write("The device isn't correct.");
}